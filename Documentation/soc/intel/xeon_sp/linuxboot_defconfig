## lib/Kconfig
```kconfig
##
## This file is part of the coreboot project.
##
## Copyright (C) 2007 coresystems GmbH
## (Written by Stefan Reinauer <stepan@coresystems.de> for coresystems GmbH)
## Copyright (C) 2007 Uwe Hermann <uwe@hermann-uwe.de>
##
## This program is free software; you can redistribute it and/or modify
## it under the terms of the GNU General Public License as published by
## the Free Software Foundation; either version 2 of the License, or
## (at your option) any later version.
##
## This program is distributed in the hope that it will be useful,
## but WITHOUT ANY WARRANTY; without even the implied warranty of
## MERCHANTABILITY or FITNESS FOR A PARTICULAR PURPOSE.  See the
## GNU General Public License for more details.
##
## You should have received a copy of the GNU General Public License
## along with this program; if not, write to the Free Software
## Foundation, Inc., 51 Franklin St, Fifth Floor, Boston, MA  02110-1301 USA
##

menu "Compression"

config COMPRESSION_LZMA
	boolean "Support LZMA compression"
	default y
	help
	  This is the preferred compression method, as LZMA reaches
	  very good compression rates with a small memory footprint.

config COMPRESSION_NRV2B
	boolean "Support NRV2B compression"
	help
	  This compression method has a smaller memory footprint than
	  LZMA but also significantly worse compression results.

choice
	prompt "Default compression method"
	default DEFAULT_COMPRESSION_LZMA

config DEFAULT_COMPRESSION_LZMA
	bool "LZMA compression"
	depends COMPRESSION_LZMA
	help
	  Choose this option as a default.

config DEFAULT_COMPRESSION_NRV2B
	bool "NRV2B compression"
	depends COMPRESSION_NRV2B
	help
	  Choose this option if you have a flash chip which is large enough.

config DEFAULT_COMPRESSION_NONE
	bool "No compression"
	help
	  Do not compress any coreboot modules per default.

endchoice

endmenu

menu "Console"

config CONSOLE
	bool "Console support"
	default y
	help
	  Support for various types of (debugging) consoles.

config CONSOLE_PREPEND_LOG_LEVEL
	boolean "Prepend log level to messages"
	default n
	depends CONSOLE && EXPERT

choice
	prompt "Console log level"
	default CONSOLE_LOGLEVEL_8
	depends CONSOLE

config CONSOLE_LOGLEVEL_8
	bool "BIOS_SPEW"
	help
	  Way too many details.

config CONSOLE_LOGLEVEL_7
	bool "BIOS_DEBUG"
	help
	  Debug-level messages.

config CONSOLE_LOGLEVEL_6
	bool "BIOS_INFO"
	help
	  Informational messages.

config CONSOLE_LOGLEVEL_5
	bool "BIOS_NOTICE"
	help
	  Normal but significant conditions.

config CONSOLE_LOGLEVEL_4
	bool "BIOS_WARNING"
	help
	  Warning conditions.

config CONSOLE_LOGLEVEL_3
	bool "BIOS_ERR"
	help
	  Error conditions.

config CONSOLE_LOGLEVEL_2
	bool "BIOS_CRIT"
	help
	  Critical conditions.

config CONSOLE_LOGLEVEL_1
	bool "BIOS_ALERT"
	help
	  Action must be taken immediately.

config CONSOLE_LOGLEVEL_0
	bool "BIOS_EMERG"
	help
	  System is unusable.

endchoice

config DEFAULT_CONSOLE_LOGLEVEL
	int
	default 0 if CONSOLE_LOGLEVEL_0
	default 1 if CONSOLE_LOGLEVEL_1
	default 2 if CONSOLE_LOGLEVEL_2
	default 3 if CONSOLE_LOGLEVEL_3
	default 4 if CONSOLE_LOGLEVEL_4
	default 5 if CONSOLE_LOGLEVEL_5
	default 6 if CONSOLE_LOGLEVEL_6
	default 7 if CONSOLE_LOGLEVEL_7
	default 8 if CONSOLE_LOGLEVEL_8
	help
	  Map the log level config names to an integer.

config CONSOLE_SERIAL
	boolean "Serial console support"
	default y
	depends CONSOLE
	help
	  Send coreboot output to serial console.

choice
	prompt "Serial console COM port"
	default CONSOLE_SERIAL_COM1
	depends CONSOLE_SERIAL

config CONSOLE_SERIAL_COM1
	bool "COM1/ttyS0"
	help
	  Serial console on COM1/ttyS0.

config CONSOLE_SERIAL_COM2
	bool "COM2/ttyS1"
	help
	  Serial console on COM2/ttyS1.

endchoice

choice
	prompt "Serial console speed"
	default CONSOLE_SERIAL_115200
	depends CONSOLE_SERIAL

config CONSOLE_SERIAL_115200
	bool "115200 bps"
	help
	  Set serial console speed to 115200 bps.

config CONSOLE_SERIAL_57600
	bool "57600 bps"
	help
	  Set serial console speed to 57600 bps.

config CONSOLE_SERIAL_38400
	bool "38400 bps"
	help
	  Set serial console speed to 38400 bps.

config CONSOLE_SERIAL_19200
	bool "19200 bps"
	help
	  Set serial console speed to 19200 bps.

config CONSOLE_SERIAL_9600
	bool "9600 bps"
	help
	  Set serial console speed to 9600 bps.

endchoice

config CONSOLE_USB
	boolean "USB2 console support (EXPERIMENTAL)"
	depends CONSOLE && EXPERIMENTAL
	help
	  Send coreboot output to USB2 (EHCI) console.

	  Note: This requires a USB2 controller which supports the EHCI
	  Debug Port capability. Controllers which are known to work:

	    * 10b9:5239 ALi Corporation USB 2.0 (USB PCI card)
	    * 8086:24cd Intel ICH4/ICH4-M
	    * 8086:24dd Intel ICH5
	    * 8086:265c Intel ICH6
	    * 8086:268c Intel 631xESB/632xESB/3100
	    * 8086:27cc Intel ICH7
	    * 8086:2836 Intel ICH8
	    * 8086:283a Intel ICH8
	    * 8086:293a Intel ICH9
	    * 10de:0088 NVIDIA MCP2A
	    * 10de:005b NVIDIA CK804
	    * 10de:026e NVIDIA MCP51
	    * 10de:036d NVIDIA MCP55
	    * 10de:03f2 NVIDIA MCP61
	    * 1002:4386 ATI/AMD SB600
	    * 1106:3104 VIA VX800

	  See http://www.coreboot.org/EHCI_Debug_Port for an up-to-date list.

comment "Cosmetic console options"
	depends EXPERT && (CONSOLE_SERIAL || CONSOLE_USB)

config CONSOLE_PREFIX
	bool "Prefix all console output with '(CB)'"
	depends EXPERT && (CONSOLE_SERIAL || CONSOLE_USB)
	default n
	help
	  When you enable this option, coreboot will prefix each line of
	  console output with '(CB)'.

config CONSOLE_BUFFER
	boolean "Console memory buffer support"
	default y
	depends CONSOLE
	help
	  Save coreboot output in a memory buffer.

endmenu
```

## mainboard/Kconfig
```kconfig
##
## This file is part of the LinuxBIOS project.
##
## Copyright (C) 2006 Segher Boessenkool <segher@kernel.crashing.org>
## Copyright (C) 2006-2007 coresystems GmbH
## (Written by Stefan Reinauer <stepan@coresystems.de> for coresystems GmbH)
## Copyright (C) 2007 Uwe Hermann <uwe@hermann-uwe.de>
##
## This program is free software; you can redistribute it and/or modify
## it under the terms of the GNU General Public License as published by
## the Free Software Foundation; version 2 of the License.
##
## This program is distributed in the hope that it will be useful,
## but WITHOUT ANY WARRANTY; without even the implied warranty of
## MERCHANTABILITY or FITNESS FOR A PARTICULAR PURPOSE.  See the
## GNU General Public License for more details.
##
## You should have received a copy of the GNU General Public License
## along with this program; if not, write to the Free Software
## Foundation, Inc., 51 Franklin St, Fifth Floor, Boston, MA  02110-1301 USA
##

menu "Mainboard"

choice
	prompt "Mainboard vendor"
	default VENDOR_EMULATION

config VENDOR_ADL
	bool "Advanced Digital Logic"
	help
	  Select this option for various systems from 
	  Advanced Digital Logic

config VENDOR_AMD
	bool "AMD"
	help
	  Select this option for various systems from 
	  Advanced Micro Devices, Inc

config VENDOR_ARTECGROUP
	bool "Artec Group"
	help
	  Select this option for various systems from 
	  the Artec Group

config VENDOR_EMULATION
	bool "Emulated systems"
	help
	  Select this option for various system emulators, such as QEMU.

endchoice

source "mainboard/emulation/Kconfig"
source "mainboard/adl/Kconfig"
source "mainboard/amd/Kconfig"
source "mainboard/artecgroup/Kconfig"

choice
	prompt "ROM chip size"
	default LINUXBIOS_ROMSIZE_KB_256

config LINUXBIOS_ROMSIZE_KB_128
	bool "128 KB"
	help
	  Choose this option if you have a 128 KB ROM chip.

config LINUXBIOS_ROMSIZE_KB_256
	bool "256 KB"
	help
	  Choose this option if you have a 256 KB ROM chip.

config LINUXBIOS_ROMSIZE_KB_512
	bool "512 KB"
	help
	  Choose this option if you have a 512 KB ROM chip.

config LINUXBIOS_ROMSIZE_KB_1024
	bool "1024 KB (1 MB)"
	help
	  Choose this option if you have a 1024 KB (1 MB) ROM chip.

config LINUXBIOS_ROMSIZE_KB_2048
	bool "2048 KB (2 MB)"
	help
	  Choose this option if you have a 2048 KB (2 MB) ROM chip.

endchoice

config LINUXBIOS_ROMSIZE_KB
	int
	default 128 if LINUXBIOS_ROMSIZE_KB_128
	default 256 if LINUXBIOS_ROMSIZE_KB_256
	default 512 if LINUXBIOS_ROMSIZE_KB_512
	default 1024 if LINUXBIOS_ROMSIZE_KB_1024
	default 2048 if LINUXBIOS_ROMSIZE_KB_2048
	help
	  Map the config names to an integer.

endmenu
```

## mainboard/adl/msm800sev/Kconfig
```kconfig
##
## This file is part of the coreboot project.
##
## Copyright (C) 2007 coresystems GmbH
## (Written by Stefan Reinauer <stepan@coresystems.de> for coresystems GmbH)
##
## This program is free software; you can redistribute it and/or modify
## it under the terms of the GNU General Public License as published by
## the Free Software Foundation; either version 2 of the License, or
## (at your option) any later version.
##
## This program is distributed in the hope that it will be useful,
## but WITHOUT ANY WARRANTY; without even the implied warranty of
## MERCHANTABILITY or FITNESS FOR A PARTICULAR PURPOSE.  See the
## GNU General Public License for more details.
##
## You should have received a copy of the GNU General Public License
## along with this program; if not, write to the Free Software
## Foundation, Inc., 51 Franklin St, Fifth Floor, Boston, MA  02110-1301 USA
##

config MAINBOARD_NAME
	string
	default adl/msm800sev
	depends BOARD_ADL_MSM800SEV
	help
	  This is the name for the Advanced Digital Logic MSM800SEV mainboard.

config MAINBOARD_PCI_SUBSYSTEM_VENDOR_ID
	hex
	# TODO: Fix the PCI ID.
	default 0x1022
	depends BOARD_ADL_MSM800SEV
	help
	  Mainboard specific PCI subsystem vendor ID.

config MAINBOARD_PCI_SUBSYSTEM_DEVICE_ID
	hex
	# TODO: Fix the PCI ID.
	default 0x2323
	depends BOARD_ADL_MSM800SEV
	help
	  Mainboard specific PCI subsystem vendor ID.
```

## mainboard/amd/Kconfig
```kconfig
##
## This file is part of the coreboot project.
##
## Copyright (C) 2007 coresystems GmbH
## (Written by Stefan Reinauer <stepan@coresystems.de> for coresystems GmbH)
##
## This program is free software; you can redistribute it and/or modify
## it under the terms of the GNU General Public License as published by
## the Free Software Foundation; either version 2 of the License, or
## (at your option) any later version.
##
## This program is distributed in the hope that it will be useful,
## but WITHOUT ANY WARRANTY; without even the implied warranty of
## MERCHANTABILITY or FITNESS FOR A PARTICULAR PURPOSE.  See the
## GNU General Public License for more details.
##
## You should have received a copy of the GNU General Public License
## along with this program; if not, write to the Free Software
## Foundation, Inc., 51 Franklin St, Fifth Floor, Boston, MA  02110-1301 USA
##

choice
	prompt "Mainboard model"
	depends on VENDOR_AMD

config BOARD_AMD_DB800
	bool "DB800"
	select ARCH_X86
	select CPU_AMD_GEODELX
	select OPTION_TABLE
	select NORTHBRIDGE_AMD_GEODELX
	select SOUTHBRIDGE_AMD_CS5536
	select SUPERIO_WINBOND_W83627HF
	select PIRQ_TABLE
	help
	  AMD DB800 Geode LX development board.

config BOARD_AMD_DBM690T
	bool "dbm690t"
	select ARCH_X86
	select OPTION_TABLE
	select CPU_AMD_K8
	select NORTHBRIDGE_AMD_K8
	select SOUTHBRIDGE_AMD_SB600
	select SOUTHBRIDGE_AMD_RS690
	select SUPERIO_ITE_IT8712F
	select IOAPIC
	help
	  AMD dbm690t development board.

config BOARD_AMD_NORWICH
	bool "Norwich"
	select ARCH_X86
	select CPU_AMD_GEODELX
	select OPTION_TABLE
	select NORTHBRIDGE_AMD_GEODELX
	select SOUTHBRIDGE_AMD_CS5536
	select PIRQ_TABLE
	help
	  AMD Norwich Geode LX development board.

config BOARD_AMD_SERENGETI
	bool "Serengeti"
	select ARCH_X86
	select OPTION_TABLE
	select CPU_AMD_K8
	select NORTHBRIDGE_AMD_K8
	select SOUTHBRIDGE_AMD_AMD8111
	select SUPERIO_WINBOND_W83627HF
	select IOAPIC
	help
	  AMD Serengeti development board.

endchoice

config MAINBOARD_DIR
	string
	default amd/db800
	depends BOARD_AMD_DB800

config MAINBOARD_DIR
	string
	default amd/dbm690t
	depends BOARD_AMD_DBM690T

config MAINBOARD_DIR
	string
	default amd/norwich
	depends BOARD_AMD_NORWICH

config MAINBOARD_DIR
	string
	default amd/serengeti
	depends BOARD_AMD_SERENGETI
```

## mainboard/amd/norwich/Kconfig
```kconfig
config MAINBOARD_NAME
	string
	default amd/norwich
	depends BOARD_AMD_NORWICH
	help
	  This is the default mainboard name.

config MAINBOARD_PCI_SUBSYSTEM_VENDOR_ID
	hex
	default 0x1022
	depends BOARD_AMD_NORWICH
	help
	  Mainboard specific PCI subsystem vendor ID.

config MAINBOARD_PCI_SUBSYSTEM_DEVICE_ID
	hex
	default 0x2323
	depends BOARD_AMD_NORWICH
	help
	  Mainboard specific PCI subsystem device ID.
```

## mainboard/amp/Kconfig
```kconfig
##
## This file is part of the coreboot project.
##
## Copyright (C) 2007 coresystems GmbH
## (Written by Stefan Reinauer <stepan@coresystems.de> for coresystems GmbH)
##
## This program is free software; you can redistribute it and/or modify
## it under the terms of the GNU General Public License as published by
## the Free Software Foundation; either version 2 of the License, or
## (at your option) any later version.
##
## This program is distributed in the hope that it will be useful,
## but WITHOUT ANY WARRANTY; without even the implied warranty of
## MERCHANTABILITY or FITNESS FOR A PARTICULAR PURPOSE.  See the
## GNU General Public License for more details.
##
## You should have received a copy of the GNU General Public License
## along with this program; if not, write to the Free Software
## Foundation, Inc., 51 Franklin St, Fifth Floor, Boston, MA  02110-1301 USA
##

choice
	prompt "Mainboard model"
	depends on VENDOR_AMP

config BOARD_AMP_TINYGX
	bool "TinyGX"
	select ARCH_X86
	select CPU_AMD_GEODELX
	select NORTHBRIDGE_AMD_GEODELX
	select SOUTHBRIDGE_AMD_CS5536
	select SUPERIO_ITE_IT8716F
	select PIRQ_TABLE
	help
	  AMP TinyGX board.

endchoice

config MAINBOARD_DIR
	string
	default amp/tinygx
	depends BOARD_AMP_TINYGX
```

## mainboard/artecgroup/Kconfig
```kconfig
##
## This file is part of the coreboot project.
##
## Copyright (C) 2007 coresystems GmbH
## (Written by Stefan Reinauer <stepan@coresystems.de> for coresystems GmbH)
##
## This program is free software; you can redistribute it and/or modify
## it under the terms of the GNU General Public License as published by
## the Free Software Foundation; either version 2 of the License, or
## (at your option) any later version.
##
## This program is distributed in the hope that it will be useful,
## but WITHOUT ANY WARRANTY; without even the implied warranty of
## MERCHANTABILITY or FITNESS FOR A PARTICULAR PURPOSE.  See the
## GNU General Public License for more details.
##
## You should have received a copy of the GNU General Public License
## along with this program; if not, write to the Free Software
## Foundation, Inc., 51 Franklin St, Fifth Floor, Boston, MA  02110-1301 USA
##

choice
	prompt "Mainboard model"
	depends on VENDOR_ARTECGROUP

config BOARD_ARTECGROUP_DBE61
	bool "DBE61"
	select ARCH_X86
	select CPU_AMD_GEODELX
	select NORTHBRIDGE_AMD_GEODELX
	select SOUTHBRIDGE_AMD_CS5536
	select PIRQ_TABLE
	help
	  Artec Group DBE61 ThinCan, also known as Linutop 1.

config BOARD_ARTECGROUP_DBE62
	bool "DBE62"
	select ARCH_X86
	select CPU_AMD_GEODELX
	select NORTHBRIDGE_AMD_GEODELX
	select SOUTHBRIDGE_AMD_CS5536
	select PIRQ_TABLE
	help
	  Artec Group DBE62 ThinCan.

endchoice

config MAINBOARD_DIR
	string
	default artecgroup/dbe61
	depends BOARD_ARTECGROUP_DBE61

config MAINBOARD_DIR
	string
	default artecgroup/dbe62
	depends BOARD_ARTECGROUP_DBE62
```
