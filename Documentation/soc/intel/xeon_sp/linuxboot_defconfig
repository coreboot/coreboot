## console/Kconfig
```kconfig
menu "Console"

config CONSOLE
	bool "Console support"
	default y
	help
	  Support for various types of (debugging) consoles.

choice
	prompt "Console log level"
	default CONSOLE_LOGLEVEL_8
	depends CONSOLE

config CONSOLE_LOGLEVEL_8
	bool "BIOS_SPEW"
	help
	  Way too many details.

config CONSOLE_LOGLEVEL_7
	bool "BIOS_DEBUG"
	help
	  Debug-level messages.

config CONSOLE_LOGLEVEL_6
	bool "BIOS_INFO"
	help
	  Informational messages.

config CONSOLE_LOGLEVEL_5
	bool "BIOS_NOTICE"
	help
	  Normal but significant conditions.

config CONSOLE_LOGLEVEL_4
	bool "BIOS_WARNING"
	help
	  Warning conditions.

config CONSOLE_LOGLEVEL_3
	bool "BIOS_ERR"
	help
	  Error conditions.

config CONSOLE_LOGLEVEL_2
	bool "BIOS_CRIT"
	help
	  Critical conditions.

config CONSOLE_LOGLEVEL_1
	bool "BIOS_ALERT"
	help
	  Action must be taken immediately.

config CONSOLE_LOGLEVEL_0
	bool "BIOS_EMERG"
	help
	  System is unusable.

endchoice

config DEFAULT_CONSOLE_LOGLEVEL
	int
	default 0 if CONSOLE_LOGLEVEL_0
	default 1 if CONSOLE_LOGLEVEL_1
	default 2 if CONSOLE_LOGLEVEL_2
	default 3 if CONSOLE_LOGLEVEL_3
	default 4 if CONSOLE_LOGLEVEL_4
	default 5 if CONSOLE_LOGLEVEL_5
	default 6 if CONSOLE_LOGLEVEL_6
	default 7 if CONSOLE_LOGLEVEL_7
	default 8 if CONSOLE_LOGLEVEL_8
	---help---
	  Map the log level config names to an integer.

config CONSOLE_SERIAL
	boolean "Serial console support"
	default y
	depends CONSOLE
	---help---
	  Send LinuxBIOS output to serial console.

choice
	prompt "Serial console COM port"
	default CONSOLE_SERIAL_COM1
	depends CONSOLE_SERIAL

config CONSOLE_SERIAL_COM1
	bool "COM1/ttyS0"
	---help---
	  Serial console on COM1/ttyS0.

config CONSOLE_SERIAL_COM2
	bool "COM2/ttyS1"
	---help---
	  Serial console on COM2/ttyS1.

endchoice

choice
	prompt "Serial console speed"
	default CONSOLE_SERIAL_115200
	depends CONSOLE_SERIAL

config CONSOLE_SERIAL_115200
	bool "115200 bps"
	---help---
	  Set serial console speed to 115200 bps.

config CONSOLE_SERIAL_57600
	bool "57600 bps"
	---help---
	  Set serial console speed to 57600 bps.

config CONSOLE_SERIAL_38400
	bool "38400 bps"
	---help---
	  Set serial console speed to 38400 bps.

config CONSOLE_SERIAL_19200
	bool "19200 bps"
	---help---
	  Set serial console speed to 19200 bps.

config CONSOLE_SERIAL_9600
	bool "9600 bps"
	---help---
	  Set serial console speed to 9600 bps.

endchoice

config CONSOLE_VGA
	boolean "VGA console support"
	depends CONSOLE
	---help---
	  Send LinuxBIOS output to VGA console as soon as VGA is initialized.

config CONSOLE_USB
	boolean "USB2 console support"
	depends CONSOLE
	---help---
	  Send LinuxBIOS output to USB2 (EHCI) console.

	  Note: This requires a USB2 controller which supports the EHCI
	  Debug Port capability. Controllers which are known to work:

	    * 10b9:5239 ALi Corporation USB 2.0 (USB PCI card)
	    * 10de:0088 nVidia MCP2A
	    * 10de:036d nVidia MCP55
	    * 8086:24dd Intel ICH5
	    * 8086:265c Intel ICH6
	    * 8086:268c Intel 631xESB/632xESB/3100
	    * 8086:27cc Intel ICH7

	  See http://linuxbios.org/EHCI_Debug_Port for an up-to-date list.

endmenu
```

## device/Kconfig
```kconfig
##
## This file is part of the coreboot project.
##
## Copyright (C) 2007 coresystems GmbH
## (Written by Stefan Reinauer <stepan@coresystems.de> for coresystems GmbH)
##
## This program is free software; you can redistribute it and/or modify
## it under the terms of the GNU General Public License as published by
## the Free Software Foundation; version 2 of the License
##
## This program is distributed in the hope that it will be useful,
## but WITHOUT ANY WARRANTY; without even the implied warranty of
## MERCHANTABILITY or FITNESS FOR A PARTICULAR PURPOSE.  See the
## GNU General Public License for more details.
##
## You should have received a copy of the GNU General Public License
## along with this program; if not, write to the Free Software
## Foundation, Inc., 51 Franklin St, Fifth Floor, Boston, MA  02110-1301 USA
##

menu "Devices"

config PCI_OPTION_ROM_RUN
	bool
	help
	  Execute PCI/AGP option ROMs if available. This is required to
	  enable PCI/AGP VGA plugin cards. This option is not exposed
	  to the user but set by the options PCI_OPTION_ROM_RUN_VM86
	  , PCI_OPTION_ROM_RUN_X86EMU and PCI_OPTION_ROM_RUN_YABEL.

choice
	prompt "Execute PCI Option ROMs"
	default PCI_OPTION_ROM_RUN_VM86
	help
	  Execute PCI/AGP option ROMs if available. You can choose to
	  execute PCI option ROMs natively (32bit x86 system required),
	  in an emulator (x86emu), or ignore option ROM execution.

config PCI_OPTION_ROM_RUN_X86EMU
	bool "x86emu"
	select PCI_OPTION_ROM_RUN
	help
	  If you choose this option, the x86 instruction set emulator
	  x86emu is used to execute 16bit legacy BIOS option ROMs.
	
	  x86emu is slow, big and safe. All 16bit x86 code is executed
	  in an encapsulated environment where it can not break out.

config PCI_OPTION_ROM_RUN_YABEL
	bool "YABEL"
	select PCI_OPTION_ROM_RUN
	help
	  YABEL: Yet another BIOS Emulation Layer
	  If you choose this option, the x86 instruction set emulator
	  x86emu is used to execute 16bit legacy BIOS option ROMs just
	  like the "x86emu" choice.
	  The BIOS Emulation code is very different from the "x86emu" 
	  choice however, it is a more complete legacy BIOS implementation
	  and should be able to execute more Option ROMs than the 
	  "x86emu" choice
	
	  YABEL is even slower and bigger than x86emu and just as safe. 
	  All 16bit x86 code is executed in an encapsulated environment 
	  where it can not break out.

config PCI_OPTION_ROM_RUN_VM86
	bool "vm86"
	select PCI_OPTION_ROM_RUN
	depends ARCH_X86
	help
	  If you choose this option, the virtual x86 mode "vm86" is used
	  to execute 16bit legacy BIOS option ROMs.

	  vm86 is very small, fast, and probably a little less safe than
	  x86emu, since it runs option ROMs on the real hardware instead
	  of an emulator.

config PCI_OPTION_ROM_RUN_NONE
	bool "Disabled"
	help
	  Do not execute PCI option ROMs at all.
	  If you choose this option, VGA plugin cards will not be initialized.

endchoice

config YABEL_ADVANCED_SETTINGS
	depends EXPERT && PCI_OPTION_ROM_RUN_YABEL
	bool "Enable advanced YABEL Settings"
	default n
	help
	  Set this to enable advanced YABEL settings

menu "Advanced YABEL Settings"
	depends YABEL_ADVANCED_SETTINGS

	config YABEL_VIRTMEM_LOCATION
		hex "YABEL Virtual Memory Location"
		help
		  Set the location that YABEL uses for "virtual" memory. 
		  YABEL uses its own memory where INT handlers, BIOS Config
		  Area and Option ROM code is copied to. This is needed to 
		  keep YABEL in its own environment. This memory area will be
		  overwritten by YABEL, so no necessary data for coreboot 
		  must reside here. 
		  If YABEL_ADVANCED_SETTINGS is not enabled, the code defaults 
		  to 0x1000000 (16 MB).

endmenu

# TODO: This should probably become a CMOS option.
config MULTIPLE_VGA_INIT
	bool "Initialize all VGA cards"
	depends PCI_OPTION_ROM_RUN
	help
	  If you enable this option, all VGA cards will be initialized.
	  If you disable this option, only the first VGA card will be
	  initialized.

config INITIALIZE_ONBOARD_VGA_FIRST
	bool "Initialize onboard VGA first"
	depends PCI_OPTION_ROM_RUN
	help
	  Initialize onboard VGA chips before any plugin VGA cards
	  are initialized.

endmenu

menu "Plugin Support"

config PCIX_PLUGIN_SUPPORT
	bool "Support for devices that provide PCI-X and aren't in the dts."
	select PCIX_SUPPORT
	default false
	help
	  Compile in the drivers for cards that provide PCI-X.

config PCIE_PLUGIN_SUPPORT
	bool "Support for devices that provide PCI-e and aren't in the dts."
	select PCIE_SUPPORT
	default false
	help
	  Compile in the drivers for cards that provide PCI-e.

config HYPERTRANSPORT_PLUGIN_SUPPORT
	bool "Support for devices that provide HT and aren't in the dts."
	select HYPERTRANSPORT_SUPPORT
	default false
	help
	  Compile in the drivers for cards that provide HT.

config AGP_PLUGIN_SUPPORT
	bool "Support for devices that provide AGP and aren't in the dts."
	select AGP_SUPPORT
	default false
	help
	  Compile in the drivers for cards that provide AGP.

config CARDBUS_PLUGIN_SUPPORT
	bool "Support for devices that provide Cardbus and aren't in the dts."
	select CARDBUS_SUPPORT
	default false
	help
	  Compile in the drivers for cards that provide Cardbus.

endmenu

menu "Power management"

config SUSPEND_TO_RAM
	bool "Suspend-to-RAM (S3)"
	depends EXPERIMENTAL && BROKEN
	help
	  Enable support for Suspend-to-RAM (S3) functionality.

config PCI_64BIT_PREF_MEM
	bool "64 bit prefetchable memory addresses"
	depends CPU_AMD_K8
	help
	  Enable support for 64-bit prefetchable memory addresses in PCI.

config HW_MEM_HOLE_SIZEK
	hex "HW memory hole size in KB"
	depends CPU_AMD_K8
	default 0x1000
	help
	  Some chipsets support setting up a "hole" at the top of memory.
	  It is essentially a hole torn in the physical address space so that
	  you can fit non-memory resources (e.g. flash) at the top of the 4G
	  address space. Given that this only happens on machines with lots
	  of memory, the default 4 MB is a very reasonable value.

endmenu
```
