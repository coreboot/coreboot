## Kconfig
```kconfig
##
## This file is part of the coreboot project.
##
## Copyright (C) 2006 Ronald G. Minnich <rminnich@gmail.com>
## Copyright (C) 2006 Segher Boessenkool <segher@kernel.crashing.org>
## Copyright (C) 2006-2007 Uwe Hermann <uwe@hermann-uwe.de>
## Copyright (C) 2006-2007 coresystems GmbH
## (Written by Stefan Reinauer <stepan@coresystems.de> for coresystems GmbH)
##
## This program is free software; you can redistribute it and/or modify
## it under the terms of the GNU General Public License as published by
## the Free Software Foundation; version 2 of the License.
##
## This program is distributed in the hope that it will be useful,
## but WITHOUT ANY WARRANTY; without even the implied warranty of
## MERCHANTABILITY or FITNESS FOR A PARTICULAR PURPOSE.  See the
## GNU General Public License for more details.
##
## You should have received a copy of the GNU General Public License
## along with this program; if not, write to the Free Software
## Foundation, Inc., 51 Franklin St, Fifth Floor, Boston, MA  02110-1301 USA
##

#
# For a description of the syntax of this configuration file,
# see http://lxr.linux.no/source/Documentation/kbuild/kconfig-language.txt.
#

mainmenu "coreboot configuration"

menu "General setup"

config EXPERIMENTAL
	bool "Prompt for development and/or incomplete code/mainboards"
	help
	  Enable this option if you want to test development features or
	  incomplete/unsupported mainboards.

	  We do not make any guarantees about anything that is marked
	  as EXPERIMENTAL! You have been warned!

config EXPERT
	bool "Expert mode"
	help
	  This allows you to select certain advanced configuration options.
	  It is mainly intended for coreboot developers.

	  Warning: Only enable this option if you really know what you're
	  doing! You have been warned!

config LOCALVERSION
	string "Local version - append to coreboot release"
	help
	  Append an extra string to the end of the coreboot version.

config BEEPS
	bool "Enable beeps upon certain coreboot events"
	depends EXPERT
	default n
	help
	  Enable this option to make coreboot beep upon certain events.

config WHOLE_PROGRAM_COMPILE
	bool "Enable whole-program optimizations (DANGEROUS)"
	depends EXPERT && EXPERIMENTAL
	help
	  Enable 'gcc -fwhole-program -combine' for select code.
	  Needs lots of annotation in stage1 and stage2.
	  Works for initram only.
	  This increases compile time (no parallel compilation possible
	  anymore) and compiler memory usage (up to a factor of 20) and
	  makes debugging really hard.

	  Requires at least gcc 4.2.x, but miscompilations may occur.

	  Say No.
	  If you are a Gentoo user, say NO!

endmenu

source mainboard/Kconfig
source arch/x86/Kconfig
source lib/Kconfig
source device/Kconfig

# These are used for internal purposes only:

# Northbridges:
config NORTHBRIDGE_AMD_GEODELX
	boolean
config NORTHBRIDGE_AMD_K8
	boolean
config NORTHBRIDGE_INTEL_I440BXEMULATION
	boolean
config NORTHBRIDGE_VIA_CN700
	boolean
config NORTHBRIDGE_INTEL_I945
	boolean

# Southbridges:
config SOUTHBRIDGE_AMD_CS5536
	boolean
config SOUTHBRIDGE_INTEL_I82371EB
	boolean
config SOUTHBRIDGE_NVIDIA_MCP55
	boolean
config SOUTHBRIDGE_AMD_AMD8132
	boolean
config SOUTHBRIDGE_AMD_AMD8111
	boolean
config SOUTHBRIDGE_AMD_SB600
	boolean
config SOUTHBRIDGE_AMD_RS690
	boolean
config SOUTHBRIDGE_VIA_VT8237
	boolean

# Super I/Os:
config SUPERIO_WINBOND_W83627HF
	boolean
config SUPERIO_FINTEK_F71805F
	boolean
config SUPERIO_ITE_IT8716F
	boolean
config SUPERIO_ITE_IT8712F
	boolean
config SUPERIO_VIA_VT1211
	boolean

menu "Payload"

config PAYLOAD_ELF_LOADER
	bool "Include ELF payload loader"
	default n
	help
	  This option allows an unparsed ELF paylaod to be added and loaded.

choice
	prompt "Payload type"
	default PAYLOAD_NONE

config PAYLOAD_ELF
	bool "An ELF executable payload file"
	help
	  Select this option if you have a payload image (an ELF file)
	  which coreboot should run as soon as the basic hardware
	  initialization is completed.

	  You will be able to specify the location and file name of the
	  payload image later.

config PAYLOAD_NONE
	bool "No payload"
	help
	  Select this option if you want to create an "empty" coreboot
	  ROM image for a certain mainboard, i.e. a coreboot ROM image
	  which does not yet contain a payload.

	  For such an image to be useful, you have to use the 'lar' tool
	  to add a payload to the ROM image later.

endchoice

config PAYLOAD_FILE
	string "Payload path and filename"
	depends PAYLOAD_ELF
	default "payload.elf"
	help
	  The path and filename of the ELF executable file to use as payload.

config PAYLOAD_NO_PREPARSE_ELF
	bool "Add ELF without parsing and converting to LAR entries"
	depends PAYLOAD_ELF && PAYLOAD_ELF_LOADER
	default n
	help
	  Until now, coreboot has used ELF for the payload. There are many
	  problems with this, not least being the inefficiency -- the ELF has
	  to be decompressed to memory and then the segments have to be
	  copied. Plus, lar can't see the segments in the ELF -- to see all
	  segments, you have to extract the ELF and run readelf on it.

	  There are problems with collisions of the decompressed ELF
	  location in memory and the segment locations in memory.
	  Finally, validation of the ELF is done at run time, once you have
	  flashed the FLASH and rebooted the machine. Boot time is really
	  not the time you want to find out your ELF payload is broken.

	  Without this option, coreboot will direct lar to break each ELF
	  segment into a LAR entry. ELF will not be used at all. Note that
	  (for now) coreboot is not backward compatible -- if you put an ELF
	  payload in, coreboot can not parse it. We hope to remove ELF
	  entirely in the future.

config ZERO_AFTER_PAYLOAD
	bool "Zero fill lar after adding the payload"
	depends PAYLOAD_ELF
	default n
	help
	  This option speeds booting but makes it so that no further files may
	  be added to the lar.

endmenu
```

## arch/Kconfig
```kconfig
##
## This file is part of the LinuxBIOS project.
##
## Copyright (C) 2006 coresystems GmbH
## (Written by Stefan Reinauer <stepan@coresystems.de> for coresystems GmbH)
##
## This program is free software; you can redistribute it and/or modify
## it under the terms of the GNU General Public License as published by
## the Free Software Foundation; either version 2 of the License, or
## (at your option) any later version.
##
## This program is distributed in the hope that it will be useful,
## but WITHOUT ANY WARRANTY; without even the implied warranty of
## MERCHANTABILITY or FITNESS FOR A PARTICULAR PURPOSE.  See the
## GNU General Public License for more details.
##
## You should have received a copy of the GNU General Public License
## along with this program; if not, write to the Free Software
## Foundation, Inc., 51 Franklin St, Fifth Floor, Boston, MA  02110-1301 USA
##

# Source all architectures.
source arch/x86/Kconfig
source arch/powerpc/Kconfig
```

## arch/x86/Kconfig
```kconfig
##
## This file is part of the coreboot project.
##
## Copyright (C) 2006-2007 coresystems GmbH
## (Written by Stefan Reinauer <stepan@coresystems.de> for coresystems GmbH)
##
## This program is free software; you can redistribute it and/or modify
## it under the terms of the GNU General Public License as published by
## the Free Software Foundation; either version 2 of the License, or
## (at your option) any later version.
##
## This program is distributed in the hope that it will be useful,
## but WITHOUT ANY WARRANTY; without even the implied warranty of
## MERCHANTABILITY or FITNESS FOR A PARTICULAR PURPOSE.  See the
## GNU General Public License for more details.
##
## You should have received a copy of the GNU General Public License
## along with this program; if not, write to the Free Software
## Foundation, Inc., 51 Franklin St, Fifth Floor, Boston, MA  02110-1301 USA
##

config ARCH_X86
	boolean
	help
	  This option is used to set the architecture of a mainboard.
	  It is usually set in mainboard/*/Kconfig.

config ARCH
	string
	default x86
	depends ARCH_X86
	help
	  This is the name of the respective subdirectory in arch/.

config CPU_I586
	boolean
	help
	  CPU type. At the moment this option selects the reset vector and
	  Cache-as-RAM (CAR) implementation for a mainboard. See
	  arch/x86/Makefile for more hints on possible values.
	  It is usually set in mainboard/*/Kconfig.

config CPU_AMD_GEODELX
	boolean
	help
	  CPU type. At the moment this option selects the reset vector and
	  Cache-as-RAM (CAR) implementation for a mainboard. See
	  arch/x86/Makefile for more hints on possible values.
	  It is usually set in mainboard/*/Kconfig.

config CPU_AMD_K8
	boolean
	help
	  CPU type. At the moment this option selects the reset vector and
	  Cache-as-RAM (CAR) implementation for a mainboard. See
	  arch/x86/Makefile for more hints on possible values.
	  It is usually set in mainboard/*/Kconfig.

config CPU_INTEL_CORE2
	boolean
	help
	  CPU type. At the moment this option selects the reset vector and
	  Cache-as-RAM (CAR) implementation for a mainboard. See
	  arch/x86/Makefile for more hints on possible values.
	  It is usually set in mainboard/*/Kconfig.

config CPU_VIA_C7
	boolean
	help
	  CPU type. At the moment this option selects the reset vector and
	  Cache-as-RAM (CAR) implementation for a mainboard. See
	  arch/x86/Makefile for more hints on possible values.
	  It is usually set in mainboard/*/Kconfig.

config HPET
	boolean
	depends CPU_AMD_K8
	help
	  Whether to configure a High Precision Event Timer (HPET). Note that
	  HPETs are known to be bug-prone.

config SMM
	boolean
	help
	  Whether to configure System Management Mode support. 
	  This is mainboard-enabled. This is a tricky option that 
	  should not be enabled/disabled casually, as some chipsets
	  will not work without some form of SMM enabled.

config K8_REV_F_SUPPORT
	hex
	default 0 if CPU_AMD_K8
	help
	  Whether to include rev F support.

config K8_SCAN_PCI_BUS
	hex
	default 0 if CPU_AMD_K8
	help
	  Whether to scan the PCI bus in stage1.

config K8_ALLOCATE_IO_RANGE
	hex
	default 0 if CPU_AMD_K8
	help
	  Whether to allocate I/O space in stage1.

config K8_ALLOCATE_MMIO_RANGE
	hex
	default 0 if CPU_AMD_K8
	help
	  Whether to allocate MMIO space in stage1.

	  Comment from code: Do we need allocate MMIO? Currently we direct
	  last 64M to southbridge link (sblink) only. We can not lose access
	  to last 4M range to ROM.

config LOGICAL_CPUS
	hex
	depends CPU_AMD_K8 || CPU_INTEL_CORE2
	default 1
	help
	  How many logical CPUs there are. FIXME.

config MAX_PHYSICAL_CPUS
	hex
	depends CPU_AMD_K8
	default 1
	help
	  Maximum number of physical CPUs (sockets).

config MAX_PHYSICAL_CPUS_4_BUT_MORE_INSTALLED
	hex
	default 0 if CPU_AMD_K8
	help
	  Config with 4 CPUs even if more are installed.

config CROSS_BAR_47_56
	hex
	default 0 if CPU_AMD_K8
	help
	  Configure for the type of crossbar on the mainboard.

config PIRQ_TABLE
	boolean
	help
	  This option is used to determine whether the mainboard has
	  a PIRQ table, which is the old way to set up interrupt routing.
	  It is usually set in mainboard/*/Kconfig.

config ACPI_TABLE
	boolean
	help
	  This option is used to determine whether the mainboard has
	  an ACPI table.
	  It is usually set in mainboard/*/Kconfig.

config SMP
	boolean
	depends CPU_I586 || CPU_AMD_K8
	default 0
	help
	  This option is used to enable certain functions to make coreboot
	  work correctly on symmetric multi processor systems.
	  It is usually set in mainboard/*/Kconfig.

config IOAPIC
	boolean
	depends ARCH_X86 && CPU_AMD_K8 || CPU_INTEL_CORE2
	default 0
	help
	  If you want to configure an IOAPIC, set this.

config CARBASE
	hex
	default 0x8f000 if CPU_I586
	default 0x80000 if CPU_AMD_GEODELX
	default 0xc8000 if CPU_AMD_K8
	default 0xffef0000 if CPU_VIA_C7
	default 0xffdf8000 if CPU_INTEL_CORE2
	help
	  This option sets the base address of the area used for CAR.

config CARSIZE
	hex
	default 0x1000 if CPU_I586
	default 0x8000 if CPU_AMD_GEODELX
	default 0x8000 if CPU_AMD_K8
	default 0x8000 if CPU_VIA_C7
	default 0x8000 if CPU_INTEL_CORE2
	help
	  This option sets the size of the area used for CAR.

config MTRR
	bool
	default n if CPU_AMD_GEODELX
	default y if CPU_AMD_K8
	default y if CPU_VIA_C7
	default y if CPU_INTEL_CORE2
	help
	  This option indicates if a cpu has MTRR support.

config CBMEMK
	hex
	default 0x1000 if CPU_I586
	default 0x1000 if CPU_AMD_GEODELX
	default 0x2000 if CPU_AMD_K8
	default 0x1000 if CPU_VIA_C7
	default 0x1000 if CPU_INTEL_CORE2
	help
	  This option sets the top of the memory area, in KiB,
	  used for coreboot.

config K8_HT_FREQ_1G_SUPPORT
	hex
	default 1 if CPU_AMD_K8
	help
	  1 GHz support. Opteron E0 or later can support 1G HT,
	  but still depends on the mainboard.

config HT_FREQ_800MHZ
	hex
	default 1 if CPU_AMD_K8
	help
	  Can we run HT at 800 MHz.

config USBDEBUG_DIRECT
	boolean
	depends SOUTHBRIDGE_NVIDIA_MCP55
	default 0
	help
	  Determines if we enable USB Direct debugging. If you don't have
	  a dongle, this is probably of no value to you.

config APIC_ID_OFFSET
	hex "APIC ID offset"
	default 0x10
	depends IOAPIC
	help
	  This is entirely mainboard dependent. 0x10 is a *typical* setting
	  but not always a good setting.

menu "Debugging"

config CARTEST
	bool "Test CAR area"
	default n
	help
	  Test the CAR area after it has been set up.

config CHECK_STACK_USAGE
	bool "Check stack usage"
	default n
	help
	  Continuously monitor stack usage and keep statistics.
	  The monitoring code is invoked from printk because printk is
	  a leaf function and consumes quite a bit of stack for itself.
	  This slows down booting a LOT.

endmenu
```
