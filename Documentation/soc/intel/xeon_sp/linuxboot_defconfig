## mainboard/emulation/Kconfig
```kconfig
##
## This file is part of the coreboot project.
##
## Copyright (C) 2006 Segher Boessenkool <segher@kernel.crashing.org>
## Copyright (C) 2006-2007 coresystems GmbH
## (Written by Stefan Reinauer <stepan@coresystems.de> for coresystems GmbH)
## Copyright (C) 2007 Uwe Hermann <uwe@hermann-uwe.de>
##
## This program is free software; you can redistribute it and/or modify
## it under the terms of the GNU General Public License as published by
## the Free Software Foundation; version 2 of the License.
##
## This program is distributed in the hope that it will be useful,
## but WITHOUT ANY WARRANTY; without even the implied warranty of
## MERCHANTABILITY or FITNESS FOR A PARTICULAR PURPOSE.  See the
## GNU General Public License for more details.
##
## You should have received a copy of the GNU General Public License
## along with this program; if not, write to the Free Software
## Foundation, Inc., 51 Franklin St, Fifth Floor, Boston, MA  02110-1301 USA
##

choice
	prompt "Mainboard model"
	depends on VENDOR_EMULATION

config BOARD_EMULATION_QEMU_X86
	bool "QEMU x86"
	select ARCH_X86
	select CPU_I586
	select OPTION_TABLE
	select NORTHBRIDGE_INTEL_I440BXEMULATION
	select SOUTHBRIDGE_INTEL_I82371EB
	select SUPERIO_WINBOND_W83627HF
	help
	  x86 QEMU variant.

endchoice

source "mainboard/emulation/qemu-x86/Kconfig"
```

## mainboard/emulation/qemu-x86/Kconfig
```kconfig
##
## This file is part of the LinuxBIOS project.
##
## Copyright (C) 2007 coresystems GmbH
## Written by Stefan Reinauer <stepan@coresystems.de> for coresystems GmbH.
## Copyright (C) 2007 Uwe Hermann <uwe@hermann-uwe.de>
##
## This program is free software; you can redistribute it and/or modify
## it under the terms of the GNU General Public License as published by
## the Free Software Foundation; either version 2 of the License, or
## (at your option) any later version.
##
## This program is distributed in the hope that it will be useful,
## but WITHOUT ANY WARRANTY; without even the implied warranty of
## MERCHANTABILITY or FITNESS FOR A PARTICULAR PURPOSE.  See the
## GNU General Public License for more details.
##
## You should have received a copy of the GNU General Public License
## along with this program; if not, write to the Free Software
## Foundation, Inc., 51 Franklin St, Fifth Floor, Boston, MA  02110-1301 USA
##

config MAINBOARD_NAME
	string
	default emulation/qemu-x86
	depends BOARD_EMULATION_QEMU_X86
	help
	  This is the default mainboard name.

config MAINBOARD_PCI_SUBSYSTEM_VENDOR_ID
	hex
	default 0x15ad
	depends BOARD_EMULATION_QEMU_X86
	help
	  Mainboard specific PCI subsystem vendor ID.

config MAINBOARD_PCI_SUBSYSTEM_DEVICE_ID
	hex
	default 0x1976
	depends BOARD_EMULATION_QEMU_X86
	help
	  Mainboard specific PCI subsystem device ID.
```

## mainboard/gigabyte/Kconfig
```kconfig
##
## This file is part of the coreboot project.
##
## Copyright (C) 2007 coresystems GmbH
## (Written by Stefan Reinauer <stepan@coresystems.de> for coresystems GmbH)
##
## This program is free software; you can redistribute it and/or modify
## it under the terms of the GNU General Public License as published by
## the Free Software Foundation; either version 2 of the License, or
## (at your option) any later version.
##
## This program is distributed in the hope that it will be useful,
## but WITHOUT ANY WARRANTY; without even the implied warranty of
## MERCHANTABILITY or FITNESS FOR A PARTICULAR PURPOSE.  See the
## GNU General Public License for more details.
##
## You should have received a copy of the GNU General Public License
## along with this program; if not, write to the Free Software
## Foundation, Inc., 51 Franklin St, Fifth Floor, Boston, MA  02110-1301 USA
##

choice
	prompt "Mainboard model"
	depends on VENDOR_GIGABYTE

config BOARD_GIGABYTE_M57SLI
	bool "M57SLI"
	select ARCH_X86
	select OPTION_TABLE
	select CPU_AMD_K8
	help
	  Gigabyte M57SLI

endchoice

config MAINBOARD_DIR
	string
	default gigabyte/m57sli
	depends BOARD_GIGABYTE_M57SLI
```

## mainboard/jetway/Kconfig
```kconfig
##
## This file is part of the coreboot project.
##
## Copyright (C) 2008 Corey Osgood <corey.osgood@gmail.com>
##
## This program is free software; you can redistribute it and/or modify
## it under the terms of the GNU General Public License as published by
## the Free Software Foundation; version 2 of the License.
##
## This program is distributed in the hope that it will be useful,
## but WITHOUT ANY WARRANTY; without even the implied warranty of
## MERCHANTABILITY or FITNESS FOR A PARTICULAR PURPOSE.  See the
## GNU General Public License for more details.
##
## You should have received a copy of the GNU General Public License
## along with this program; if not, write to the Free Software
## Foundation, Inc., 51 Franklin St, Fifth Floor, Boston, MA  02110-1301 USA
##

choice
	prompt "Mainboard model"
	depends on VENDOR_JETWAY

config BOARD_JETWAY_J7F2
	bool "J7F2 Series (INCOMPLETE)"
	select ARCH_X86
	select CPU_VIA_C7
	select NORTHBRIDGE_VIA_CN700
	select SOUTHBRIDGE_VIA_VT8237
	select SUPERIO_FINTEK_F71805F
	select PIRQ_TABLE
	help
	  Jetway J7F2-Series board.
endchoice

##TODO: Make this more generic, perhaps put it in a per-NB Kconfig. This can't
##	be completely universal, because different video chips support
##	different video memory sizes.

choice
	prompt "Video Memory Size"
	default CN700_VIDEO_MB_32
	depends NORTHBRIDGE_VIA_CN700

config CN700_VIDEO_MB_NONE
	bool "none"
	help
	  Choose this option to disable the onboard video.

config CN700_VIDEO_MB_32
	bool "32 MB"
	help
	  Choose this option to use 32MB of system memory for onboard video.

config CN700_VIDEO_MB_64
	bool "64 MB"
	help
	  Choose this option to use 64MB of system memory for onboard video.

config CN700_VIDEO_MB_128
	bool "128 MB"
	help
	  Choose this option to use 128MB of system memory for onboard video.

config CN700_VIDEO_MB_256
	bool "256 MB"
	help
	  Choose this option to use 256MB of system memory for onboard video.
endchoice

config CN700_VIDEO_MB
	int
	default 0 if CN700_VIDEO_MB_NONE
	default 32 if CN700_VIDEO_MB_32
	default 64 if CN700_VIDEO_MB_64
	default 128 if CN700_VIDEO_MB_128
	default 256 if CN700_VIDEO_MB_256
	help
	  Map the config names to an integer.


config MAINBOARD_DIR
	string
	default jetway/j7f2
	depends BOARD_JETWAY_J7F2
```

## mainboard/kontron/Kconfig
```kconfig
##
## This file is part of the coreboot project.
##
## Copyright (C) 2008 coresystems GmbH
## (Written by Stefan Reinauer <stepan@coresystems.de> for coresystems GmbH)
##
## This program is free software; you can redistribute it and/or modify
## it under the terms of the GNU General Public License as published by
## the Free Software Foundation; either version 2 of the License, or
## (at your option) any later version.
##
## This program is distributed in the hope that it will be useful,
## but WITHOUT ANY WARRANTY; without even the implied warranty of
## MERCHANTABILITY or FITNESS FOR A PARTICULAR PURPOSE.  See the
## GNU General Public License for more details.
##
## You should have received a copy of the GNU General Public License
## along with this program; if not, write to the Free Software
## Foundation, Inc., 51 Franklin St, Fifth Floor, Boston, MA  02110-1301 USA
##

choice
	prompt "Mainboard model"
	depends on VENDOR_KONTRON

config BOARD_KONTRON_986LCD_M
	bool "986LCD-M"
	select ARCH_X86
	select CPU_INTEL_CORE2
	select OPTION_TABLE
	select NORTHBRIDGE_INTEL_I945
	select SOUTHBRIDGE_INTEL_I82801GX
	select SUPERIO_WINBOND_W83627HF
	select PIRQ_TABLE
	help
	  Kontron 986LCD-M Series mainboards

endchoice

config MAINBOARD_DIR
	string
	default kontron/986lcd-m
	depends BOARD_KONTRON_986LCD_M
```

## mainboard/pcengines/Kconfig
```kconfig
##
## This file is part of the coreboot project.
##
## Copyright (C) 2007 coresystems GmbH
## (Written by Stefan Reinauer <stepan@coresystems.de> for coresystems GmbH)
##
## This program is free software; you can redistribute it and/or modify
## it under the terms of the GNU General Public License as published by
## the Free Software Foundation; either version 2 of the License, or
## (at your option) any later version.
##
## This program is distributed in the hope that it will be useful,
## but WITHOUT ANY WARRANTY; without even the implied warranty of
## MERCHANTABILITY or FITNESS FOR A PARTICULAR PURPOSE.  See the
## GNU General Public License for more details.
##
## You should have received a copy of the GNU General Public License
## along with this program; if not, write to the Free Software
## Foundation, Inc., 51 Franklin St, Fifth Floor, Boston, MA  02110-1301 USA
##

choice
	prompt "Mainboard model"
	depends on VENDOR_PCENGINES

config BOARD_PCENGINES_ALIX1C
	bool "ALIX.1C"
	select ARCH_X86
	select CPU_AMD_GEODELX
	select NORTHBRIDGE_AMD_GEODELX
	select SOUTHBRIDGE_AMD_CS5536
	select SUPERIO_WINBOND_W83627HF
	select PIRQ_TABLE
	help
	  PC Engines ALIX.1C.

config BOARD_PCENGINES_ALIX2C3
	bool "ALIX.2C3"
	select ARCH_X86
	select CPU_AMD_GEODELX
	select NORTHBRIDGE_AMD_GEODELX
	select SOUTHBRIDGE_AMD_CS5536
	select PIRQ_TABLE
	help
	  PC Engines ALIX.2C3.

endchoice

config MAINBOARD_DIR
	string
	default pcengines/alix1c
	depends BOARD_PCENGINES_ALIX1C

config MAINBOARD_DIR
	string
	default pcengines/alix2c3
	depends BOARD_PCENGINES_ALIX2C3
```

## mainboard/pcengines/alix2c3/Kconfig
```kconfig
##
## This file is part of the coreboot project.
##
## Copyright (C) 2007 coresystems GmbH
## (Written by Stefan Reinauer <stepan@coresystems.de> for coresystems GmbH)
## Copyright (C) 2007 Ronald G. Minnich <rminnich@gmail.com>
##
## This program is free software; you can redistribute it and/or modify
## it under the terms of the GNU General Public License as published by
## the Free Software Foundation; either version 2 of the License, or
## (at your option) any later version.
##
## This program is distributed in the hope that it will be useful,
## but WITHOUT ANY WARRANTY; without even the implied warranty of
## MERCHANTABILITY or FITNESS FOR A PARTICULAR PURPOSE.  See the
## GNU General Public License for more details.
##
## You should have received a copy of the GNU General Public License
## along with this program; if not, write to the Free Software
## Foundation, Inc., 51 Franklin St, Fifth Floor, Boston, MA  02110-1301 USA
##

config MAINBOARD_NAME
	string
	default pcengines/alix2c3
	depends BOARD_PCENGINES_ALIX2C3
	help
	  This is the default mainboard name.
```
