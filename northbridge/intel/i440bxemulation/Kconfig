## northbridge/intel/i440bxemulation/Kconfig
```kconfig
config NORTHBRIDGE_INTEL_I440BXEMULATION_RAMSIZE
	int
	default 32 # Mbytes
	help
	  This is the default RAM size of emulation.
```

## payloads/Kconfig
```kconfig
menu "Payload"

config NO_DEFAULT_PAYLOAD
	bool

choice
	prompt "Add a payload"
	default PAYLOAD_NONE if NO_DEFAULT_PAYLOAD || !ARCH_X86
	default PAYLOAD_SEABIOS if ARCH_X86

config PAYLOAD_NONE
	bool "None"
	help
	  Select this option if you want to create an "empty" coreboot
	  ROM image for a certain mainboard, i.e. a coreboot ROM image
	  which does not yet contain a payload.

	  For such an image to be useful, you have to use 'cbfstool'
	  to add a payload to the ROM image later.

config PAYLOAD_ELF
	bool "An ELF executable payload"
	help
	  Select this option if you have a payload image (an ELF file)
	  which coreboot should run as soon as the basic hardware
	  initialization is completed.

	  You will be able to specify the location and file name of the
	  payload image later.

config PAYLOAD_FIT
	bool "A FIT payload"
	depends on ARCH_ARM64 || ARCH_RISCV || ARCH_ARM
	select PAYLOAD_FIT_SUPPORT
	help
	  Select this option if you have a payload image (a FIT file) which
	  coreboot should run as soon as the basic hardware initialization
	  is completed.

	  You will be able to specify the location and file name of the
	  payload image later.

source "payloads/external/*/Kconfig.name"

endchoice

source "payloads/external/*/Kconfig"

config PAYLOAD_FILE
	string "Payload path and filename"
	depends on PAYLOAD_ELF || PAYLOAD_FIT
	default "payload.elf" if PAYLOAD_ELF
	default "uImage" if PAYLOAD_FIT
	help
	  The path and filename of the ELF executable file to use as payload.

choice
	prompt "Payload compression algorithm"
	default COMPRESSED_PAYLOAD_LZMA
	default COMPRESSED_PAYLOAD_NONE if PAYLOAD_LINUX || PAYLOAD_LINUXBOOT || PAYLOAD_FIT
	depends on !PAYLOAD_NONE && !PAYLOAD_LINUX && !PAYLOAD_LINUXBOOT && !PAYLOAD_FIT
	help
	  Choose the compression algorithm for the chosen payloads.
	  You can choose between None, LZMA, or LZ4.

config COMPRESSED_PAYLOAD_NONE
	bool "Use no compression for payloads"
	help
	  Do not compress the payload.

config COMPRESSED_PAYLOAD_LZMA
	bool "Use LZMA compression for payloads"
	help
	  In order to reduce the size payloads take up in the ROM chip
	  coreboot can compress them using the LZMA algorithm.

config COMPRESSED_PAYLOAD_LZ4
	bool "Use LZ4 compression for payloads"
	help
	  In order to reduce the size payloads take up in the ROM chip
	  coreboot can compress them using the LZ4 algorithm.
endchoice

config PAYLOAD_OPTIONS
	string
	default ""
	help
	  Additional cbfstool options for the payload

config PAYLOAD_IS_FLAT_BINARY
	def_bool n
	help
	  Add the payload to cbfs as a flat binary type instead of as an
	  elf payload

config PAYLOAD_FIT_SUPPORT
	bool "FIT support"
	default n
	default y if PAYLOAD_LINUX && (ARCH_ARM || ARCH_ARM64 || ARCH_RISCV)
	depends on ARCH_ARM64 || ARCH_RISCV || ARCH_ARM
	select FLATTENED_DEVICE_TREE
	help
	  Select this option if your payload is of type FIT.
	  Enables FIT parser and devicetree patching. The FIT is non
	  self-extracting and needs to have a compatible compression format.

config COMPRESS_SECONDARY_PAYLOAD
	bool "Use LZMA compression for secondary payloads"
	default y
	help
	  In order to reduce the size secondary payloads take up in the
	  ROM chip they can be compressed using the LZMA algorithm.

menu "Secondary Payloads"

config COREINFO_SECONDARY_PAYLOAD
	bool "Load coreinfo as a secondary payload"
	default n
	depends on ARCH_X86
	help
	  coreinfo can be loaded as a secondary payload under SeaBIOS, GRUB,
	  or any other payload that can load additional payloads.

config GRUB2_SECONDARY_PAYLOAD
	bool "Load GRUB2 as a secondary payload"
	default n
	depends on !PAYLOAD_GRUB2
	select PAYLOAD_BUILD_GRUB2
	help
	  GRUB2 can be loaded as a secondary payload under SeaBIOS or any
	  other payload that can load additional payloads.

config MEMTEST_SECONDARY_PAYLOAD
	bool "Load Memtest86+ as a secondary payload"
	default n
	depends on ARCH_X86
	help
	  Memtest86+ can be loaded as a secondary payload under SeaBIOS, GRUB,
	  or any other payload that can load additional payloads.

config NVRAMCUI_SECONDARY_PAYLOAD
	bool "Load nvramcui as a secondary payload"
	default n
	depends on ARCH_X86 && HAVE_OPTION_TABLE
	help
	  nvramcui can be loaded as a secondary payload under SeaBIOS, GRUB,
	  or any other payload that can load additional payloads.

config SEABIOS_SECONDARY_PAYLOAD
	bool "Load SeaBIOS as a secondary payload"
	default n
	depends on ARCH_X86
	depends on !PAYLOAD_SEABIOS
	depends on !PAYLOAD_SEAGRUB
	select PAYLOAD_BUILD_SEABIOS
	help
	  SeaBIOS can be loaded as a secondary payload under GRUB or any
	  other payload that can load additional payloads.

config TINT_SECONDARY_PAYLOAD
	bool "Load tint as a secondary payload"
	default n
	depends on ARCH_X86
	help
	  tint can be loaded as a secondary payload under SeaBIOS, GRUB,
	  or any other payload that can load additional payloads.

source "payloads/external/*/Kconfig.secondary"

endmenu # "Secondary Payloads"
endmenu
```

## payloads/coreinfo/Kconfig
```kconfig
## SPDX-License-Identifier: GPL-2.0-only

# For a description of the syntax of this configuration file,
# see http://lxr.linux.no/source/Documentation/kbuild/kconfig-language.txt.
#

mainmenu "coreinfo Configuration"

menu "General settings"

# TODO: Needs changes in coreinfo, won't update without keypress currently.
config SHOW_DATE_TIME
	bool "Show current date/time in the menu"
	default y
	help
	  Show the current date and time in the lower-right corner of
	  the coreinfo menu.

	  This option will increase the ELF file size by ca. 250 bytes.

config PAYLOAD_INFO_NAME
	string "Payload name"
	default "coreinfo"
	help
	  The name of this payload for use in (e.g.) Bayou.

config PAYLOAD_INFO_LISTNAME
	string "Payload menu entry name"
	default "System Information"
	help
	  The name of this payload's menu entry for use in (e.g.) Bayou.

config PAYLOAD_INFO_DESC
	string "Payload description"
	default "Display information about the system"
	help
	  The description of this payload for use in (e.g.) Bayou.

config PAYLOAD_INFO_VERSION
	string "Payload version"
	default "0.1"
	help
	  The version number of this payload.

endmenu

menu "Modules"

config MODULE_COREBOOT
	bool "Enable the coreboot module"
	default y
	help
	  This option will increase the ELF file size by ca. 2250 bytes.

config MODULE_MULTIBOOT
	bool "Enable the multiboot module"
	default y
	help
	  This option will increase the ELF file size by ca. 1790 bytes.

config MODULE_CPUINFO
	bool "Enable the cpuinfo module"
	default y
	help
	  This option will increase the ELF file size by ca. 2650 bytes.

config MODULE_PCI
	bool "Enable the PCI info module"
	default y
	help
	  This option will increase the ELF file size by ca. 1750 bytes.

config MODULE_NVRAM
	bool "Enable the NVRAM dump module"
	default y
	help
	  This option will increase the ELF file size by ca. 350 bytes.

config MODULE_BOOTLOG
	bool "Enable the coreboot bootlog module"
	default y

config MODULE_RAMDUMP
	bool "Enable the RAM dump module"
	default y

config MODULE_CBFS
	bool "Enable the coreboot CBFS module"
	default y
	help
	  This option will increase the ELF file size by ca. 1440 bytes.

config MODULE_TIMESTAMPS
	bool "Enable the coreboot timestamps module"
	default y
	help
	  This option will increase the ELF file size by ca. 4200 bytes.

endmenu
```

## payloads/external/BOOTBOOT/Kconfig
```kconfig
## SPDX-License-Identifier: GPL-2.0-only

if PAYLOAD_BOOTBOOT

config PAYLOAD_FILE
	default "payloads/external/BOOTBOOT/bootboot/dist/bootbootcb.elf"

endif
```

## payloads/external/BOOTBOOT/Kconfig.name
```kconfig
config PAYLOAD_BOOTBOOT
	bool "BOOTBOOT"
	depends on ARCH_X86 || ARCH_ARM64
	help
	  Select this option if you want to build a coreboot image
	  with a BOOTBOOT Protocol payload.

	  See https://gitlab.com/bztsrc/bootboot for more information.
```

## payloads/external/CrabEFI/Kconfig
```kconfig
## SPDX-License-Identifier: GPL-2.0-only

if PAYLOAD_CRABEFI

config PAYLOAD_FILE
	string "CrabEFI ELF binary"
	default "payloads/external/CrabEFI/CrabEFI/target/x86_64-unknown-none/debug/crabefi" if CRABEFI_DEBUG
	default "payloads/external/CrabEFI/CrabEFI/target/x86_64-unknown-none/release/crabefi"
	help
	  The path to the CrabEFI ELF binary.

choice
	prompt "CrabEFI version"
	default CRABEFI_MASTER

config CRABEFI_MASTER
	bool "master"
	help
	  Use the latest master branch of CrabEFI.

config CRABEFI_REVISION
	bool "git revision"
	help
	  Use a specific git revision of CrabEFI.

endchoice

config CRABEFI_REPOSITORY
	string "CrabEFI git repository URL"
	default "https://github.com/ArthurHeymans/CrabEFI"
	help
	  The git repository URL for CrabEFI.

config CRABEFI_TAG_OR_REV
	string "CrabEFI git tag or revision"
	default "origin/master" if CRABEFI_MASTER
	default "" if CRABEFI_REVISION
	help
	  The git tag, branch name, or commit SHA-1 to use.
	  For branch names, prefix with "origin/" (e.g., "origin/master").

choice
	prompt "CrabEFI build type"
	default CRABEFI_RELEASE

config CRABEFI_DEBUG
	bool "Debug"
	help
	  Build CrabEFI with debug symbols and without optimizations.

config CRABEFI_RELEASE
	bool "Release"
	help
	  Build CrabEFI with optimizations.

endchoice

config CRABEFI_UI
	bool "Enable CrabEFI graphical UI"
	default y
	help
	  Enable CrabEFI's graphical UI, including mouse support and the
	  setup utility.

endif # PAYLOAD_CRABEFI
```

## payloads/external/FILO/Kconfig
```kconfig
if PAYLOAD_FILO

choice
	prompt "FILO version"
	default FILO_STABLE

config FILO_STABLE
	bool "tested"
	help
	  Tested FILO version

config FILO_HEAD
	bool "HEAD"
	help
	  Newest FILO version

endchoice

config FILO_USE_AUTOBOOT
	prompt "Use FILO's autoboot"
	default n
	bool
	help
	  Select this option to make FILO autoboot a command line after
	  timeout. This disables the GRUB legacy like interface.

config FILO_AUTOBOOT_FILE
	string "Configure FILO's autoboot kernel filename and parameters"
	depends on FILO_USE_AUTOBOOT
	default "hda1:/vmlinuz root=/dev/hda1 console=tty0 console=ttyS0,115200"
	help
	  Examples:

	  #AUTOBOOT_FILE = "hda1:/vmlinuz root=/dev/sda1 console=tty0 console=ttyS0,115200"
	  #AUTOBOOT_FILE = "mem@0xfff80000"
	  #AUTOBOOT_FILE = "hde1@0"
	  #AUTOBOOT_FILE = "uda1:/vmlinuz.elf"
	  #AUTOBOOT_FILE = "flashb@0x00400000,0x154a00 console=tty0 console=ttyS0,115200"

config FILO_AUTOBOOT_DELAY
	int "Time in seconds before booting"
	depends on FILO_USE_AUTOBOOT
	default 2
	help
	  Time in seconds before booting AUTOBOOT_FILE.

config PAYLOAD_FILE
	default "payloads/external/FILO/filo/build/filo.elf"

endif
```

## payloads/external/FILO/Kconfig.name
```kconfig
config PAYLOAD_FILO
	bool "FILO"
	depends on ARCH_X86
	help
	  Select this option if you want to build a coreboot image
	  with a FILO payload. If you don't know what this is
	  about, just leave it enabled.

	  See https://doc.coreboot.org/payloads.html for more information.
```

## payloads/external/GRUB2/Kconfig
```kconfig
config PAYLOAD_BUILD_GRUB2
	bool

if PAYLOAD_GRUB2

config PAYLOAD_FILE
	default "payloads/external/GRUB2/grub2/build/default_payload.elf"

endif

if PAYLOAD_BUILD_GRUB2

choice
	prompt "GRUB2 version"
	default GRUB2_STABLE

config GRUB2_STABLE
	bool "2.06"
	help
	  Stable GRUB2 version

config GRUB2_MASTER
	bool "HEAD"
	help
	  Newest GRUB2 version

config GRUB2_REVISION
	bool "git revision"
	help
	  Select this option if you have a specific commit or branch
	  that you want to use as the revision from which to
	  build GRUB2.

	  You will be able to specify the name of a branch or a commit id
	  later.
endchoice

config GRUB2_REVISION_ID
	string "Insert a commit's SHA-1 or a branch name"
	depends on GRUB2_REVISION
	default "origin/master"
	help
	   The commit's SHA-1 or branch name of the revision to use.

config GRUB2_EXTRA_MODULES
	string "Extra modules to include in GRUB image"
	help
	  Space-separated list of additional modules to include. Few common
	  ones:
	  * bsd for *BSD
	  * png/jpg for PNG/JPG images
	  * gfxmenu for graphical menus (you'll need a theme as well)
	  * gfxterm_background for setting background

config GRUB2_INCLUDE_RUNTIME_CONFIG_FILE
	bool "Include GRUB2 runtime config file into ROM image"
	depends on PAYLOAD_BUILD_GRUB2
	default n
	help
	  The GRUB2 payload reads its runtime configuration file from etc/grub.cfg
	  stored in the CBFS on the flash ROM chip. Without that, it’ll just drop
	  into a rescue shell.

	  This configuration may need to be coreboot specific.

	  Select this option, if you want to include the GRUB2 runtime
	  configuration file into CBFS as `etc/grub.cfg` automatically.

	  You will be able to specify the path of the configuration file later.

	  Without this option you would need to add this file manually with
	  build/cbfstool build/coreboot.rom add -f grub.cfg -n etc/grub.cfg -t raw

config GRUB2_RUNTIME_CONFIG_FILE
	string "Path of grub.cfg"
	depends on GRUB2_INCLUDE_RUNTIME_CONFIG_FILE
	default "grub.cfg"
	help
	  The path of the GRUB2 runtime configuration file to be added to CBFS.

endif

if PAYLOAD_SEAGRUB

config PAYLOAD_FILE
	default "payloads/external/SeaBIOS/seabios/out/bios.bin.elf"

config SEABIOS_BOOTORDER_FILE
	default "payloads/external/GRUB2/bootorder-seagrub"

config SEAGRUB_ALLOW_SEABIOS_BOOTMENU
	bool "Allow to access SeaBIOS boot menu before launching GRUB"
	help
	  Enable this to allow the access to the boot menu of SeaBIOS. It
	  increases the flexibility but allows to entirely bypass GRUB, along
	  with all secure mechanism implemented in its runtime config.
	  Please use this with caution.

endif
```

## payloads/external/GRUB2/Kconfig.name
```kconfig
config PAYLOAD_GRUB2
	bool "GRUB2"
	depends on ARCH_X86 || ARCH_ARM
	select PAYLOAD_BUILD_GRUB2
	help
	  Select this option if you want to build a coreboot image
	  with a GRUB2 payload. If you don't know what this is
	  about, just leave it enabled.

	  See https://doc.coreboot.org/payloads.html for more information.

config PAYLOAD_SEAGRUB
	bool "GRUB2 atop SeaBIOS"
	depends on ARCH_X86
	select PAYLOAD_BUILD_SEABIOS
	select GRUB2_SECONDARY_PAYLOAD
	help
	  Select this option if you want to build a coreboot image
	  with a GRUB2 payload running atop SeaBIOS to improve its
	  hardware compatibility.

	  See https://doc.coreboot.org/payloads.html for more information.
```
