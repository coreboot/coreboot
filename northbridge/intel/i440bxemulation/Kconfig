## payloads/external/depthcharge/Kconfig
```kconfig
if PAYLOAD_DEPTHCHARGE

choice
prompt "Depthcharge version"

config DEPTHCHARGE_STABLE
	bool "stable"
	help
	  Latest stable version.

config DEPTHCHARGE_MASTER
	bool "master"
	help
	  Newest Depthcharge version.

config DEPTHCHARGE_REVISION
	bool "git revision"
	help
	  Select this option if you have a specific commit or branch that
	  you want to use as the revision from which to build Depthcharge.

	  You will be able to specify the name of a branch or a commit SHA
	  later.

endchoice

config DEPTHCHARGE_REVISION_ID
	string "Insert a commit's SHA-1 or a branch name"
	depends on DEPTHCHARGE_REVISION
	default "origin/master"
	help
	   The commit's SHA-1 or branch name of the revision to use.

config PAYLOAD_FILE
	string
	default "payloads/external/depthcharge/depthcharge/build/depthcharge.elf"

config MAINBOARD_DEPTHCHARGE
	string ""
	help
	   Override BOARD setting for depthcharge

config LP_DEFCONFIG_OVERRIDE
	bool "Use default libpayload config"
	help
	  The Depthcharge makefile looks for a file config.<boardname> in the
	  libpayload/configs directory.  Say Y here to use the file defconfig
	  instead.  This is can be a convenience for development purposes, or
	  if the defaults in defconfig are sufficient for your system.

endif
```
