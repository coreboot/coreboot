## payloads/external/LinuxBoot/x86_64/defconfig
```kconfig
# CONFIG_LOCALVERSION_AUTO is not set
CONFIG_KERNEL_XZ=y
# CONFIG_SWAP is not set
CONFIG_SYSVIPC=y
CONFIG_NO_HZ_IDLE=y
CONFIG_HIGH_RES_TIMERS=y
CONFIG_VIRT_CPU_ACCOUNTING_GEN=y
CONFIG_CGROUPS=y
CONFIG_MEMCG=y
CONFIG_BLK_CGROUP=y
CONFIG_CGROUP_SCHED=y
CONFIG_CGROUP_PIDS=y
CONFIG_CGROUP_RDMA=y
CONFIG_CGROUP_DEVICE=y
CONFIG_CGROUP_CPUACCT=y
CONFIG_CGROUP_PERF=y
CONFIG_RELAY=y
CONFIG_BLK_DEV_INITRD=y
# CONFIG_RD_GZIP is not set
# CONFIG_RD_BZIP2 is not set
# CONFIG_RD_LZMA is not set
# CONFIG_RD_LZO is not set
# CONFIG_RD_LZ4 is not set
CONFIG_CC_OPTIMIZE_FOR_SIZE=y
# CONFIG_MULTIUSER is not set
# CONFIG_SYSFS_SYSCALL is not set
# CONFIG_BUG is not set
# CONFIG_PCSPKR_PLATFORM is not set
# CONFIG_BASE_FULL is not set
# CONFIG_AIO is not set
# CONFIG_KALLSYMS is not set
CONFIG_BPF_SYSCALL=y
CONFIG_USERFAULTFD=y
CONFIG_EMBEDDED=y
# CONFIG_VM_EVENT_COUNTERS is not set
# CONFIG_COMPAT_BRK is not set
CONFIG_SLOB=y
# CONFIG_SLAB_MERGE_DEFAULT is not set
CONFIG_GCC_PLUGINS=y
CONFIG_GCC_PLUGIN_LATENT_ENTROPY=y
CONFIG_GCC_PLUGIN_STRUCTLEAK=y
CONFIG_GCC_PLUGIN_STRUCTLEAK_BYREF_ALL=y
CONFIG_GCC_PLUGIN_RANDSTRUCT=y
# CONFIG_VMAP_STACK is not set
CONFIG_REFCOUNT_FULL=y
# CONFIG_BLK_DEV_BSG is not set
CONFIG_PARTITION_ADVANCED=y
# CONFIG_IOSCHED_DEADLINE is not set
# CONFIG_IOSCHED_CFQ is not set
# CONFIG_MQ_IOSCHED_DEADLINE is not set
# CONFIG_MQ_IOSCHED_KYBER is not set
# CONFIG_ZONE_DMA is not set
# CONFIG_X86_MPPARSE is not set
# CONFIG_X86_EXTENDED_PLATFORM is not set
CONFIG_IOSF_MBI=y
# CONFIG_SCHED_OMIT_FRAME_POINTER is not set
# CONFIG_DMI is not set
CONFIG_PREEMPT=y
# CONFIG_X86_MCE is not set
# CONFIG_MICROCODE is not set
CONFIG_X86_MSR=y
CONFIG_X86_CPUID=y
# CONFIG_SPARSEMEM_VMEMMAP is not set
# CONFIG_COMPACTION is not set
# CONFIG_MTRR is not set
# CONFIG_X86_INTEL_UMIP is not set
# CONFIG_X86_INTEL_MEMORY_PROTECTION_KEYS is not set
CONFIG_KEXEC=y
# CONFIG_RELOCATABLE is not set
# CONFIG_MODIFY_LDT_SYSCALL is not set
# CONFIG_SUSPEND is not set
# CONFIG_ACPI_REV_OVERRIDE_POSSIBLE is not set
# CONFIG_ACPI_AC is not set
# CONFIG_ACPI_BATTERY is not set
CONFIG_ACPI_VIDEO=y
# CONFIG_ACPI_FAN is not set
# CONFIG_ACPI_PROCESSOR is not set
# CONFIG_ACPI_TABLE_UPGRADE is not set
# CONFIG_X86_PM_TIMER is not set
# CONFIG_CPU_IDLE is not set
CONFIG_PCIEPORTBUS=y
CONFIG_PCIEASPM_POWER_SUPERSAVE=y
CONFIG_PCI_MSI=y
# CONFIG_ISA_DMA_API is not set
# CONFIG_BINFMT_SCRIPT is not set
# CONFIG_COREDUMP is not set
# CONFIG_UEVENT_HELPER is not set
CONFIG_DEVTMPFS=y
CONFIG_DEVTMPFS_MOUNT=y
# CONFIG_STANDALONE is not set
# CONFIG_FW_LOADER is not set
# CONFIG_ALLOW_DEV_COREDUMP is not set
# CONFIG_PNP_DEBUG_MESSAGES is not set
CONFIG_BLK_DEV_LOOP=y
CONFIG_BLK_DEV_SD=y
# CONFIG_SCSI_LOWLEVEL is not set
CONFIG_ATA=y
CONFIG_SATA_AHCI=y
CONFIG_MD=y
CONFIG_BLK_DEV_DM=y
CONFIG_DM_CRYPT=y
CONFIG_HW_RANDOM_TIMERIOMEM=y
# CONFIG_HW_RANDOM_AMD is not set
# CONFIG_HW_RANDOM_VIA is not set
CONFIG_TCG_TPM=y
CONFIG_TCG_TIS=y
# CONFIG_DEVPORT is not set
CONFIG_I2C=y
CONFIG_POWER_SUPPLY=y
# CONFIG_HWMON is not set
# CONFIG_VGA_ARB is not set
CONFIG_FB=y
CONFIG_FIRMWARE_EDID=y
CONFIG_FB_FOREIGN_ENDIAN=y
CONFIG_FB_MODE_HELPERS=y
CONFIG_FB_TILEBLITTING=y
CONFIG_BACKLIGHT_LCD_SUPPORT=y
CONFIG_VGACON_SOFT_SCROLLBACK=y
CONFIG_VGACON_SOFT_SCROLLBACK_PERSISTENT_ENABLE_BY_DEFAULT=y
CONFIG_FRAMEBUFFER_CONSOLE=y
CONFIG_FRAMEBUFFER_CONSOLE_DETECT_PRIMARY=y
CONFIG_FRAMEBUFFER_CONSOLE_ROTATION=y
# CONFIG_USB_SUPPORT is not set
CONFIG_SYNC_FILE=y
# CONFIG_VIRTIO_MENU is not set
# CONFIG_X86_PLATFORM_DEVICES is not set
# CONFIG_FIRMWARE_MEMMAP is not set
CONFIG_GOOGLE_FIRMWARE=y
CONFIG_GOOGLE_COREBOOT_TABLE_ACPI=y
CONFIG_GOOGLE_MEMCONSOLE_COREBOOT=y
CONFIG_GOOGLE_VPD=y
CONFIG_EXT4_FS=y
# CONFIG_FILE_LOCKING is not set
# CONFIG_DNOTIFY is not set
# CONFIG_INOTIFY_USER is not set
CONFIG_ISO9660_FS=y
CONFIG_JOLIET=y
CONFIG_ZISOFS=y
CONFIG_UDF_FS=y
CONFIG_MSDOS_FS=y
CONFIG_VFAT_FS=y
CONFIG_FAT_DEFAULT_UTF8=y
CONFIG_TMPFS=y
# CONFIG_MISC_FILESYSTEMS is not set
# CONFIG_ENABLE_WARN_DEPRECATED is not set
# CONFIG_ENABLE_MUST_CHECK is not set
CONFIG_FRAME_WARN=1024
# CONFIG_UNUSED_SYMBOLS is not set
# CONFIG_SECTION_MISMATCH_WARN_ONLY is not set
# CONFIG_SCHED_DEBUG is not set
# CONFIG_DEBUG_PREEMPT is not set
# CONFIG_FTRACE is not set
# CONFIG_X86_VERBOSE_BOOTUP is not set
# CONFIG_EARLY_PRINTK is not set
# CONFIG_DOUBLEFAULT is not set
CONFIG_OPTIMIZE_INLINING=y
# CONFIG_X86_DEBUG_FPU is not set
CONFIG_UNWINDER_GUESS=y
CONFIG_SECURITY_DMESG_RESTRICT=y
CONFIG_FORTIFY_SOURCE=y
# CONFIG_CRYPTO_ECHAINIV is not set
CONFIG_CRYPTO_SHA256_SSSE3=y
CONFIG_CRYPTO_ANSI_CPRNG=y
CONFIG_CRYPTO_JITTERENTROPY=y
# CONFIG_CRYPTO_HW is not set
# CONFIG_VIRTUALIZATION is not set
```

## payloads/external/Memtest86Plus/Kconfig.secondary
```kconfig
## SPDX-License-Identifier: GPL-2.0-only

if MEMTEST_SECONDARY_PAYLOAD

comment "Memtest86+"

choice
	prompt "Memtest86+ 5/6"

config MEMTEST86PLUS_V6
	bool "Memtest86+ V6"

config MEMTEST86PLUS_V5
	bool "Memtest86+ V5"

endchoice

choice
	prompt "Target architecture"
	depends on MEMTEST86PLUS_V6

config MEMTEST86PLUS_ARCH_64
	bool "64 bit"

config MEMTEST86PLUS_ARCH_32
	bool "32 bit"

endchoice

choice
	prompt "Memtest86+ revision"
	depends on MEMTEST_SECONDARY_PAYLOAD

config MEMTEST_STABLE
	bool "Stable"
	help
	  Stable Memtest86+ version.

	  For reproducible builds, this option must be selected.
config MEMTEST_MAIN
	bool "Main"
	help
	  Newest Memtest86+ version.

	  This option will fetch the newest version of the Memtest86+ code,
	  updating as new changes are committed.  This makes the build
	  non-reproducible, as it can fetch different code each time.

config MEMTEST_REVISION
	bool "git revision"
	help
	  Select this option if you have a specific commit or branch
	  that you want to use as the revision from which to
	  build Memtest86+. Using a branch version makes the build
	  non-reproducible, as it can fetch different code each time.

	  You will be able to specify the name of a branch or a commit id
	  later.

endchoice

config MEMTEST_REVISION_ID
	string "Insert a commit's SHA-1 or a branch name"
	depends on MEMTEST_REVISION
	default "origin/main"
	help
	   The commit's SHA-1 or branch name of the revision to use.

endif
```

## payloads/external/SeaBIOS/Kconfig
```kconfig
config PAYLOAD_BUILD_SEABIOS
	bool

if PAYLOAD_SEABIOS

config PAYLOAD_FILE
	default "payloads/external/SeaBIOS/seabios/out/bios.bin.elf"

endif

if PAYLOAD_BUILD_SEABIOS

choice
	prompt "SeaBIOS version"
	default SEABIOS_STABLE

config SEABIOS_STABLE
	bool "1.16.0"
	help
	  Stable SeaBIOS version
config SEABIOS_MASTER
	bool "master"
	help
	  Newest SeaBIOS version
config SEABIOS_REVISION
	bool "git revision"
	help
	  Select this option if you have a specific commit or branch
	  that you want to use as the revision from which to
	  build SeaBIOS.

	  You will be able to specify the name of a branch or a commit id
	  later.

endchoice

config SEABIOS_REVISION_ID
	string "Insert a commit's SHA-1 or a branch name"
	depends on SEABIOS_REVISION
	default "origin/master"
	help
	   The commit's SHA-1 or branch name of the revision to use.

config SEABIOS_PS2_TIMEOUT
	prompt "PS/2 keyboard controller initialization timeout (milliseconds)"
	default 0
	int
	help
	  Some PS/2 keyboard controllers don't respond to commands immediately
	  after powering on. This specifies how long SeaBIOS will wait for the
	  keyboard controller to become ready before giving up.

config SEABIOS_THREAD_OPTIONROMS
	prompt "Hardware init during option ROM execution"
	default n
	bool
	help
	  Allow hardware init to run in parallel with optionrom execution.

	  This can reduce boot time, but can cause some timing
	  variations during option ROM code execution. It is not
	  known if all option ROMs will behave properly with this option.

config SEABIOS_HARDWARE_IRQ
	prompt "Hardware Interrupts"
	default y
	bool
	help
	  Program and support hardware interrupts using the i8259
	  programmable interrupt controller (PIC).  Deselected by
	  boards which would otherwise hang at the boot menu (eg,
	  google/rambi).

config SEABIOS_VGA_COREBOOT
	prompt "Include generated option rom that implements legacy VGA BIOS compatibility"
	default y if !VENDOR_EMULATION
	default y if COREDOOM_SECONDARY_PAYLOAD
	depends on !VGA_ROM_RUN && (VGA_TEXT_FRAMEBUFFER || LINEAR_FRAMEBUFFER)
	bool
	help
	  coreboot can initialize the GPU of some mainboards.

	  After initializing the GPU, the information about it can be passed to the payload.
	  Provide an option rom that implements this legacy VGA BIOS compatibility requirement.

config PAYLOAD_CONFIGFILE
	string "SeaBIOS config file"
	default ""
	help
	  This option allows a platform to set Kconfig options for a basic
	  SeaBIOS payload.  In general, if the option is used, the default
	  would be "$(top)/src/mainboard/$(MAINBOARDDIR)/config_seabios"

config SEABIOS_BOOTORDER_FILE
	string "SeaBIOS bootorder file"
	default ""
	help
	  Add a SeaBIOS bootorder file.  From the wiki:
	  "The bootorder file may be used to configure the boot up order. The file
	  should be ASCII text and contain one line per boot method. The description
	  of each boot method follows an Open Firmware device path format. SeaBIOS
	  will attempt to boot from each item in the file - first line of the file
	  first."

	  See: https://www.coreboot.org/SeaBIOS#Configuring_boot_order

	  If used, a typical value would be:
	    $(top)/src/mainboard/$(MAINBOARDDIR)/bootorder

config SEABIOS_ADD_SERCON_PORT_FILE
	prompt "Add SeaBIOS sercon-port file to CBFS"
	default n
	bool
	help
	  Select this option to enable SeaBIOS' VGA adapter emulation
	  on serial port.

config SEABIOS_SERCON_PORT_ADDR
	hex "SeaBIOS sercon-port base address"
	depends on SEABIOS_ADD_SERCON_PORT_FILE
	default TTYS0_BASE
	help
	  Set this field to the IO address of a serial port for SeaBIOS' VGA
	  adapter emulation.

	  By default primary console UART defined by TTYS0_BASE is used.

config PAYLOAD_VGABIOS_FILE
	string
	depends on SEABIOS_VGA_COREBOOT
	default "payloads/external/SeaBIOS/seabios/out/vgabios.bin"

config SEABIOS_DEBUG_LEVEL
	int "SeaBIOS debug level (verbosity)"
	default -1
	help
	  The higher the number, the more verbose SeaBIOS will be. See the table
	  below for the current values corresponding to various items as of SeaBIOS
	  version 1.10.1. Set this value to -1 to use SeaBIOS' default.

	  Output at various SeaBIOS log levels:
	  level 0  - Logging disabled
	  level 1  - Basic output, interrupts 5, 18h, 19h, 40h, SMP, PNP, PMM
	  level 2  - AHCI, Floppy, Basic ps2, interrupts 11h, 12h, 14h, 17h
	  level 3  - bootsplash, initializations, SeaBIOS VGA BIOS interrupts
	  level 4  - BIOS tables, more optionrom
	  level 5  - Extra bootsplash, more XHCI
	  level 6  - ATA commands, extra optionrom
	  level 7  - extra ps2 commands, more OHCI & EHCI
	  level 8  - extra malloc info, more AHCI
	  level 9  - interrupts 15h, 16h, 1ah, APM, PCI, SMIs, PCIBIOS,
	             USB-HID commands, SDcard commands, Floppy commands
	  level 10 - interrupt 13h (Drives other than floppy)
	  level 20 - interrupt 10h (Display)

comment "Using default SeaBIOS log level"
	depends on SEABIOS_DEBUG_LEVEL = -1

comment "SeaBIOS logging disabled"
	depends on SEABIOS_DEBUG_LEVEL = 0

endif
```

## payloads/external/SeaBIOS/Kconfig.name
```kconfig
config PAYLOAD_SEABIOS
	bool "SeaBIOS"
	depends on ARCH_X86
	select PAYLOAD_BUILD_SEABIOS
	help
	  Select this option if you want to build a coreboot image
	  with a SeaBIOS payload. If you don't know what this is
	  about, just leave it enabled.

	  See https://coreboot.org/Payloads for more information.
```

## payloads/external/U-Boot/Kconfig
```kconfig
## SPDX-License-Identifier: GPL-2.0-only

if PAYLOAD_UBOOT

config PAYLOAD_SPECIFIC_OPTIONS
	def_bool y
	select PAYLOAD_IS_FLAT_BINARY
	select WANT_LINEAR_FRAMEBUFFER

config UBOOT_STABLE_COMMIT_ID
	string
	default "v2024.07"

choice
	prompt "U-Boot version"
	default UBOOT_STABLE

config UBOOT_STABLE
	bool "v2024.07"
	help
	  Stable U-Boot version

config UBOOT_MASTER
	bool "master"
	help
	  Newest U-Boot version

endchoice

config PAYLOAD_CONFIGFILE
	string "U-Boot config file"
	default ""
	help
	  This option allows a platform to set Kconfig options for a basic
	  U-Boot payload.  In general, if the option is used, the default
	  would be "$(top)/src/mainboard/$(MAINBOARDDIR)/config_uboot"
	  for a config stored in the coreboot mainboard directory, or
	  "$(project_dir)/configs/coreboot-x86_defconfig" to use a config
	  from the U-Boot config directory

config PAYLOAD_FILE
	default "payloads/external/U-Boot/build/u-boot.bin"

config PAYLOAD_OPTIONS
	default "-l 0x1110000 -e 0x1110000"

endif
```

## payloads/external/U-Boot/Kconfig.name
```kconfig
config PAYLOAD_UBOOT
	bool "U-Boot (Experimental)"
	depends on ARCH_X86
	help
	  Select this option if you want to build a coreboot image
	  with a U-Boot payload.

	  See https://doc.coreboot.org/payloads.html and U-Boot's documentation
	  at http://git.denx.de/?p=u-boot.git;a=blob;f=doc/README.x86
	  for more information.
```

## payloads/external/Yabits/Kconfig
```kconfig
if PAYLOAD_YABITS

choice
	prompt "Yabits version"
	default YABITS_STABLE

config YABITS_STABLE
	bool "Stable"
	help
	  Stable Yabits version.

	  For reproducible builds, this option must be selected.

config YABITS_MASTER
	bool "Master"
	help
	  Newest version.

	  This option will fetch the newest version of the Yabits code,
	  updating as new changes are committed.  This makes the build
	  non-reproducible, as it can fetch different code each time.

config YABITS_REVISION
	bool "git revision"
	help
	  Select this option if you have a specific commit or branch
	  that you want to use as the revision from which to
	  build Yabits.  Using a branch name makes the build
	  non-reproducible, as it can fetch different code as the
	  branch changes.

	  You will be able to specify the name of a branch or a commit id
	  later.

endchoice

config YABITS_REVISION_ID
	string "Insert a commit's SHA-1 or a branch name"
	depends on YABITS_REVISION
	default "origin/master"
	help
	   The commit's SHA-1 or branch name of the revision to use.

config PAYLOAD_FILE
	default "payloads/external/Yabits/uefi/build/uefi.elf"

endif
```

## payloads/external/Yabits/Kconfig.name
```kconfig
config PAYLOAD_YABITS
	bool "Yabits - Yet another UEFI Bootloader (Under Development)"
	depends on ARCH_X86
	help
	  Yabits - yabits.github.io
	  yabits is a pure UEFI coreboot payload. Compared with
	  TianoCore, it is fast and lightweight. yabits is based on the
	  part of Minoca OS. It can run GRUB2, Linux, OpenBSD, and other
	  UEFI applications.

	  It is still under the development and not ready for production.
```

## payloads/external/coreDOOM/Kconfig.secondary
```kconfig
if COREDOOM_SECONDARY_PAYLOAD

config COREDOOM_WAD_FILE
	string "DOOM WAD file"
	depends on COREDOOM_SECONDARY_PAYLOAD
	default "doom.wad"
	help
	  Add a WAD file to be loaded by coreDOOM.

	  A WAD file contains all the game data for the Doom-engine, and
	  is required to play the game.

	  A list of the WAD files included in the official games can be
	  found here: https://doomwiki.org/wiki/IWAD
	  These WADs can be extracted from copies of the game that you
	  own, and the shareware WADs may be freely downloaded from the
	  internet.

	  For a completely free (as in freedom) experience, the Freedoom
	  project (https://freedoom.github.io) provides original game
	  content under the BSD license. Other WADs not mentioned here are
	  also available and may be found from various sources such as
	  the internet and copies of other games using the Doom engine.

endif
```
