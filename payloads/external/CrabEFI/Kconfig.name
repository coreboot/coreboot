## payloads/external/CrabEFI/Kconfig.name
```kconfig
## SPDX-License-Identifier: GPL-2.0-only

config PAYLOAD_CRABEFI
	bool "CrabEFI"
	depends on ARCH_X86
	help
	  Select this option if you want to build a coreboot image
	  with a CrabEFI payload.

	  CrabEFI is a minimal UEFI implementation written in Rust,
	  designed to run as a coreboot payload. It implements just
	  enough UEFI to boot Linux via shim/GRUB2 or systemd-boot.

	  This requires cargo to be installed.

	  See https://github.com/ArthurHeymans/CrabEFI for more information.
```

## src/drivers/ampere/ftpm/Kconfig
```kconfig
## SPDX-License-Identifier: GPL-2.0-only

config AMPERE_CRB_FTPM
	bool
	default n
	depends on !CRB_TPM && !AMD_CRB_FTPM
	select TPM_STARTUP_IGNORE_POSTINIT
	help
	  Ampere firmware TPM (fTPM) with Command Response Buffer support.
	  The fTPM runs in the secure world (TF-A, EL3) and is reached by
	  submitting the command to the CRB control area and then making an
	  SMC call to invoke the TPM service handler. The SoC provides the
	  address of the control area and the SMC function ID with
	  ampere_ftpm_get_params().

	  TF-A already sends TPM2_Startup to the fTPM, so the TPM2_Startup
	  coreboot issues returns TPM_RC_INITIALIZE and is ignored.
```

## src/drivers/generic/cfr_asset_tag/Kconfig
```kconfig
## SPDX-License-Identifier: GPL-2.0-only

config DRIVERS_GENERIC_CFR_ASSET_TAG
	bool "SMBIOS asset tag from CFR"
	depends on DRIVERS_EFI_VARIABLE_STORE && SMMSTORE
	default n
	help
	  Enable this option to fill in the SMBIOS values for the mainboard
	  and chassis asset tag from an EFI variable which can be modified
	  by the user via firmware setup.
	  You need to add the 'cfr_asset_tag' SM object to your CFR forms.
```

## src/drivers/self_test/Kconfig
```kconfig
## SPDX-License-Identifier: GPL-2.0-only

config SELF_TEST
	bool "Execute built-in self tests"
	help
	  Run diagnostic tests during the boot sequence to ensure system stability.

if SELF_TEST

source "src/drivers/self_test/modules/*/Kconfig"

config SELF_TEST_DEBUG
	bool "Enable self test verbose debugging"
	help
	  Print detailed log messages from the self test routines to the AP console.

config SELF_TEST_OUTPUT_BUFFER_SIZE
	int "Self test log buffer size (bytes)"
	default 4096
	help
	  Amount of dedicated memory (CBMEM) allocated to capture and store
	  the self test output logs.

endif
```

## src/drivers/self_test/modules/intel_cpu/Kconfig
```kconfig
## SPDX-License-Identifier: GPL-2.0-only

config SELF_TEST_INTEL_CPU
	bool
	default y if CPU_INTEL_COMMON
	depends on SELF_TEST
	help
	  Run diagnostic self tests specific to Intel processors.

config SELF_TEST_INTEL_CPU_UCODE
	bool
	default y if SOC_INTEL_COMMON_BLOCK_CPU_MPINIT
	depends on SELF_TEST_INTEL_CPU
	help
	  Validate the microcode (uCode) patch loading status on Intel processors.
```

## src/drivers/vpd/Kconfig
```kconfig
## SPDX-License-Identifier: GPL-2.0-only

config VPD
	bool "Support for Vital Product Data tables"
	default n
	help
	  Enable support for flash based vital product data.

config VPD_FMAP_NAME
	string
	depends on VPD
	default "RO_VPD"
	help
	  Name of the FMAP region created in the default FMAP to store VPD tables.

config VPD_FMAP_SIZE
	hex
	depends on VPD
	default 0x4000
	help
	  Size in bytes of the FMAP region created to store VPD tables.

config SMBIOS_UUID_FROM_VPD
	bool "Load system UUID from VPD"
	depends on VPD && GENERATE_SMBIOS_TABLES
	help
	  VPD storage keys:
	  - system_uuid; stored as a raw UUID, byte-order is given by the SMBIOS
	    specification. The UUID 00112233-4455-6677-8899-AABBCCDDEEFF would be
	    stored as the bytes 33 22 11 00 55 44 77 66 88 99 AA BB CC DD EE FF.

config SMBIOS_SERIAL_FROM_VPD
	bool "Load mainboard and system serial number from VPD"
	depends on VPD && GENERATE_SMBIOS_TABLES
	help
	  VPD storage keys:
	  - mlb_serial_number: mainboard serial number
	  - serial_number: system serial number

config SMBIOS_SERIAL_SIZE
	int "Maximum serial number size"
	depends on SMBIOS_SERIAL_FROM_VPD
	help
	  Including the terminating null byte
	default 64

config SMBIOS_SYSTEM_DATA_FROM_VPD
	bool "Load system/product DMI strings from VPD"
	depends on VPD && GENERATE_SMBIOS_TABLES
	help
	  Loads the following system/product DMI strings from VPD:
	  - system_family
	  - system_product_name
	  - system_sku

config SMBIOS_SYSTEM_DATA_SIZE
	int "Maximum length of a single system/product DMI string"
	depends on SMBIOS_SYSTEM_DATA_FROM_VPD
	help
	  Including the terminating null byte
	default 64
```

## src/ec/lenovo/ideapad/Kconfig
```kconfig
## SPDX-License-Identifier: GPL-2.0-only

config EC_LENOVO_IDEAPAD
	bool
	select EC_ACPI
	help
	  ACPI support for the embedded controller interface used by Lenovo
	  IdeaPad (and related MIIX) laptops. Provides the standard ACPI EC
	  device, battery, AC adapter and lid objects, plus the Lenovo VPC
	  (VPC2004) hotkey/feature device consumed by the ideapad-laptop
	  Linux driver.
```

## src/mainboard/acer/travelmate_p633_series/Kconfig
```kconfig
## SPDX-License-Identifier: GPL-2.0-only

config BOARD_ACER_TRAVELMATE_P633_SERIES
	bool
	select BOARD_ROMSIZE_KB_12288
	select DRIVERS_OPTION_CFR_ENABLED if PAYLOAD_EDK2 && SMMSTORE
	select EC_ACPI
	select GFX_GMA_PANEL_1_ON_LVDS
	select HAVE_ACPI_RESUME
	select HAVE_ACPI_TABLES
	select HAVE_CMOS_DEFAULT
	select HAVE_OPTION_TABLE
	select INTEL_GMA_HAVE_VBT
	select INTEL_INT15
	select MAINBOARD_HAS_LIBGFXINIT
	select MAINBOARD_HAS_TPM1
	select MEMORY_MAPPED_TPM
	select NO_UART_ON_SUPERIO
	select NORTHBRIDGE_INTEL_SANDYBRIDGE
	select SERIRQ_CONTINUOUS_MODE
	select SOUTHBRIDGE_INTEL_C216
	select SYSTEM_TYPE_LAPTOP
	select USE_NATIVE_RAMINIT

config BOARD_ACER_TRAVELMATE_P633_M
	bool
	select BOARD_ACER_TRAVELMATE_P633_SERIES

config BOARD_ACER_TRAVELMATE_P633_V
	bool
	select BOARD_ACER_TRAVELMATE_P633_SERIES
	select MAINBOARD_USES_IFD_GBE_REGION

if BOARD_ACER_TRAVELMATE_P633_SERIES

config MAINBOARD_DIR
	default "acer/travelmate_p633_series"

config MAINBOARD_PART_NUMBER
	default "TravelMate P633-M" if BOARD_ACER_TRAVELMATE_P633_M
	default "TravelMate P633-V" if BOARD_ACER_TRAVELMATE_P633_V

config VARIANT_DIR
	default "p633_m" if BOARD_ACER_TRAVELMATE_P633_M
	default "p633_v" if BOARD_ACER_TRAVELMATE_P633_V

config OVERRIDE_DEVICETREE
	default "variants/\$(CONFIG_VARIANT_DIR)/overridetree.cb"

# Override the default variant behavior, since the data.vbt is probably the same
config INTEL_GMA_VBT_FILE
	default "src/mainboard/\$(MAINBOARDDIR)/data.vbt"

config CBFS_SIZE
	default 0x600000

endif
```

## src/mainboard/acer/travelmate_p633_series/Kconfig.name
```kconfig
## SPDX-License-Identifier: GPL-2.0-only

config BOARD_ACER_TRAVELMATE_P633_M
	bool "TravelMate P633-M"

config BOARD_ACER_TRAVELMATE_P633_V
	bool "TravelMate P633-V"
```

## src/mainboard/adlink/Kconfig
```kconfig
## SPDX-License-Identifier: GPL-2.0-only

if VENDOR_ADLINK

choice
	prompt "Mainboard model"

source "src/mainboard/adlink/*/Kconfig.name"

endchoice

source "src/mainboard/adlink/*/Kconfig"

config MAINBOARD_VENDOR
	default "ADLINK"

endif # VENDOR_ADLINK
```

## src/mainboard/adlink/alva/Kconfig
```kconfig
# SPDX-License-Identifier: GPL-2.0-or-later

if BOARD_ADLINK_ALVA

config BOARD_SPECIFIC_OPTIONS
	def_bool y
	#select BOARD_ROMSIZE_KB_16384
	select BOARD_ROMSIZE_KB_32768
	select MISSING_BOARD_RESET
	select SOC_AMPERE_ALTRA

config FMDFILE
	default "src/mainboard/adlink/alva/flash.fmd"

config MAINBOARD_DIR
	default "adlink/alva"

config MAINBOARD_PART_NUMBER
	default "Ampere Altra Developer Platform"

endif #  BOARD_ADLINK_ALVA
```

## src/mainboard/apple/i945_macs/Kconfig
```kconfig
## SPDX-License-Identifier: GPL-2.0-only

config BOARD_APPLE_I945_MACS_COMMON
	bool
	select CPU_INTEL_SOCKET_M
	select NORTHBRIDGE_INTEL_I945
	select NORTHBRIDGE_INTEL_SUBTYPE_I945GM
	select SOUTHBRIDGE_INTEL_I82801GX
	select NO_UART_ON_SUPERIO
	select EC_ACPI
	select HAVE_OPTION_TABLE
	select HAVE_CMOS_DEFAULT
	select HAVE_MP_TABLE
	select BOARD_ROMSIZE_KB_2048
	select INTEL_INT15
	select HAVE_ACPI_TABLES
	select HAVE_ACPI_RESUME

config BOARD_APPLE_MACBOOK11
	bool
	select BOARD_APPLE_I945_MACS_COMMON
	select SYSTEM_TYPE_LAPTOP

config BOARD_APPLE_MACBOOK21
	bool
	select BOARD_APPLE_I945_MACS_COMMON
	select SYSTEM_TYPE_LAPTOP

config BOARD_APPLE_IMAC41
	bool
	select BOARD_APPLE_I945_MACS_COMMON
#	select VGA_BIOS

config BOARD_APPLE_IMAC52
	bool
	select BOARD_APPLE_I945_MACS_COMMON

if BOARD_APPLE_I945_MACS_COMMON

config MAINBOARD_DIR
	default "apple/i945_macs"

config MAINBOARD_PART_NUMBER
	default "Macbook1,1" if BOARD_APPLE_MACBOOK11
	default "MacBook2,1" if BOARD_APPLE_MACBOOK21
	default "iMac4,1" if BOARD_APPLE_IMAC41
	default "iMac5,2" if BOARD_APPLE_IMAC52

config VARIANT_DIR
	default "macbook1_1" if BOARD_APPLE_MACBOOK11
	default "macbook2_1" if BOARD_APPLE_MACBOOK21
	default "imac4_1" if BOARD_APPLE_IMAC41
	default "imac5_2" if BOARD_APPLE_IMAC52

config OVERRIDE_DEVICETREE
	default "variants/\$(CONFIG_VARIANT_DIR)/overridetree.cb"

config MAX_CPUS
	default 2

config MAINBOARD_SMBIOS_MANUFACTURER
	default "Apple Inc."

endif

if BOARD_APPLE_IMAC41

config VGA_BIOS_ID
	string
	default "1002,71c5"

endif
```

## src/mainboard/asrock/turind8ud-2t/Kconfig
```kconfig
## SPDX-License-Identifier: GPL-2.0-only

if BOARD_ASROCK_TURIND8UD_2T

config BOARD_SPECIFIC_OPTIONS
	def_bool y
	select BOARD_ROMSIZE_KB_32768
	select DISABLE_KEYBOARD_RESET_PIN
	select DRIVERS_ASPEED_AST2050
	select HAVE_CMOS_DEFAULT
	select HAVE_OPTION_TABLE
	select IPMI_KCS
	select IPMI_KCS_ROMSTAGE
	select MEMORY_MAPPED_TPM
	select SOC_AMD_TURIN_POC
	select SPI_FLASH_FORCE_4_BYTE_ADDR_MODE
	select SUPERIO_ASPEED_AST2400
	select SUPERIO_NUVOTON_NCT6796D
	select SYSTEM_TYPE_SERVER

config FMDFILE
	default "src/mainboard/asrock/turind8ud-2t/board.fmd"

config BUILD_WITH_DEBUG_APCB
	def_bool n
	prompt "Build with debug APCB"

config MAINBOARD_DIR
	default "asrock/turind8ud-2t"

config MAINBOARD_PART_NUMBER
	default "TURIND8UD-2T/X550"

config MAINBOARD_SMBIOS_MANUFACTURER
	default "ASRockRack"

config ECAM_MMCONF_BASE_ADDRESS
	default 0xe0000000

config EFS_SPI_READ_MODE
	default 0	# Normal read

config EFS_SPI_SPEED
	default 2	# 22MHz

config EFS_SPI_MICRON_FLAG
	default 0

config NORMAL_READ_SPI_SPEED
	default 2	# 22MHz

config ALT_SPI_SPEED
	default 2	# 22MHz

config TPM_SPI_SPEED
	default 2	# 22MHz

config EFS_ESPI0_CONFIG0
	default 0x0e

config EFS_ESPI1_CONFIG0
	default 0x2c

config TPM_MEASURED_BOOT_INIT_BOOTBLOCK
	default y if TPM_MEASURED_BOOT && !VBOOT

endif
```

## src/mainboard/asrock/turind8ud-2t/Kconfig.name
```kconfig
## SPDX-License-Identifier: GPL-2.0-only

config BOARD_ASROCK_TURIND8UD_2T
	bool "TURIND8UD-2T/X550"
```

## src/mainboard/asrock/z97_anniversary/Kconfig
```kconfig
## SPDX-License-Identifier: GPL-2.0-only

if BOARD_ASROCK_Z97_ANNIVERSARY

config BOARD_SPECIFIC_OPTIONS
	def_bool y
	select BOARD_ROMSIZE_KB_8192
	select HAVE_ACPI_RESUME
	select HAVE_ACPI_TABLES
	select INTEL_GMA_HAVE_VBT
	select MAINBOARD_HAS_LIBGFXINIT
	select MAINBOARD_USES_IFD_GBE_REGION
	select MEMORY_MAPPED_TPM
	select NORTHBRIDGE_INTEL_HASWELL
	select SERIRQ_CONTINUOUS_MODE
	select SOUTHBRIDGE_INTEL_LYNXPOINT
	select SUPERIO_NUVOTON_COMMON_COM_A
	select SUPERIO_NUVOTON_NCT6776
	select USE_BROADWELL_MRC if !USE_NATIVE_RAMINIT

config CBFS_SIZE
	default 0x600000

config MAINBOARD_DIR
	default "asrock/z97_anniversary"

config MAINBOARD_PART_NUMBER
	default "Z97 Anniversary"

config USBDEBUG_HCD_INDEX
	default 2	# Rear:		USB3_01 (Top)
			# Header:	USB2_3
endif
```

## src/mainboard/asrock/z97_anniversary/Kconfig.name
```kconfig
## SPDX-License-Identifier: GPL-2.0-or-later

config BOARD_ASROCK_Z97_ANNIVERSARY
	bool "Z97 Anniversary"
```

## src/mainboard/asus/h81m-c/Kconfig.name
```kconfig
## SPDX-License-Identifier: GPL-2.0-only

config BOARD_ASUS_H81M_C
	bool "H81M-C"
```

## src/mainboard/dell/precision_m4800/Kconfig
```kconfig
## SPDX-License-Identifier: GPL-2.0-only

if BOARD_DELL_PRECISION_M4800

config BOARD_SPECIFIC_OPTIONS
	def_bool y
	select BOARD_ROMSIZE_KB_12288
	select EC_ACPI
	select EC_DELL_MEC5035
	select HAVE_ACPI_RESUME
	select HAVE_ACPI_TABLES
	select HAVE_CMOS_DEFAULT
	select HAVE_OPTION_TABLE
	select INTEL_GMA_HAVE_VBT
	select MAINBOARD_HAS_LIBGFXINIT
	select MAINBOARD_HAS_TPM1
	select MAINBOARD_USES_IFD_GBE_REGION
	select MEMORY_MAPPED_TPM
	select NORTHBRIDGE_INTEL_HASWELL
	select SERIRQ_CONTINUOUS_MODE
	select SOUTHBRIDGE_INTEL_LYNXPOINT
	select SYSTEM_TYPE_LAPTOP

config CBFS_SIZE
	default 0x600000

config MAINBOARD_DIR
	default "dell/precision_m4800"

config MAINBOARD_PART_NUMBER
	default "Precision M4800"

config USBDEBUG_HCD_INDEX
	# Rear-most port on right side
	# Index 2 is front-most port on left side
	default 1
endif
```

## src/mainboard/dell/precision_m4800/Kconfig.name
```kconfig
## SPDX-License-Identifier: GPL-2.0-only

config BOARD_DELL_PRECISION_M4800
	bool "Precision M4800"
```

## src/mainboard/framework/Kconfig
```kconfig
## SPDX-License-Identifier: GPL-2.0-or-later

if VENDOR_FRAMEWORK

choice
	prompt "Mainboard model"

source "src/mainboard/framework/*/Kconfig.name"

endchoice

source "src/mainboard/framework/*/Kconfig"

config MAINBOARD_VENDOR
	default "Framework"

config EC_GOOGLE_CHROMEEC_ACPI_HID
	default "FRMWC004"

config FRAMEWORK_COMMON_CFR
	def_bool y
	select DRIVERS_OPTION_CFR_ENABLED if PAYLOAD_EDK2 && SMMSTORE

config FRAMEWORK_TOUCHSCREEN_STYLUS
	bool
	help
	  Selected by boards that have a touchscreen stylus protocol switch GPIO
	  (stylus_sw_r), i.e. the Framework Laptop 12. Exposes a CFR option to
	  choose between the MPP and USI stylus protocols.

config FRAMEWORK_INPUT_DECK
	bool
	default n
	help
	  Selected by boards that have detectable input deck, to enable the Input
	  Deck Mode CFR option.

endif # VENDOR_FRAMEWORK
```

## src/mainboard/framework/adlrpl/Kconfig
```kconfig
## SPDX-License-Identifier: GPL-2.0-or-later

config BOARD_FRAMEWORK_ADLRPL_COMMON
	def_bool n
	select BOARD_ROMSIZE_KB_32768
	select DRIVERS_ACPI_THERMAL_ZONE
	select DRIVERS_I2C_HID
	select DRIVERS_INTEL_USB4_RETIMER
	select DRIVERS_INTEL_WIFI
	select EC_GOOGLE_CHROMEEC
	select EC_GOOGLE_CHROMEEC_ESPI
	select EC_GOOGLE_CHROMEEC_MEC
	select HAVE_ACPI_RESUME
	select HAVE_ACPI_TABLES
	select INTEL_GMA_HAVE_VBT
	select INTEL_LPSS_UART_FOR_CONSOLE
	select MEMORY_MAPPED_TPM
	select MAINBOARD_HAS_TPM2
	select NO_UART_ON_SUPERIO
	select SOC_INTEL_COMMON_BLOCK_HDA_VERB
	select SOC_INTEL_ENABLE_USB4_PCIE_RESOURCES
	select SPD_CACHE_ENABLE
	select SPD_CACHE_IN_FMAP
	select SPD_READ_BY_WORD
	select SYSTEM_TYPE_LAPTOP
	select TPM_MEASURED_BOOT

config BOARD_FRAMEWORK_HX30
	select BOARD_FRAMEWORK_ADLRPL_COMMON
	select SOC_INTEL_ALDERLAKE_PCH_P

if BOARD_FRAMEWORK_ADLRPL_COMMON

config MAINBOARD_DIR
	default "framework/adlrpl"

config MAINBOARD_PART_NUMBER
	default "hx30" if BOARD_FRAMEWORK_HX30

config MAINBOARD_SMBIOS_PRODUCT_NAME
	default "Laptop (12th Gen Intel Core)" if BOARD_FRAMEWORK_HX30

config MAINBOARD_FAMILY
	default "13in Laptop"

config CONSOLE_POST
	default y

config DIMM_MAX
	default 4

config DIMM_SPD_SIZE
	default 512	# DDR4

config POST_DEVICE
	default n

config UART_FOR_CONSOLE
	default 0

config TPM_PIRQ
	hex
	default 0x61	# GPP_F11 TPM_PIRQ#

config FMDFILE
	default "src/mainboard/\$(CONFIG_MAINBOARD_DIR)/board.fmd"

config VBOOT
	default y
	select VBOOT_ALWAYS_ENABLE_DISPLAY
	select VBOOT_CLEAR_RECOVERY_IN_RAMSTAGE
	select VBOOT_NO_BOARD_SUPPORT
	select VBOOT_SLOTS_RW_AB

endif
```

## src/mainboard/framework/adlrpl/Kconfig.name
```kconfig
## SPDX-License-Identifier: GPL-2.0-or-later

config BOARD_FRAMEWORK_HX30
	bool "Laptop 13 (12th Gen Intel Core)"
```
