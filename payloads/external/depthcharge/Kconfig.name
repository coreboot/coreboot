## payloads/libpayload/arch/x86/Kconfig
```kconfig
##
##
## Copyright (c) 2012 Google Inc.
##
## Redistribution and use in source and binary forms, with or without
## modification, are permitted provided that the following conditions
## are met:
## 1. Redistributions of source code must retain the above copyright
##    notice, this list of conditions and the following disclaimer.
## 2. Redistributions in binary form must reproduce the above copyright
##    notice, this list of conditions and the following disclaimer in the
##    documentation and/or other materials provided with the distribution.
## 3. The name of the author may not be used to endorse or promote products
##    derived from this software without specific prior written permission.
##
## THIS SOFTWARE IS PROVIDED BY THE AUTHOR AND CONTRIBUTORS ``AS IS'' AND
## ANY EXPRESS OR IMPLIED WARRANTIES, INCLUDING, BUT NOT LIMITED TO, THE
## IMPLIED WARRANTIES OF MERCHANTABILITY AND FITNESS FOR A PARTICULAR PURPOSE
## ARE DISCLAIMED.  IN NO EVENT SHALL THE AUTHOR OR CONTRIBUTORS BE LIABLE
## FOR ANY DIRECT, INDIRECT, INCIDENTAL, SPECIAL, EXEMPLARY, OR CONSEQUENTIAL
## DAMAGES (INCLUDING, BUT NOT LIMITED TO, PROCUREMENT OF SUBSTITUTE GOODS
## OR SERVICES; LOSS OF USE, DATA, OR PROFITS; OR BUSINESS INTERRUPTION)
## HOWEVER CAUSED AND ON ANY THEORY OF LIABILITY, WHETHER IN CONTRACT, STRICT
## LIABILITY, OR TORT (INCLUDING NEGLIGENCE OR OTHERWISE) ARISING IN ANY WAY
## OUT OF THE USE OF THIS SOFTWARE, EVEN IF ADVISED OF THE POSSIBILITY OF
## SUCH DAMAGE.
##

if ARCH_X86

config ARCH_SPECIFIC_OPTIONS # dummy
	def_bool y
	select LITTLE_ENDIAN
	select IO_ADDRESS_SPACE

config ENABLE_APIC
	bool "Enables the Local APIC"

choice
	prompt "Interrupt Handling"
	default LOG_UNKNOWN_INTERRUPTS if ENABLE_APIC
	default DIE_ON_UNKNOWN_INTERRUPT

config IGNORE_UNKNOWN_INTERRUPTS
	bool "Ignore unknown user defined interrupts"

config LOG_UNKNOWN_INTERRUPTS
	bool "Logs unknown user defined interrupts to the console"

config DIE_ON_UNKNOWN_INTERRUPT
	bool "Die if an unknown user defined interrupt is encountered"

endchoice

endif
```

## payloads/libpayload/configs/defconfig
```kconfig
# CONFIG_LP_MULTIBOOT is not set
CONFIG_LP_COREBOOT_VIDEO_CONSOLE=y
CONFIG_LP_USB=y
CONFIG_LP_USB_UHCI=y
CONFIG_LP_USB_OHCI=y
CONFIG_LP_USB_EHCI=y
CONFIG_LP_USB_XHCI=y
CONFIG_LP_HEAP_SIZE=1048576
```

## payloads/libpayload/drivers/storage/Kconfig
```kconfig
##
##
## SPDX-License-Identifier: GPL-2.0-only

config STORAGE
	bool "Support for storage devices"
	default y if !CHROMEOS
	help
	  Select this option if you want support for storage devices (like
	  hard drives, memory sticks or optical drives).

config STORAGE_64BIT_LBA
	bool "Use 64-bit integers to address sectors"
	depends on STORAGE
	default n
	help
	  If this is selected, sectors will be addressed by an 64-bit integer.
	  Select this to support LBA-48 for ATA drives.

config STORAGE_ATA
	bool "Support ATA drives (i.e. hard drives)"
	depends on STORAGE
	default y
	help
	  Select this option if you want support for ATA storage devices
	  (i.e. hard drives).

config STORAGE_ATAPI
	bool "Support ATAPI drives (i.e. optical drives)"
	depends on STORAGE
	default y
	select STORAGE_ATA
	help
	  Select this option if you want support for ATAPI storage devices
	  (i.e. optical drives like CD or DVD drives).

config STORAGE_AHCI
	bool "Support for AHCI host controllers"
	depends on STORAGE && (STORAGE_ATA || STORAGE_ATAPI) && PCI
	default y
	help
	  Select this option if you want support for SATA controllers in
	  AHCI mode.

config STORAGE_AHCI_ONLY_TESTED
	bool "Only enable tested controllers"
	depends on STORAGE_AHCI
	default n
	help
	  If this option is selected, only AHCI controllers which are known
	  to work will be used.
```

## payloads/libpayload/drivers/timer/Kconfig
```kconfig
##
## This file is part of the coreboot project.
##
## This program is free software; you can redistribute it and/or modify
## it under the terms of the GNU General Public License as published by
## the Free Software Foundation; version 2 of the License.
##
## This program is distributed in the hope that it will be useful,
## but WITHOUT ANY WARRANTY; without even the implied warranty of
## MERCHANTABILITY or FITNESS FOR A PARTICULAR PURPOSE.  See the
## GNU General Public License for more details.

choice
	prompt "Timer driver"
	default TIMER_NONE if !ARCH_X86
	default TIMER_RDTSC if ARCH_X86

config TIMER_RDTSC
	bool "x86 rdtsc"
	depends on ARCH_X86

config TIMER_NONE
	bool "None"
	help
	  The timer driver is provided by the payload itself.

config TIMER_MCT
	bool "Exynos MCT"

config TIMER_TEGRA_1US
	bool "Tegra 1us"

config TIMER_IPQ806X
	bool "Timer for ipq806x platforms"

config TIMER_IPQ40XX
	bool "Timer for ipq40xx platforms"
	help
	  This is the timer driver for QCA IPQ40xx based
	  platforms.

config TIMER_ARM64_ARCH
	bool "Architecture Timer for ARM64 platforms"
	help
	  The cntfrq register needs to have been pre-initialized.

config TIMER_RK3288
	bool "Timer for Rockchip RK3288"

config TIMER_RK3399
	bool "Timer for Rockchip RK3399"

config TIMER_MTK
	bool "Timer for MediaTek"

endchoice

config TIMER_GENERIC_HZ
	int "Generic Timer Frequency"
	default 48000000 if TIMER_IPQ40XX
	default 6250000 if TIMER_IPQ806X
	default 24000000 if TIMER_MCT
	default 13000000 if TIMER_MTK
	default 24000000 if TIMER_RK3288
	default 24000000 if TIMER_RK3399
	default 1000000 if TIMER_TEGRA_1US
	default 0
	help
	  Clock frequency of generic time counter in Hertz. Leave at 0 to
	  disable when using a non-generic timer driver.

config TIMER_GENERIC_REG
	hex "Generic Timer Register Address"
	default 0x004A2000 if TIMER_IPQ40XX
	default 0x0200A028 if TIMER_IPQ806X
	default 0x101C0100 if TIMER_MCT
	default 0x10008068 if TIMER_MTK
	default 0xff810028 if TIMER_RK3288
	default 0xff850008 if TIMER_RK3399
	default 0x60005010 if TIMER_TEGRA_1US
	default 0x0
	help
	  Register address to read generic time counter from.

config TIMER_GENERIC_HIGH_REG
	hex "Generic Timer High Register Address"
	default 0x004A2004 if TIMER_IPQ40XX
	default 0x101C0104 if TIMER_MCT
	default 0x10008078 if TIMER_MTK
	default 0xff81002C if TIMER_RK3288
	default 0xff85000C if TIMER_RK3399
	default 0x0
	help
	  Register address to read high 32 bits of generic time counter from.
	  Leave at 0x0 for 32-bit counters.
```

## payloads/libpayload/drivers/usb/Kconfig
```kconfig
##
## This file is part of the coreboot project.
##
## This program is free software; you can redistribute it and/or modify
## it under the terms of the GNU General Public License as published by
## the Free Software Foundation; version 2 of the License.
##
## This program is distributed in the hope that it will be useful,
## but WITHOUT ANY WARRANTY; without even the implied warranty of
## MERCHANTABILITY or FITNESS FOR A PARTICULAR PURPOSE.  See the
## GNU General Public License for more details.
##

config USB
	bool "USB Support"
	default y

config USB_UHCI
	bool "Support for USB UHCI controllers"
	depends on USB && ARCH_X86
	default y if !CHROMEOS
	help
	  Select this option if you are going to use USB 1.1 on an Intel based
	  system.

config USB_OHCI
	bool "Support for USB OHCI controllers"
	depends on USB
	default y if !CHROMEOS
	help
	  Select this option if you are going to use USB 1.1 on a non-Intel based
	  system.

config USB_EHCI
	bool "Support for USB EHCI controllers"
	depends on USB
	default y if !CHROMEOS
	help
	  Select this option if you want to use USB 2.0

config USB_XHCI
	bool "Support for USB xHCI controllers"
	depends on USB
	default y if !CHROMEOS
	help
	  Select this option if you want to use USB 3.0

config USB_XHCI_MTK_QUIRK
	bool "Support for USB xHCI controllers on MTK SoC"
	depends on USB_XHCI
	help
	  Select this option if you want to use USB 3.0 on MTK platform.

config USB_DWC2
	bool "Support for USB DesignWare HCD controllers"
	depends on USB
	help
	  Select this option if you want to use DesignWare USB 2.0 host controller

config USB_HID
	bool "Support for USB keyboards"
	depends on USB
	default y
	help
	  Select this option if you want to use devices complying to the
	  USB HID (Human Interface Device) standard. Such devices are for
	  example keyboards and mice. Currently only keyboards are supported.
	  Say Y here unless you know exactly what you are doing.

config USB_HUB
	bool "Support for USB hubs"
	depends on USB
	default y
	help
	  Select this option if you want to compile in support for USB hubs.
	  Say Y here unless you know exactly what you are doing.

config USB_EHCI_HOSTPC_ROOT_HUB_TT
	bool "Support for USB EHCI ROOT HUB that has TT"
	depends on USB_EHCI
	default n
	help
	  Select this option if USB EHCI root hub supports TT (Transaction
	  Translator).
	  To support this TT feature we read port-speed from non-standard
	  register HOSTPC (offset 84h of Operational Register base).

config USB_MSC
	bool "Support for USB storage"
	depends on USB
	default y
	help
	  Select this option if you want to compile in support for USB mass
	  storage devices (USB memory sticks, hard drives, CDROM/DVD drives)
	  Say Y here unless you know exactly what you are doing.

config USB_GEN_HUB
	bool
	default n if (!USB_HUB && !USB_XHCI)
	default y if (USB_HUB || USB_XHCI)
config USB_PCI
	bool "Auto-scan PCI bus for USB host controllers"
	depends on USB
	default y if ARCH_X86
	default n

config UDC
	bool "USB device mode support"
	default n
	help
	  Select this option to add support for running as
	  a USB device.

config UDC_CI
	bool "ChipIdea driver for USB device mode"
	depends on UDC
	default n
	help
	  Select this option to add the driver for ChipIdea
	  USB device controller.

config UDC_DWC2
	bool "Designware driver for USB device mode"
	depends on UDC
	default n
	help
	  Select this option to add the driver for Designware
	  USB device controller.
```

## payloads/libpayload/libcbfs/Kconfig
```kconfig
## SPDX-License-Identifier: BSD-3-Clause OR GPL-2.0-or-later

config CBFS
	bool "CBFS support"
	default y
	help
	  CBFS is the archive format of coreboot

if CBFS

config DEBUG_CBFS
	bool "Output verbose CBFS debug messages"
	default n
	help
	  This option enables additional CBFS related debug messages.

config ENABLE_CBFS_FALLBACK
	bool "Fallback to RO (COREBOOT) region"
	default n
	help
	  When this option is enabled, the CBFS code will look for a file in the
	  RO (COREBOOT) region, if it isn't available in the active RW region.
	  This option makes sense only if CONFIG_VBOOT was enabled in the coreboot.

config CBFS_VERIFICATION
	bool "Enable CBFS verification"
	depends on VBOOT_LIB
	help
	  This option enables hash verification of CBFS files in RO (COREBOOT) and RW regions.

endif
```

## payloads/libpayload/vboot/Kconfig
```kconfig
# SPDX-License-Identifier: BSD-3-Clause

config VBOOT_LIB
	bool "Compile verified boot (vboot) library"
	default y if CHROMEOS
	default n
	help
	  This option enables compiling and building vboot libraries vboot_fw and tlcl.

if VBOOT_LIB

config VBOOT_CBFS_INTEGRATION
	bool "Enable vboot and CBFS integration"
	default n
	depends on CBFS_VERIFICATION
	help
	  Say yes to request reboot on CBFS file hash mismatch in non-recovery mode.

config VBOOT_TPM2_MODE
	bool "TPM2 Mode"
	default y
	help
	  This option enables TPM 2.0 support in vboot. Disabling it allows using TPM 1.2.

config VBOOT_X86_SHA_EXT
	bool "x86 SHA Extension"
	default y if CHROMEOS
	default n
	depends on ARCH_X86
	help
	  This option enables SHA256 implementation using x86 SHA processor extension
	  instructions: sha256msg1, sha256msg2, sha256rnds2.

config VBOOT_X86_RSA_ACCELERATION
	bool "Use SSE2 instructions for RSA signature verification"
	default y if CHROMEOS
	default n
	depends on ARCH_X86
	help
	  Use paddq, pmuludq, psrlq, punpckldq and punpcklqdq SSE2
	  instructions to accelerate the modulus exponentiation which
	  is part of the RSA signature verification process.

config VBOOT_SHA_ARMV8_CE
	bool "SHA256 implementation using ARMv8 Crypto Extension"
	default y if CHROMEOS
	default n
	depends on ARCH_ARM64
	help
	  This option enables SHA256 implementation using ARMv8 Crypto Extension.

config VBOOT_ARM64_RSA_ACCELERATION
	bool "Use arm64 SIMD instructions to accelerate RSA signature verification"
	default y
	depends on ARCH_ARM64
	help
	  Use arm64 SIMD instructions (NEON) to parallelize two multiplications
	  in the modulus exponentiation algorithm, which speeds up RSA signature
	  verification in vboot. This is supported on all arm64 CPUs so you'd
	  generally always want this enabled, unless your SoC is overriding
	  vboot's hwcrypto API with its own crypto accelerator IP instead (or
	  you're trying really hard to save on code size).

endif
```
