/*
 * This file is part of the coreboot project.
 *
 * Copyright (C) 2008 Corey Osgood <corey.osgood@gmail.com>
 *
 * This program is free software; you can redistribute it and/or modify
 * it under the terms of the GNU General Public License as published by
 * the Free Software Foundation; either version 2 of the License, or
 * (at your option) any later version.
 *
 * This program is distributed in the hope that it will be useful,
 * but WITHOUT ANY WARRANTY; without even the implied warranty of
 * MERCHANTABILITY or FITNESS FOR A PARTICULAR PURPOSE.  See the
 * GNU General Public License for more details.
 *
 * You should have received a copy of the GNU General Public License
 * along with this program; if not, write to the Free Software
 * Foundation, Inc., 51 Franklin St, Fifth Floor, Boston, MA  02110-1301 USA
 */

{
	device_operations = "vt8237r_lpc";
	enable_keyboard = "1";
	acpi_io_base = "0x500";
	acpi_irq = "0x9";
	apic_id = "0x2";
	apic_base = "0xfec00000ULL";	

	/* These are unused by vt8237r, but necessary to use
	 * the same driver for vt8237s */
	spi_mem_base = "0";
	hpet_addr = "0";
};

{
	device_operations = "vt8237s_lpc";
	enable_keyboard = "1";
	acpi_io_base = "0x500";
	acpi_irq = "0x9";
	apic_id = "0x2";
	apic_base = "0xfec00000ULL";	
	spi_mem_base = "0xfed02000ULL";
	hpet_addr = "0xfed00000ULL";
};
