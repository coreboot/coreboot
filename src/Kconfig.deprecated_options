## src/Kconfig.deprecated_options
```kconfig
# Options in this file are meant to be deprecated. Avoid their use
# if possible, and if you find the time, or touch the general area
# for other purposes, please consider removing their uses.

menu "Deprecated"

# It might be possible to consolidate hard_reset() to southbridges,
# given that it (usually) uses its registers.
# The long term goal would be to eliminate hard_reset() from boards.
config BOARD_HAS_HARD_RESET
	bool
	default n
	help
	  This variable specifies whether a given board has a reset.c
	  file containing a hard_reset() function.

# Will be removed (alongside with the PS/2 init code) once payloads
# reliably support PS/2 init themselves.
config DRIVERS_PS2_KEYBOARD
	bool "PS/2 keyboard init"
	default y
	help
	  Enable this option to initialize PS/2 keyboards found connected
	  to the PS/2 port.

	  Some payloads (eg, filo) require this option.  Other payloads
	  (eg, SeaBIOS, Linux) do not require it.
	  Initializing a PS/2 keyboard can take several hundred milliseconds.

	  If you know you will only use a payload which does not require
	  this option, then you can say N here to speed up boot time.
	  Otherwise say Y.

# This was a config option for a long time, but it never showed up in Kconfig.
# It should go away and "tuning" should always be enabled when PCIe is there,
# or it should be more fine grained (ie. Enable PCIe ASPM)
config PCIE_TUNING
	bool
	default n
	help
	  This variable enables certain PCIe optimizations. Right now it's
	  only ASPM and it's untested.

config ID_SECTION_OFFSET
	hex
	default 0x80

endmenu
```

## src/acpi/Kconfig
```kconfig
# SPDX-License-Identifier: GPL-2.0-only

config ACPI_AMD_HARDWARE_SLEEP_VALUES
	def_bool n
	help
	  Provide common definitions for AMD hardware PM1_CNT register sleep
	  values.

config ACPI_CPU_STRING
	string
	default "CP%02X"
	depends on HAVE_ACPI_TABLES
	help
	  Specifies the ACPI name format string used by the acpigen
	  function to generate the processor scope. Default is CPxx.

config ACPI_FNKEY_GEN_SCANCODE
	int
	default 0
	help
	  Specifies the scancode, if any, which is generated when the Fn key is
	  pressed. A value of 0 is ignored, which is the default since most
	  keyboards do not emit a scancode for the Fn key.

config ACPI_HAVE_PCAT_8259
	def_bool y if !ACPI_NO_PCAT_8259

config ACPI_INTEL_HARDWARE_SLEEP_VALUES
	def_bool n
	help
	  Provide common definitions for Intel hardware PM1_CNT register sleep
	  values.

config ACPI_SOC_NVS
	bool
	help
	  Set to indicate <soc/nvs.h> exists for the platform with a definition
	  for global_nvs.

config ACPI_GNVS_USB_CHARGECTL
	bool
	depends on ACPI_SOC_NVS
	help
	  Set to indicate <soc/nvs.h> implements fields s3u0, s3u1, s5u0, s5u1
	  to control USB port power rail for S3/S4/S5 sleep states.

config ACPI_CUSTOM_MADT
	bool
	default n if ACPI_NO_CUSTOM_MADT
	default y
	help
	  Selected by platforms that need to expose custom MADT entries.

config ACPI_NO_CUSTOM_MADT
	bool
	default y if ACPI_COMMON_MADT_LAPIC && ACPI_COMMON_MADT_IOAPIC

config ACPI_COMMON_MADT_LAPIC
	bool

config ACPI_COMMON_MADT_IOAPIC
	bool

config ACPI_COMMON_MADT_GICC_V3
	bool
	depends on ARCH_ARM64

config ACPI_NO_PCAT_8259
	bool
	help
	  Selected by platforms that don't expose a PC/AT 8259 PIC pair.

config ACPI_EINJ
	def_bool n
	depends on HAVE_ACPI_TABLES
	help
	  This variable provides control for ACPI error injection table (EINJ)

config HAVE_ACPI_TABLES
	bool
	help
	  This variable specifies whether a given board has ACPI table support.
	  It is usually set in mainboard/*/Kconfig.

config ACPI_LPIT
	bool
	depends on HAVE_ACPI_TABLES
	help
	  Selected by platforms that support and fill Intel Low Power Idle Table.

config ACPI_GTDT
	bool
	depends on HAVE_ACPI_TABLES
	help
	  Selected by platforms that implement ARM generic timers

config ACPI_IORT
	def_bool n
	depends on ARCH_ARM64 && HAVE_ACPI_TABLES
	help
	  Selected by platforms that implement ARM IO Remap table.

config MAX_ACPI_TABLE_SIZE_KB
	int
	default 144
	help
	  Set the maximum size of all ACPI tables in KiB.

config ACPI_PPTT
	bool
	depends on HAVE_ACPI_TABLES
	help
	  Selected to build an ACPI Processor Properties Topology Table.

config ACPI_PPTT_MAX_CACHES
	int
	depends on ACPI_PPTT
	default 4
	help
	  This variable sets the maximum number of distinct caches per
	  topology level. Increasing this option also increases stack usage.

config ACPI_WDAT_WDT
	bool
	default n
	depends on HAVE_ACPI_TABLES
	help
	  Selected by platforms that support and fill ACPI Watchdog Action Table
	  (WDAT).

config ACPI_HEST
	bool
	depends on HAVE_ACPI_TABLES
	help
	  Selected by platforms that support and fill ACPI Hardware Error Source Table (HEST)

config ACPI_HEST_ERROR_LOG_BUFFER_SIZE
	hex
	default 0x4000
	depends on ACPI_HEST
	help
	  Define the size of the HEST ACPI error log buffer
```

## src/arch/aarch64/Kconfig
```kconfig
menu "Architecture (aarch64)"

config ARM_AARCH64_OPTIONS
	bool
	default y
#	select HAVE_ARCH_MEMSET
#	select HAVE_ARCH_MEMCPY
#	select HAVE_ARCH_MEMMOVE

# Maximum reboot count
# TODO: Improve description.
config MAX_REBOOT_CNT
	int
	default 3

config BOOTBLOCK_SOURCE
	string
	default "bootblock_simple.c"

config UPDATE_IMAGE
	bool "Update existing coreboot.rom image"
	default n
	help
	  If this option is enabled, no new coreboot.rom file
	  is created. Instead it is expected that there already
	  is a suitable file for further processing.
	  The bootblock will not be modified.

endmenu
```

## src/arch/arm/Kconfig
```kconfig
## SPDX-License-Identifier: GPL-2.0-only

config ARCH_ARM
	bool
	select CLANG_UNSUPPORTED

config ARCH_BOOTBLOCK_ARM
	bool
	select ARCH_ARM

config ARCH_VERSTAGE_ARM
	bool
	select ARCH_ARM

config ARCH_ROMSTAGE_ARM
	bool
	select ARCH_ARM

config ARCH_RAMSTAGE_ARM
	bool
	select ARCH_ARM

source "src/arch/arm/armv4/Kconfig"
source "src/arch/arm/armv7/Kconfig"

config ARM_LPAE
	bool
	default n
```

## src/arch/arm/armv4/Kconfig
```kconfig
config ARCH_BOOTBLOCK_ARMV4
	bool
	select ARCH_BOOTBLOCK_ARM

config ARCH_VERSTAGE_ARMV4
	bool
	select ARCH_VERSTAGE_ARM

config ARCH_ROMSTAGE_ARMV4
	bool
	select ARCH_ROMSTAGE_ARM

config ARCH_RAMSTAGE_ARMV4
	bool
	select ARCH_RAMSTAGE_ARM
```

## src/arch/arm/armv7/Kconfig
```kconfig
config ARCH_BOOTBLOCK_ARMV7
	bool
	select ARCH_BOOTBLOCK_ARM

config ARCH_VERSTAGE_ARMV7
	bool
	select ARCH_VERSTAGE_ARM

config ARCH_ROMSTAGE_ARMV7
	bool
	select ARCH_ROMSTAGE_ARM

config ARCH_RAMSTAGE_ARMV7
	bool
	select ARCH_RAMSTAGE_ARM

config ARCH_BOOTBLOCK_ARMV7_M
	bool
	select ARCH_BOOTBLOCK_ARM

config ARCH_VERSTAGE_ARMV7_M
	bool
	select ARCH_VERSTAGE_ARM

config ARCH_BOOTBLOCK_ARMV7_R
	bool
	select ARCH_BOOTBLOCK_ARM

config ARCH_VERSTAGE_ARMV7_R
	bool
	select ARCH_VERSTAGE_ARM

config ARCH_ROMSTAGE_ARMV7_R
	bool
	select ARCH_ROMSTAGE_ARM

config ARCH_RAMSTAGE_ARMV7_R
	bool
	select ARCH_RAMSTAGE_ARM
```

## src/arch/arm64/Kconfig
```kconfig
## SPDX-License-Identifier: GPL-2.0-only

config ARCH_ARM64
	bool

config ARCH_BOOTBLOCK_ARM64
	bool
	select ARCH_ARM64

config ARCH_VERSTAGE_ARM64
	bool
	select ARCH_ARM64

config ARCH_ROMSTAGE_ARM64
	bool
	select ARCH_ARM64

config ARCH_RAMSTAGE_ARM64
	bool
	select ARCH_ARM64

source "src/arch/arm64/armv8/Kconfig"

if ARCH_ARM64

config ARM64_CURRENT_EL
	int
	default 3
	range 1 3
	help
	  The exception level on which coreboot is started. Accepted
	  values are: 1 (EL1), 2 (EL2) and 3 (EL3). This option can be
	  used to restrict access to available control registers in case
	  prior firmware already dropped to a lower exception level. By default,
	  coreboot is the first firmware that runs on the system and should thus
	  always run on EL3. This option is only provided for edge-case platforms
	  that require running a different firmware before coreboot which drops
	  to a lower exception level.

config ARM64_USE_ARCH_TIMER
	bool
	default n

config ARM64_USE_ARM_TRUSTED_FIRMWARE
	bool
	default n
	depends on ARCH_RAMSTAGE_ARM64 && ARM64_CURRENT_EL = 3

config ARM64_BL31_OPTEE_WITH_SMC
	bool "Build OP-TEE dispatcher for BL31 and allow loading via an SMC"
	default n
	depends on ARM64_USE_ARM_TRUSTED_FIRMWARE
	help
	  This option adds support for building the OP-TEE Secure Payload Dispatcher
	  (SPD) for BL31, and allows loading the OP-TEE image via a Secure Monitor Call
	  (SMC).

config ARM64_BL31_EXTERNAL_FILE
	string "Path to external BL31.ELF (leave empty to build from source)"
	depends on ARM64_USE_ARM_TRUSTED_FIRMWARE
	help
	  The blob to use instead of building the Arm Trusted Firmware
	  from tree. It is discouraged as compatibility with out-of-tree
	  blobs may break anytime.

config ARM64_USE_SECURE_OS
	bool
	default n
	depends on ARM64_USE_ARM_TRUSTED_FIRMWARE

config ARM64_SECURE_OS_FILE
	string "Secure OS binary file"
	depends on ARM64_USE_SECURE_OS
	help
	  Secure OS binary file.

config ARM64_A53_ERRATUM_843419
	bool
	default n
	help
	  Some early Cortex-A53 revisions had a hardware bug that results in
	  incorrect address calculations in rare cases. This option enables a
	  linker workaround to avoid those cases if your toolchain supports it.
	  Should be selected automatically by SoCs that are affected.

endif # if ARCH_ARM64
```

## src/arch/arm64/armv8/Kconfig
```kconfig
config ARCH_BOOTBLOCK_ARMV8_64
	bool
	select ARCH_BOOTBLOCK_ARM64

config ARCH_VERSTAGE_ARMV8_64
	bool
	select ARCH_VERSTAGE_ARM64

config ARCH_ROMSTAGE_ARMV8_64
	bool
	select ARCH_ROMSTAGE_ARM64

config ARCH_RAMSTAGE_ARMV8_64
	bool
	select ARCH_RAMSTAGE_ARM64

if ARCH_ARM64

config ARCH_ARMV8_EXTENSION
	int
	default 0
	help
	  Specify ARMv8 extension, for example '1' for ARMv8.1, to control the
	  '-march' option passed into the compiler. Defaults to 0 for vanilla
	  ARMv8 but may be overridden in the SoC's Kconfig.

	  All ARMv8 implementations are downwards-compatible, so this does not
	  need to be changed unless specific features (e.g. new instructions)
	  are used by the SoC's coreboot code.

endif # ARCH_ARM64
```

## src/arch/armv7/Kconfig
```kconfig
config ARCH_BOOTBLOCK_ARMV7
	bool
	default n
	select ARCH_ARMV7

config ARCH_ROMSTAGE_ARMV7
	bool
	default n

config ARCH_RAMSTAGE_ARMV7
	bool
	default n

# If a custom bootblock is necessary, this option should be "select"-ed by
# the thing that needs it, probably the CPU.
config ARM_BOOTBLOCK_CUSTOM
	bool
	default n

config CPU_HAS_BOOTBLOCK_INIT
	bool
	default n

config MAINBOARD_HAS_BOOTBLOCK_INIT
	bool
	default n
```

## src/arch/i386/Kconfig
```kconfig
# This option is used to set the architecture of a mainboard to X86.
# It is usually set in mainboard/*/Kconfig.
config ARCH_X86
	bool
	default n

# This is an SMP option. It relates to starting up APs.
# It is usually set in mainboard/*/Kconfig.
# TODO: Improve description.
config AP_IN_SIPI_WAIT
	bool
	default n
	depends on ARCH_X86

# This is the name of the respective architecture subdirectory in arch/.
config ARCH
	string
	default i386
	depends on ARCH_X86

config ROMBASE
	hex
	default 0xffff0000

config ROM_IMAGE_SIZE
	hex
	default 0x10000

config RAMBASE
	hex
	default 0x100000

config RAMTOP
	hex
	default 0x200000

config STACK_SIZE
	hex
	default 0x8000

# Maximum reboot count
# TODO: Improve description.
config MAX_REBOOT_CNT
	int
	default 3

config TINY_BOOTBLOCK
	bool
	default n

config BIG_BOOTBLOCK
	bool
	default n if TINY_BOOTBLOCK
	default y

choice
	prompt "Bootblock behaviour"
	default BOOTBLOCK_SIMPLE
	depends on TINY_BOOTBLOCK

config BOOTBLOCK_SIMPLE
	bool "Always load fallback"

config BOOTBLOCK_NORMAL
	bool "Switch to normal if CMOS says so"

endchoice

config BOOTBLOCK_SOURCE
	string
	default "bootblock_simple.c" if BOOTBLOCK_SIMPLE
	default "bootblock_normal.c" if BOOTBLOCK_NORMAL

config UPDATE_IMAGE
	bool "Update existing coreboot.rom image"
	default n
	depends on TINY_BOOTBLOCK
	help
	  If this option is enabled, no new coreboot.rom file
	  is created. Instead it is expected that there already
	  is a suitable file for further processing.
	  The bootblock will not be modified.

config ROMCC
	bool
	default n

config BOOTBLOCK_NORTHBRIDGE_INIT
	string

config BOOTBLOCK_SOUTHBRIDGE_INIT
	string
```

## src/arch/mips/Kconfig
```kconfig
#
# This file is part of the coreboot project.
#
# Copyright (C) 2014 Imagination Technologies
#
# This program is free software; you can redistribute it and/or
# modify it under the terms of the GNU General Public License as
# published by the Free Software Foundation; version 2 of
# the License.
#
# This program is distributed in the hope that it will be useful,
# but WITHOUT ANY WARRANTY; without even the implied warranty of
# MERCHANTABILITY or FITNESS FOR A PARTICULAR PURPOSE.  See the
# GNU General Public License for more details.
#

config ARCH_MIPS
	bool
	default n

config ARCH_BOOTBLOCK_MIPS
	bool
	default n
	select ARCH_MIPS
	select BOOTBLOCK_CUSTOM

config ARCH_VERSTAGE_MIPS
	bool
	default n

config ARCH_ROMSTAGE_MIPS
	bool
	default n

config ARCH_RAMSTAGE_MIPS
	bool
	default n
```

## src/arch/power8/Kconfig
```kconfig
config ARCH_POWER8
	bool
	default n

config ARCH_BOOTBLOCK_POWER8
	bool
	default n
	select ARCH_POWER8
	select BOOTBLOCK_CUSTOM
	select C_ENVIRONMENT_BOOTBLOCK
	select ARCH_VERSTAGE_POWER8
	select ARCH_ROMSTAGE_POWER8
	select ARCH_RAMSTAGE_POWER8

config ARCH_VERSTAGE_POWER8
	bool
	default n

config ARCH_ROMSTAGE_POWER8
	bool
	default n

config ARCH_RAMSTAGE_POWER8
	bool
	default n
```

## src/arch/ppc/Kconfig
```kconfig
# This option is used to set the architecture of a mainboard to PowerPC.
# It is usually set in mainboard/*/Kconfig.
config ARCH_POWERPC
	bool

# This is the name of the respective architecture subdirectory in arch/.
config ARCH
	string
	default ppc
	depends on ARCH_POWERPC
```

## src/arch/ppc64/Kconfig
```kconfig
## SPDX-License-Identifier: GPL-2.0-only

config ARCH_PPC64
	bool

config ARCH_BOOTBLOCK_PPC64
	bool
	select ARCH_PPC64
	select BOOTBLOCK_CUSTOM

config ARCH_VERSTAGE_PPC64
	bool
	select ARCH_PPC64

config ARCH_ROMSTAGE_PPC64
	bool
	select ARCH_PPC64

config ARCH_RAMSTAGE_PPC64
	bool
	select ARCH_PPC64
```
