## src/cpu/amd/agesa/family14/Kconfig
```kconfig
# SPDX-License-Identifier: GPL-2.0-only

config CPU_AMD_AGESA_FAMILY14
	bool
	select X86_AMD_FIXED_MTRRS
	select CPU_X86_CACHE_HELPER

if CPU_AMD_AGESA_FAMILY14

config CPU_ADDR_BITS
	int
	default 36

endif
```

## src/cpu/amd/agesa/family15tn/Kconfig
```kconfig
# SPDX-License-Identifier: GPL-2.0-only

config CPU_AMD_AGESA_FAMILY15_TN
	bool
	select IDS_OPTIONS_HOOKED_UP
	select X86_AMD_FIXED_MTRRS
```

## src/cpu/amd/agesa/family16kb/Kconfig
```kconfig
# SPDX-License-Identifier: GPL-2.0-only

config CPU_AMD_AGESA_FAMILY16_KB
	bool
	select SMM_ASEG
	select X86_AMD_FIXED_MTRRS

if CPU_AMD_AGESA_FAMILY16_KB

config FORCE_AM1_SOCKET_SUPPORT
	bool
	default n
	help
		Force AGESA to ignore package type mismatch between CPU and northbridge
		in memory code. This enables Socket AM1 support with current AGESA
		version for Kabini platform.
		Enable this option only if you have Socket AM1 board.
		Note that the AGESA release shipped with coreboot does not officially
		support the AM1 socket. Selecting this option might damage your hardware.

endif
```

## src/cpu/amd/agesa_wrapper/family14/Kconfig
```kconfig
#
# This file is part of the coreboot project.
#
# Copyright (C) 2011 Advanced Micro Devices, Inc.
#
# This program is free software; you can redistribute it and/or modify
# it under the terms of the GNU General Public License as published by
# the Free Software Foundation; version 2 of the License.
#
# This program is distributed in the hope that it will be useful,
# but WITHOUT ANY WARRANTY; without even the implied warranty of
# MERCHANTABILITY or FITNESS FOR A PARTICULAR PURPOSE.  See the
# GNU General Public License for more details.
#
# You should have received a copy of the GNU General Public License
# along with this program; if not, write to the Free Software
# Foundation, Inc., 51 Franklin St, Fifth Floor, Boston, MA  02110-1301 USA
#

config CPU_AMD_AGESA_WRAPPER_FAMILY14
	bool
	select PCI_IO_CFG_EXT

config CPU_ADDR_BITS
	int
	default 36
	depends on CPU_AMD_AGESA_WRAPPER_FAMILY14

config CPU_SOCKET_TYPE
	hex
	default 0x10
	depends on CPU_AMD_AGESA_WRAPPER_FAMILY14

# DDR2 and REG
config DIMM_SUPPORT
	hex
	default 0x0104
	depends on CPU_AMD_AGESA_WRAPPER_FAMILY14

config EXT_RT_TBL_SUPPORT
	bool
	default n
	depends on CPU_AMD_AGESA_WRAPPER_FAMILY14

config EXT_CONF_SUPPORT
	bool
	default n
	depends on CPU_AMD_AGESA_WRAPPER_FAMILY14

config CBB
	hex
	default 0x0
	depends on CPU_AMD_AGESA_WRAPPER_FAMILY14

config CDB
	hex
	default 0x18
	depends on CPU_AMD_AGESA_WRAPPER_FAMILY14

config XIP_ROM_BASE
	hex
	default 0xfff80000
	depends on CPU_AMD_AGESA_WRAPPER_FAMILY14

config XIP_ROM_SIZE
	hex
	default 0x80000
	depends on CPU_AMD_AGESA_WRAPPER_FAMILY14
	
config HAVE_INIT_TIMER
	bool
	default y
	depends on CPU_AMD_AGESA_WRAPPER_FAMILY14 
		
```

## src/cpu/amd/family_10h-family_15h/Kconfig
```kconfig
config CPU_AMD_MODEL_10XXX
	bool
	select ARCH_BOOTBLOCK_X86_32
	select ARCH_VERSTAGE_X86_32
	select ARCH_ROMSTAGE_X86_32
	select ARCH_RAMSTAGE_X86_32
	select SSE
	select SSE2
	select TSC_SYNC_LFENCE
	select UDELAY_LAPIC
	select HAVE_MONOTONIC_TIMER
	select SUPPORT_CPU_UCODE_IN_CBFS
	select CPU_MICROCODE_MULTIPLE_FILES if !CPU_MICROCODE_CBFS_NONE
	select ACPI_HUGE_LOWMEM_BACKUP

if CPU_AMD_MODEL_10XXX

config USE_LARGE_DCACHE
	bool
	default y if CPU_AMD_SOCKET_G34_NON_AGESA
	default y if CPU_AMD_SOCKET_FM2_NON_AGESA
	default y if CPU_AMD_SOCKET_C32_NON_AGESA
	default n

config NUM_IPI_STARTS
	int
	default 1

config CPU_ADDR_BITS
	int
	default 48

config DCACHE_RAM_BASE
	hex
	default 0xc4000

config DCACHE_RAM_SIZE
	hex
	default 0x0c000

config DCACHE_BSP_STACK_SIZE
	hex
	default 0x4000

config DCACHE_BSP_STACK_SLUSH
	hex
	default 0x4000 if USE_LARGE_DCACHE
	default 0x1000

config DCACHE_AP_STACK_SIZE
	hex
	default 0x500

config SET_FIDVID
	bool
	default y

config MAX_PHYSICAL_CPUS
	int
	default 1

config LIFT_BSP_APIC_ID
	bool
	default n

if SET_FIDVID
config SET_FIDVID_DEBUG
	bool
	default y

config SET_FIDVID_STORE_AP_APICID_AT_FIRST
	bool
	default y

config SET_FIDVID_CORE0_ONLY
	bool
	default n

# 0: all cores
# 1: core 0 only
# 2: all but core 0
config SET_FIDVID_CORE_RANGE
	int
	default 0

endif	# SET_FIDVID

config UDELAY_LAPIC_FIXED_FSB
	int
	default 200

endif	# CPU_AMD_MODEL_10XXX
```

## src/cpu/amd/geode_gx2/Kconfig
```kconfig
##
## This file is part of the coreboot project.
##
## Copyright (C) 2010 coresystems GmbH
##
## This program is free software; you can redistribute it and/or modify
## it under the terms of the GNU General Public License as published by
## the Free Software Foundation; version 2 of the License.
##
## This program is distributed in the hope that it will be useful,
## but WITHOUT ANY WARRANTY; without even the implied warranty of
## MERCHANTABILITY or FITNESS FOR A PARTICULAR PURPOSE.  See the
## GNU General Public License for more details.
##

config CPU_AMD_GEODE_GX2
	bool
	select ARCH_BOOTBLOCK_X86_32
	select ARCH_VERSTAGE_X86_32
	select ARCH_ROMSTAGE_X86_32
	select ARCH_RAMSTAGE_X86_32

if CPU_AMD_GEODE_GX2

config CPU_SPECIFIC_OPTIONS
	def_bool y
	select NO_MMCONF_SUPPORT

config DCACHE_RAM_BASE
	hex
	default 0xc8000

config DCACHE_RAM_SIZE
	hex
	default 0x04000

config DCACHE_BSP_STACK_SIZE
	hex
	default 0x1000

config DCACHE_BSP_STACK_SLUSH
	hex
	default 0x1000

config DCACHE_AP_STACK_SIZE
	hex
	default 0x400

config GEODE_VSA
	bool
	default y

config GEODE_VSA_FILE
	bool "Add a VSA image"
	help
	  Select this option if you have an AMD Geode GX2 vsa that you would
	  like to add to your ROM.

	  You will be able to specify the location and file name of the
	  image later.

config VSA_FILENAME
	string "AMD Geode GX2 VSA path and filename"
	depends on GEODE_VSA_FILE
	default "gpl_vsa_gx_102.bin"
	help
	  The path and filename of the file to use as VSA.

endif # CPU_AMD_GEODE_GX2
```

## src/cpu/amd/geode_lx/Kconfig
```kconfig
config CPU_AMD_GEODE_LX
	bool
	select ARCH_BOOTBLOCK_X86_32
	select ARCH_VERSTAGE_X86_32
	select ARCH_ROMSTAGE_X86_32
	select ARCH_RAMSTAGE_X86_32

if CPU_AMD_GEODE_LX

config CPU_SPECIFIC_OPTIONS
	def_bool y
	select NO_MMCONF_SUPPORT
	select TSC_MONOTONIC_TIMER

config DCACHE_RAM_BASE
	hex
	default 0xc8000

config DCACHE_RAM_SIZE
	hex
	default 0x8000

config DCACHE_BSP_STACK_SIZE
	hex
	default 0x2000

config DCACHE_BSP_STACK_SLUSH
	hex
	default 0x1000

config DCACHE_AP_STACK_SIZE
	hex
	default 0x400

config GEODE_VSA
	bool
	default y

config GEODE_VSA_FILE
	bool "Add a VSA image"
	default y
	help
	  Select this option if you have an AMD Geode LX vsa that you would
	  like to add to your ROM.

	  You will be able to specify the location and file name of the
	  image later.

config VSA_FILENAME
	string "AMD Geode LX VSA path and filename"
	depends on GEODE_VSA_FILE
	default "3rdparty/blobs/cpu/amd/geode_lx/gpl_vsa_lx_102.bin"
	help
	  The path and filename of the file to use as VSA.

endif # CPU_AMD_GEODE_LX
```

## src/cpu/amd/model_10xxx/Kconfig
```kconfig
config CPU_AMD_MODEL_10XXX
	bool
	select ARCH_BOOTBLOCK_X86_32
	select ARCH_VERSTAGE_X86_32
	select ARCH_ROMSTAGE_X86_32
	select ARCH_RAMSTAGE_X86_32
	select SSE
	select SSE2
	select MMCONF_SUPPORT_DEFAULT
	select TSC_SYNC_LFENCE
	select UDELAY_LAPIC
	select HAVE_MONOTONIC_TIMER
	select SUPPORT_CPU_UCODE_IN_CBFS

if CPU_AMD_MODEL_10XXX

config NUM_IPI_STARTS
	int
	default 1

config CPU_ADDR_BITS
	int
	default 48

config DCACHE_RAM_BASE
	hex
	default 0xc4000

config DCACHE_RAM_SIZE
	hex
	default 0x0c000

config UDELAY_IO
	bool
	default n

config SET_FIDVID
	bool
	default y

config MAX_PHYSICAL_CPUS
	int
	default 1

config LIFT_BSP_APIC_ID
	bool
	default n

if SET_FIDVID
config SET_FIDVID_DEBUG
	bool
	default y

config SET_FIDVID_STORE_AP_APICID_AT_FIRST
	bool
	default y

config SET_FIDVID_CORE0_ONLY
	bool
	default n

# 0: all cores
# 1: core 0 only
# 2: all but core 0
config SET_FIDVID_CORE_RANGE
	int
	default 0

endif	# SET_FIDVID

config UDELAY_LAPIC_FIXED_FSB
	int
	default 200

config CONSOLE_PRERAM_BUFFER_SIZE
	hex
	default 0x0 if CONSOLE_PRERAM_BUFFER_BASE = 0xabadbeef
	default 0x8000

endif	# CPU_AMD_MODEL_10XXX
```

## src/cpu/amd/model_fxx/Kconfig
```kconfig
config CPU_AMD_MODEL_FXX
	bool
	select ARCH_BOOTBLOCK_X86_32
	select ARCH_VERSTAGE_X86_32
	select ARCH_ROMSTAGE_X86_32
	select ARCH_RAMSTAGE_X86_32
	select MMX
	select SSE
	select SSE2
	select TSC_SYNC_LFENCE
	select UDELAY_LAPIC
	select SUPPORT_CPU_UCODE_IN_CBFS
	select ACPI_HUGE_LOWMEM_BACKUP

if CPU_AMD_MODEL_FXX
config CPU_ADDR_BITS
	int
	default 40

config MAX_PHYSICAL_CPUS
	int
	default 1

config LIFT_BSP_APIC_ID
	bool
	default n

config SET_FIDVID
	bool
	default y if K8_REV_F_SUPPORT
	default n

config HW_SCRUBBER
	bool
	default n

config UDELAY_LAPIC_FIXED_FSB
	int
	default 200

if SET_FIDVID
config SET_FIDVID_DEBUG
	bool
	default n

config SET_FIDVID_CORE0_ONLY
	bool
	default y

config SET_FIDVID_ONE_BY_ONE
	bool
	default y

config SET_FIDVID_STORE_AP_APICID_AT_FIRST
	bool
	default y
endif
endif
```

## src/cpu/amd/model_gx2/Kconfig
```kconfig
##
## This file is part of the coreboot project.
##
## Copyright (C) 2010 coresystems GmbH
##
## This program is free software; you can redistribute it and/or modify
## it under the terms of the GNU General Public License as published by
## the Free Software Foundation; version 2 of the License.
##
## This program is distributed in the hope that it will be useful,
## but WITHOUT ANY WARRANTY; without even the implied warranty of
## MERCHANTABILITY or FITNESS FOR A PARTICULAR PURPOSE.  See the
## GNU General Public License for more details.
##
## You should have received a copy of the GNU General Public License
## along with this program; if not, write to the Free Software
## Foundation, Inc., 51 Franklin St, Fifth Floor, Boston, MA  02110-1301 USA
##

config CPU_AMD_GX2
	bool

config DCACHE_RAM_BASE
	hex
	default 0xc0000
	depends on CPU_AMD_GX2

config DCACHE_RAM_SIZE
	hex
	default 0x01000
	depends on CPU_AMD_GX2

config GEODE_VSA
	bool "Add a VSA image"
	depends on CPU_AMD_GX2
	help
	  Select this option if you have an AMD Geode GX2 vsa that you would
	  like to add to your ROM.

	  You will be able to specify the location and file name of the
	  image later.

config VSA_FILE
	string "AMD Geode GX2 VSA path and filename"
	depends on GEODE_VSA && CPU_AMD_GX2
	default "gpl_vsa_gx_102.bin"
	help
	  The path and filename of the file to use as VSA.
```

## src/cpu/amd/model_lx/Kconfig
```kconfig
config CPU_AMD_LX
	bool

if CPU_AMD_LX

config CPU_SPECIFIC_OPTIONS
	def_bool y
	select CACHE_AS_RAM

config DCACHE_RAM_BASE
	hex
	default 0xc8000

config DCACHE_RAM_SIZE
	hex
	default 0x8000

config GEODE_VSA
	bool
	default y
	select PCI_OPTION_ROM_RUN_REALMODE

config GEODE_VSA_FILE
	bool "Add a VSA image"
	help
	  Select this option if you have an AMD Geode LX vsa that you would
	  like to add to your ROM.

	  You will be able to specify the location and file name of the
	  image later.

config VSA_FILENAME
	string "AMD Geode LX VSA path and filename"
	depends on GEODE_VSA_FILE
	default "gpl_vsa_lx_102.bin"
	help
	  The path and filename of the file to use as VSA.

endif # CPU_AMD_LX
```

## src/cpu/amd/pi/00630F01/Kconfig
```kconfig
# SPDX-License-Identifier: GPL-2.0-only

config CPU_AMD_PI_00630F01
	bool
	select X86_AMD_FIXED_MTRRS

if CPU_AMD_PI_00630F01

config CPU_ADDR_BITS
	int
	default 48

endif
```

## src/cpu/amd/pi/00660F01/Kconfig
```kconfig
# SPDX-License-Identifier: GPL-2.0-only

config CPU_AMD_PI_00660F01
	bool
	select X86_AMD_FIXED_MTRRS

if CPU_AMD_PI_00660F01

config CPU_ADDR_BITS
	int
	default 48

endif
```

## src/cpu/amd/pi/00730F01/Kconfig
```kconfig
# SPDX-License-Identifier: GPL-2.0-only

config CPU_AMD_PI_00730F01
	bool
	select X86_AMD_FIXED_MTRRS
	select SUPPORT_CPU_UCODE_IN_CBFS
	select MICROCODE_BLOB_UNDISCLOSED

if CPU_AMD_PI_00730F01

config ACPI_CPU_STRING
	string
	default "P%03d"

endif # CPU_AMD_PI_00730F01
```

## src/cpu/amd/pi/Kconfig
```kconfig
# SPDX-License-Identifier: GPL-2.0-only

config CPU_AMD_PI
	bool
	default y if CPU_AMD_PI_00630F01
	default y if CPU_AMD_PI_00730F01
	default n
	select ARCH_ALL_STAGES_X86_32
	select DRIVERS_AMD_PI
	select TSC_SYNC_LFENCE
	select UDELAY_LAPIC
	select LAPIC_MONOTONIC_TIMER
	select SPI_FLASH if HAVE_ACPI_RESUME
	select SMM_ASEG
	select SSE2
	select ACPI_NO_SMI_GNVS

if CPU_AMD_PI

config UDELAY_LAPIC_FIXED_FSB
	int
	default 200

# TODO: Sync these with definitions in PI vendorcode.
# DCACHE_RAM_BASE must equal BSP_STACK_BASE_ADDR.
# DCACHE_RAM_SIZE must equal BSP_STACK_SIZE.

config DCACHE_RAM_BASE
	hex
	default 0x30000

config DCACHE_RAM_SIZE
	hex
	default 0x10000

config DCACHE_BSP_STACK_SIZE
	hex
	default 0x4000

config C_ENV_BOOTBLOCK_SIZE
	hex
	default 0x8000

endif # CPU_AMD_PI

source "src/cpu/amd/pi/00630F01/Kconfig"
source "src/cpu/amd/pi/00730F01/Kconfig"
```

## src/cpu/amd/sc520/Kconfig
```kconfig
config CPU_AMD_SC520
	bool
	select ARCH_BOOTBLOCK_X86_32
	select ARCH_ROMSTAGE_X86_32
	select ARCH_RAMSTAGE_X86_32
```

## src/cpu/amd/socket_754/Kconfig
```kconfig
config CPU_AMD_SOCKET_754
	bool

if CPU_AMD_SOCKET_754

config SOCKET_SPECIFIC_OPTIONS
	def_bool y
	select CPU_AMD_MODEL_FXX
	select X86_AMD_FIXED_MTRRS

config DCACHE_RAM_BASE
	hex
	default 0xc8000

config DCACHE_RAM_SIZE
	hex
	default 0x08000

config DCACHE_BSP_STACK_SIZE
	hex
	default 0x2000

config DCACHE_BSP_STACK_SLUSH
	hex
	default 0x1000

config DCACHE_AP_STACK_SIZE
	hex
	default 0x400

endif # CPU_AMD_SOCKET_754
```

## src/cpu/amd/socket_939/Kconfig
```kconfig
config CPU_AMD_SOCKET_939
	bool
	select CPU_AMD_MODEL_FXX
	select X86_AMD_FIXED_MTRRS
```

## src/cpu/amd/socket_940/Kconfig
```kconfig
config CPU_AMD_SOCKET_940
	bool

if CPU_AMD_SOCKET_940

config SOCKET_SPECIFIC_OPTIONS
	def_bool y
	select K8_HT_FREQ_1G_SUPPORT
	select CPU_AMD_MODEL_FXX
	select X86_AMD_FIXED_MTRRS

config DCACHE_RAM_BASE
	hex
	default 0xc8000

config DCACHE_RAM_SIZE
	hex
	default 0x08000

config DCACHE_BSP_STACK_SIZE
	hex
	default 0x2000

config DCACHE_BSP_STACK_SLUSH
	hex
	default 0x1000

config DCACHE_AP_STACK_SIZE
	hex
	default 0x400

endif # CPU_AMD_SOCKET_940
```

## src/cpu/amd/socket_AM2/Kconfig
```kconfig
config CPU_AMD_SOCKET_AM2
	bool
	select K8_REV_F_SUPPORT
	# Opteron K8 1G HT support
	select K8_HT_FREQ_1G_SUPPORT
	select CPU_AMD_MODEL_FXX
	select CACHE_AS_RAM
	select X86_AMD_FIXED_MTRRS

config CPU_SOCKET_TYPE
	hex
	default 0x11
	depends on CPU_AMD_SOCKET_AM2
```

## src/cpu/amd/socket_AM2r2/Kconfig
```kconfig
config CPU_AMD_SOCKET_AM2R2
	bool
	select CPU_AMD_MODEL_10XXX
	select HT3_SUPPORT
	select PCI_IO_CFG_EXT
	select CACHE_AS_RAM
	select X86_AMD_FIXED_MTRRS

if CPU_AMD_SOCKET_AM2R2

config CPU_SOCKET_TYPE
	hex
	default 0x11

config EXT_RT_TBL_SUPPORT
	bool
	default n

config EXT_CONF_SUPPORT
	bool
	default n

config CBB
	hex
	default 0x0

config CDB
	hex
	default 0x18

config XIP_ROM_SIZE
	hex
	default 0x80000

endif
```

## src/cpu/amd/socket_ASB2/Kconfig
```kconfig
config CPU_AMD_SOCKET_ASB2
	bool
	select CPU_AMD_MODEL_10XXX
	select HT3_SUPPORT
	select PCI_IO_CFG_EXT
	select CACHE_AS_RAM

config CPU_SOCKET_TYPE
	hex
	default 0x13
	depends on CPU_AMD_SOCKET_ASB2

config EXT_RT_TBL_SUPPORT
	bool
	default n
	depends on CPU_AMD_SOCKET_ASB2

config EXT_CONF_SUPPORT
	bool
	default n
	depends on CPU_AMD_SOCKET_ASB2

config CBB
	hex
	default 0x0
	depends on CPU_AMD_SOCKET_ASB2

config CDB
	hex
	default 0x18
	depends on CPU_AMD_SOCKET_ASB2

config XIP_ROM_BASE
	hex
	default 0xfff80000
	depends on CPU_AMD_SOCKET_ASB2

config XIP_ROM_SIZE
	hex
	default 0x80000
	depends on CPU_AMD_SOCKET_ASB2
```
