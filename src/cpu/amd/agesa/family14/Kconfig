## src/cpu/amd/socket_C32/Kconfig
```kconfig
config CPU_AMD_SOCKET_C32_NON_AGESA
	bool
	select CPU_AMD_MODEL_10XXX
	select HT3_SUPPORT
	select PCI_IO_CFG_EXT
	select CACHE_AS_RAM
	select X86_AMD_FIXED_MTRRS

config CPU_SOCKET_TYPE
	hex
	default 0x14
	depends on CPU_AMD_SOCKET_C32_NON_AGESA

config EXT_RT_TBL_SUPPORT
	bool
	default n
	depends on CPU_AMD_SOCKET_C32_NON_AGESA

config EXT_CONF_SUPPORT
	bool
	default n
	depends on CPU_AMD_SOCKET_C32_NON_AGESA

config CBB
	hex
	default 0x0
	depends on CPU_AMD_SOCKET_C32_NON_AGESA

config CDB
	hex
	default 0x18
	depends on CPU_AMD_SOCKET_C32_NON_AGESA

config XIP_ROM_SIZE
	hex
	default 0x80000
	depends on CPU_AMD_SOCKET_C32_NON_AGESA
```

## src/cpu/amd/socket_F/Kconfig
```kconfig
config CPU_AMD_SOCKET_F
	bool
	select K8_REV_F_SUPPORT
	select K8_HT_FREQ_1G_SUPPORT
	select CPU_AMD_MODEL_FXX
	select CACHE_AS_RAM
	select X86_AMD_FIXED_MTRRS

config CPU_SOCKET_TYPE
	hex
	default 0x10
	depends on CPU_AMD_SOCKET_F
```

## src/cpu/amd/socket_F_1207/Kconfig
```kconfig
config CPU_AMD_SOCKET_F_1207
	bool
	select CPU_AMD_MODEL_10XXX
	select PCI_IO_CFG_EXT
	select CACHE_AS_RAM
	select X86_AMD_FIXED_MTRRS

if CPU_AMD_SOCKET_F_1207

config CPU_SOCKET_TYPE
	hex
	default 0x10

config EXT_RT_TBL_SUPPORT
	bool
	default n

config EXT_CONF_SUPPORT
	bool
	default n

config CBB
	hex
	default 0x0

config CDB
	hex
	default 0x18

config XIP_ROM_SIZE
	hex
	default 0x80000

endif
```
