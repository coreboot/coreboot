## src/cpu/amd/socket_S1G1/Kconfig
```kconfig
config CPU_AMD_SOCKET_S1G1
	bool

if CPU_AMD_SOCKET_S1G1

config SOCKET_SPECIFIC_OPTIONS
	def_bool y
	select K8_REV_F_SUPPORT
	select K8_HT_FREQ_1G_SUPPORT
	select CPU_AMD_MODEL_FXX
	select X86_AMD_FIXED_MTRRS

config CPU_SOCKET_TYPE
	hex
	default 0x12

#DDR2 and REG, S1G1
config DIMM_SUPPORT
	hex
	default 0x0204

config DCACHE_RAM_BASE
	hex
	default 0xc8000

config DCACHE_RAM_SIZE
	hex
	default 0x08000

config DCACHE_BSP_STACK_SIZE
	hex
	default 0x2000

config DCACHE_BSP_STACK_SLUSH
	hex
	default 0x1000

config DCACHE_AP_STACK_SIZE
	hex
	default 0x400

endif
```

## src/cpu/armltd/Kconfig
```kconfig
## SPDX-License-Identifier: GPL-2.0-only

source "src/cpu/armltd/cortex-a9/Kconfig"
```

## src/cpu/armltd/armv8/Kconfig
```kconfig
config BOOTBLOCK_CPU_INIT
	string
	default "cpu/armltd/armv8/bootblock.c"
	help
	  CPU/SoC-specific bootblock code.
```

## src/cpu/armltd/cortex-a9/Kconfig
```kconfig
config CPU_ARMLTD_CORTEX_A9
	bool
	select ARCH_BOOTBLOCK_ARMV7
	select ARCH_VERSTAGE_ARMV7
	select ARCH_ROMSTAGE_ARMV7
	select ARCH_RAMSTAGE_ARMV7
	default n

if CPU_ARMLTD_CORTEX_A9

endif
```

## src/cpu/dmp/vortex86ex/Kconfig
```kconfig
##
## This file is part of the coreboot project.
##
## Copyright (C) 2013 DMP Electronics Inc.
##
## This program is free software; you can redistribute it and/or modify
## it under the terms of the GNU General Public License as published by
## the Free Software Foundation; version 2 of the License.
##
## This program is distributed in the hope that it will be useful,
## but WITHOUT ANY WARRANTY; without even the implied warranty of
## MERCHANTABILITY or FITNESS FOR A PARTICULAR PURPOSE.  See the
## GNU General Public License for more details.
##
## You should have received a copy of the GNU General Public License
## along with this program; if not, write to the Free Software
## Foundation, Inc.
##

config CPU_DMP_VORTEX86EX
	bool

if CPU_DMP_VORTEX86EX

config CPU_SPECIFIC_OPTIONS
	def_bool y
	select ARCH_BOOTBLOCK_X86_32
	select ARCH_VERSTAGE_X86_32
	select ARCH_ROMSTAGE_X86_32
	select ARCH_RAMSTAGE_X86_32
	select UDELAY_TSC

# ROM Strap PLL config setting :

choice
	prompt "ROM Strap PLL config"
	default PLL_300_300_33

config PLL_200_200_33
	bool "CPU=200Mhz/DRAM=200Mhz/PCI=33Mhz"

config PLL_300_300_33
	bool "CPU=300Mhz/DRAM=300Mhz/PCI=33Mhz"

config PLL_300_300_100
	bool "CPU=300Mhz/DRAM=300Mhz/PCI=100Mhz"

config PLL_400_200_33
	bool "CPU=400Mhz/DRAM=200Mhz/PCI=33Mhz"

config PLL_400_200_100
	bool "CPU=400Mhz/DRAM=200Mhz/PCI=100Mhz"

config PLL_400_400_33
	bool "CPU=400Mhz/DRAM=400Mhz/PCI=33Mhz"

config PLL_500_250_33
	bool "CPU=500Mhz/DRAM=250Mhz/PCI=33Mhz"

config PLL_500_500_33
	bool "CPU=500Mhz/DRAM=500Mhz/PCI=33Mhz"

config PLL_400_300_33
	bool "CPU=400Mhz/DRAM=300Mhz/PCI=33Mhz"

config PLL_400_300_100
	bool "CPU=400Mhz/DRAM=300Mhz/PCI=100Mhz"

config PLL_444_333_33
	bool "CPU=444Mhz/DRAM=333Mhz/PCI=33Mhz"

config PLL_466_350_33
	bool "CPU=466Mhz/DRAM=350Mhz/PCI=33Mhz"

config PLL_500_375_33
	bool "CPU=500Mhz/DRAM=375Mhz/PCI=33Mhz"

endchoice

config CHIPSET_BOOTBLOCK_INCLUDE
	string
	default "cpu/dmp/vortex86ex/chipset_bootblock.inc"

endif
```

## src/cpu/intel/Kconfig
```kconfig
# CPU models
source "src/cpu/intel/model_6xx/Kconfig"
source "src/cpu/intel/model_65x/Kconfig"
source "src/cpu/intel/model_67x/Kconfig"
source "src/cpu/intel/model_68x/Kconfig"
source "src/cpu/intel/model_6bx/Kconfig"
source "src/cpu/intel/model_6ex/Kconfig"
source "src/cpu/intel/model_6fx/Kconfig"
source "src/cpu/intel/model_1067x/Kconfig"
source "src/cpu/intel/model_106cx/Kconfig"
source "src/cpu/intel/model_206ax/Kconfig"
source "src/cpu/intel/model_2065x/Kconfig"
source "src/cpu/intel/model_f3x/Kconfig"
source "src/cpu/intel/model_f4x/Kconfig"
source "src/cpu/intel/haswell/Kconfig"
# Sockets/Slots
source "src/cpu/intel/slot_1/Kconfig"
source "src/cpu/intel/socket_BGA956/Kconfig"
source "src/cpu/intel/socket_FCBGA559/Kconfig"
source "src/cpu/intel/socket_m/Kconfig"
source "src/cpu/intel/socket_p/Kconfig"
source "src/cpu/intel/socket_441/Kconfig"
source "src/cpu/intel/socket_LGA775/Kconfig"
# Architecture specific features
source "src/cpu/intel/fit/Kconfig"
source "src/cpu/intel/turbo/Kconfig"
source "src/cpu/intel/common/Kconfig"
source "src/cpu/intel/microcode/Kconfig"
source "src/cpu/intel/car/non-evict/Kconfig"
```

## src/cpu/intel/car/non-evict/Kconfig
```kconfig
config CPU_HAS_L2_ENABLE_MSR
	bool
	help
	  Select this in Kconfig of CPU sockets/SOC where the CPU
	  has an MSR to enable the L2 CPU cache
```

## src/cpu/intel/common/Kconfig
```kconfig
config CPU_INTEL_COMMON
	bool

if CPU_INTEL_COMMON

config ENABLE_VMX
	bool "Enable VMX for virtualization"
	default y

config SET_IA32_FC_LOCK_BIT
	bool "Set IA32_FEATURE_CONTROL lock bit"
	default y
	help
	  Although the Intel manual says you must set the lock bit in addition
	  to the VMX bit in order for VMX to work, this isn't strictly true, so
	  we have the option to leave it unlocked and allow the OS (e.g. Linux)
	  to manage things itself. This is beneficial for testing purposes as
	  there is no need to reflash the firmware just to toggle the lock bit.
	  However, leaving the lock bit unset will break Windows' detection of
	  VMX support and built-in virtualization features like Hyper-V.

config SET_MSR_AESNI_LOCK_BIT
	bool "Lock the AES-NI enablement state"
	default y
	help
	  This config sets the AES-NI lock bit, if available, to prevent any
	  further change of AES-NI enablement. This may be disabled for e.g.
	  testing or debugging.

config CPU_INTEL_COMMON_TIMEBASE
	bool

endif

config CPU_INTEL_COMMON_SMM
	bool
	default y if CPU_INTEL_COMMON
```

## src/cpu/intel/ep80579/Kconfig
```kconfig
config CPU_INTEL_EP80579
	bool
	select ARCH_BOOTBLOCK_X86_32
	select ARCH_VERSTAGE_X86_32
	select ARCH_ROMSTAGE_X86_32
	select ARCH_RAMSTAGE_X86_32
	select SSE
	select SUPPORT_CPU_UCODE_IN_CBFS

if CPU_INTEL_EP80579

# These are just dummy values to keep build happy.
# This CPU does not have tested cache_as_ram.inc.

config DCACHE_RAM_BASE
	hex
	default 0xffaf8000

config DCACHE_RAM_SIZE
	hex
	default 0x8000

endif
```

## src/cpu/intel/fit/Kconfig
```kconfig
## SPDX-License-Identifier: GPL-2.0-only

config CPU_INTEL_FIRMWARE_INTERFACE_TABLE
	def_bool n
	help
	  This option selects building a Firmware Interface Table (FIT).

config CPU_INTEL_NUM_FIT_ENTRIES
	int
	default 16 if INTEL_TXT || INTEL_CBNT_SUPPORT
	default 4
	depends on CPU_INTEL_FIRMWARE_INTERFACE_TABLE
	help
	  This option selects the number of empty entries in the FIT table.

config HAVE_PBP_BIN
	bool "Add Intel platform boot policy file"
	default n
	depends on SOC_INTEL_COMMON_IBL_BASE
	help
	  The platform boot policy file. Platform boot policy (type 4) entry
	  in the FIT is required for server executing CBnT and/or PFR without
	  a PCH.

config PBP_BIN_PATH
	string "Path and filename of the platform boot policy file"
	default "site-local/mainboard/\$(MAINBOARDDIR)/pbp.bin"
	depends on HAVE_PBP_BIN
```

## src/cpu/intel/fsp_model_206ax/Kconfig
```kconfig
##
## This file is part of the coreboot project.
##
## Copyright (C) 2013 Sage Electronic Engineering, LLC.
##
## This program is free software; you can redistribute it and/or modify
## it under the terms of the GNU General Public License as published by
## the Free Software Foundation; version 2 of the License.
##
## This program is distributed in the hope that it will be useful,
## but WITHOUT ANY WARRANTY; without even the implied warranty of
## MERCHANTABILITY or FITNESS FOR A PARTICULAR PURPOSE.  See the
## GNU General Public License for more details.
##


config CPU_INTEL_FSP_MODEL_206AX
	bool

config CPU_INTEL_FSP_MODEL_306AX
	bool

if CPU_INTEL_FSP_MODEL_206AX || CPU_INTEL_FSP_MODEL_306AX

config CPU_SPECIFIC_OPTIONS
	def_bool y
	select PLATFORM_USES_FSP1_0
	select ARCH_BOOTBLOCK_X86_32
	select ARCH_VERSTAGE_X86_32
	select ARCH_ROMSTAGE_X86_32
	select ARCH_RAMSTAGE_X86_32
	select SMP
	select SSE2
	select UDELAY_LAPIC
	select SMM_TSEG
	select SUPPORT_CPU_UCODE_IN_CBFS
	select PARALLEL_CPU_INIT
	select TSC_SYNC_MFENCE
	select LAPIC_MONOTONIC_TIMER

config BOOTBLOCK_CPU_INIT
	string
	default "cpu/intel/fsp_model_206ax/bootblock.c"

config SMM_TSEG_SIZE
	hex
	default 0x800000

config ENABLE_VMX
	bool "Enable VMX for virtualization"
	default n

endif
```

## src/cpu/intel/fsp_model_406dx/Kconfig
```kconfig
##
## This file is part of the coreboot project.
##
## Copyright (C) 2013-2014 Sage Electronic Engineering, LLC.
##
## This program is free software; you can redistribute it and/or modify
## it under the terms of the GNU General Public License as published by
## the Free Software Foundation; version 2 of the License.
##
## This program is distributed in the hope that it will be useful,
## but WITHOUT ANY WARRANTY; without even the implied warranty of
## MERCHANTABILITY or FITNESS FOR A PARTICULAR PURPOSE.  See the
## GNU General Public License for more details.
##

config CPU_INTEL_FSP_MODEL_406DX
	bool

if CPU_INTEL_FSP_MODEL_406DX

config CPU_SPECIFIC_OPTIONS
	def_bool y
	select PLATFORM_USES_FSP1_0
	select ARCH_BOOTBLOCK_X86_32
	select ARCH_VERSTAGE_X86_32
	select ARCH_ROMSTAGE_X86_32
	select ARCH_RAMSTAGE_X86_32
	select SMP
	select SSE2
	select UDELAY_LAPIC
	select SUPPORT_CPU_UCODE_IN_CBFS
	select PARALLEL_CPU_INIT
	select TSC_SYNC_MFENCE
	select LAPIC_MONOTONIC_TIMER

	# Microcode header files are delivered in FSP package
	select USES_MICROCODE_HEADER_FILES if HAVE_FSP_BIN

choice
	prompt "Rangeley CPU Stepping"
	default FSP_MODEL_406DX_B0

config FSP_MODEL_406DX_A1
	bool "A1"

config FSP_MODEL_406DX_B0
	bool "B0"

endchoice

config BOOTBLOCK_CPU_INIT
	string
	default "cpu/intel/fsp_model_406dx/bootblock.c"

config ENABLE_VMX
	bool "Enable VMX for virtualization"
	default n

#set up microcode for rangeley POSTGOLD4 release
config CPU_MICROCODE_HEADER_FILES
	string
	default "../intel/cpu/rangeley/microcode/microcode-m01406d000e.h ../intel/cpu/rangeley/microcode/microcode-m01406d8128.h"

endif #CPU_INTEL_FSP_MODEL_406DX
```

## src/cpu/intel/haswell/Kconfig
```kconfig
config CPU_INTEL_HASWELL
	bool

if CPU_INTEL_HASWELL

config CPU_SPECIFIC_OPTIONS
	def_bool y
	select ARCH_X86
	select MMX
	select SSE2
	select UDELAY_TSC
	select TSC_MONOTONIC_TIMER
	select SUPPORT_CPU_UCODE_IN_CBFS
	#select AP_IN_SIPI_WAIT
	select TSC_SYNC_MFENCE
	select CPU_INTEL_FIRMWARE_INTERFACE_TABLE
	select CPU_INTEL_COMMON
	select CPU_INTEL_COMMON_TIMEBASE
	select HAVE_ASAN_IN_ROMSTAGE
	select CPU_INTEL_COMMON_VOLTAGE

config SMM_TSEG_SIZE
	hex
	default 0x800000

config IED_REGION_SIZE
	hex
	default 0x400000

config SMM_RESERVED_SIZE
	hex
	default 0x100000

config MAX_CPUS
	int
	default 8

config CPU_INTEL_NUM_FIT_ENTRIES
	default 6
endif
```

## src/cpu/intel/microcode/Kconfig
```kconfig
config MICROCODE_UPDATE_PRE_RAM
	bool
	depends on SUPPORT_CPU_UCODE_IN_CBFS
	default n if CPU_INTEL_FIRMWARE_INTERFACE_TABLE
	default y
	help
	  Select this option if you want to update the microcode
	  during the cache as RAM setup.

config RELOAD_MICROCODE_PATCH
	bool
	default n
	help
	  Select this option if SoC recommends to re-load microcode
	  patch as part of CPU multiprocessor initialization process.
	  This feature is mostly required with Intel latest generation
	  processors starting with Alder Lake (with modified MCHECK init
	  flow).

config CPU_INTEL_MICROCODE_CBFS_SPLIT_BINS
	bool "For Intel CPU, include microcode per CPUID into CBFS"
	depends on CBFS_VERIFICATION && !MICROCODE_UPDATE_PRE_RAM
	default n
	help
	  This option controls whether to include external microcode binaries per
	  CPUID in CBFS.

	  The current approach of loading microcode blobs post CPU reset is to search
	  the unified blob in the CBFS and then perform the CBFS verification. The bigger
	  the unified microcode blob in size the longer it takes to perform the verification.

	  Select this option to store the split microcode blobs per CPUID in the CBFS.
	  As the microcode blobs will be divided into smaller chunks per CPUID, which will
	  reduce the overall search, verify and load time.

	  The microcode file may be removed from the ROM image at a later
	  time with cbfstool, if desired.

	  If unsure, and applicable, select "Generate from tree"

config CPU_INTEL_UCODE_SPLIT_BINARIES
	string "Specify the split microcode blob directory path"
	depends on CPU_INTEL_MICROCODE_CBFS_SPLIT_BINS
	default ""
	help
	  Provide the split microcode blob directory path if
	  CPU_INTEL_MICROCODE_CBFS_SPLIT_BINS config is enabled.

	  CPU_INTEL_MICROCODE_CBFS_SPLIT_BINS config is allowed to pack the individual microcode
	  patch file per CPUID inside the CBFS.

	  Intel distributes CPU microcode updates based on CPUID as part of the github repository
	  in INC format and expects it also getting used in binary form.

	  For example: Intel CPU microcode `m506e3.inc` is getting converted into F-MO-S
	  (06-5e-03) binary file for Linux kernel.

	  `MicrocodeConverter` is an Intel-provided tool for converting binary form MCU into
	  several other common formats for integration.

	  Implementation logic behind CPU_INTEL_MICROCODE_CBFS_SPLIT_BINS config relies on
	  converting Intel CPU microcode INC file into the binary file as per format specified
	  here `cpu_microcode_$(CPUID).bin`. For example: Intel CPU microcode `m506e3.inc` to
	  convert into `cpu_microcode_506e3.bin` binary file for coreboot to integrate if
	  CPU_INTEL_MICROCODE_CBFS_SPLIT_BINS config is enabled.

	  This config provides the directory name (including path) that holds the split microcode
	  binary files per CPUID as mentioned above for each coreboot variants. For example: if
	  google/kunimitsu had built with Intel SkyLake processor with CPUID `506e3` and `506e4`
	  then CPU_INTEL_UCODE_SPLIT_BINARIES refers to the directory path that holds the split
	  microcode binary files aka `cpu_microcode_506e3.bin` and `cpu_microcode_506e4.bin`.

	  CONFIG_CPU_UCODE_SPLIT_BINARIES="3rdparty/blobs/mainboard/google/kunimitsu/microcode_inputs/kunimitsu"
	  Refer to the file representation below:
	  |---3rdparty
	  |   |--- blobs
	  |   |    |--- mainboard
	  |   |    |   |--- google
	  |   |    |   |    |--- kunimitsu
	  |   |    |   |    |    |--- microcode_inputs
	  |   |    |   |    |    |    |--- kunimitsu
	  |   |    |   |    |    |    |    |--- cpu_microcode_506e3.bin
	  |   |    |   |    |    |    |    |--- cpu_microcode_506e4.bin

	  Users of this config option requires to manually place the microcode binary files per
	  CPUIDs as per the given format (`cpu_microcode_$(CPUID).bin`) in a directory.
	  Finally specify the microcode binary directory path using CPU_UCODE_SPLIT_BINARIES
	  config.

	  At runtime (either from romstage/ramstage), coreboot read the CPUID and search for the
	  `cpu_microcode_$(CPUID).bin` file (in this example: cpu_microcode_506e3.bin) inside RW
	  CBFS. Eventually able to locate the appropriate `cpu_microcode_$(CPUID).bin` file and
	  perform the verification prior loading into the CPUs (BSP and APs).

	  If unsure, leave this blank.
```

## src/cpu/intel/model_1067x/Kconfig
```kconfig
config CPU_INTEL_MODEL_1067X
	bool
	select ARCH_ALL_STAGES_X86_32
	select SSE2
	select UDELAY_TSC
	select TSC_MONOTONIC_TIMER
	select TSC_SYNC_MFENCE
	select SUPPORT_CPU_UCODE_IN_CBFS
	select CPU_INTEL_COMMON
	select CPU_INTEL_COMMON_TIMEBASE
	select SETUP_XIP_CACHE
```

## src/cpu/intel/model_106cx/Kconfig
```kconfig
config CPU_INTEL_MODEL_106CX
	bool
	select ARCH_X86
	select SSE2
	select UDELAY_TSC
	select TSC_MONOTONIC_TIMER
	select SIPI_VECTOR_IN_ROM
	select AP_IN_SIPI_WAIT
	select TSC_SYNC_MFENCE
	select SUPPORT_CPU_UCODE_IN_CBFS
	select SERIALIZED_SMM_INITIALIZATION
	select CPU_INTEL_COMMON
	select CPU_INTEL_COMMON_TIMEBASE
```
