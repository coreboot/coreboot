## src/cpu/intel/model_2065x/Kconfig
```kconfig
config CPU_INTEL_MODEL_2065X
	bool

if CPU_INTEL_MODEL_2065X

config CPU_SPECIFIC_OPTIONS
	def_bool y
	select HAVE_EXP_X86_64_SUPPORT
	select ARCH_X86
	select SSE2
	select UDELAY_TSC
	select TSC_MONOTONIC_TIMER
	select SUPPORT_CPU_UCODE_IN_CBFS
	#select AP_IN_SIPI_WAIT
	select TSC_SYNC_MFENCE
	select CPU_INTEL_COMMON
	select CPU_INTEL_COMMON_TIMEBASE

config SMM_TSEG_SIZE
	hex
	default 0x800000

config SMM_RESERVED_SIZE
	hex
	default 0x100000

config MAX_CPUS
	int
	default 4

endif
```

## src/cpu/intel/model_206ax/Kconfig
```kconfig
config CPU_INTEL_MODEL_206AX
	bool

if CPU_INTEL_MODEL_206AX

config CPU_SPECIFIC_OPTIONS
	def_bool y
	select ARCH_X86
	select HAVE_EXP_X86_64_SUPPORT if USE_NATIVE_RAMINIT
	select MMX
	select SSE2
	select UDELAY_TSC
	select TSC_MONOTONIC_TIMER
	select SUPPORT_CPU_UCODE_IN_CBFS
	#select AP_IN_SIPI_WAIT
	select TSC_SYNC_MFENCE
	select CPU_INTEL_COMMON
	select CPU_INTEL_COMMON_TIMEBASE

config SMM_TSEG_SIZE
	hex
	default 0x800000

config SMM_RESERVED_SIZE
	hex
	default 0x100000

# Intel Enhanced Debug region must be 4MB
config IED_REGION_SIZE
	hex
	default 0x400000

config MAX_CPUS
	int
	default 8

endif
```

## src/cpu/intel/model_65x/Kconfig
```kconfig
config CPU_INTEL_MODEL_65X
	bool
	select ARCH_X86
	select SUPPORT_CPU_UCODE_IN_CBFS
	select CPU_X86_CACHE_HELPER
```

## src/cpu/intel/model_67x/Kconfig
```kconfig
config CPU_INTEL_MODEL_67X
	bool
	select ARCH_X86
	select SUPPORT_CPU_UCODE_IN_CBFS
```

## src/cpu/intel/model_68x/Kconfig
```kconfig
## SPDX-License-Identifier: GPL-2.0-or-later

config CPU_INTEL_MODEL_68X
	bool
	select ARCH_X86
	select SUPPORT_CPU_UCODE_IN_CBFS
	select CPU_X86_CACHE_HELPER
```

## src/cpu/intel/model_69x/Kconfig
```kconfig
config CPU_INTEL_MODEL_69X
	bool
	select ARCH_X86
	select SMP
	select SUPPORT_CPU_UCODE_IN_CBFS
```
