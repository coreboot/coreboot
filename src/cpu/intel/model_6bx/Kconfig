## src/cpu/intel/model_6bx/Kconfig
```kconfig
## SPDX-License-Identifier: GPL-2.0-only

config CPU_INTEL_MODEL_6BX
	bool
	select ARCH_X86
	select SUPPORT_CPU_UCODE_IN_CBFS
```

## src/cpu/intel/model_6dx/Kconfig
```kconfig
config CPU_INTEL_MODEL_6DX
	bool
	select ARCH_X86
	select SMP
	select SUPPORT_CPU_UCODE_IN_CBFS
```

## src/cpu/intel/model_6ex/Kconfig
```kconfig
config CPU_INTEL_CORE
	bool
	select SMP
	select SSE2
	select UDELAY_LAPIC
	select AP_IN_SIPI_WAIT
```

## src/cpu/intel/model_6fx/Kconfig
```kconfig
config CPU_INTEL_MODEL_6FX
	bool
	select ARCH_X86
	select SSE2
	select UDELAY_TSC
	select TSC_MONOTONIC_TIMER
	select AP_IN_SIPI_WAIT
	select TSC_SYNC_MFENCE
	select SUPPORT_CPU_UCODE_IN_CBFS
	select CPU_INTEL_COMMON
	select CPU_INTEL_COMMON_TIMEBASE
	select SETUP_XIP_CACHE
```

## src/cpu/intel/model_6xx/Kconfig
```kconfig
## SPDX-License-Identifier: GPL-2.0-only

config CPU_INTEL_MODEL_6XX
	bool
	select ARCH_X86
	select SUPPORT_CPU_UCODE_IN_CBFS
```

## src/cpu/intel/model_f0x/Kconfig
```kconfig
config CPU_INTEL_MODEL_F0X
	bool
	select ARCH_X86
	select SMP
	select SUPPORT_CPU_UCODE_IN_CBFS
```

## src/cpu/intel/model_f1x/Kconfig
```kconfig
config CPU_INTEL_MODEL_F1X
	bool
	select ARCH_X86
	select SMP
	select SUPPORT_CPU_UCODE_IN_CBFS
```

## src/cpu/intel/model_f2x/Kconfig
```kconfig
config CPU_INTEL_MODEL_F2X
	bool
	select ARCH_X86
	select SUPPORT_CPU_UCODE_IN_CBFS
	select CPU_INTEL_COMMON
	select SSE2
```

## src/cpu/intel/model_f3x/Kconfig
```kconfig
config CPU_INTEL_MODEL_F3X
	bool
	select ARCH_X86
	select SUPPORT_CPU_UCODE_IN_CBFS
	select CPU_INTEL_COMMON
	select SSE2
```

## src/cpu/intel/model_f4x/Kconfig
```kconfig
config CPU_INTEL_MODEL_F4X
	bool
	select ARCH_X86
	select SUPPORT_CPU_UCODE_IN_CBFS
	select SSE2
```

## src/cpu/intel/slot_1/Kconfig
```kconfig
## SPDX-License-Identifier: GPL-2.0-only

config CPU_INTEL_SLOT_1
	bool

if CPU_INTEL_SLOT_1

config SLOT_SPECIFIC_OPTIONS
	def_bool y
	select CPU_INTEL_MODEL_65X
	select CPU_INTEL_MODEL_67X
	select CPU_INTEL_MODEL_68X
	select CPU_INTEL_MODEL_6BX
	select CPU_INTEL_MODEL_6XX
	select NO_SMM
	select UDELAY_TSC
	select TSC_MONOTONIC_TIMER
	select UNKNOWN_TSC_RATE
	select SETUP_XIP_CACHE

config DCACHE_RAM_BASE
	hex
	default 0xfefc0000

config DCACHE_RAM_SIZE
	hex
	default 0x02000

config DCACHE_BSP_STACK_SIZE
	hex
	default 0x1000

config C_ENV_BOOTBLOCK_SIZE
	hex
	default 0x10000

endif
```

## src/cpu/intel/socket_441/Kconfig
```kconfig
config CPU_INTEL_SOCKET_441
	bool
	select CPU_INTEL_MODEL_106CX
	select SETUP_XIP_CACHE

if CPU_INTEL_SOCKET_441

config DCACHE_RAM_BASE
	hex
	default 0xfefc0000

config DCACHE_RAM_SIZE
	hex
	default 0x8000

config DCACHE_BSP_STACK_SIZE
	hex
	default 0x2000

endif # CPU_INTEL_SOCKET_441
```

## src/cpu/intel/socket_BGA1284/Kconfig
```kconfig
config CPU_INTEL_SOCKET_BGA1284
	bool

if CPU_INTEL_SOCKET_BGA1284

config SOCKET_SPECIFIC_OPTIONS # dummy
	def_bool y
	select MMX
	select SSE

endif
```

## src/cpu/intel/socket_BGA956/Kconfig
```kconfig
## SPDX-License-Identifier: GPL-2.0-only

config CPU_INTEL_SOCKET_BGA956
	bool
	select CPU_INTEL_MODEL_1067X

if CPU_INTEL_SOCKET_BGA956

config DCACHE_RAM_BASE
	hex
	default 0xfefc0000

config DCACHE_RAM_SIZE
	hex
	default 0x10000

config PRERAM_CBFS_CACHE_SIZE
	default 0x0

config DCACHE_BSP_STACK_SIZE
	hex
	default 0x2000

config MAX_CPUS
	int
	default 2

endif
```

## src/cpu/intel/socket_FCBGA1023/Kconfig
```kconfig
config CPU_INTEL_SOCKET_FCBGA1023
	bool

if CPU_INTEL_SOCKET_FCBGA1023

config SOCKET_SPECIFIC_OPTIONS # dummy
	def_bool y
	select MMX
	select SSE
	select SSE2

endif
```

## src/cpu/intel/socket_FCBGA559/Kconfig
```kconfig
config CPU_INTEL_SOCKET_FCBGA559
	bool
	select CPU_INTEL_MODEL_106CX
	select CPU_HAS_L2_ENABLE_MSR
	help
	  Select this socket on Intel Pineview

if CPU_INTEL_SOCKET_FCBGA559

config DCACHE_RAM_BASE
	hex
	default 0xfefc0000

config DCACHE_RAM_SIZE
	hex
	default 0x8000

config DCACHE_BSP_STACK_SIZE
	hex
	default 0x2000
	help
	  The amount of anticipated stack usage in CAR by bootblock and
	  other stages.

config MAX_CPUS
	int
	default 4

endif
```

## src/cpu/intel/socket_FC_PGA370/Kconfig
```kconfig
##
## This file is part of the coreboot project.
##
## Copyright (C) 2010 Joseph Smith <joe@settoplinux.org>
##
## This program is free software; you can redistribute it and/or modify
## it under the terms of the GNU General Public License as published by
## the Free Software Foundation; either version 2 of the License, or
## (at your option) any later version.
##
## This program is distributed in the hope that it will be useful,
## but WITHOUT ANY WARRANTY; without even the implied warranty of
## MERCHANTABILITY or FITNESS FOR A PARTICULAR PURPOSE.  See the
## GNU General Public License for more details.
##

config CPU_INTEL_SOCKET_FC_PGA370
	bool
	select CPU_INTEL_MODEL_68X
	select MMX
	select SSE

if CPU_INTEL_SOCKET_FC_PGA370

config DCACHE_RAM_BASE
	hex
	default 0xc8000

config DCACHE_RAM_SIZE
	hex
	default 0x08000

endif
```

## src/cpu/intel/socket_LGA1155/Kconfig
```kconfig
config CPU_INTEL_SOCKET_LGA1155
	bool

if CPU_INTEL_SOCKET_LGA1155

config SOCKET_SPECIFIC_OPTIONS # dummy
	def_bool y
	select MMX
	select SSE

endif # CPU_INTEL_SOCKET_LGA1155
```

## src/cpu/intel/socket_LGA771/Kconfig
```kconfig
config CPU_INTEL_SOCKET_LGA771
	bool
	select CPU_INTEL_MODEL_6FX
	select SSE2
	select MMX
	select AP_IN_SIPI_WAIT

if CPU_INTEL_SOCKET_LGA771

config DCACHE_RAM_BASE
	hex
	default 0xfefc0000

config DCACHE_RAM_SIZE
	hex
	default 0x8000

endif
```

## src/cpu/intel/socket_LGA775/Kconfig
```kconfig
config CPU_INTEL_SOCKET_LGA775
	bool
	select CPU_INTEL_MODEL_6FX
	select CPU_INTEL_MODEL_F3X
	select CPU_INTEL_MODEL_F4X
	select CPU_INTEL_MODEL_1067X
	select SIPI_VECTOR_IN_ROM

if CPU_INTEL_SOCKET_LGA775

config DCACHE_RAM_SIZE
	hex
	default 0x8000 # 32 kB

config DCACHE_BSP_STACK_SIZE
	hex
	default 0x2000

config DCACHE_RAM_BASE
	hex
	default 0xfeff8000 # 4GB - 16MB - DCACHE_RAM_SIZE

endif # CPU_INTEL_SOCKET_LGA775
```
