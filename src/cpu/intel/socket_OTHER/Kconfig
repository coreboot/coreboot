## src/cpu/intel/socket_PGA370/Kconfig
```kconfig
##
## This file is part of the coreboot project.
##
## Copyright (C) 2009 Uwe Hermann <uwe@hermann-uwe.de>
##
## This program is free software; you can redistribute it and/or modify
## it under the terms of the GNU General Public License as published by
## the Free Software Foundation; version 2 of the License.
##
## This program is distributed in the hope that it will be useful,
## but WITHOUT ANY WARRANTY; without even the implied warranty of
## MERCHANTABILITY or FITNESS FOR A PARTICULAR PURPOSE.  See the
## GNU General Public License for more details.
##

config CPU_INTEL_SOCKET_PGA370
	bool
	select CPU_INTEL_MODEL_6XX
	select MMX
	select UDELAY_TSC

if CPU_INTEL_SOCKET_PGA370

# Not all CPUs for Socket 370 can do SSE2
config SSE2
	bool
	default n

config DCACHE_RAM_BASE
	hex
	default 0xcf000

config DCACHE_RAM_SIZE
	hex
	default 0x01000

endif
```

## src/cpu/intel/socket_m/Kconfig
```kconfig
## SPDX-License-Identifier: GPL-2.0-only

config CPU_INTEL_SOCKET_M
	bool
	select CPU_INTEL_MODEL_6EX
	select CPU_INTEL_MODEL_6FX

if CPU_INTEL_SOCKET_M

config DCACHE_RAM_BASE
	hex
	default 0xfefc0000

config DCACHE_RAM_SIZE
	hex
	default 0x8000

config PRERAM_CBFS_CACHE_SIZE
	default 0x0

config DCACHE_BSP_STACK_SIZE
	hex
	default 0x2000

endif
```

## src/cpu/intel/socket_mFCBGA479/Kconfig
```kconfig
config CPU_INTEL_SOCKET_MFCBGA479
	bool
	select CPU_INTEL_MODEL_6BX
	select MMX
	select SSE

if CPU_INTEL_SOCKET_MFCBGA479

config DCACHE_RAM_BASE
	hex
	default 0xc8000

config DCACHE_RAM_SIZE
	hex
	default 0x08000

endif
```

## src/cpu/intel/socket_mPGA478/Kconfig
```kconfig
config CPU_INTEL_SOCKET_MPGA478
	bool
	select CPU_INTEL_MODEL_69X
	select CPU_INTEL_MODEL_6DX
```

## src/cpu/intel/socket_mPGA478MN/Kconfig
```kconfig
config CPU_INTEL_SOCKET_MPGA478MN
	bool
	select CPU_INTEL_MODEL_1067X
	select CPU_INTEL_MODEL_6FX
	select MMX
	select SSE

if CPU_INTEL_SOCKET_MPGA478MN

config DCACHE_RAM_BASE
	hex
	default 0xfefc0000

config DCACHE_RAM_SIZE
	hex
	default 0x8000

endif
```

## src/cpu/intel/socket_mPGA479M/Kconfig
```kconfig
config CPU_INTEL_SOCKET_MPGA479M
	bool
	select CPU_INTEL_MODEL_69X
	select CPU_INTEL_MODEL_6BX
	select CPU_INTEL_MODEL_6DX
	select CPU_INTEL_MODEL_F2X
	select MMX
	select SSE

if CPU_INTEL_SOCKET_MPGA479M

config DCACHE_RAM_BASE
	hex
	default 0xc8000

config DCACHE_RAM_SIZE
	hex
	default 0x08000

endif
```

## src/cpu/intel/socket_mPGA603/Kconfig
```kconfig
config CPU_INTEL_SOCKET_MPGA603
	bool
	select CPU_INTEL_MODEL_F0X
	select CPU_INTEL_MODEL_F1X
	select CPU_INTEL_MODEL_F2X
```

## src/cpu/intel/socket_mPGA604/Kconfig
```kconfig
config CPU_INTEL_SOCKET_MPGA604
	bool
	select CPU_INTEL_MODEL_F2X
	select UDELAY_TSC
	select TSC_MONOTONIC_TIMER
	select SIPI_VECTOR_IN_ROM
	select CPU_INTEL_COMMON
	select CPU_INTEL_COMMON_TIMEBASE

if CPU_INTEL_SOCKET_MPGA604

config DCACHE_RAM_BASE
	hex
	default 0xfefc0000

config DCACHE_RAM_SIZE
	hex
	default 0x4000

config DCACHE_BSP_STACK_SIZE
	hex
	default 0x2000

endif # CPU_INTEL_SOCKET_MPGA604
```

## src/cpu/intel/socket_p/Kconfig
```kconfig
config CPU_INTEL_SOCKET_P
	bool

if CPU_INTEL_SOCKET_P

config SOCKET_SPECIFIC_OPTIONS
	def_bool y
	select CPU_INTEL_MODEL_1067X
	select CPU_INTEL_MODEL_6FX
	select MMX

config DCACHE_RAM_BASE
	hex
	default 0xfefc0000

config DCACHE_RAM_SIZE
	hex
	default 0x10000

config DCACHE_BSP_STACK_SIZE
	hex
	default 0x2000

config MAX_CPUS
	int
	default 4

endif
```

## src/cpu/intel/socket_rPGA988B/Kconfig
```kconfig
config CPU_INTEL_SOCKET_RPGA988B
	bool

if CPU_INTEL_SOCKET_RPGA988B

config SOCKET_SPECIFIC_OPTIONS # dummy
	def_bool y
	select MMX
	select SSE

endif
```

## src/cpu/intel/socket_rPGA989/Kconfig
```kconfig
config CPU_INTEL_SOCKET_RPGA989
	bool

if CPU_INTEL_SOCKET_RPGA989

config SOCKET_SPECIFIC_OPTIONS # dummy
	def_bool y
	select MMX
	select SSE

endif
```

## src/cpu/intel/turbo/Kconfig
```kconfig
config CPU_INTEL_TURBO_NOT_PACKAGE_SCOPED
	def_bool n
	help
	  This option indicates that the turbo mode setting is not package
	  scoped. i.e. enable_turbo() needs to be called on not just the bsp
```

## src/cpu/loongson/Kconfig
```kconfig
config CPU_LOONGSON_2E
	depends on ARCH_MIPS32
	bool
	default n

if CPU_LOONGSON_2E
source src/cpu/loongson/loongson2e/Kconfig
endif
```

## src/cpu/power9/Kconfig
```kconfig
## SPDX-License-Identifier: GPL-2.0-only

config CPU_POWER9
	bool
	select ARCH_BOOTBLOCK_PPC64
	select ARCH_VERSTAGE_PPC64
	select ARCH_ROMSTAGE_PPC64
	select ARCH_RAMSTAGE_PPC64
```

## src/cpu/qemu-power8/Kconfig
```kconfig
##
## This file is part of the coreboot project.
##
## This program is free software; you can redistribute it and/or modify
## it under the terms of the GNU General Public License as published by
## the Free Software Foundation; version 2 of the License.
##
## This program is distributed in the hope that it will be useful,
## but WITHOUT ANY WARRANTY; without even the implied warranty of
## MERCHANTABILITY or FITNESS FOR A PARTICULAR PURPOSE.  See the
## GNU General Public License for more details.
##

config CPU_QEMU_POWER8
	bool
	select ARCH_BOOTBLOCK_PPC64
	select ARCH_VERSTAGE_PPC64
	select ARCH_ROMSTAGE_PPC64
	select ARCH_RAMSTAGE_PPC64
	select NO_MONOTONIC_TIMER
```

## src/cpu/qemu-x86/Kconfig
```kconfig
## SPDX-License-Identifier: GPL-2.0-only

config CPU_QEMU_X86
	bool
	select ARCH_X86
	select HAVE_X86_64_SUPPORT
	select UDELAY_TSC
	select TSC_MONOTONIC_TIMER
	select UNKNOWN_TSC_RATE
	select NEED_SMALL_2MB_PAGE_TABLES	# QEMU doesn't support 1GB pages
	select IDT_IN_EVERY_STAGE

if CPU_QEMU_X86

# coreboot i440fx does not support SMM
choice
	prompt "SMM support"
	default CPU_QEMU_X86_ASEG_SMM
	depends on BOARD_EMULATION_QEMU_X86_Q35

config CPU_QEMU_X86_NO_SMM
	bool "No SMM"
	select NO_SMM

config CPU_QEMU_X86_ASEG_SMM
	bool "SMM in ASEG"
	select SMM_ASEG

config CPU_QEMU_X86_TSEG_SMM
	bool "SMM in TSEG"
	select SMM_TSEG

endchoice

config SMM_TSEG_SIZE
	hex
	depends on SMM_TSEG
	default 0x100000

config MAX_CPUS
	int
	default 32 if SMM_TSEG
	default 4

endif
```

## src/cpu/samsung/Kconfig
```kconfig
source src/cpu/samsung/exynos5250/Kconfig
source src/cpu/samsung/exynos5420/Kconfig
```

## src/cpu/samsung/exynos5250/Kconfig
```kconfig
config CPU_SAMSUNG_EXYNOS5250
	depends on ARCH_ARMV7
	select HAVE_MONOTONIC_TIMER
	select HAVE_UART_SPECIAL
	select EARLY_CONSOLE
	bool
	default n

if CPU_SAMSUNG_EXYNOS5250

config BOOTBLOCK_CPU_INIT
	string
	default "cpu/samsung/exynos5250/bootblock.c"
	help
	  CPU/SoC-specific bootblock code. This is useful if the
	  bootblock must load microcode or copy data from ROM before
	  searching for the bootblock.

# ROM image layout.
#
# 0x0000: vendor-provided BL1 (8k).
# 0x2000: bootblock
#  0x2010-0x2090: reserved for CBFS master header.
# 0xA000: Free for CBFS data.

config BOOTBLOCK_ROM_OFFSET
	hex
	default 0x2000

config CBFS_HEADER_ROM_OFFSET
	hex "offset of master CBFS header in ROM"
	default 0x2010

config CBFS_ROM_OFFSET
	# Calculated by BOOTBLOCK_ROM_OFFSET + max bootblock size.
	hex "offset of CBFS data in ROM"
	default 0x0A000


# Example SRAM/iRAM map for Exynos5250 platform:
#
# 0x0202_0000: vendor-provided BL1
# 0x0202_3400: bootblock, assume up to 32KB in size
# 0x0203_0000: romstage, assume up to 128KB in size.
# 0x0207_8000: stack pointer

config BOOTBLOCK_BASE
	hex
	default 0x02023400

config ROMSTAGE_BASE
	hex
	default 0x02030000

config ROMSTAGE_SIZE
	hex
	default 0x10000

# Stack may reside in either IRAM or DRAM. We will define it to live
# at the top of IRAM for now.
#
# Stack grows downward, push operation stores register contents in
# consecutive memory locations ending just below SP
config STACK_TOP
	hex
	default 0x02078000

config STACK_BOTTOM
	hex
	default 0x02077000

config STACK_SIZE
	hex
	default 0x1000

# TODO We may probably move this to board-specific implementation files instead
# of KConfig values.
config CBFS_CACHE_ADDRESS
	hex "memory address to put CBFS cache data"
	default 0x02060000

config CBFS_CACHE_SIZE
	hex "size of CBFS cache data"
	default 0x000017000

config SYS_SDRAM_BASE
	hex
	default 0x40000000

config SYS_TEXT_BASE
	hex
	default 0x43e00000

config COREBOOT_TABLES_SIZE
	hex
	default 0x4000000

choice CONSOLE_SERIAL_UART_CHOICES
	prompt "Serial Console UART"
	default CONSOLE_SERIAL_UART3
	depends on CONSOLE_SERIAL_UART

config CONSOLE_SERIAL_UART0
	bool "UART0"
	help
	  Serial console on UART0

config CONSOLE_SERIAL_UART1
	bool "UART1"
	help
	  Serial console on UART1

config CONSOLE_SERIAL_UART2
	bool "UART2"
	help
	  Serial console on UART2

config CONSOLE_SERIAL_UART3
	bool "UART3"
	help
	  Serial console on UART3

endchoice

config CONSOLE_SERIAL_UART_ADDRESS
	hex
	depends on CONSOLE_SERIAL_UART
	default 0x12c00000 if CONSOLE_SERIAL_UART0
	default 0x12c10000 if CONSOLE_SERIAL_UART1
	default 0x12c20000 if CONSOLE_SERIAL_UART2
	default 0x12c30000 if CONSOLE_SERIAL_UART3
	help
	  Map the UART names to the respective MMIO address.

endif
```

## src/cpu/samsung/exynos5420/Kconfig
```kconfig
config CPU_SAMSUNG_EXYNOS5420
	depends on ARCH_ARMV7
	select HAVE_MONOTONIC_TIMER
	select HAVE_UART_SPECIAL
	select EARLY_CONSOLE
	select DYNAMIC_CBMEM
	bool
	default n

if CPU_SAMSUNG_EXYNOS5420

config BOOTBLOCK_CPU_INIT
	string
	default "cpu/samsung/exynos5420/bootblock.c"
	help
	  CPU/SoC-specific bootblock code. This is useful if the
	  bootblock must load microcode or copy data from ROM before
	  searching for the bootblock.

# ROM image layout.
#
# 0x0000: vendor-provided BL1 (8k).
# 0x2000: variable length bootblock checksum header
# 0x2010: bootblock
#  0x2020-0x20A0: reserved for CBFS master header.
# 0xA000: Free for CBFS data.

config BOOTBLOCK_ROM_OFFSET
	hex
	default 0x2010

config CBFS_HEADER_ROM_OFFSET
	hex "offset of master CBFS header in ROM"
	default 0x2020

config CBFS_ROM_OFFSET
	# Calculated by BOOTBLOCK_ROM_OFFSET + max bootblock size.
	hex "offset of CBFS data in ROM"
	default 0x0A000


# Example SRAM/iRAM map for Exynos5420 platform:
#
# 0x0202_0000: vendor-provided BL1
# 0x0202_4400: variable length bootblock checksum header.
# 0x0202_4410: bootblock, assume up to 32KB in size
# 0x0203_0000: romstage, assume up to 128KB in size.
# 0x0207_4000: stack pointer

config BOOTBLOCK_BASE
	hex
	default 0x02024410

config ROMSTAGE_BASE
	hex
	default 0x02030000

config ROMSTAGE_SIZE
	hex
	default 0x10000

# Stack may reside in either IRAM or DRAM. We will define it to live
# at the top of IRAM for now.
#
# Stack grows downward, push operation stores register contents in
# consecutive memory locations ending just below SP
config STACK_TOP
	hex
	default 0x02074000

config STACK_BOTTOM
	hex
	default 0x02073000

config STACK_SIZE
	hex
	default 0x1000

# TODO We may probably move this to board-specific implementation files instead
# of KConfig values.
config CBFS_CACHE_ADDRESS
	hex "memory address to put CBFS cache data"
	default 0x02060000

config CBFS_CACHE_SIZE
	hex "size of CBFS cache data"
	default 0x000013000

config SYS_SDRAM_BASE
	hex
	default 0x20000000

config CONSOLE_PORT
	int
	default 3

endif
```

## src/cpu/ti/am335x/Kconfig
```kconfig
config CPU_TI_AM335X
	select ARCH_BOOTBLOCK_ARMV7
	select ARCH_VERSTAGE_ARMV7
	select ARCH_ROMSTAGE_ARMV7
	select ARCH_RAMSTAGE_ARMV7
	select HAVE_UART_SPECIAL
	select UART_OVERRIDE_REFCLK
	select BOOT_DEVICE_NOT_SPI_FLASH
	bool
	default n

if CPU_TI_AM335X

config MEMLAYOUT_LD_FILE
	string
	default "src/cpu/ti/am335x/memlayout.ld"

endif
```
