## src/device/dram/Kconfig
```kconfig
## SPDX-License-Identifier: GPL-2.0-only

config DRAM_SUPPORT_DDR5
	bool
	default n
	help
	  System supports DDR5 memory

config DRAM_SUPPORT_LPDDR4
	bool
	default n
	help
	  System supports LPDDR4 memory

config DRAM_SUPPORT_DDR4
	bool
	default n
	help
	  System supports DDR4 memory

config DRAM_SUPPORT_DDR3
	bool
	default n
	help
	  System supports DDR3 memory

config DRAM_SUPPORT_DDR2
	bool
	default n
	help
	  System supports DDR2 memory
```

## src/devices/Kconfig
```kconfig
##
## This file is part of the coreboot project.
##
## Copyright (C) 2007-2010 coresystems GmbH
## (Written by Stefan Reinauer <stepan@coresystems.de> for coresystems GmbH)
##
## This program is free software; you can redistribute it and/or modify
## it under the terms of the GNU General Public License as published by
## the Free Software Foundation; version 2 of the License.
##
## This program is distributed in the hope that it will be useful,
## but WITHOUT ANY WARRANTY; without even the implied warranty of
## MERCHANTABILITY or FITNESS FOR A PARTICULAR PURPOSE.  See the
## GNU General Public License for more details.
##
## You should have received a copy of the GNU General Public License
## along with this program; if not, write to the Free Software
## Foundation, Inc., 51 Franklin St, Fifth Floor, Boston, MA  02110-1301 USA
##

config VGA_BRIDGE_SETUP
	bool "Setup bridges on path to VGA adapter"
	default y
	help
	  Allow bridges to set up legacy decoding ranges for VGA. Don't disable
	  this unless you're sure you don't want the briges setup for VGA.

# TODO: Explain differences (if any) for onboard cards.
config VGA_ROM_RUN
	bool "Run VGA Option ROMs"
	default y
	help
	  Execute VGA Option ROMs, if found. This is required to enable
	  PCI/AGP/PCI-E video cards.

config S3_VGA_ROM_RUN
	bool "Re-run VGA Option ROMs on S3 resume"
	default y
	depends on VGA_ROM_RUN && HAVE_ACPI_RESUME
	help
	  Execute VGA Option ROMs when coming out of an S3 resume.

config PCI_ROM_RUN
	bool "Run non-VGA Option ROMs"
	default y
	help
	  Execute non-VGA PCI Option ROMs, if found.

	  Examples include IDE/SATA controller Option ROMs and Option ROMs
	  for network cards (NICs).

config ON_DEVICE_ROM_RUN
	bool "Run Option ROMs on PCI devices"
	default y
	help
	  Execute Option ROMs that are stored on PCI/PCIe/AGP devices.

	  If disabled, only Option ROMs stored in CBFS will be executed. If
	  you are concerned about security, you might want to disable this
	  option, but it might leave your system in a state of degraded
	  functionality.

	  If unsure, say Y

choice
	prompt "Option ROM execution type"
	default PCI_OPTION_ROM_RUN_YABEL if !ARCH_X86
	default PCI_OPTION_ROM_RUN_REALMODE if ARCH_X86
	depends on PCI_ROM_RUN || VGA_ROM_RUN || GEODE_VSA

config PCI_OPTION_ROM_RUN_REALMODE
	prompt "Native mode"
	bool
	depends on ARCH_X86
	help
	  If you select this option, PCI Option ROMs will be executed
	  natively on the CPU in real mode. No CPU emulation is involved,
	  so this is the fastest, but also the least secure option.
	  (only works on x86/x64 systems)

config PCI_OPTION_ROM_RUN_YABEL
	prompt "Secure mode"
	bool
	depends on !GEODE_VSA
	help
	  If you select this option, the x86emu CPU emulator will be used to
	  execute PCI Option ROMs.

	  This option prevents Option ROMs from doing dirty tricks with the
	  system (such as installing SMM modules or hypervisors), but it is
	  also significantly slower than the native Option ROM initialization
	  method.

	  This is the default choice for non-x86 systems.

endchoice

config YABEL_PCI_ACCESS_OTHER_DEVICES
	prompt "Allow Option ROMs to access other devices"
	bool
	depends on PCI_OPTION_ROM_RUN_YABEL
	help
	  Per default, YABEL only allows Option ROMs to access the PCI device
	  that they are associated with. However, this causes trouble for some
	  onboard graphics chips whose Option ROM needs to reconfigure the
	  north bridge.

config YABEL_PCI_FAKE_WRITING_OTHER_DEVICES_CONFIG
	prompt "Fake success on writing other device's config space"
	bool
	depends on YABEL_PCI_ACCESS_OTHER_DEVICES
	help
	  By default, YABEL aborts when the Option ROM tries to write to other
	  devices' config spaces. With this option enabled, the write doesn't
	  follow through, but the Option ROM is allowed to go on.
	  This can create issues such as hanging Option ROMs (if it depends on
	  that other register changing to the written value), so test for
	  impact before using this option.

config YABEL_VIRTMEM_LOCATION
	prompt "Location of YABEL's virtual memory"
	hex
	depends on PCI_OPTION_ROM_RUN_YABEL && EXPERT
	default 0x1000000
	help
	  YABEL requires 1MB memory for its CPU emulation. This memory is
	  normally located at 16MB.

config YABEL_VIRTMEM_LOCATION
	hex
	depends on PCI_OPTION_ROM_RUN_YABEL && !EXPERT
	default 0x1000000

config YABEL_DIRECTHW
	prompt "Direct hardware access"
	bool
	depends on PCI_OPTION_ROM_RUN_YABEL
	help
	  YABEL consists of two parts: It uses x86emu for the CPU emulation and
	  additionally provides a PC system emulation that filters bad device
	  and memory access (such as PCI config space access to other devices
	  than the initialized one).

	  When choosing this option, x86emu will pass through all hardware
	  accesses to memory and I/O devices to the underlying memory and I/O
	  addresses. While this option prevents Option ROMs from doing dirty
	  tricks with the CPU (such as installing SMM modules or hypervisors),
	  they can still access all devices in the system.
	  Enable this option for a good compromise between security and speed.

config MULTIPLE_VGA_ADAPTERS
	bool
	default n

config PCI_64BIT_PREF_MEM
	bool
	default n

config HYPERTRANSPORT_PLUGIN_SUPPORT
	bool
	default n

config PCIX_PLUGIN_SUPPORT
	bool
	default y

config PCIEXP_PLUGIN_SUPPORT
	bool
	default y

config AGP_PLUGIN_SUPPORT
	bool
	default y

config CARDBUS_PLUGIN_SUPPORT
	bool
	default y

config PCIEXP_COMMON_CLOCK
	prompt "Enable PCIe Common Clock"
	bool
	default n
	help
	  Detect and enable Common Clock on PCIe links.

config PCIEXP_ASPM
	prompt "Enable PCIe ASPM"
	bool
	default n
	help
	  Detect and enable ASPM on PCIe links.
```

## src/drivers/Kconfig
```kconfig
##
## This file is part of the coreboot project.
##
## Copyright (C) 2010 Rudolf Marek <r.marek@assembler.cz>
##
## This program is free software; you can redistribute it and/or modify
## it under the terms of the GNU General Public License as published by
## the Free Software Foundation; version 2 of the License.
##
## This program is distributed in the hope that it will be useful,
## but WITHOUT ANY WARRANTY; without even the implied warranty of
## MERCHANTABILITY or FITNESS FOR A PARTICULAR PURPOSE.  See the
## GNU General Public License for more details.
##
## You should have received a copy of the GNU General Public License
## along with this program; if not, write to the Free Software
## Foundation, Inc., 51 Franklin St, Fifth Floor, Boston, MA 02110-1301 USA
##

source src/drivers/ati/Kconfig
source src/drivers/dec/Kconfig
source src/drivers/elog/Kconfig
source src/drivers/emulation/Kconfig
source src/drivers/generic/Kconfig
source src/drivers/i2c/Kconfig
source src/drivers/ics/Kconfig
source src/drivers/ipmi/Kconfig
source src/drivers/maxim/Kconfig
source src/drivers/oxford/Kconfig
source src/drivers/parade/Kconfig
if PC80_SYSTEM
source src/drivers/pc80/Kconfig
endif
source src/drivers/realtek/Kconfig
source src/drivers/sil/Kconfig
source src/drivers/spi/Kconfig
source src/drivers/ti/Kconfig
source src/drivers/trident/Kconfig
```

## src/drivers/acpi/thermal_zone/Kconfig
```kconfig
## SPDX-License-Identifier: GPL-2.0-only

config DRIVERS_ACPI_THERMAL_ZONE
	bool
	default n
	depends on HAVE_ACPI_TABLES
	help
	  Adds a chip driver that generates ACPI ThermalZones. See the chapter
	  on Thermal Management in the ACPI specification.
```

## src/drivers/amd/ftpm/Kconfig
```kconfig
## SPDX-License-Identifier: GPL-2.0-only

config AMD_CRB_FTPM
	bool
	default n
	depends on !CRB_TPM
	depends on SOC_AMD_COMMON_BLOCK_PSP_GEN2
	# The fTPM needs to access the SPI flash, either directly when
	# ROM Armor is used, or via PSP SMI when ROM Armor is not used.
	depends on SOC_AMD_COMMON_BLOCK_PSP_SMI || SOC_AMD_COMMON_BLOCK_PSP_ROM_ARMOR3
	help
	  Mainboard has AMD fTPM with Command Response Buffer support.
	  The fTPM is based on the CRB interface as defined by TCG,
	  but with reduced set of registers being implemented.
```

## src/drivers/amd/opensil/Kconfig
```kconfig
# SPDX-License-Identifier: GPL-2.0-only

config OPENSIL_DRIVER
	bool
	help
	  Indicate that the openSIL driver is being used on the platform.
```

## src/drivers/ams/Kconfig
```kconfig
config DRIVERS_AS3722_RTC
	bool "AS3722 RTC support"
	default n
	select RTC

config DRIVERS_AS3722_RTC_BUS
	int "AS3722 RTC bus"
	depends on DRIVERS_AS3722_RTC
	default 0

config DRIVERS_AS3722_RTC_ADDR
	hex "AS3722 RTC chip address"
	depends on DRIVERS_AS3722_RTC
	default 0x00
```

## src/drivers/aspeed/Kconfig
```kconfig
source src/drivers/aspeed/common/Kconfig
source src/drivers/aspeed/ast2050/Kconfig
```

## src/drivers/aspeed/ast2050/Kconfig
```kconfig
config DRIVERS_ASPEED_AST2050
	bool
	select DRIVERS_ASPEED_AST_COMMON
	select MAINBOARD_HAS_NATIVE_VGA_INIT
```

## src/drivers/aspeed/common/Kconfig
```kconfig
config DRIVERS_ASPEED_AST_COMMON
	bool
	select HAVE_LINEAR_FRAMEBUFFER if MAINBOARD_DO_NATIVE_VGA_INIT
	select HAVE_VGA_TEXT_FRAMEBUFFER if MAINBOARD_DO_NATIVE_VGA_INIT
	select VGA if VGA_TEXT_FRAMEBUFFER
	select SOFTWARE_I2C if GENERIC_LINEAR_FRAMEBUFFER
```
