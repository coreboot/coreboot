## src/drivers/camera/Kconfig
```kconfig
## SPDX-License-Identifier: GPL-2.0-only

config CHROMEOS_CAMERA
	bool
	default n
	help
	  Camera with identifiers following ChromeOS Camera Info. The info is
	  usually available on MIPI camera EEPROM for identifying correct
	  drivers and config.
```

## src/drivers/crb/Kconfig
```kconfig
config CRB_TPM
	bool
	default n
	help
	  Mainboard has Command Response Buffer support

config CRB_TPM_BASE_ADDRESS
	hex
	default 0xfed40000
	help
	  Base Address of the CRB TPM Command Structure
```

## src/drivers/efi/Kconfig
```kconfig
## SPDX-License-Identifier: GPL-2.0-only

config DRIVERS_EFI_VARIABLE_STORE
	bool "Include EFI variable store driver"
	select UDK_2017_BINDING if !PLATFORM_USES_FSP2_0
	help
	  Adds a driver that is able to read and write an EFI formatted
	  VariableStore as used by tianocore.

config DRIVERS_EFI_FW_INFO
	bool "Expose firmware version in a EFI-friendly form"
	select UDK_2017_BINDING if !PLATFORM_USES_FSP2_0
	help
	  Adds firmware version information to coreboot table in a form similar to
	  EFI System Resource Table (ESRT) that can be used for firmware updates.

config DRIVERS_EFI_MAIN_FW_GUID
	string "GUID of the firmware"
	default "00112233-4455-6677-8899-aabbccddeeff"
	depends on DRIVERS_EFI_FW_INFO
	help
	  GUID used to identify firmware kind for the purposes of updates.

config DRIVERS_EFI_MAIN_FW_VERSION
	hex "Version of the firmware"
	range 0x00000000 0xFFFFFFFF
	default 0x00000000
	depends on DRIVERS_EFI_FW_INFO
	help
	  32-bit unsigned integer representing current firmware's version.

	  If set to 0, coreboot will try to derive a version from LOCALVERSION by
	  parsing a leading "<major>.<minor>" and encoding it as
	  (major << 16) | minor.

	  Non-digits before and after "<major>.<minor>" are ignored.
	  Examples:
	  - "26.01" -> 0x001A0001
	  - "v26.01-rc1" -> 0x001A0001

config DRIVERS_EFI_MAIN_FW_LSV
	hex "Lowest supported firmware version"
	range 0x00000000 0xFFFFFFFF
	default 0x00000000
	depends on DRIVERS_EFI_FW_INFO
	help
	  32-bit unsigned integer representing lowest firmware version number
	  that is allowed to replace the current one.  Can be used to forbid
	  bugged versions.

	  If set to 0, coreboot uses DRIVERS_EFI_MAIN_FW_VERSION.

config DRIVERS_EFI_UPDATE_CAPSULES
	bool "Include EFI update capsules driver"
	depends on DRIVERS_EFI_VARIABLE_STORE && SMMSTORE && DRIVERS_EFI_FW_INFO
	help
	  Adds a driver that is able to parse CapsuleUpdateData* EFI variables
	  to discover firmware updates and expose them for tianocore thorough
	  CBMEM for execution.  tianocore is responsible for erasing the variables.

config DRIVERS_EFI_CAPSULE_ACCEPT_EMBEDDED_DRIVERS
	bool "Allow embedded drivers in update capsules"
	depends on PAYLOAD_EDK2 && DRIVERS_EFI_UPDATE_CAPSULES
	help
	  Allow the EDK2 payload's capsule processing to load embedded drivers
	  from capsules (PcdCapsuleEmbeddedDriverSupport).

	  This is required for capsules that contain embedded drivers.

	  Note: if Secure Boot is enabled, the embedded driver must be signed by a
	  key trusted by the running firmware (or capsule processing may fail).

config DRIVERS_EFI_GENERATE_CAPSULE
	bool "Generate an update capsule during the build"
	depends on PAYLOAD_EDK2 && DRIVERS_EFI_UPDATE_CAPSULES
	help
	  Generates a UEFI capsule from the final ROM image using EDK2 BaseTools.
	  This is intended for fwupd update workflows that use the ESRT/FMP
	  mechanism.

config DRIVERS_EFI_CAPSULE_EMBED_FMP_DXE
	bool "Embed FmpDxe driver into generated capsules"
	depends on DRIVERS_EFI_GENERATE_CAPSULE
	depends on DRIVERS_EFI_CAPSULE_ACCEPT_EMBEDDED_DRIVERS
	help
	  When generating build/coreboot.cap, embed the built FmpDxe.efi as an
	  embedded driver in the capsule.


config DRIVERS_EFI_CAPSULE_INITIATE_RESET
	bool "Request reset after capsule is applied"
	default n
	depends on DRIVERS_EFI_GENERATE_CAPSULE
	help
	  Add the InitiateReset capsule flag when generating build/coreboot.cap.

	  Note: Linux rejects capsules with InitiateReset when using
	  /dev/efi_capsule_loader.


config DRIVERS_EFI_CAPSULE_REGIONS
	string "FMAP regions to include in the capsule manifest"
	default "COREBOOT"
	depends on DRIVERS_EFI_GENERATE_CAPSULE
	help
	  Whitespace-separated list of FMAP regions that the update capsule is
	  allowed to modify. The list is embedded as a manifest inside the ROM
	  image prior to building the capsule.

menu "Capsule signing certificates"
	depends on DRIVERS_EFI_GENERATE_CAPSULE

config DRIVERS_EFI_CAPSULE_SIGNER_PRIVATE_CERT
	string "PEM file used to sign generated capsules"
	default "BaseTools/Source/Python/Pkcs7Sign/TestCert.pem"
	depends on DRIVERS_EFI_GENERATE_CAPSULE
	help
	  Path to a PEM file containing the private key and leaf certificate used
	  when signing the capsule with EDK2 GenerateCapsule.

	  If the path is relative, it is interpreted relative to the configured
	  EDK2 repository (payloads/external/edk2 workspace).

	  See Documentation/drivers/efi_capsule_generation.md and
	  BaseTools/Source/Python/Pkcs7Sign/Readme.md in the EDK2 tree.

config DRIVERS_EFI_CAPSULE_OTHER_PUBLIC_CERT
	string "Intermediate certificate for capsule signing (PEM)"
	default "BaseTools/Source/Python/Pkcs7Sign/TestSub.pub.pem"
	depends on DRIVERS_EFI_GENERATE_CAPSULE
	help
	  Path to the intermediate certificate (PEM) used when generating a PKCS#7
	  signature for the capsule.

	  If the path is relative, it is interpreted relative to the configured
	  EDK2 repository (payloads/external/edk2 workspace).

config DRIVERS_EFI_CAPSULE_TRUSTED_PUBLIC_CERT
	string "Trusted root certificate for capsule signing (PEM)"
	default "BaseTools/Source/Python/Pkcs7Sign/TestRoot.pub.pem"
	depends on DRIVERS_EFI_GENERATE_CAPSULE
	help
	  Path to the trusted root certificate (PEM) used when generating a PKCS#7
	  signature for the capsule.

	  If the path is relative, it is interpreted relative to the configured
	  EDK2 repository (payloads/external/edk2 workspace).

endmenu
```

## src/drivers/elog/Kconfig
```kconfig
##
## This file is part of the coreboot project.
##
## Copyright (C) 2012 The Chromium OS Authors.  All rights reserved.
##
## This program is free software; you can redistribute it and/or modify
## it under the terms of the GNU General Public License as published by
## the Free Software Foundation; version 2 of the License.
##
## This program is distributed in the hope that it will be useful,
## but WITHOUT ANY WARRANTY; without even the implied warranty of
## MERCHANTABILITY or FITNESS FOR A PARTICULAR PURPOSE.  See the
## GNU General Public License for more details.
##

config ELOG
	bool "Support for flash based event log"
	default n
	depends on BOOT_DEVICE_SUPPORTS_WRITES
	help
	  Enable support for flash based event logging.

if ELOG

config ELOG_DEBUG
	bool "Enable debug output for event logging"
	default n

config ELOG_CBMEM
	bool "Store a copy of ELOG in CBMEM"
	default n
	help
	 This option will have ELOG store a copy of the flash event log
	 in a CBMEM region and export that address in SMBIOS to the OS.
	 This is useful if the ELOG location is not in memory mapped flash,
	 but it means that events added at runtime via the SMI handler
	 will not be reflected in the CBMEM copy of the log.

endif

config ELOG_GSMI
	depends on ELOG && SMM_TSEG
	bool "SMI interface to write and clear event log"
	select SPI_FLASH_SMM if BOOT_DEVICE_SPI_FLASH_RW_NOMMAP
	default n
	help
	  This interface is compatible with the linux kernel driver
	  available with CONFIG_GOOGLE_GSMI and can be used to write
	  kernel reset/shutdown messages to the event log.

config ELOG_BOOT_COUNT
	depends on ELOG
	bool "Maintain a monotonic boot number in CMOS"
	default n
	help
	  Store a monotonic boot number in CMOS and provide an interface
	  to read the current value and increment the counter.  This boot
	  counter will be logged as part of the System Boot event.

config ELOG_BOOT_COUNT_CMOS_OFFSET
	depends on ELOG && ELOG_BOOT_COUNT && !USE_OPTION_TABLE
	int "Offset in CMOS to store the boot count"
	default 0
	help
	  This value must be greater than 16 bytes so as not to interfere
	  with the standard RTC region.  Requires 8 bytes.
```

## src/drivers/emulation/qemu/Kconfig
```kconfig
## SPDX-License-Identifier: GPL-2.0-only

config DRIVERS_EMULATION_QEMU_BOCHS
	bool "bochs dispi interface vga driver"
	default y
	depends on PCI
	depends on VENDOR_EMULATION
	depends on MAINBOARD_DO_NATIVE_VGA_INIT
	select HAVE_VGA_TEXT_FRAMEBUFFER if CPU_QEMU_X86
	select HAVE_LINEAR_FRAMEBUFFER
	select VGA
	help
	   VGA driver for qemu emulated vga cards supporting
	   the bochs dispi interface.  This includes
	   standard vga, vmware svga, and qxl.

config DRIVERS_EMULATION_QEMU_CIRRUS
	bool "cirrus svga driver"
	default y
	depends on CPU_QEMU_X86
	depends on MAINBOARD_DO_NATIVE_VGA_INIT
	select HAVE_VGA_TEXT_FRAMEBUFFER
	select HAVE_LINEAR_FRAMEBUFFER
	select VGA
	help
	   VGA driver for qemu emulated cirrus svga card.

config DRIVERS_EMULATION_QEMU_XRES
	int "qemu vga xres"
	default 800
	depends on LINEAR_FRAMEBUFFER
	depends on DRIVERS_EMULATION_QEMU_BOCHS || DRIVERS_EMULATION_QEMU_CIRRUS

config DRIVERS_EMULATION_QEMU_YRES
	int "qemu vga yres"
	default 600
	depends on LINEAR_FRAMEBUFFER
	depends on DRIVERS_EMULATION_QEMU_BOCHS || DRIVERS_EMULATION_QEMU_CIRRUS

config DRIVERS_EMULATION_QEMU_FW_CFG
	bool "qemu fw_cfg"
	default n
	help
	  qemu fw_cfg driver
```

## src/drivers/generic/Kconfig
```kconfig
source src/drivers/generic/generic/Kconfig
source src/drivers/generic/ioapic/Kconfig
```

## src/drivers/generic/bayhub_lv2/Kconfig
```kconfig
## SPDX-License-Identifier: GPL-2.0-only

config DRIVERS_GENERIC_BAYHUB_LV2
	bool
```

## src/drivers/generic/cbfs-serial/Kconfig
```kconfig
## SPDX-License-Identifier: GPL-2.0-only

config DRIVERS_GENERIC_CBFS_SERIAL
	bool "Serial number in CBFS"
	default n
	help
	  Enable this option to read the board serial number from a
	  text file located in CBFS.
```

## src/drivers/generic/cbfs-uuid/Kconfig
```kconfig
config DRIVERS_GENERIC_CBFS_UUID
	bool "System UUID in CBFS"
	default n
	help
	  Enable this option to read the SMBIOS system UUID from a
	  text file located in CBFS.
```

## src/drivers/generic/gfx/Kconfig
```kconfig
config DRIVERS_GENERIC_GFX
	bool
	default n
	depends on HAVE_ACPI_TABLES
	help
	  Include support for generic graphics device in devicetree
```

## src/drivers/generic/gpio_regulator/Kconfig
```kconfig
# SPDX-License-Identifier: GPL-2.0-only

config DRIVERS_GENERIC_GPIO_REGULATOR
	bool
	depends on HAVE_ACPI_TABLES
```

## src/drivers/generic/max98357a/Kconfig
```kconfig
## SPDX-License-Identifier: GPL-2.0-only

config DRIVERS_GENERIC_MAX98357A
	bool
	depends on HAVE_ACPI_TABLES
```

## src/drivers/genesyslogic/gl9750/Kconfig
```kconfig
config DRIVERS_GENESYSLOGIC_GL9750
	bool "Genesys Logic GL9750"
	help
	  GL9750 is a PCI Express Rev. 1.1 compliant card reader controller
	  which integrates PCI Express PHY, memory card access interface,
	  regulators (3.3V-to-1.2V) and card power switch. Enabling this driver
	  will disable L0s support, which will allow the device to enter the
	  PCIe L1 link state.
```

## src/drivers/genesyslogic/gl9755/Kconfig
```kconfig
config DRIVERS_GENESYSLOGIC_GL9755
	bool "Genesys Logic GL9755"
	help
	  GL9755 is a PCI Express Rev. 2.1 compliant card reader controller
	  which integrates PCI Express PHY, UHS-II PHY, memory card access
	  interface, regulators (3.3V-to-1.8V and 3.3V-to-1.2V) and card
	  power switch.
```
