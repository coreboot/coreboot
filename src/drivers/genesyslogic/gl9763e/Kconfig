## src/drivers/genesyslogic/gl9763e/Kconfig
```kconfig
config DRIVERS_GENESYSLOGIC_GL9763E
	bool "Genesys Logic GL9763E"
	default n

config DRIVERS_GENESYSLOGIC_GL9763E_L1_MAX
	bool "Set L1 entry delay to MAX"
	depends on DRIVERS_GENESYSLOGIC_GL9763E
	default n
```

## src/drivers/gfx/generic/Kconfig
```kconfig
## SPDX-License-Identifier: GPL-2.0-only

config DRIVERS_GFX_GENERIC
	bool
	default n
	depends on HAVE_ACPI_TABLES
	help
	  Include support for generic graphics device in devicetree
```

## src/drivers/gic/Kconfig
```kconfig
config GIC
	def_bool n
	help
	  This option enables GIC support, the ARM generic interrupt controller.
```

## src/drivers/hwid_dmi/Kconfig
```kconfig
## SPDX-License-Identifier: GPL-2.0-only

config DRIVERS_HWID_DMI
	bool "HWID from CBFS for SMBIOS product name"
	default n
	help
	  Enable this option to read the hardware ID (HWID) from a
	  file in CBFS and use it to populate the SMBIOS product name.
	  The driver will read a file named 'hwid' from CBFS, process it
	  to extract the base HWID (trimming whitespace, removing 'hwid:'
	  prefix, and dropping everything after hyphen or space), and
	  use it as the SMBIOS system product name.
```

## src/drivers/hwm/Kconfig
```kconfig
config SUPERIO_HWM
	bool "Super I/O HWM"
	default n
	help
	  Just enough of a driver to make coreboot control system fans.
	  No configuration is necessary for the OS to pick up the device.
```

## src/drivers/i2c/Kconfig
```kconfig
source src/drivers/i2c/adm1026/Kconfig
source src/drivers/i2c/adm1027/Kconfig
source src/drivers/i2c/adt7463/Kconfig
source src/drivers/i2c/at24rf08c/Kconfig
source src/drivers/i2c/i2cmux/Kconfig
source src/drivers/i2c/i2cmux2/Kconfig
source src/drivers/i2c/lm63/Kconfig
source src/drivers/i2c/rtd2132/Kconfig
source src/drivers/i2c/tpm/Kconfig
source src/drivers/i2c/w83793/Kconfig
source src/drivers/i2c/w83795/Kconfig
source src/drivers/i2c/ww_ring/Kconfig
```

## src/drivers/i2c/adm1026/Kconfig
```kconfig
config DRIVERS_I2C_ADM1026
	bool
	default n
	help
	  Support for ADM1026-Thermal System Management Fan Controller IC
```

## src/drivers/i2c/adm1027/Kconfig
```kconfig
config DRIVERS_I2C_ADM1027
	bool
	default n
	help
	  Support for ADM1027-Remote Thermal Controller and Voltage Monitor
```

## src/drivers/i2c/adt7463/Kconfig
```kconfig
config DRIVERS_I2C_ADT7463
	bool
	default n
	help
	  Support for ADT7463-Remote Thermal Controller and Voltage Monitor
```

## src/drivers/i2c/at24rf08c/Kconfig
```kconfig
## SPDX-License-Identifier: GPL-2.0-only

config DRIVER_LENOVO_SERIALS
	bool
	select SMBIOS_PROVIDED_BY_MOBO

config DRIVER_LENOVO_SERIALS_EARLY_LOCK
	bool
	depends on DRIVER_LENOVO_SERIALS
```

## src/drivers/i2c/cs35l53/Kconfig
```kconfig
## SPDX-License-Identifier: GPL-2.0-only

config DRIVERS_I2C_CS35L53
	bool
	depends on HAVE_ACPI_TABLES
```

## src/drivers/i2c/cs42l42/Kconfig
```kconfig
## SPDX-License-Identifier: GPL-2.0-only

config DRIVERS_I2C_CS42L42
	bool
	depends on HAVE_ACPI_TABLES
```

## src/drivers/i2c/designware/Kconfig
```kconfig
## SPDX-License-Identifier: GPL-2.0-only

config DRIVERS_I2C_DESIGNWARE
	bool
	help
	  Designware I2C support

config DRIVERS_I2C_DESIGNWARE_CLOCK_MHZ
	int
	depends on DRIVERS_I2C_DESIGNWARE
	help
	  The i2c ip block's clock.

config DRIVERS_I2C_DESIGNWARE_DEBUG
	bool
	default n
	depends on DRIVERS_I2C_DESIGNWARE
```

## src/drivers/i2c/gpiomux/Kconfig
```kconfig
config DRIVERS_I2C_GPIO_MUX
	bool
	default n
	depends on HAVE_ACPI_TABLES
	help
	  When enabled, add identifiers in ACPI tables for GPIO based I2C multiplexer.
```

## src/drivers/i2c/hid/Kconfig
```kconfig
## SPDX-License-Identifier: GPL-2.0-only

config DRIVERS_I2C_HID
	bool
	select DRIVERS_I2C_GENERIC
```

## src/drivers/i2c/i2cmux/Kconfig
```kconfig
config DRIVERS_I2C_I2CMUX
	bool
	default n
	help
	  Support for PCA9556 SMBus IC
```

## src/drivers/i2c/i2cmux2/Kconfig
```kconfig
config DRIVERS_I2C_I2CMUX2
	bool
	default n
	help
	  Support for PCA9554 SMBus IC
```

## src/drivers/i2c/lm63/Kconfig
```kconfig
config DRIVERS_I2C_LM63
	bool
	default n
	help
	  Support for National Semiconductor LM63
```

## src/drivers/i2c/lm96000/Kconfig
```kconfig
## SPDX-License-Identifier: GPL-2.0-only

config DRIVERS_I2C_LM96000
	depends on HAVE_MONOTONIC_TIMER
	bool
	help
	  Hardware-monitoring IC LM96000.
```
