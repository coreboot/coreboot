## src/drivers/i2c/max98396/Kconfig
```kconfig
## SPDX-License-Identifier: GPL-2.0-only

config DRIVERS_I2C_MAX98396
	bool "Enable AMP MAX98396"
	depends on HAVE_ACPI_TABLES
```

## src/drivers/i2c/max98927/Kconfig
```kconfig
## SPDX-License-Identifier: GPL-2.0-only

config DRIVERS_I2C_MAX98927
	bool
	default n
	depends on HAVE_ACPI_TABLES
```

## src/drivers/i2c/nct7802y/Kconfig
```kconfig
## SPDX-License-Identifier: GPL-2.0-only

config DRIVERS_I2C_NCT7802Y
	bool
	help
	  The NCT7802Y by Nuvoton is a Hardware Monitoring IC.
```

## src/drivers/i2c/pca9538/Kconfig
```kconfig
## SPDX-License-Identifier: GPL-2.0-only

config DRIVERS_I2C_PCA9538
	bool
	default n
	help
	  Enable support for I2C I/O expander PCA9538.
```

## src/drivers/i2c/pcf8523/Kconfig
```kconfig
## SPDX-License-Identifier: GPL-2.0-only

config DRIVERS_I2C_PCF8523
	bool
	default n
```

## src/drivers/i2c/pi608gp/Kconfig
```kconfig
config DRIVERS_I2C_PI608GP
	bool
	default n
	help
	  Enable support for configuring the Pericom PI7C9X2G608GP Gen2 PCIe switch over SMBus.
```

## src/drivers/i2c/ptn3460/Kconfig
```kconfig
config DRIVERS_I2C_PTN3460
	bool
	default n
	help
	  Enable support for external display bridge (eDP to LVDS) PTN3460.

config PTN3460_EARLY_INIT
	bool
	default n
	depends on DRIVERS_I2C_PTN3460
	help
	  Enable early initialization of the PTN3460 DP-to-LVDS bridge

config PTN3460_EARLY_ADDR
	hex
	default 0x60
	depends on PTN3460_EARLY_INIT
	help
	  I2C address for early initialization of the PTN3460 DP-to-LVDS bridge
```

## src/drivers/i2c/rt5645/Kconfig
```kconfig
## SPDX-License-Identifier: GPL-2.0-only

config DRIVERS_I2C_RT5645
	bool
	depends on HAVE_ACPI_TABLES
```

## src/drivers/i2c/rt5663/Kconfig
```kconfig
## SPDX-License-Identifier: GPL-2.0-only

config DRIVERS_I2C_RT5663
	bool
	default n
	depends on HAVE_ACPI_TABLES
```

## src/drivers/i2c/rtd2132/Kconfig
```kconfig
## SPDX-License-Identifier: GPL-2.0-only

config DRIVERS_I2C_RTD2132
	bool
	default n
	help
	  Enable support for Realtek RTD2132 DisplayPort to LVDS bridge chip.
```

## src/drivers/i2c/rv3028c7/Kconfig
```kconfig
config DRIVERS_I2C_RV3028C7
	bool
	default n
	help
	  Enable support for external RTC chip RV-3028-C7
```

## src/drivers/i2c/rx6110sa/Kconfig
```kconfig
config DRIVERS_I2C_RX6110SA
	bool
	default n
	help
	  Enable support for external RTC chip RX6110 SA.

config RX6110SA_DISABLE_ACPI
	bool
	default n
	help
	  Disable the generation of an ACPI entry for this RTC. This is helpful
	  when the native driver for this RTC in OS does not have ACPI support enabled.
```

## src/drivers/i2c/sx9310/Kconfig
```kconfig
config DRIVERS_I2C_SX9310
	bool
	default n
	depends on HAVE_ACPI_TABLES
	help
	  Board has a Semtech SX9310 proximity sensor.
```

## src/drivers/i2c/sx9324/Kconfig
```kconfig
config DRIVERS_I2C_SX9324
	bool
	default n
	depends on HAVE_ACPI_TABLES
	help
	  Board has a Semtech SX9324 proximity sensor.

config DRIVERS_I2C_SX9324_SUPPORT_LEGACY_LINUX_DRIVER
	bool
	default n
	depends on DRIVERS_I2C_SX9324
	help
	  Board may use the legacy sx932x linux driver.
	  This option is mainly to ease migrating from the legacy driver to the
	  Linux one and should be deleted once all variants finish migration.
	  This driver never reached upstream Linux and is only available in
	  ChromeOS kernel fork of 4.4 and 5.4. Linux later accepted a different
	  implementation named SX9324 and has been available since 5.4.
	  Ideally all variants should adopt the new driver; however, during the
	  transition phase, coreboot must support both drivers. By selecting this
	  option, coreboot's SX9324 driver will specify all properties to work with
	  both Linux kernel drivers.
```

## src/drivers/i2c/sx9360/Kconfig
```kconfig
config DRIVERS_I2C_SX9360
	bool
	default n
	depends on HAVE_ACPI_TABLES
	help
	  Board has a Semtech SX9360 proximity sensor.
```

## src/drivers/i2c/tas2563/Kconfig
```kconfig
## SPDX-License-Identifier: GPL-2.0-only

config DRIVERS_I2C_TAS2563
	bool
	default n
	help
	  Enable support for TI TAS2563 Amplifier.
```

## src/drivers/i2c/tas5825m/Kconfig
```kconfig
## SPDX-License-Identifier: GPL-2.0-only

config DRIVERS_I2C_TAS5825M
	bool
	default n
	help
	  Enable support for TI TAS5825M Amplifier.
```

## src/drivers/i2c/tpm/Kconfig
```kconfig
config I2C_TPM
	bool
	help
	  I2C TPM driver is enabled!

config DRIVER_TIS_DEFAULT
	bool
	depends on I2C_TPM
	default n if TPM_ATMEL
	default y

config DRIVER_TPM_I2C_BUS
	hex
	default 0x9 # FIXME, workaround for Kconfig BS
	depends on I2C_TPM

config DRIVER_TPM_I2C_ADDR
	hex
	default 0x2 # FIXME, workaround for Kconfig BS
	depends on I2C_TPM

config DRIVER_I2C_TPM_ACPI
	bool "Generate I2C TPM ACPI device" if I2C_TPM
	default y if ARCH_X86 && I2C_TPM
	default n

config DRIVER_TPM_DISPLAY_TIS_BYTES
	bool "TPM: Display the TIS transactions to I2C TPM chip"
	default n
	depends on I2C_TPM

config TPM_ATMEL
	bool
	default n
	help
	  The mainboard has an Atmel TPM chip.
```
