## src/drivers/intel/fsp2_0/Kconfig.debug_blob
```kconfig
if PLATFORM_USES_FSP2_0

config DISPLAY_FSP_CALLS_AND_STATUS
	bool "Display the FSP calls and status"
	default n
	help
	  Display the FSP call entry point and parameters prior to calling FSP
	  and display the status upon return from FSP.

config DISPLAY_FSP_HEADER
	bool "Display the FSP header"
	default n
	help
	  Display the FSP header information when the FSP file is found.

config DISPLAY_HOBS
	bool "Display the hand-off-blocks"
	default n
	help
	  Display the FSP HOBs which are provided for coreboot.

config DISPLAY_UPD_DATA
	bool "Display UPD data"
	default n
	help
	  Display the user specified product data prior to memory
	  initialization.

config VERIFY_HOBS
	bool "Verify the FSP hand-off-blocks"
	default n
	help
	  Verify that the HOBs required by coreboot are returned by FSP and
	  that the resource HOBs are in the correct order and position.

config DISPLAY_FSP_VERSION_INFO
	bool "Display Firmware Ingredient Version Information"
	help
	  Select this option to display Firmware version information.

config DISPLAY_FSP_VERSION_INFO_2
	bool
	default n
	help
	  Select this option to display Firmware version information
	  using new header 'FirmwareVersionInfo.h'.

endif # PLATFORM_USES_FSP2_0
```

## src/drivers/intel/fsp2_0/ppi/Kconfig
```kconfig
# SPDX-License-Identifier: GPL-2.0-only

config MP_SERVICES_PPI
	bool
	default n
	depends on SOC_INTEL_COMMON_BLOCK_CPU_MPINIT
	help
	  This option allows to create MP service PPI for Intel FSP usage.
	  Intel FSP will use this PPI to run CPU feature programming on APs.

config MP_SERVICES_PPI_V1
	bool
	default n
	select MP_SERVICES_PPI
	help
	  This option provides EFI_PEI_MP_SERVICES_PPI structure definitions
	  along with all APIs as per edk2 specification.

config MP_SERVICES_PPI_V2
	bool
	default n
	select MP_SERVICES_PPI
	help
	  This option provides EDKII_PEI_MP_SERVICES2_PPI structure definitions
	  along with all APIs as per edk2 specification. MP services2 PPI is slight
	  modification over MP services1 PPIs. A new API StartupAllCPUs have been
	  added to allow running a task on BSP and all APs. Also the EFI_PEI_SERVICES
	  parameter has been removed from all MP PPI APIs.
```

## src/drivers/intel/gma/Kconfig
```kconfig
## SPDX-License-Identifier: GPL-2.0-only

config INTEL_DDI
	bool
	default n
	help
	  helper functions for intel DDI operations

config INTEL_EDID
	bool
	default n

config INTEL_INT15
	bool
	default n

config INTEL_GMA_ACPI
	bool
	default n

config INTEL_GMA_BCLV_OFFSET
	hex
	default 0xc8254

config INTEL_GMA_BCLV_WIDTH
	int
	default 16

config INTEL_GMA_BCLM_OFFSET
	hex
	default 0xc8256

config INTEL_GMA_BCLM_WIDTH
	int
	default 16

config INTEL_GMA_SSC_ALTERNATE_REF
	bool
	default n
	help
	  Set when the SSC reference clock for LVDS runs at a different fre-
	  quency than the general display reference clock.

	  To be set by northbridge or mainboard Kconfig.  For most platforms,
	  there is no choice, i.e. for i945 and gm45 the SSC reference always
	  differs from the display reference clock (i945: 66Mhz SSC vs. 48MHz
	  DREF; gm45: 100MHz SSC vs. 96Mhz DREF), for Arrandale and newer, it's
	  the same frequency for SSC/non-SSC (120MHz).  The only, currently
	  supported platform with a choice seems to be Pineview, where the
	  alternative is 100MHz vs. the default 96MHz.

config INTEL_GMA_SWSMISCI
	bool
	default n
	help
	  Select this option for Atom-based platforms which use the SWSMISCI
	  register (0xe0) rather than the SWSCI register (0xe8).

config INTEL_GMA_LIBGFXINIT_EDID
	bool

config VBT_DATA_SIZE_KB
	int
	default 8

config GFX_GMA_ANALOG_I2C_HDMI_B
	bool

config GFX_GMA_ANALOG_I2C_HDMI_C
	bool

config GFX_GMA_ANALOG_I2C_HDMI_D
	bool

config GFX_GMA_IGNORE_PRESENCE_STRAPS
	def_bool n
	depends on MAINBOARD_HAS_LIBGFXINIT
	help
	  libgfxinit uses the GPU presence straps to determine if a display port
	  is present/enabled. Select this option if a board doesn't correctly implement
	  these straps, causing libgfxinit to fail to detect an attached panel.

config GFX_GMA
	def_bool y
	depends on NORTHBRIDGE_INTEL_GM45 || NORTHBRIDGE_INTEL_X4X \
		|| NORTHBRIDGE_INTEL_IRONLAKE || NORTHBRIDGE_INTEL_SANDYBRIDGE \
		|| NORTHBRIDGE_INTEL_HASWELL || SOC_INTEL_BROADWELL \
		|| SOC_INTEL_COMMON_SKYLAKE_BASE || SOC_INTEL_APOLLOLAKE \
		|| SOC_INTEL_CANNONLAKE_BASE
	depends on MAINBOARD_USE_LIBGFXINIT || INTEL_GMA_LIBGFXINIT_EDID
	select RAMSTAGE_LIBHWBASE

config EARLY_GFX_GMA
	def_bool y
	depends on SOC_INTEL_ALDERLAKE
	depends on MAINBOARD_USE_EARLY_LIBGFXINIT
	select ROMSTAGE_LIBHWBASE

config GFX_GMA_DEFAULT_MMIO
	hex
	depends on HWBASE_STATIC_MMIO && (GFX_GMA || EARLY_GFX_GMA)
	help
	  Graphics device MMIO address. This is typically an unused
	  memory mapping region which can be allocated to the MMIO
	  region as graphics PCI device Base Address Range zero.

config GFX_GMA_PANEL_1_ON_EDP
	bool
	depends on GFX_GMA || MAINBOARD_HAS_LIBGFXINIT \
		|| MAINBOARD_HAS_EARLY_LIBGFXINIT
	default n if GFX_GMA_PANEL_1_ON_LVDS
	default y

config GFX_GMA_PANEL_1_ON_LVDS
	bool
	depends on GFX_GMA || MAINBOARD_HAS_LIBGFXINIT \
		|| MAINBOARD_HAS_EARLY_LIBGFXINIT
	default y if NORTHBRIDGE_INTEL_GM45 || NORTHBRIDGE_INTEL_IRONLAKE
	default n

config INTEL_GMA_OPREGION_2_0
	bool
	default n if INTEL_GMA_OPREGION_2_1
	default y

config INTEL_GMA_OPREGION_2_1
	bool
	default n

if GFX_GMA || EARLY_GFX_GMA

config GFX_GMA_DYN_CPU
	def_bool y
	help
	  Activates runtime CPU detection in libgfxinit.

config GFX_GMA_GENERATION
	string
	default "Broxton" if SOC_INTEL_APOLLOLAKE
	default "Skylake" if SOC_INTEL_COMMON_SKYLAKE_BASE || SOC_INTEL_CANNONLAKE_BASE
	default "Haswell" if NORTHBRIDGE_INTEL_HASWELL || SOC_INTEL_BROADWELL
	default "Ironlake" if NORTHBRIDGE_INTEL_IRONLAKE || NORTHBRIDGE_INTEL_SANDYBRIDGE
	default "G45" if NORTHBRIDGE_INTEL_GM45 || NORTHBRIDGE_INTEL_X4X
	default "Tigerlake" if SOC_INTEL_ALDERLAKE

config GFX_GMA_PCH
	string
	default "Ibex_Peak" if NORTHBRIDGE_INTEL_IRONLAKE
	default "Cougar_Point" if NORTHBRIDGE_INTEL_SANDYBRIDGE
	default "Lynx_Point" if NORTHBRIDGE_INTEL_HASWELL || SOC_INTEL_BROADWELL
	default "Sunrise_Point" if SOC_INTEL_COMMON_SKYLAKE_BASE
	default "Cannon_Point" if SOC_INTEL_CANNONLAKE_BASE
	default "Alder_Point" if SOC_INTEL_ALDERLAKE
	default "No_PCH"

config GFX_GMA_PANEL_1_PORT
	string
	default "eDP" if GFX_GMA_PANEL_1_ON_EDP
	default "LVDS"

config GFX_GMA_PANEL_2_PORT
	string
	default "Disabled"

config GFX_GMA_ANALOG_I2C_PORT
	string
	default "PCH_HDMI_B" if GFX_GMA_ANALOG_I2C_HDMI_B
	default "PCH_HDMI_C" if GFX_GMA_ANALOG_I2C_HDMI_C
	default "PCH_HDMI_D" if GFX_GMA_ANALOG_I2C_HDMI_D
	default "PCH_DAC"
	help
	  Boards with a DVI-I connector share the I2C pins for both analog and
	  digital displays. In that case, the EDID for a VGA display has to be
	  read over the I2C interface of the coupled digital port.

endif
```

## src/drivers/intel/i210/Kconfig
```kconfig
## SPDX-License-Identifier: GPL-2.0-only

config DRIVER_INTEL_I210
	bool
	default n
```

## src/drivers/intel/ish/Kconfig
```kconfig
## SPDX-License-Identifier: GPL-2.0-only

config DRIVERS_INTEL_ISH
	bool
	default n
	help
	   When enabled, chip driver/intel/ish will publish information to the
	   SSDT _DSD table for the ISH device.

config DRIVER_INTEL_ISH_HAS_MAIN_FW
	bool
	default n
	depends on DRIVERS_INTEL_ISH
	help
	  This config specifies that the Intel Sensor Hub (ISH) is using ISH MAIN firmware. The
	  ISH MAIN FW resides in the rootfs and is loaded by the kernel. Since there is no dependency
	  on AP firmware, the ISH BUP version is not fetched from the CSE firmware partition.

	  This setting is platform-specific. Enable it only on platforms where the ISH is
	  confirmed to be using the MAIN firmware.
```

## src/drivers/intel/mipi_camera/Kconfig
```kconfig
## SPDX-License-Identifier: GPL-2.0-only

config DRIVERS_INTEL_MIPI_CAMERA
	bool
	depends on HAVE_ACPI_TABLES
	default n
	help
	  MIPI CSI I2C camera SSDT generator. Generates SSDB and PWDB
	  structures which are used by the Intel kernel drivers.

if DRIVERS_INTEL_MIPI_CAMERA

config DRIVERS_INTEL_MIPI_SUPPORTS_PRE_PRODUCTION_SOC
	def_bool n
	help
	  Use this config to provide information to IPU kernel driver
	  if pre-production or production signed IPU FW needs to be loaded.

choice
	prompt "MIPI camera ACPI type"
	default MIPI_ACPI_TYPE_CHROMEOS if CHROMEOS
	default MIPI_ACPI_TYPE_WINDOWS_LINUX
	help
	  Select the ACPI device type to generate for the MIPI camera.

config MIPI_ACPI_TYPE_WINDOWS_LINUX
	bool "Windows / Linux"
	help
	  Generates a single ACPI device for the camera sensor and any
	  associated VCM or NVM devices on the same I2C bus, instead of
	  separate ACPI devices for each camera related device. The IPU
	  ACPI device is attached to the iGPU, not standalone. This is
	  the preferred method for Windows and mainline Linux.

config MIPI_ACPI_TYPE_CHROMEOS
	bool "Chrome OS"
	help
	  Generates separate ACPI devices for each camera related device.
	  The IPU ACPI device is generated separately from the iGPU.
	  This is the preferred method for ChromeOS.

endchoice
endif
```

## src/drivers/intel/pmc_mux/Kconfig
```kconfig
config DRIVERS_INTEL_PMC
	bool
	default n
	depends on HAVE_ACPI_TABLES
	help
	   When enabled, driver/intel/pmc_mux will add support for mux
	   configuration of USB Type-C ports via the SoC's muxes.
```

## src/drivers/intel/ptt/Kconfig
```kconfig
config HAVE_INTEL_PTT
	bool
	default n
	select VBOOT_MOCK_SECDATA if VBOOT
	help
		Activate if your platform has Intel Platform Trust Technology like Intel iTPM and you want to use it.
```

## src/drivers/intel/touch/Kconfig
```kconfig
## SPDX-License-Identifier: GPL-2.0-only

config DRIVERS_INTEL_TOUCH
	bool
	help
	  If selected, chip drivers/intel/touch publishes data into the SSDT (Secondary System
	  Description Table) for both the touch controller and the sensor device.
```

## src/drivers/intel/usb4/retimer/Kconfig
```kconfig
config DRIVERS_INTEL_USB4_RETIMER
	bool
	depends on HAVE_ACPI_TABLES
	help
	   A retimer is a device that retransmits a fresh copy of the signal it
	   receives, by doing CDR and retransmitting the data (i.e., it is
	   protocol-aware). If your mainboard has a USB4 retimer (usually
	   located close to the USB4 ports), then select this driver.
```

## src/drivers/intel/wifi/Kconfig
```kconfig
config DRIVERS_INTEL_WIFI
	bool "Support Intel PCI-e WiFi adapters"
	depends on PCI
	default y if PCIEXP_PLUGIN_SUPPORT
	select DRIVERS_WIFI_GENERIC
	help
	   When enabled, add identifiers in ACPI and SMBIOS tables to
	   make OS drivers work with certain Intel PCI-e WiFi chipsets.
```

## src/drivers/ipmi/Kconfig
```kconfig
config IPMI_KCS
	bool
	default n

config IPMI_KCS_REGISTER_SPACING
	int
	default 1
	depends on IPMI_KCS
	help
	  KCS status and command register IO port address spacing

config IPMI_FRU_SINGLE_RW_SZ
	int
	default 16
	depends on IPMI_KCS
	help
	  The data size in a single IPMI FRU read/write command.
	  IPMB messages are limited to 32-bytes total. When the
	  data size is larger than this value, IPMI can complete
	  reading/writing the data over multiple commands.

config IPMI_KCS_ROMSTAGE
	bool
	default n
	depends on IPMI_KCS
	help
	  IPMI KCS support in romstage.

config BMC_KCS_BASE
	hex
	default 0xca2
	depends on IPMI_KCS
	help
	  The PNP base address of BMC KCS. It must be equal to the
	  pnp port value defined in devicetree for chip drivers/ipmi.

config IPMI_KCS_TIMEOUT_MS
	int
	default 5000
	depends on IPMI_KCS
	help
	  The time unit is millisecond for each IPMI KCS transfer.
	  IPMI spec v2.0 rev 1.1 Sec. 9.15, a five-second timeout or
	  greater is recommended.

config DRIVERS_IPMI_SUPERMICRO_OEM
	bool "Supermicro IPMI OEM BMC support"
	depends on IPMI_KCS
	default n
	help
	  Tested on X11SSH only. Different BMCs might not support these OEM
	  commands.
	  The following features are implemented:
	  * Communicates the BIOS version to the BMC
	  * Communicates the BIOS date to the BMC
```

## src/drivers/ipmi/ocp/Kconfig
```kconfig
config IPMI_OCP
	bool
	default n
	help
	  This implements OCP specific IPMI command

config IPMI_BMC_SEL
	bool
	depends on IPMI_OCP
	default n
	help
	  This implements OCP specific command to generate/send SEL record

config RAS_SEL_VENDOR_ID
	hex
	depends on IPMI_BMC_SEL
	default 0xff
	help
	  This option specifies a vendor ID for BMC SEL messages
```

## src/drivers/lenovo/Kconfig
```kconfig
config DRIVERS_LENOVO_WACOM
	bool
	default n

if DRIVERS_LENOVO_WACOM

choice
	prompt "Digitizer"
	default DIGITIZER_AUTODETECT

config DIGITIZER_AUTODETECT
	bool "Autodetect"
	help
	  The presence of digitizer is inferred from model number stored in
	  AT24RF chip.

config DIGITIZER_PRESENT
	bool "Present"
	help
	  The digitizer is assumed to be present.

config DIGITIZER_ABSENT
	bool "Absent"
	help
	  The digitizer is assumed to be absent.

endchoice

endif

config DRIVERS_LENOVO_HYBRID_GRAPHICS
	bool
	default n

config HYBRID_GRAPHICS_GPIO_NUM
	depends on DRIVERS_LENOVO_HYBRID_GRAPHICS
	int
	default 52
	help
	  Set a default GPIO that sets the panel LVDS signal routing to
	  integrated or discrete GPU.
```

## src/drivers/lenovo/hybrid_graphics/Kconfig
```kconfig
## SPDX-License-Identifier: GPL-2.0-only

config DRIVERS_LENOVO_HYBRID_GRAPHICS
	bool
	default n
	# for dual graphics we need to set this
	select ONBOARD_VGA_IS_PRIMARY
```

## src/drivers/maxim/Kconfig
```kconfig
config DRIVER_MAXIM_77686
	bool "Maxim 77686"
	default n
	help
	  Maxim 77686 power regulator
```
