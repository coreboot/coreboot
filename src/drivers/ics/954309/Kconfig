## src/drivers/intel/Kconfig
```kconfig
##
## This file is part of the coreboot project.
##
## Copyright (C) 2013 Google Inc.
##
## This program is free software; you can redistribute it and/or modify
## it under the terms of the GNU General Public License as published by
## the Free Software Foundation; version 2 of the License.
##
## This program is distributed in the hope that it will be useful,
## but WITHOUT ANY WARRANTY; without even the implied warranty of
## MERCHANTABILITY or FITNESS FOR A PARTICULAR PURPOSE.  See the
## GNU General Public License for more details.
##

source src/drivers/intel/fsp1_1/Kconfig
source src/drivers/intel/gma/Kconfig
source src/drivers/intel/i210/Kconfig
```

## src/drivers/intel/dptf/Kconfig
```kconfig
config DRIVERS_INTEL_DPTF
	bool
	depends on HAVE_ACPI_TABLES
	default n
	help
	   When enabled, entries in the devicetree are used to generate
	   Intel DPTF Tables at runtime in the SSDT.

config HAVE_DPTF_EISA_HID
	bool

config DPTF_USE_EISA_HID
	bool
	depends on DRIVERS_INTEL_DPTF
	default y if HAVE_DPTF_EISA_HID
	default n
	help
	  Prior to Tiger Lake, all DPTF devices used 7-character EISA
	  IDs. If selected, the 7-character _HIDs will be emitted,
	  otherwise, it will use the "new" style, which are regular
	  8-character _HIDs.

config DRIVERS_INTEL_DPTF_SUPPORTS_TPCH
	def_bool n
	depends on HAVE_ACPI_TABLES && PMC_IPC_ACPI_INTERFACE
	help
	  When enabled, chip driver/intel/dptf will publish information to the
	  SSDT for the TPCH device.

config DRIVERS_INTEL_DPTF_SUPPORTS_TPWR
	def_bool n
	depends on DRIVERS_INTEL_DPTF
	help
	  When enabled, chip driver/intel/dptf will publish information to the
	  SSDT for TPWR device.

config DRIVERS_INTEL_DPTF_SUPPORTS_TBAT
	def_bool n
	depends on DRIVERS_INTEL_DPTF
	help
	  When enabled, chip driver/intel/dptf will publish information to the
	  SSDT for TBAT device.
```

## src/drivers/intel/dtbt/Kconfig
```kconfig
config DRIVERS_INTEL_DTBT
	def_bool n
	help
	  Enable support for discrete Thunderbolt controllers (Alpine Ridge,
	  Titan Ridge, and Maple Ridge). Provides device initialization and ACPI
	  _DSD/opregion for S3 sleep support. Mainboards must call \TBTS from
	  their MPTS so TBT is prepared before sleep.

	  Note: Only a single TBT bridge device is currently supported.
```

## src/drivers/intel/fsp1_0/Kconfig
```kconfig
##
## This file is part of the coreboot project.
##
## This program is free software; you can redistribute it and/or modify
## it under the terms of the GNU General Public License as published by
## the Free Software Foundation; version 2 of the License.
##
## This program is distributed in the hope that it will be useful,
## but WITHOUT ANY WARRANTY; without even the implied warranty of
## MERCHANTABILITY or FITNESS FOR A PARTICULAR PURPOSE.  See the
## GNU General Public License for more details.
##

config PLATFORM_USES_FSP1_0
	bool
	default n
	select CAR_GLOBAL_MIGRATION
	select NO_FMAP_CACHE	# doesn't work with CAR_GLOBAL restrictions
	help
	  Selected for Intel processors/platform combinations that use the
	  Intel Firmware Support Package (FSP) 1.0 for initialization.

if PLATFORM_USES_FSP1_0

comment "Intel FSP"

config HAVE_FSP_BIN
	bool "Use Intel Firmware Support Package"
	help
	  Select this option to add an Intel FSP binary to
	  the resulting coreboot image.

	  Note: Without this binary, coreboot builds relying on the FSP
	  will not boot

config DCACHE_RAM_BASE
	hex
	default 0xfef00000

config DCACHE_RAM_SIZE
	hex
	default 0x4000

config FSP_HEADER_PATH
	string "Location of FSP headers"
	help
	  The path to headers files that are released with the FSP binary.

config FSP_SRC_PATH
	string "Additional FSP source file"
	help
	  Additional source files that are released with the FSP binary.

if HAVE_FSP_BIN

config FSP_FILE
	string "Intel FSP binary path and filename"
	help
	  The path and filename of the Intel FSP binary for this platform.

endif #HAVE_FSP_BIN

config FSP_LOC
	hex "Intel FSP Binary location in CBFS"
	help
	  The location in CBFS that the FSP is located. This must match the
	  value that is set in the FSP binary.  If the FSP needs to be moved,
	  rebase the FSP with Intel's BCT (tool).

config ENABLE_FSP_FAST_BOOT
	bool "Enable Fast Boot"
	select ENABLE_MRC_CACHE
	default n
	help
	  Enabling this feature will force the MRC data to be cached in NV
	  storage to be used for speeding up boot time on future reboots
	  and/or power cycles.

config ENABLE_MRC_CACHE
	bool
	default y if HAVE_ACPI_RESUME
	default n
	help
	  Enabling this feature will cause MRC data to be cached in NV storage.
	  This can either be used for fast boot, or just because the FSP wants
	  it to be saved.

config MRC_CACHE_FMAP
	bool "Use MRC Cache in FMAP"
	depends on ENABLE_MRC_CACHE
	select CACHE_MRC_SETTINGS
	default n
	help
	  Use the region "RW_MRC_CACHE" in FMAP instead of "mrc.cache" in CBFS.
	  Your FMAP must contain a region named "RW_MRC_CACHE".

config MRC_CACHE_SIZE
	hex "Fast Boot Data Cache Size"
	default 0x10000
	depends on ENABLE_MRC_CACHE
	depends on !MRC_CACHE_FMAP
	help
	  This is the amount of space in NV storage that is reserved for the
	  fast boot data cache storage.

	  WARNING: Because this area will be erased and re-written, the size
	  should be a full sector of the flash ROM chip and nothing else should
	  be included in CBFS in any sector that the fast boot cache data is in.

config VIRTUAL_ROM_SIZE
	hex "Virtual ROM Size"
	default ROM_SIZE
	depends on ENABLE_MRC_CACHE
	help
	  This is used to calculate the offset of the MRC data cache in NV
	  Storage for fast boot.  If in doubt, leave this set to the default
	  which sets the virtual size equal to the ROM size.

	  Example: Cougar Canyon 2 has two 8 MB SPI ROMs.  When the SPI ROMs are
	  loaded with a 4 MB coreboot image, the virtual ROM size is 8 MB.  When
	  the SPI ROMs are loaded with an 8 MB coreboot image, the virtual ROM
	  size is 16 MB.

config USE_GENERIC_FSP_CAR_INC
	bool
	default n
	help
	  The chipset can select this to use a generic cache_as_ram.inc file
	  that should be good for all FSP based platforms.

config FSP_USES_UPD
	bool
	default n
	help
	  If this FSP uses UPD/VPD data regions, select this in the chipset Kconfig.
endif #PLATFORM_USES_FSP1_0
```

## src/drivers/intel/fsp1_1/Kconfig
```kconfig
## SPDX-License-Identifier: GPL-2.0-only

config PLATFORM_USES_FSP1_1
	bool
	depends on !VBOOT_STARTS_IN_BOOTBLOCK
	select UEFI_2_4_BINDING
	select INTEL_GMA_ADD_VBT if RUN_FSP_GOP
	select MICROCODE_UPDATE_PRE_RAM
	help
	  Does the code require the Intel Firmware Support Package?

if PLATFORM_USES_FSP1_1

comment "Intel FSP 1.1"

config FSP_USE_REPO
	bool "Use FSP binary from 3rdparty/fsp repo"
	select HAVE_FSP_BIN
	depends on SOC_INTEL_BRASWELL && !USE_GOOGLE_FSP
	default y

config HAVE_FSP_BIN
	bool "Add Intel FSP binary to flash image"
	help
	  Select this option to add an Intel FSP binary to
	  the resulting coreboot image.

	  Note: Without this binary, coreboot builds relying on the FSP
	  will not boot

config FSP_FILE
	string
	prompt "Intel FSP binary path and filename" if !FSP_USE_REPO
	depends on HAVE_FSP_BIN
	default "3rdparty/fsp/BraswellFspBinPkg/FspBin/BSWFSP.fd" if FSP_USE_REPO
	default ""
	help
	  The path and filename of the Intel FSP binary for this platform.

config FSP_LOC
	hex "Intel FSP Binary location in CBFS"
	default 0xfff6e000 if SOC_INTEL_BRASWELL && USE_GOOGLE_FSP
	default 0xfff20000 if SOC_INTEL_BRASWELL
	default 0xffee0000 if SOC_INTEL_SKYLAKE
	help
	  The location in CBFS that the FSP is located. This must match the
	  value that is set in the FSP binary.  If the FSP needs to be moved,
	  rebase the FSP with Intel's BCT (tool).

config DISPLAY_HOBS
	bool "Display hand-off-blocks (HOBs)"
	default n

config DISPLAY_VBT
	bool "Display Video BIOS Table (VBT)"
	default n

config DISPLAY_FSP_ENTRY_POINTS
	bool "Display FSP entry points"
	default n

config DISPLAY_UPD_DATA
	bool "Display UPD data"
	default n
	help
	  Display the user specified product data prior to memory
	  initialization.

config USE_GENERIC_FSP_CAR_INC
	bool
	default n
	help
	  The chipset can select this to use a generic cache_as_ram.inc file
	  that should be good for all FSP based platforms.

config SKIP_FSP_CAR
	def_bool n
	help
	  Selected by platforms that implement their own CAR setup.

config BMP_LOGO
	bool "Enable logo"
	default n
	help
	  Uses the FSP to display the boot logo. This method supports a
	  BMP file only. The uncompressed size can be up to 1 MB.

config FSP1_1_LOGO_FILE_NAME
	string "Logo file"
	depends on BMP_LOGO
	default "3rdparty/blobs/mainboard/\$(MAINBOARDDIR)/logo.bmp"

endif #PLATFORM_USES_FSP1_1
```
