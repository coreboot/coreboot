## src/drivers/intel/fsp2_0/Kconfig.debug_blob
```kconfig
## SPDX-License-Identifier: GPL-2.0-only

if PLATFORM_USES_FSP2_0

config DISPLAY_FSP_CALLS_AND_STATUS
	bool "Display the FSP calls and status"
	default n
	help
	  Display the FSP call entry point and parameters prior to calling FSP
	  and display the status upon return from FSP.

config DISPLAY_FSP_HEADER
	bool "Display the FSP header"
	default n
	help
	  Display the FSP header information when the FSP file is found.

config DISPLAY_HOBS
	bool "Display the hand-off-blocks"
	default n
	help
	  Display the FSP HOBs which are provided for coreboot. Shows the headers
	  for all HOBs and their parsed contents for those HOBs where coreboot knows
	  how to parse them.

config DISPLAY_HOB_HEXDUMP
	depends on DISPLAY_HOBS
	bool "Hexdump unknown HOBs"
	default n
	help
	  Display HOB content as hexdump for those HOBs where coreboot does not know
	  how to parse them. Log level must be set to BIOS_SPEW. Note that this is
	  excessively verbose and will add several hundred kilobytes to the debug output.

config DISPLAY_UPD_DATA
	bool "Display UPD data"
	default n
	help
	  Display the user specified product data prior to memory
	  initialization.

config VERIFY_HOBS
	bool "Verify the FSP hand-off-blocks"
	default n
	help
	  Verify that the HOBs required by coreboot are returned by FSP and
	  that the resource HOBs are in the correct order and position.

config DISPLAY_FSP_VERSION_INFO
	bool "Display Firmware Ingredient Version Information"
	help
	  Select this option to display Firmware version information.

config DISPLAY_FSP_VERSION_INFO_2
	bool
	default n
	help
	  Select this option to display Firmware version information
	  using new header 'FirmwareVersionInfo.h'.

config ENABLE_FSP_ERROR_INFO
	bool "Enable FSP Error Information"
	default n
	depends on PLATFORM_USES_FSP2_1
	help
	  Select this option to enable FSP Error information. FSP detects certain errors
	  and notifies coreboot of a fatal error occurring during the execution of the FSP.
	  Although it's defined in FSP v2.1 but has only been verified on Intel Xeon-SP
	  Sapphire Rapids.

config HAVE_GPIO_SNAPSHOT_VERIFY_SUPPORT
	bool
	default n
	help
	  Select this option if platform provides support for GPIO
	  config snapshot and verify callbacks: `gpio_snapshot()`
	  and `gpio_verify_snapshot()`

config CHECK_GPIO_CONFIG_CHANGES
	bool "Check GPIO config changes across calls to FSP-S"
	depends on HAVE_GPIO_SNAPSHOT_VERIFY_SUPPORT
	help
	  Select this option to identify if any GPIOs are re-configured
	  by FSP-S differently than the mainboard configuration. This
	  requires platform support to snapshot and verify that config
	  matches snapshot.

endif # PLATFORM_USES_FSP2_0
```

## src/mainboard/asrock/z97_extreme4/Kconfig
```kconfig
## SPDX-License-Identifier: GPL-2.0-or-later

if BOARD_ASROCK_Z97_EXTREME4

config BOARD_SPECIFIC_OPTIONS
	def_bool y
	select BOARD_ROMSIZE_KB_8192
	select HAVE_ACPI_RESUME
	select HAVE_ACPI_TABLES
	select INTEL_GMA_HAVE_VBT
	select MAINBOARD_HAS_LIBGFXINIT
	select MAINBOARD_USES_IFD_GBE_REGION
	select MEMORY_MAPPED_TPM
	select NORTHBRIDGE_INTEL_HASWELL
	select SERIRQ_CONTINUOUS_MODE
	select SOUTHBRIDGE_INTEL_LYNXPOINT
	select SUPERIO_NUVOTON_NCT6791D
	select USE_BROADWELL_MRC if !USE_NATIVE_RAMINIT

config CBFS_SIZE
	default 0x600000

config MAINBOARD_DIR
	default "asrock/z97_extreme4"

config MAINBOARD_PART_NUMBER
	default "Z97 Extreme4"

config USBDEBUG_HCD_INDEX
	default 2	# Rear:		PS2_KB1_MS1_USB01
			# Header:	USB3_0_1
endif
```

## src/mainboard/asrock/z97_extreme4/Kconfig.name
```kconfig
## SPDX-License-Identifier: GPL-2.0-or-later

config BOARD_ASROCK_Z97_EXTREME4
	bool "Z97 Extreme4"
```

## src/mainboard/lenovo/crestline_thinkpad/Kconfig
```kconfig
## SPDX-License-Identifier: GPL-2.0-only

config BOARD_LENOVO_CRESTLINE_THINKPAD_COMMON
	def_bool n
	select BOARD_ROMSIZE_KB_4096
	select CPU_INTEL_SOCKET_M
	select DRIVERS_I2C_CK505
	select DRIVERS_LENOVO_WACOM
	select DRIVERS_OPTION_CFR_ENABLED if PAYLOAD_EDK2 && SMMSTORE
	select DRIVER_LENOVO_SERIALS
	select EC_LENOVO_H8
	select EC_LENOVO_PMH7
	select H8_HAS_2ND_THERMAL_ZONE
	select H8_HAS_BDC_GPIO_DETECTION
	select HAVE_ACPI_RESUME
	select HAVE_ACPI_TABLES
	select HAVE_CMOS_DEFAULT
	select HAVE_OPTION_TABLE
	select INTEL_GMA_HAVE_VBT
	select INTEL_INT15
	select MAINBOARD_HAS_LIBGFXINIT
	select MAINBOARD_HAS_TPM1
	select MAINBOARD_USES_IFD_GBE_REGION
	select MEMORY_MAPPED_TPM
	select NORTHBRIDGE_INTEL_GM965
	select SOUTHBRIDGE_INTEL_I82801HX
	select SOUTHBRIDGE_RICOH_RL5C476
	select SUPERIO_NSC_PC87382
	select SYSTEM_TYPE_LAPTOP

config BOARD_LENOVO_X61
	select BOARD_LENOVO_CRESTLINE_THINKPAD_COMMON
	select SUPERIO_NSC_PC87392

if BOARD_LENOVO_CRESTLINE_THINKPAD_COMMON

config CBFS_SIZE
	default 0x180000 # size of the BIOS region

config VBOOT_SLOTS_RW_A
	default y

config MAINBOARD_DIR
	default "lenovo/crestline_thinkpad"

config VARIANT_DIR
	default "x61" if BOARD_LENOVO_X61

config OVERRIDE_DEVICETREE
	default "variants/\$(CONFIG_VARIANT_DIR)/overridetree.cb"

config MAINBOARD_PART_NUMBER
	default "ThinkPad X61" if BOARD_LENOVO_X61

config MAX_CPUS
	int
	default 2

config PS2K_EISAID
	default "PNP0303"

config PS2M_EISAID
	default "IBM3780"

endif
```

## src/mainboard/lenovo/crestline_thinkpad/Kconfig.name
```kconfig
## SPDX-License-Identifier: GPL-2.0-only

config BOARD_LENOVO_X61
	bool "ThinkPad X61 / X61s"

config BOARD_LENOVO_T61
	bool "ThinkPad T61 / T61p"
```
