## src/drivers/maxim/max77686/Kconfig
```kconfig
## SPDX-License-Identifier: GPL-2.0-only

config DRIVER_MAXIM_MAX77686
	bool
	default n
	help
	  Maxim MAX77686 power regulator
```

## src/drivers/mipi/Kconfig
```kconfig
## SPDX-License-Identifier: GPL-2.0-only

# Mainboards should select the options in here to specify which panel parameter
# settings they want stored in their CBFS.

config MIPI_PANEL_AUO_B101UAN08_3
	bool

config MIPI_PANEL_AUO_KD101N80_45NA
	bool

config MIPI_PANEL_AUO_NT51021D8P
	bool

config MIPI_PANEL_BOE_NV110WUM_L60
	bool

config MIPI_PANEL_BOE_TV080WUM_NG0
	bool

config MIPI_PANEL_BOE_TV101WUM_N53
	bool

config MIPI_PANEL_BOE_TV101WUM_NG0
	bool

config MIPI_PANEL_BOE_TV101WUM_NL6
	bool

config MIPI_PANEL_BOE_TV105WUM_NW0
	bool

config MIPI_PANEL_BOE_TV110C9M_LL0
	bool

config MIPI_PANEL_CMN_P097PFG_SSD2858
	bool

config MIPI_PANEL_INX_HJ110IZ_01A_B2
	bool

config MIPI_PANEL_INX_OTA7290D10P
	bool

config MIPI_PANEL_IVO_T109NW41
	bool

config MIPI_PANEL_KD_KD101NE3_40TI
	bool

config MIPI_PANEL_KD_KD110N11_51IE
	bool

config MIPI_PANEL_LCE_LMFBX101117480
	bool

config MIPI_PANEL_STA_2081101QFH032011_53G
	bool

config MIPI_PANEL_STA_ER88577
	bool

config MIPI_PANEL_STA_HIMAX83102_J02
	bool

config MIPI_PANEL_STA_ILI9882T
	bool

config MIPI_PANEL_VIS_RM69299
	bool
```

## src/drivers/mmc/Kconfig
```kconfig
config DRIVER_MMC
	bool
	default n
	help
	  Generic MMC and SD card driver

if DRIVER_MMC

config DRIVER_MMC_BOOTBLOCK
	bool
	default n
	help
	  Include MMC driver in the bootblock.

endif # DRIVER_MMC
```

## src/drivers/mrc_cache/Kconfig
```kconfig
config CACHE_MRC_SETTINGS
	bool
	help
	  Save cached MRC settings

if CACHE_MRC_SETTINGS

config MRC_SETTINGS_CACHE_SIZE
	hex
	default 0x10000

config MRC_SETTINGS_PROTECT
	bool "Enable protection on MRC settings"
	default n

config HAS_RECOVERY_MRC_CACHE
	bool
	default n

config MRC_SETTINGS_VARIABLE_DATA
	bool
	default n

config MRC_WRITE_NV_LATE
	bool
	default n
	help
	  MRC settings are normally written to NVRAM at BS_DEV_ENUMERATE-EXIT.
	  If a platform requires MRC settings written to NVRAM later than
	  normal, select this item.  This will cause the write to occur at
	  BS_OS_RESUME_CHECK-ENTRY.

config MRC_STASH_TO_CBMEM
	bool
	default y if MRC_WRITE_NV_LATE || BOOT_DEVICE_SPI_FLASH_NO_EARLY_WRITES
	default n
	help
	  Instead of writing back MRC_CACHE training data back to the
	  MRC_CACHE right away, stash the data into cbmem.  This data
	  will be written back later to MRC_CACHE.  This is selected
	  for platforms which either do not support writes to SPI
	  flash in early stages
	  (BOOT_DEVICE_SPI_FLASH_NO_EARLY_WRITES) or the platforms
	  that need to write back the MRC data in late ramstage boot
	  states (MRC_WRITE_NV_LATE).

config MRC_SAVE_HASH_IN_TPM
	bool "Save a hash of the MRC_CACHE data in TPM NVRAM"
	depends on VBOOT_STARTS_IN_BOOTBLOCK && TPM2 && !TPM1 && !VBOOT_MOCK_SECDATA
	default y
	help
	  Store a hash of the MRC_CACHE training data in a TPM NVRAM
	  space to ensure that it cannot be tampered with.

endif # CACHE_MRC_SETTINGS
```

## src/drivers/net/Kconfig
```kconfig
## SPDX-License-Identifier: GPL-2.0-only

config REALTEK_8168_RESET
	bool
	help
	  This forces a realtek 10ec:8168 card to reset to ensure power state
	  is correct at boot.

config REALTEK_8168_MACADDRESS
	string "Realtek rt8168 mac address"
	depends on REALTEK_8168_RESET && !RT8168_GET_MAC_FROM_VPD
	default "00:e0:4c:00:c0:b0"
	help
	  This is a string to set the mac address on a Realtek rt8168 card.
	  It must be in the form  of "xx:xx:xx:xx:xx:xx", where x is a
	  hexadecimal number for it to be valid. Failing to do so will
	  result in the default macaddress being used.

config RT8168_PUT_MAC_TO_ERI
	bool
	help
	  After programming MAC address into the regular rt8168 ID registers,
	  also program it into ERI. On some mainboards our programmed
	  MAC address will not survive a controller reset without this step.

	  Select at mainboard level only if its rt8168 has no EEPROM and
	  programmed MAC address is lost after booting to OS.

config RT8168_GET_MAC_FROM_VPD
	bool
	default n
	select REALTEK_8168_RESET

config RT8168_SUPPORT_LEGACY_VPD_MAC
	bool
	default n
	help
	  Previously VPD expected that device_indexes set to zero were
	  special cased. Selecting this Kconfig restores the legacy
	  VPD format and behaviour. If unsure, you likely do not need this!

config RT8168_SET_LED_MODE
	bool
	default n
	select REALTEK_8168_RESET
	help
	  This is to set a customized LED mode to distinguish 10/100/1000
	  link and speed status with limited LEDs available on a board.
	  Please refer to RTL811x datasheet section 7.2 Customizable LED
	  Configuration for details. With this flag enabled, the
	  customized_leds variable will be read from devicetree setting.

config RT8168_GEN_ACPI_POWER_RESOURCE
	bool
	default n
	depends on REALTEK_8168_RESET
	help
	  Select this if an ACPI power resource needs to be generated.

config ATHEROS_ATL1E_SETMAC
	bool
	help
	  This sets the MAC address on boards featuring the atheros 1968:1026
	  NIC which lack an eeprom to store it.

config ATHEROS_ATL1E_MACADDRESS
	string "Atheros AR8121/AR8113/AR8114 mac address"
	depends on ATHEROS_ATL1E_SETMAC
	default "90:e6:ba:24:f9:d2"
	help
	  This is a string to set the mac address on an Atheros atl1e card.
	  It must be in the form  of "xx:xx:xx:xx:xx:xx", where x is a
	  hexadecimal number for it to be valid. Failing to do so will
	  result in the default MAC address being used.
```

## src/drivers/net/phy/m88e1512/Kconfig
```kconfig
## SPDX-License-Identifier: GPL-2.0-only

config DRIVERS_ETH_PHY_M88E1512
	bool
	default n
	help
	  Enable support for external Marvell PHY chip 88E1512.
```

## src/drivers/nxp/uwb/Kconfig
```kconfig
config DRIVERS_NXP_UWB_SR1XX
	bool "NXP UWB SR1xx driver"
	help
	  Enable support for a NXP UWB SR1xx (e.g., SR150) chip.

	  A configuration should be added to device tree like below:
	  device ref gspi0 on
	          chip drivers/nxp/uwb
	                  # The ACPI name of the device.  Note it will be
	                  # truncated to 4 characters if a longer name is given.
	                  register "name" = ""UWB0""

	                  # Description of the module.
	                  register "desc" = ""NXP UWB Module""

	                  # SPI bus speed (in Hz).
	                  register "speed" = "1000000"

	                  # The GPIO connected to SENSORINT.
	                  register "irq_gpio" = "ACPI_GPIO_IRQ_LEVEL_HIGH(GPP_F21)"

	                  # The GPIO connected to CHIP_EN.
	                  register "ce_gpio" = "ACPI_GPIO_OUTPUT_ACTIVE_HIGH(GPP_A12)"

	                  # The GPIO connected to WAKEUP.
	                  register "ri_gpio" = "ACPI_GPIO_OUTPUT_ACTIVE_HIGH(GPP_A7)"

	                  device spi 0 on end
	          end
	  end
```

## src/drivers/ocp/dmi/Kconfig
```kconfig
config OCP_DMI
	bool
	default n
	depends on IPMI_KCS && GENERATE_SMBIOS_TABLES && XEON_SP_COMMON_BASE
	help
	  It implements the SMBIOS IPMI FRU mapping table defined in
	  https://www.opencompute.org/documents/facebook-xeon-motherboard-v31
	  22.3 SMBIOS FRU mapping table

config FRU_DEVICE_ID
	int
	default 0
	depends on OCP_DMI
```

## src/drivers/ocp/ewl/Kconfig
```kconfig
## SPDX-License-Identifier: GPL-2.0-only

config OCP_EWL
	bool
	default n
	help
	  It implements checking FSP Enhanced Warning Log Hob.
```

## src/drivers/ocp/vpd/Kconfig
```kconfig
config OCP_VPD
	bool
	default n
	depends on VPD
	help
	  It implements functions that get common VPD variables for OCP projects.

config LINUXPAYLOAD_CMDLINE_VPD_OVERWRITE
	bool
	default n
	depends on VPD
	help
	  Overwrite Linux payload's kernel command line by using VPD. Currently only
	  overwrite the value of kernel command line 'loglevel'. The Linux kernel command
	  line data is detected in the last segment loaded in memory and overwritten.
```

## src/drivers/option/Kconfig
```kconfig
config DRIVERS_OPTION_CFR_ENABLED
	def_bool n

config DRIVERS_OPTION_CFR
	bool "Support generating a CFR list of options"
	select DRIVERS_EFI_VARIABLE_STORE if PAYLOAD_EDK2 && SMMSTORE
	default y if DRIVERS_OPTION_CFR_ENABLED
```

## src/drivers/oxford/oxpcie/Kconfig
```kconfig
config DRIVERS_OXFORD_OXPCIE
	bool "Oxford OXPCIe952"
	default n
	depends on PCI
	select DRIVERS_UART_8250MEM
	select EARLY_PCI_BRIDGE
	help
	  Support for Oxford OXPCIe952 serial port PCIe cards.
	  Currently only devices with the vendor ID 0x1415 and device ID
	  0xc158 or 0xc11b will work.
```

## src/drivers/parade/ps8625/Kconfig
```kconfig
## SPDX-License-Identifier: GPL-2.0-only

config DRIVER_PARADE_PS8625
	bool
	default n
	help
	  Parade ps8625 display port to lvds bridge
```

## src/drivers/parade/ps8640/Kconfig
```kconfig
## SPDX-License-Identifier: GPL-2.0-only

config DRIVER_PARADE_PS8640
	bool
	default n
	help
	  Parade PS8640 MIPI DSI to eDP Converter
```

## src/drivers/pc80/Kconfig
```kconfig
# Might be removed (alongside with the PS/2 init code) once payloads
# reliably support PS/2 init themselves.
if PC80_SYSTEM

config DRIVERS_PS2_KEYBOARD
	bool "PS/2 keyboard init"
	default n
	help
	  Enable this option to initialize PS/2 keyboards found connected
	  to the PS/2 port.

	  Some payloads (eg, filo) require this option.  Other payloads
	  (eg, GRUB 2, SeaBIOS, Linux) do not require it.
	  Initializing a PS/2 keyboard can take several hundred milliseconds.

	  If you know you will only use a payload which does not require
	  this option, then you can say N here to speed up boot time.
	  Otherwise say Y.

config DRIVERS_MC146818
	bool
	default y if ARCH_X86
	select RTC

source src/drivers/pc80/tpm/Kconfig

endif
```

## src/drivers/pc80/rtc/Kconfig
```kconfig
config DRIVERS_MC146818
	bool
	default y if ARCH_X86
	depends on PC80_SYSTEM

config USE_PC_CMOS_ALTCENTURY
	bool "Use legacy-BIOS alt-century byte in CMOS"
	default y if !USE_OPTION_TABLE
	depends on DRIVERS_MC146818
	help
	  May be useful for legacy OSes that assume its presence.

config PC_CMOS_BASE_PORT_BANK0
	hex
	default 0x70

config PC_CMOS_BASE_PORT_BANK1
	hex
	default 0x72
```

## src/drivers/pc80/tpm/Kconfig
```kconfig
config MEMORY_MAPPED_TPM
	bool
	default n
	help
	  Board has memory mapped TPM support

if MEMORY_MAPPED_TPM

config TPM_TIS_BASE_ADDRESS
	hex
	default 0xfed40000
	help
	  This can be used to adjust the TPM memory base address.
	  The default is specified by the TCG PC Client Specific TPM
	  Interface Specification 1.2 and should not be changed unless
	  the TPM being used does not conform to TPM TIS 1.2.

config TPM_PIRQ
	hex
	default 0x0
	help
	  This can be used to specify a PIRQ to use instead of SERIRQ,
	  which is needed for SPI TPM interrupt support on x86.

endif
```

## src/drivers/pc80/vga/Kconfig
```kconfig
## SPDX-License-Identifier: GPL-2.0-only

config VGA
	bool
	help
	  Include legacy VGA support code.

config ROMSTAGE_VGA
	bool
	help
	  Include legacy VGA support code in romstage.
```

## src/drivers/pci/Kconfig
```kconfig
config EARLY_PCI_BRIDGE
	bool "Early PCI bridge"
	depends on PCI
	default n
	help
	  While coreboot is executing code from ROM, the coreboot resource
	  allocator has not been running yet. Hence PCI devices living behind
	  a bridge are not yet visible to the system.

	  This option enables static configuration for a single pre-defined
	  PCI bridge function on bus 0.

if EARLY_PCI_BRIDGE

config EARLY_PCI_BRIDGE_DEVICE
	hex "bridge device"
	default 0x0

config EARLY_PCI_BRIDGE_FUNCTION
	hex "bridge function"
	default 0x0

config EARLY_PCI_MMIO_BASE
	hex "MMIO window base"
	default 0x0

config EARLY_PCI_BRIDGE_SECONDARY
	hex "Early PCI bridge secondary bus"
	default 0x0

endif # EARLY_PCI_BRIDGE
```

## src/drivers/pcie/generic/Kconfig
```kconfig
config DRIVERS_PCIE_GENERIC
	bool
	default n
	depends on HAVE_ACPI_TABLES
	help
	  This driver allows attaching arbitrary ACPI properties to
	  arbitrary PCI root ports or devices. Currently it supports one
	  property, "DmaProperty", which indicates to the operating system that
	  the PCIe device may be considered untrusted, and appropriate policies,
	  e.g. IOMMU isolation, should take place.
```

## src/drivers/pcie/rtd3/device/Kconfig
```kconfig
config DRIVERS_PCIE_RTD3_DEVICE
	bool
	depends on HAVE_ACPI_TABLES
	help
	   When enabled, this driver will add support for ACPI controlled
	   Runtime D3 using GPIOs for power/reset control of the PCIe device.
```

## src/drivers/realtek/Kconfig
```kconfig
## SPDX-License-Identifier: GPL-2.0-only

config DRIVERS_REALTEK_RTSX_PCI_CARDREADER
	bool
	help
	  Apply the vendor PHY/init sequence to the Realtek RTS5227/RTS5229 PCIe
	  SD card reader after PCIe enumeration, replicating what the Lenovo DXE
	  module DxeRealtekCrcInit does. Without this, the controller's command
	  engine times out on every SD command (rtsx_pci_send_cmd error -110) on
	  boards with this chip, such as the ThinkPad T440p (coreboot issue #297).
```

## src/drivers/ricoh/rce822/Kconfig
```kconfig
## SPDX-License-Identifier: GPL-2.0-only

config DRIVERS_RICOH_RCE822
	bool
	default n
```
