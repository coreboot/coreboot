## src/drivers/secunet/dmi/Kconfig
```kconfig
## SPDX-License-Identifier: GPL-2.0-only

config SECUNET_DMI
	bool
	select SMBIOS_PROVIDED_BY_MOBO
```

## src/drivers/siemens/nc_fpga/Kconfig
```kconfig
config DRIVER_SIEMENS_NC_FPGA
	bool
	default n

config NC_FPGA_NOTIFY_CB_READY
	bool
	default n

config NC_FPGA_POST_CODE
	bool
	default n
	select EARLY_PCI_BRIDGE
```

## src/drivers/sil/3114/Kconfig
```kconfig
config DRIVERS_SIL_3114
	bool "Silicon Image SIL3114"
	default n
	depends on PCI
	help
	  It sets PCI class to IDE compatible native mode, allowing
	  SeaBIOS, FILO etc... to boot from it.
```

## src/drivers/smmstore/Kconfig
```kconfig
## SPDX-License-Identifier: GPL-2.0-only

config SMMSTORE
	bool "Support for flash based, SMM mediated data store"
	depends on BOOT_DEVICE_SUPPORTS_WRITES && HAVE_SMI_HANDLER
	default y if PAYLOAD_EDK2
	select SPI_FLASH_SMM if BOOT_DEVICE_SPI_FLASH_RW_NOMMAP
	help
	  SMMSTORE allows secure communication with SMM and makes no
	  assumptions on the structure of the data stored within. It splits
	  the store into blocks to allow fault tolerant writes.

if SMMSTORE

config SMMSTORE_SIZE
	hex "size of the SMMSTORE FMAP region"
	default 0x80000
	help
	  Sets the size of the default SMMSTORE FMAP region.
	  If using an UEFI payload, note that UEFI specifies at least 64K.
	  The current implementation of SMMSTORE is append only, so until
	  garbage collection is implemented it is better to set this to
	  a rather large value.

config SMMSTORE_BLOCK_SIZE
	int
	default 65536
	help
	  Sets the logical block size used by the SMMSTORE protocol. This is
	  an internal SoC or board policy value, not a user-visible option.

endif
```

## src/drivers/sof/Kconfig
```kconfig
## SPDX-License-Identifier: GPL-2.0-only

config DRIVERS_AUDIO_SOF
	bool
	depends on HAVE_ACPI_TABLES
```

## src/drivers/soundwire/alc1308/Kconfig
```kconfig
## SPDX-License-Identifier: GPL-2.0-only

config DRIVERS_SOUNDWIRE_ALC1308
	bool
```

## src/drivers/soundwire/alc1320/Kconfig
```kconfig
## SPDX-License-Identifier: GPL-2.0-only

config DRIVERS_SOUNDWIRE_ALC1320
	bool
	depends on HAVE_ACPI_TABLES
	default n
	help
	  SoundWire ALC1320 speaker amplifier SSDT generator.
```

## src/drivers/soundwire/alc5682/Kconfig
```kconfig
## SPDX-License-Identifier: GPL-2.0-only

config DRIVERS_SOUNDWIRE_ALC5682
	bool
```

## src/drivers/soundwire/alc711/Kconfig
```kconfig
## SPDX-License-Identifier: GPL-2.0-only

config DRIVERS_SOUNDWIRE_ALC_BASE_7XX
	bool
	help
	  Base code for Realtek ALC7xxx Codec SoundWire driver.

config DRIVERS_SOUNDWIRE_ALC711
	bool
	select DRIVERS_SOUNDWIRE_ALC_BASE_7XX
	help
	  SoundWire driver for Realtek ALC711 device

config DRIVERS_SOUNDWIRE_ALC721
	bool
	select  DRIVERS_SOUNDWIRE_ALC_BASE_7XX
	help
	  SoundWire driver for Realtek ALC721 device

config DRIVERS_SOUNDWIRE_ALC722
	bool
	select DRIVERS_SOUNDWIRE_ALC_BASE_7XX
	help
	  SoundWire driver for Realtek ALC722 device
```

## src/drivers/soundwire/cs35l56/Kconfig
```kconfig
## SPDX-License-Identifier: GPL-2.0-only

config DRIVERS_SOUNDWIRE_CS35L56_FAMILY
	bool
	depends on HAVE_ACPI_TABLES
	default n
	help
	  SoundWire CS35L56 Family audio amp SSDT generator.
	  This supports the CS35L56, CS35L57, and CS35L63 audio amplifiers
	  from Cirrus Logic.
```

## src/drivers/soundwire/cs42l42/Kconfig
```kconfig
## SPDX-License-Identifier: GPL-2.0-only

config DRIVERS_SOUNDWIRE_CS42L42
	bool
	depends on HAVE_ACPI_TABLES
	default n
	help
	  SoundWire CS42L42 audio codec SSDT generator.
```

## src/drivers/soundwire/cs42l43/Kconfig
```kconfig
## SPDX-License-Identifier: GPL-2.0-only

config DRIVERS_SOUNDWIRE_CS42L43
	bool
	depends on HAVE_ACPI_TABLES
	default n
	help
	  SoundWire CS42L43 CODEC SSDT generator.
```

## src/drivers/soundwire/max98363/Kconfig
```kconfig
## SPDX-License-Identifier: GPL-2.0-only

config DRIVERS_SOUNDWIRE_MAX98363
	bool
	depends on HAVE_ACPI_TABLES
	default n
	help
	  SoundWire MAX98363 audio amp SSDT generator.
```

## src/drivers/soundwire/max98373/Kconfig
```kconfig
## SPDX-License-Identifier: GPL-2.0-only

config DRIVERS_SOUNDWIRE_MAX98373
	bool
```

## src/drivers/spi/Kconfig
```kconfig
## SPDX-License-Identifier: GPL-2.0-only

config COMMON_CBFS_SPI_WRAPPER
	bool
	default n
	depends on !ARCH_X86
	depends on BOOT_DEVICE_SPI_FLASH
	select BOOT_DEVICE_SUPPORTS_WRITES
	help
	 Use common wrapper to interface CBFS to SPI bootrom.

config SPI_FLASH
	bool
	default y if BOOT_DEVICE_SPI_FLASH && BOOT_DEVICE_SUPPORTS_WRITES
	default n
	help
	  Select this option if your chipset driver needs to store certain
	  data in the SPI flash.

config SPI_SDCARD
	bool
	default n
	help
	  Select this option if your chipset driver needs to store certain
	  data in the SPI sdcard.

if SPI_FLASH

# Keep at 0 because lots of boards assume this default.
config BOOT_DEVICE_SPI_FLASH_BUS
	int
	default 0
	help
	  Which SPI bus the boot device is connected to.

config BOOT_DEVICE_SPI_FLASH_RW_NOMMAP
	bool
	default y if !COMMON_CBFS_SPI_WRAPPER
	default n
	depends on BOOT_DEVICE_SPI_FLASH
	help
	  Provide common implementation of the RW boot device that
	  doesn't provide mmap() operations.

config BOOT_DEVICE_SPI_FLASH_NO_EARLY_WRITES
	bool
	default n
	depends on BOOT_DEVICE_SPI_FLASH_RW_NOMMAP
	help
	  For platforms who do not allow writes to SPI flash in early
	  stages like romstage.  Not selecting this config will result
	  in the auto-selection of
	  BOOT_DEVICE_SPI_FLASH_RW_NOMMAP_EARLY if
	  BOOT_DEVICE_SPI_FLASH_RW_NOMMAP is selected by the platform.

config BOOT_DEVICE_SPI_FLASH_RW_NOMMAP_EARLY
	bool
	default y if BOOT_DEVICE_SPI_FLASH_RW_NOMMAP && !BOOT_DEVICE_SPI_FLASH_NO_EARLY_WRITES
	default n
	depends on BOOT_DEVICE_SPI_FLASH_RW_NOMMAP
	help
	  Include the common implementation in all stages, including the
	  early ones.

config SPI_FLASH_DONT_INCLUDE_ALL_DRIVERS
	bool
	default y if COMMON_CBFS_SPI_WRAPPER
	default n

config SPI_FLASH_INCLUDE_ALL_DRIVERS
	bool
	default n if SPI_FLASH_DONT_INCLUDE_ALL_DRIVERS
	default y

config SPI_FLASH_SMM
	bool
	depends on HAVE_SMI_HANDLER
	help
	  Select this option if you want SPI flash support in SMM.

config SPI_FLASH_NO_FAST_READ
	bool "Disable Fast Read command"
	default n
	help
	  Select this option if your setup requires to avoid "fast read"s
	  from the SPI flash parts.

config SPI_FLASH_ADESTO
	bool
	default y if SPI_FLASH_INCLUDE_ALL_DRIVERS
	help
	  Select this option if your chipset driver needs to store certain
	  data in the SPI flash and your SPI flash is made by Adesto Technologies.

config SPI_FLASH_AMIC
	bool
	default y if SPI_FLASH_INCLUDE_ALL_DRIVERS
	help
	  Select this option if your chipset driver needs to store certain
	  data in the SPI flash and your SPI flash is made by AMIC.

config SPI_FLASH_ATMEL
	bool
	default y if SPI_FLASH_INCLUDE_ALL_DRIVERS
	help
	  Select this option if your chipset driver needs to store certain
	  data in the SPI flash and your SPI flash is made by Atmel.

config SPI_FLASH_EON
	bool
	default y if SPI_FLASH_INCLUDE_ALL_DRIVERS
	help
	  Select this option if your chipset driver needs to store certain
	  data in the SPI flash and your SPI flash is made by EON.

config SPI_FLASH_GIGADEVICE
	bool
	default y if SPI_FLASH_INCLUDE_ALL_DRIVERS
	help
	  Select this option if your chipset driver needs to store certain
	  data in the SPI flash and your SPI flash is made by Gigadevice.

config SPI_FLASH_MACRONIX
	bool
	default y if SPI_FLASH_INCLUDE_ALL_DRIVERS
	help
	  Select this option if your chipset driver needs to store certain
	  data in the SPI flash and your SPI flash is made by Macronix.

config SPI_FLASH_SPANSION
	bool
	default y if SPI_FLASH_INCLUDE_ALL_DRIVERS
	help
	  Select this option if your chipset driver needs to store certain
	  data in the SPI flash and your SPI flash is made by Spansion.

config SPI_FLASH_SST
	bool
	default y if SPI_FLASH_INCLUDE_ALL_DRIVERS
	help
	  Select this option if your chipset driver needs to store certain
	  data in the SPI flash and your SPI flash is made by SST.

config SPI_FLASH_STMICRO
	bool
	default y if SPI_FLASH_INCLUDE_ALL_DRIVERS
	help
	  Select this option if your chipset driver needs to store certain
	  data in the SPI flash and your SPI flash is made by ST Micro,
	  Numonyx or Micron.

config SPI_FLASH_WINBOND
	bool
	default y if SPI_FLASH_INCLUDE_ALL_DRIVERS
	help
	  Select this option if your chipset driver needs to store certain
	  data in the SPI flash and your SPI flash is made by Winbond.

config SPI_FLASH_ISSI
	bool
	default y if SPI_FLASH_INCLUDE_ALL_DRIVERS
	help
	  Select this option if your chipset driver needs to store certain
	  data in the SPI flash and your SPI flash is made by ISSI.

config SPI_FLASH_HAS_VOLATILE_GROUP
	bool
	default n
	help
	  Allows chipset to group write/erase operations under a single volatile
	  group.

config SPI_FLASH_EXIT_4_BYTE_ADDR_MODE
	bool
	default n
	help
	  This will send an Exit 4-Byte Address Mode (E9h) command before the first
	  access to the SPI flash. On some platforms with SPI flashes larger than 32MB,
	  the SPI flash may power up in 4-byte addressing mode and this command needs
	  to be sent before coreboot's 3-byte address commands can be interpreted correctly.
	  On flashes that don't support 4-byte addressing mode or where it is already
	  disabled, this command should be a no-op.

config SPI_FLASH_FORCE_4_BYTE_ADDR_MODE
	bool
	default n
	help
	  This will force coreboot to send addresses as 4-bytes instead of 3-bytes.
	  On some platforms with SPI flashes larger than 16MB, the SPI flash may need
	  to remain in 4-byte addressing mode.

config SPI_FLASH_SFDP
	bool
	help
	  Include serial flash discoverable parameters (SFDP) support.

config SPI_FLASH_RPMC
	bool
	select SPI_FLASH_SFDP
	help
	  Include replay-protected monotonic counter (RPMC) support.

endif # SPI_FLASH

config HAVE_EM100PRO_SPI_CONSOLE_SUPPORT
	def_bool n
```

## src/drivers/spi/acpi/Kconfig
```kconfig
# SPDX-License-Identifier: GPL-2.0-only

config DRIVERS_SPI_ACPI
	bool
	depends on HAVE_ACPI_TABLES
```

## src/drivers/spi/tpm/Kconfig
```kconfig
config SPI_TPM
	bool
	help
	  SPI TPM driver is enabled!

config DRIVER_TPM_SPI_BUS
	hex "SPI bus TPM chip is connected to"
	default 0x0
	depends on SPI_TPM

config DRIVER_TPM_SPI_CHIP
	int "Chip Select of the TPM chip on its SPI bus"
	default 0
	depends on SPI_TPM
```

## src/drivers/storage/Kconfig
```kconfig
##
## This file is part of the coreboot project.
##
## Copyright (C) 2017 Intel Corp.
##
## This program is free software; you can redistribute it and/or modify
## it under the terms of the GNU General Public License as published by
## the Free Software Foundation; version 2 of the License.
##
## This program is distributed in the hope that it will be useful,
## but WITHOUT ANY WARRANTY; without even the implied warranty of
## MERCHANTABILITY or FITNESS FOR A PARTICULAR PURPOSE.  See the
## GNU General Public License for more details.
##

config DRIVERS_STORAGE
	bool
	default n

if DRIVERS_STORAGE

config DRIVERS_STORAGE_MMC
	bool "Enable MultiMediaCard (MMC) and eMMC device support"
	default n

config DRIVERS_STORAGE_SD
	bool "Enable Secure Digital (SD) memory card support"
	default n

config STORAGE_ERASE
	bool "Support SD/MMC erase operations"
	default n
	help
	  Select to enable SD/MMC erase oprations

config STORAGE_EARLY_ERASE
	bool "Enable erase operations in bootblock and verstage"
	default n
	depends on STORAGE_ERASE

config STORAGE_WRITE
	bool "Support SD/MMC write operations"
	default n
	help
	  Select to enable SD/MMC write oprations

config STORAGE_EARLY_WRITE
	bool "Enable write operations in bootblock and verstage"
	default n
	depends on STORAGE_WRITE

config SD_MMC_DEBUG
	bool "Debug SD/MMC card/devices operations"
	default n
	help
	  Display overview of SD/MMC card/device operations

config SD_MMC_TRACE
	bool "Trace SD/MMC card/device operations"
	default n
	help
	  Display details of SD/MMC card/device operations

config SDHC_DEBUG
	bool "Debug SD/MMC controller settings"
	default n
	help
	  Display clock speed and bus width settings

config SDHC_TRACE
	bool "Trace SD/MMC controller operations"
	default n
	help
	  Display the operations performed by the SD/MMC controller

config SDHCI_CONTROLLER
	bool "Support SD host controller"
	default n

if SDHCI_CONTROLLER

config SDHCI_ADMA_IN_BOOTBLOCK
	bool
	default n
	help
	  Determine if bootblock is able to use ADMA2 or ADMA64

config SDHCI_ADMA_IN_ROMSTAGE
	bool
	default n
	help
	  Determine if romstage is able to use ADMA2 or ADMA64

config SDHCI_ADMA_IN_VERSTAGE
	bool
	default n
	help
	  Determine if verstage is able to use ADMA2 or ADMA64

config SDHCI_BOUNCE_BUFFER
	bool "Use DMA bounce buffer for SD/MMC controller"
	default n

endif # SDHCI_CONTROLLER
endif # DRIVERS_STORAGE
```

## src/drivers/ti/sn65dsi86bridge/Kconfig
```kconfig
## SPDX-License-Identifier: GPL-2.0-only

config DRIVERS_TI_SN65DSI86BRIDGE
	bool
	default n
	help
	  TI SN65DSI86 eDP bridge driver
```

## src/drivers/ti/tps65090/Kconfig
```kconfig
## SPDX-License-Identifier: GPL-2.0-only

config DRIVER_TI_TPS65090
	bool
	default n
	help
	  TI TPS65090
```

## src/drivers/ti/tps65913/Kconfig
```kconfig
## SPDX-License-Identifier: GPL-2.0-only

config DRIVERS_TI_TPS65913_RTC
	bool
	default n
	select RTC

config DRIVERS_TI_TPS65913_RTC_BUS
	int "TI TPS65913 RTC bus"
	depends on DRIVERS_TI_TPS65913_RTC
	default 0

config DRIVERS_TI_TPS65913_RTC_ADDR
	hex "TI TPS65913 RTC chip address"
	depends on DRIVERS_TI_TPS65913_RTC
	default 0x00
```

## src/drivers/tpm/Kconfig
```kconfig
config TPM_INIT_RAMSTAGE
	bool
	default y if TPM
	depends on !VBOOT && !VENDORCODE_ELTAN_VBOOT && !VENDORCODE_ELTAN_MBOOT \
		&& !TPM_MEASURED_BOOT_INIT_BOOTBLOCK
	help
	  This driver automatically initializes the TPM if vboot is not used.
	  The TPM driver init is done during the ramstage chip init phase.

config TPM_PPI
	bool "Generate ACPI code to implement TPM physical presence interface"
	depends on TPM
	depends on HAVE_ACPI_TABLES
	depends on !CHROMEOS
	default y if PAYLOAD_EDK2
	help
	  This driver automatically generates ACPI tables for the Physical
	  Presence Interface defined by the TCG. If not activated only a stub
	  will be generated without any functionality.
```
