## src/drivers/uart/Kconfig
```kconfig
config DRIVERS_UART
	bool

config DRIVERS_UART_8250IO
	# FIXME: Shouldn't have a prompt, should default to n, and
	#        should be selected by boards that have it instead.
	bool "Serial port on SuperIO"
	depends on ARCH_X86 || ARCH_PPC64
	default n if DRIVERS_UART_8250MEM || HAVE_UART_SPECIAL
	default n if NO_UART_ON_SUPERIO
	default y
	select DRIVERS_UART

config DRIVERS_UART_8250IO_SKIP_INIT
	def_bool n
	depends on DRIVERS_UART_8250IO

# Select this for mainboard without SuperIO serial port.
config NO_UART_ON_SUPERIO
	def_bool n

config UART_OVERRIDE_INPUT_CLOCK_DIVIDER
	bool
	default n
	help
	  Set to "y" when the platform overrides the uart_input_clock_divider
	  routine.

config UART_OVERRIDE_REFCLK
	bool
	default n
	help
	  Set to "y" when the platform overrides the uart_platform_refclk
	  routine.

config DRIVERS_UART_8250MEM
	bool
	default n
	select DRIVERS_UART

config DRIVERS_UART_8250MEM_32
	bool
	default n
	select DRIVERS_UART_8250MEM

config HAVE_UART_SPECIAL
	bool
	default n
	select DRIVERS_UART

config DRIVERS_UART_OXPCIE
	bool "Oxford OXPCIe952"
	default n
	depends on PCI && !DRIVERS_UART_8250MEM_32
	select DRIVERS_UART_8250MEM
	select EARLY_PCI_BRIDGE
	select UART_OVERRIDE_REFCLK
	help
	  Support for Oxford OXPCIe952 serial port PCIe cards.
	  Currently only devices with the vendor ID 0x1415 and device ID
	  0xc158 or 0xc11b will work.

config DRIVERS_UART_PL011
	bool
	default n
	select HAVE_UART_SPECIAL

config DRIVERS_UART_SIFIVE
	bool
	select HAVE_UART_SPECIAL
	select UART_OVERRIDE_INPUT_CLOCK_DIVIDER

config UART_USE_REFCLK_AS_INPUT_CLOCK
	bool
	default n
	help
	  Use uart_platform_refclk to specify the input clock value.

config UART_PCI_ADDR
	hex "UART's PCI bus, device, function address"
	default 0x0
	help
	  Specify zero if the UART is connected to another bus type.
	  For PCI based UARTs, build the value as:
	  * 1 << 31 - Valid bit, PCI UART in use
	  * Bus << 20
	  * Device << 15
	  * Function << 12
```

## src/drivers/usb/Kconfig
```kconfig
	# Use "select HAVE_USBDEBUG" on southbridges which have Debug Port code.
config HAVE_USBDEBUG
	bool
	default y if HAVE_USBDEBUG_OPTIONS
	default n

# Use "select HAVE_USBDEBUG_OPTIONS" on southbridges with multiple
# EHCI controllers or multiple ports with Debug Port capability
config HAVE_USBDEBUG_OPTIONS
	def_bool n

config USBDEBUG
	bool "USB 2.0 EHCI debug dongle support"
	default n
	depends on HAVE_USBDEBUG
	help
	  This option allows you to use a so-called USB EHCI Debug device
	  (such as the Ajays NET20DC, AMIDebug RX, or a system using the
	  Linux "EHCI Debug Device gadget" driver found in recent kernel)
	  to retrieve the coreboot debug messages (instead, or in addition
	  to, a serial port).

	  This feature is NOT supported on all chipsets in coreboot!

	  It also requires a USB2 controller which supports the EHCI
	  Debug Port capability.

	  See https://www.coreboot.org/EHCI_Debug_Port for an up-to-date list
	  of supported controllers.

	  If unsure, say N.

if USBDEBUG

config USBDEBUG_IN_PRE_RAM
	bool "Enable early (pre-RAM) usbdebug"
	default y
	help
	   Configuring USB controllers in system-agent binary may cause
	   problems to usbdebug. Disabling this option delays usbdebug to
	   be setup on entry to ramstage.

	   If unsure, say Y.

config USBDEBUG_HCD_INDEX
	int
	default 0
	prompt "Index for EHCI controller to use with usbdebug" if HAVE_USBDEBUG_OPTIONS
	help
	   Some boards have multiple EHCI controllers with possibly only
	   one having the Debug Port capability on an external USB port.

	   Mapping of this index to PCI device functions is southbridge
	   specific and mainboard level Kconfig should already provide
	   a working default value here.

config USBDEBUG_DEFAULT_PORT
	int
	default 0
	prompt "Default USB port to use as Debug Port" if HAVE_USBDEBUG_OPTIONS
	help
	  Selects which physical USB port usbdebug dongle is connected to.
	  Setting of 0 means to scan possible ports starting from 1.

	  Intel platforms have hardwired the debug port location and this
	  setting makes no difference there.

	  Hence, if you select the correct port here, you can speed up
	  your boot time. Which USB port number refers to which actual
	  port on your mainboard (potentially also USB pin headers on
	  your mainboard) is highly board-specific, and you'll likely
	  have to find out by trial-and-error.

choice
	prompt "Type of dongle"
	default USBDEBUG_DONGLE_STD

config USBDEBUG_DONGLE_STD
	bool "USB gadget driver or Net20DC"
	help
	  Net20DC, BeagleBone Black, Raspberry Pi Zero W

config USBDEBUG_DONGLE_BEAGLEBONE
	bool "BeagleBone (not BeagleBone Black)"
	help
	  Use this to configure the USB hub on BeagleBone board.
	  Do NOT select this for the BeagleBone Black.

config USBDEBUG_DONGLE_FTDI_FT232H
	bool "FTDI FT232H UART"
	help
	  Use this with FT232H usb-to-uart. Configuration is hard-coded
	  to use 8n1, no flow control.

config USBDEBUG_DONGLE_WCH_CH347
	bool "WCH CH347 UART"
	help
	  Use this with CH347 usb-to-uart. Configuration is hard-coded
	  to use 8n1, no flow control. For compatibility across modes
	  0, 1, and 3, only UART 1 is supported. The UART in mode 2 is
	  not currently supported.

endchoice

config USBDEBUG_DONGLE_FTDI_FT232H_BAUD
	int "FTDI FT232H baud rate"
	default 115200
	depends on USBDEBUG_DONGLE_FTDI_FT232H
	help
	  Select baud rate for FT232H in the range 733..12,000,000. Make
	  sure that your receiving side supports the same setting and your
	  connection works with it. Multiples of 115,200 seem to be a good
	  choice, and EHCI debug usually can't saturate more than 576,000.

config USBDEBUG_DONGLE_WCH_CH347_BAUD
	int "WCH CH347 baud rate"
	default 115200
	depends on USBDEBUG_DONGLE_WCH_CH347
	help
	  Select baud rate for CH347 in the range 1200..9,000,000. Make
	  sure that your receiving side supports the same setting and your
	  connection works with it. Multiples of 115,200 seem to be a good
	  choice, and EHCI debug usually can't saturate more than 576,000.

config USBDEBUG_OPTIONAL_HUB_PORT
	int
	default 2 if USBDEBUG_DONGLE_BEAGLEBONE
	default 0

endif # USBDEBUG
```

## src/drivers/usb/acpi/Kconfig
```kconfig
## SPDX-License-Identifier: GPL-2.0-only

config DRIVERS_USB_ACPI
	bool
	default n
	depends on HAVE_ACPI_TABLES
```

## src/drivers/usb/hub/Kconfig
```kconfig
config DRIVERS_USB_HUB
	bool
	default n
	depends on HAVE_ACPI_TABLES
	help
	   This driver is for soldered down USB Hub in the mainboard. When enabled,
	   this driver will add ACPI support for the USB hub and any devices on the
	   downstream facing ports.
```

## src/drivers/usb/pci_xhci/Kconfig
```kconfig
config DRIVERS_USB_PCI_XHCI
	def_bool n
	depends on HAVE_ACPI_TABLES
	select XHCI_UTILS
	help
	  PCI driver that generates ACPI nodes for an xHCI compatible controller.
```

## src/drivers/wifi/generic/Kconfig
```kconfig
config DRIVERS_WIFI_GENERIC
	bool
	default n
	help
	  When enabled, add identifiers in ACPI tables that are common
	  to WiFi chipsets from multiple vendors.

config DRIVERS_INTEL_WIFI
	bool "Support Intel PCI-e WiFi adapters"
	depends on PCI
	default y if PCIEXP_PLUGIN_SUPPORT
	select DRIVERS_WIFI_GENERIC
	help
	   When enabled, add identifiers in ACPI and SMBIOS tables to
	   make OS drivers work with certain Intel PCI-e WiFi chipsets.

if DRIVERS_WIFI_GENERIC

config USE_SAR
	bool
	default n
	help
	  Enable it when wifi driver uses SAR configuration feature.

config SAR_ENABLE
	bool
	default n
	depends on USE_SAR

config DSAR_ENABLE
	bool
	default n
	depends on USE_SAR

config GEO_SAR_ENABLE
	bool
	default n
	depends on USE_SAR

config WIFI_SAR_CBFS_FILEPATH
	string "The cbfs file which has WIFI SAR defaults"
	depends on USE_SAR
	default ""

config DSAR_SET_NUM
	hex "Number of SAR sets when D-SAR is enabled"
	default 0x3
	depends on USE_SAR
	help
	  There can be up to 3 optional SAR table sets.

endif # DRIVERS_WIFI_GENERIC
```

## src/drivers/wwan/fm/Kconfig
```kconfig
config DRIVERS_WWAN_FM350GL
	bool
	default n
	depends on SOC_INTEL_COMMON_BLOCK_PCIE_RTD3
	help
	   This driver is for Fibocom FM350-GL PCIe 5G WWAN.
	   When enabled, this driver will add support for ACPI controlled
	   WWAN using GPIOs for power/reset control of the device.
	   This driver depends on rtd3 driver code to build as it needs to
	   point to the rtd3 chip on the same parent for the methods provided
	   only for the same root port.
```

## src/drivers/xgi/common/Kconfig
```kconfig
config DRIVERS_XGI_Z79_COMMON
	bool
	select VGA
	select NO_EDID_FILL_FB
	select MAINBOARD_HAS_NATIVE_VGA_INIT
	select HAVE_VGA_TEXT_FRAMEBUFFER if MAINBOARD_DO_NATIVE_VGA_INIT
```

## src/drivers/xpowers/axp209/Kconfig
```kconfig
config DRIVER_XPOWERS_AXP209
	bool
	default n
	help
	  X-Powers AXP902 Power Management Unit

if DRIVER_XPOWERS_AXP209

config DRIVER_XPOWERS_AXP209_BOOTBLOCK
	bool
	default n
	help
	  Make AXP209 functionality available in he bootblock.

endif # DRIVER_XPOWERS_AXP209
```

## src/ec/51nb/npce985la0dx/Kconfig
```kconfig
# SPDX-License-Identifier: GPL-2.0-or-later
# This file is part of the coreboot project.

config EC_51NB_NPCE985LA0DX
	bool
	default n
	help
	  Support for the 51NB NPCE985LA0DX EC

if EC_51NB_NPCE985LA0DX

comment "Please select the following otherwise your laptop cannot be powered on."

config EC_51NB_NPCE985LA0DX_FIRMWARE
	bool "Add firmware image for 51NB NPCE985LA0DX EC"
	depends on EC_51NB_NPCE985LA0DX
	default n
	help
	  Select this option to add the firmware blob for the 51NB EC.
	  You need this blob to power on your machine.

config EC_51NB_NPCE985LA0DX_FW
	string "51NB EC firmware path"
	depends on EC_51NB_NPCE985LA0DX_FIRMWARE
	default "ec.bin"
	help
	  The path and filename of the file to use as 51NB firmware.
endif
```

## src/ec/Kconfig
```kconfig
source src/ec/acpi/Kconfig
source src/ec/compal/Kconfig
source src/ec/google/Kconfig
source src/ec/kontron/Kconfig
source src/ec/lenovo/Kconfig
source src/ec/smsc/Kconfig
source src/ec/quanta/Kconfig
```

## src/ec/acpi/Kconfig
```kconfig
## SPDX-License-Identifier: GPL-2.0-only

config EC_ACPI
	bool
	help
	  ACPI Embedded Controller interface. Mostly found in laptops.

config EC_SUPPORTS_DPTF_TEVT
	bool
	help
	  The EC ASL code supports calling of TEVT method when provided by
	  SoC or mainboard.
```

## src/ec/clevo/it5570e/Kconfig
```kconfig
# SPDX-License-Identifier: GPL-2.0-only

config EC_CLEVO_IT5570E
	bool
	select EC_ACPI
	help
	  IT5570E embedded controller in Clevo notebooks

if EC_CLEVO_IT5570E

config EC_CLEVO_IT5570E_MEM_BASE
	hex
	help
	  Memory address for the EC memory region mapped via LGMR

config EC_CLEVO_IT5570E_AC_FAN_ALWAYS_ON
	bool "Fan always on with AC attached"
	default n
	help
	  Never turn the fan fully off when AC is attached.

	  This setting can be overridden by cmos option `ac_fan_always_on`.

config EC_CLEVO_IT5570E_KBLED_BOOTEFFECT
	bool "Keyboard boot effect"
	default n
	help
	  Enable the "breathing" boot effect of the LED keyboard.

	  This setting can be overridden by cmos option `kbled_booteffect`.

config EC_CLEVO_IT5570E_KBLED_TIMEOUT
	int "Keyboard backlight timeout"
	default 15
	help
	  Keyboard backlight timeout in seconds. 0 keeps the backlight
	  always on.

	  This setting can be overridden by cmos option `kbled_timeout`.

config EC_CLEVO_IT5570E_FN_WIN_SWAP
	bool "Swap Fn/Windows keys"
	default n
	help
	  Swap the Fn and Windows key.

	  This setting can be overridden by cmos option `fn_win_swap`.

config EC_CLEVO_IT5570E_FLEXICHARGER
	bool "Flexicharger"
	default n
	help
	  Enable the Flexicharger functionality.

	  This setting can be overridden by cmos option `flexicharger`.

if EC_CLEVO_IT5570E_FLEXICHARGER

config EC_CLEVO_IT5570E_FLEXICHG_START
	int "Start charge threshold"
	default 95
	help
	  Start charge threshold in percent.

	  This setting can be overridden by cmos option `flexicharger_start`.

config EC_CLEVO_IT5570E_FLEXICHG_STOP
	int "Stop charge threshold"
	default 100
	help
	  Stop charge threshold in percent.

	  This setting can be overridden by cmos option `flexicharger_stop`.

endif

choice
	prompt "Camera default state"
	default EC_CLEVO_IT5570E_CAM_BOOT_STATE_KEEP
	help
	  Camera default state.

	  This setting can be overridden by cmos option `camera_boot_state`.

config EC_CLEVO_IT5570E_CAM_BOOT_STATE_KEEP
	bool "Keep previous state"

config EC_CLEVO_IT5570E_CAM_BOOT_STATE_DISABLE
	bool "Disable"

config EC_CLEVO_IT5570E_CAM_BOOT_STATE_ENABLE
	bool "Enable"

endchoice

config EC_CLEVO_IT5570E_CAM_BOOT_STATE
	int
	default 0 if EC_CLEVO_IT5570E_CAM_BOOT_STATE_DISABLE
	default 1 if EC_CLEVO_IT5570E_CAM_BOOT_STATE_ENABLE
	default 2

choice
	prompt "Touchpad toggle mode"
	default EC_CLEVO_IT5570E_TP_TOGGLE_MODE_CTRLALTF9
	help
	  There are two modes for the touchpad toggle (Fn-F1):
	    - Ctrl-Alt-F9 mode sends the windows-native touchpad toggle keyboard shortcut.
	    - Keycode mode sends special key codes f7/f8 which can be configured in udev
	      to be handled as touchpad toggle.

	  This setting can be overridden by cmos option `tp_toggle_mode`.

config EC_CLEVO_IT5570E_TP_TOGGLE_MODE_CTRLALTF9
	bool "Ctrl-Alt-F9"

config EC_CLEVO_IT5570E_TP_TOGGLE_MODE_KEYOCDE_F7F8
	bool "Keycode f7/f8"

endchoice

config EC_CLEVO_IT5570E_TP_TOGGLE_MODE
	int
	default 0 if EC_CLEVO_IT5570E_TP_TOGGLE_MODE_CTRLALTF9
	default 1 if EC_CLEVO_IT5570E_TP_TOGGLE_MODE_KEYOCDE_F7F8

endif
```

## src/ec/compal/ene932/Kconfig
```kconfig
## SPDX-License-Identifier: GPL-2.0-only

config EC_COMPAL_ENE932
	bool
	help
	  Interface to COMPAL ENE932 Embedded Controller.
```

## src/ec/dasharo/ec/Kconfig
```kconfig
## SPDX-License-Identifier: GPL-2.0-only

config EC_DASHARO_EC
	select EC_ACPI
	bool
	help
	  Dasharo EC

if EC_DASHARO_EC

config EC_DASHARO_EC_BAT_THRESHOLDS
	bool
	default y

config EC_DASHARO_EC_DGPU
	bool
	default n

config EC_DASHARO_EC_UPDATE
	bool "Update the embedded controller firmware"
	default n

config EC_DASHARO_EC_UPDATE_FILE
	depends on EC_DASHARO_EC_UPDATE
	string "Path to the EC update file"
	default "ec.rom"

config EC_DASHARO_EC_FLASH_SIZE
	hex
	default 0x20000

endif # EC_DASHARO_EC
```
