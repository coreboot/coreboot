## src/ec/google/chromeec/mux/Kconfig
```kconfig
if EC_GOOGLE_CHROMEEC

config EC_GOOGLE_CHROMEEC_MUX
	bool
	depends on HAVE_ACPI_TABLES
	help
	  This enables the Cros EC Mux driver that is required to fill the
	  SSDT nodes for the EC Mux platform device which is used to
	  configure Type C muxes and retimers.

endif
```

## src/ec/google/common/Kconfig
```kconfig
## SPDX-License-Identifier: GPL-2.0-only

config EC_GOOGLE_COMMON_MEC
	bool
	help
	  Google common EC functions for Microchip EMI region.

config EC_GOOGLE_COMMON_RTK
	bool
	help
	  Google common EC functions for Realtek EMI region.
```

## src/ec/google/wilco/Kconfig
```kconfig
config EC_GOOGLE_WILCO
	bool
	default n
	select EC_GOOGLE_COMMON_MEC
	select EC_ACPI
	select EC_SUPPORTS_DPTF_TEVT
	help
	  Google Wilco Embedded Controller interface.

if EC_GOOGLE_WILCO

config EC_BASE_ACPI_DATA
	hex
	default 0x930
	help
	  This option provides the 16-bit IO base address for the ACPI
	  data interface.  This is the standard ACPI EC interface that
	  is used by the ACPI EC drivers in the OS.

config EC_BASE_ACPI_COMMAND
	hex
	default 0x934
	help
	  This option provides the 16-bit IO base address for the ACPI
	  EC command interface.  This is the standard ACPI EC interface
	  that is used by the ACPI EC drivers in the OS.

config EC_BASE_HOST_DATA
	hex
	default 0x940
	help
	  This option provides the 16-bit IO base address for the host
	  data interface.  This is the interface that is used to drive
	  the mailbox protocol.

config EC_BASE_HOST_COMMAND
	hex
	default 0x944
	help
	  This option provides the 16-bit IO base address for the host
	  command interface.  This is the interface that is used to drive
	  the mailbox protocol.

config EC_BASE_PACKET
	hex
	default 0x950
	help
	  This option provides the 16-bit IO base address for the EC
	  mailbox interface data region.  This data buffer is used along
	  with the host command and data registers to drive the EC
	  mailbox interface.  This is also the MEC EMI base address.

endif # EC_GOOGLE_WILCO
```

## src/ec/hp/kbc1126/Kconfig
```kconfig
## SPDX-License-Identifier: GPL-2.0-only

config EC_HP_KBC1126
	bool
	help
	  Interface to SMSC KBC1126 embedded controller in HP laptops.

config EC_HP_KBC1126_GPE
	hex
	depends on EC_HP_KBC1126
	default 0x16

config EC_HP_KBC1126_ECFW_IN_CBFS
	bool
	depends on EC_HP_KBC1126
	default y

if EC_HP_KBC1126_ECFW_IN_CBFS

comment "Please select the following otherwise your laptop cannot be powered on."

config KBC1126_FIRMWARE
	bool "Add firmware images for KBC1126 EC"
	depends on EC_HP_KBC1126
	default n
	help
	  Select this option to add the two firmware blobs for KBC1126.
	  You need these two blobs to power on your machine.

config KBC1126_FW1
	string "KBC1126 firmware #1 path and filename"
	depends on KBC1126_FIRMWARE
	default "fw1.bin"
	help
	  The path and filename of the file to use as KBC1126 firmware #1.
	  You can use util/kbc1126/kbc1126_ec_dump to dump it from the
	  vendor firmware.

config KBC1126_FW1_OFFSET
	string "Offset of KBC1126 firmware #1"
	depends on KBC1126_FIRMWARE
	default "0xfffe8000"

config KBC1126_FW2
	string "KBC1126 filename #2 path and filename"
	depends on KBC1126_FIRMWARE
	default "fw2.bin"
	help
	  The path and filename of the file to use as KBC1126 firmware #2.
	  You can use util/kbc1126/kbc1126_ec_dump to dump it from the
	  vendor firmware.

config KBC1126_FW2_OFFSET
	string "Offset of KBC1126 firmware #2"
	depends on KBC1126_FIRMWARE
	default "0xfffd0000"

endif
```

## src/ec/kontron/it8516e/Kconfig
```kconfig
config EC_KONTRON_IT8516E
	select EC_ACPI
	bool
	help
	  Kontron uses an ITE IT8516E on the KTQM77. It's firmware might
	  come from Fintek (mentioned as Finte*c* somewhere in their Linux
	  driver).
	  The KTQM77 is an embedded board and the IT8516E seems to be
	  only used for fan control and GPIO.
```

## src/ec/kontron/kempld/Kconfig
```kconfig
config EC_KONTRON_KEMPLD
	bool
	select DRIVERS_UART_8250IO
	help
	  Driver for Kontron's express module programmable logic device used
	  on their COMexpress modules.
```

## src/ec/lenovo/h8/Kconfig
```kconfig
config EC_LENOVO_H8
	select EC_ACPI
	bool

if EC_LENOVO_H8

config SEABIOS_PS2_TIMEOUT
	int
	depends on PAYLOAD_SEABIOS
	default 5000

config H8_BEEP_ON_DEATH
	bool "Beep on fatal error"
	default y
	help
	  Beep when encountered a fatal error.

config H8_FLASH_LEDS_ON_DEATH
	bool "Flash LEDs on fatal error"
	default y
	help
	  Flash all LEDs when encountered a fatal error.

config H8_SUPPORT_BT_ON_WIFI
	bool "Support bluetooth on wifi cards"
	default n
	help
	  Disable BDC detection and assume bluetooth is installed. Required for
	  bluetooth on wifi cards, as it's not possible to detect it in coreboot.

config H8_FN_CTRL_SWAP
	bool "Swap Fn and Ctrl keys"
	help
	  Specifies the fallback value of the "fn_ctrl_swap" option, which is
	  only used when the value cannot be obtained from the option backend.
	  The main use-case for this Kconfig option is to enable Fn-Ctrl swap
	  without using any runtime configurable option backends (e.g. CMOS).

config H8_HAS_BAT_THRESHOLDS_IMPL
	bool
	default n

config H8_FN_KEY_AS_VBOOT_RECOVERY_SW
	bool "Enable Fn-Key as VBOOT recovery switch"
	depends on VBOOT
	default n
	help
	  If VBOOT is enabled, press Fn-Key at power on to force a recovery mode
	  boot instead of regular FW_MAIN_x boot.

config H8_HAS_PRIMARY_FN_KEYS
	bool
	default n

config THINKPADEC_HKEY_EISAID
	string
	default "IBM0068"
	help
	  Motherboards of newer thinkpad models can override the default to match
	  vendor drivers and quirks.

endif # EC_LENOVO_H8
```

## src/ec/lenovo/mec1653/Kconfig
```kconfig
## SPDX-License-Identifier: GPL-2.0-only

config EC_LENOVO_MEC1653
	bool

if EC_LENOVO_MEC1653

config MEC1653_HAS_DEBUG_UNLOCK
	bool

config MEC1653_DEBUG_UNLOCK_KEY
	string
	depends on MEC1653_HAS_DEBUG_UNLOCK
	help
	  Debug unlock key necessary to enable the UART.

config MEC1653_ENABLE_UART
	bool "Enable EC UART"
	depends on MEC1653_HAS_DEBUG_UNLOCK
	help
	  The EC UART physical interface is board-specific and requires
	  a board-specific debug unlock key.

endif
```

## src/ec/purism/librem-ec/Kconfig
```kconfig
## SPDX-License-Identifier: GPL-2.0-only

config EC_LIBREM_EC
	bool
	help
	  Purism Librem EC
```

## src/ec/quanta/ene_kb3940q/Kconfig
```kconfig
## SPDX-License-Identifier: GPL-2.0-only

config EC_QUANTA_ENE_KB3940Q
	bool
	help
	  Interface to QUANTA ENE KB3940Q Embedded Controller.
```

## src/ec/quanta/it8518/Kconfig
```kconfig
## SPDX-License-Identifier: GPL-2.0-only

config EC_QUANTA_IT8518
	bool
	help
	  Interface to QUANTA IT8518 Embedded Controller.
```

## src/ec/roda/it8518/Kconfig
```kconfig
## SPDX-License-Identifier: GPL-2.0-only

config EC_RODA_IT8518
	bool
	select EC_ACPI
	help
	  Interface to IT8518 embedded controller in Roda notebooks.
```

## src/ec/smsc/mec1308/Kconfig
```kconfig
## SPDX-License-Identifier: GPL-2.0-only

config EC_SMSC_MEC1308
	bool
	help
	  Shared memory mailbox interface to SMSC MEC1308 Embedded Controller.
```

## src/ec/starlabs/it8987/Kconfig
```kconfig
## SPDX-License-Identifier: GPL-2.0-only

config EC_STARLABS_IT8987
	bool
	select EC_ACPI
	help
	  Interface to IT8987 embedded controller principally in Star Labs notebooks.
```

## src/ec/starlabs/merlin/Kconfig
```kconfig
## SPDX-License-Identifier: GPL-2.0-only

config EC_STARLABS_NUVOTON
	bool
	select EC_ACPI
	help
	  Interface to Nuvoton embedded controller principally in Star Labs notebooks.

config EC_STARLABS_ITE
	bool
	default y if EC_STARLABS_MERLIN
	select EC_ACPI
	help
	  Interface to ITE embedded controller principally in Star Labs notebooks.
	  Works with closed-source ITE firmware versions:
	  TGL - 1.00 or later
	  CML - 1.04 or later
	  KBL - 3.12 or later
	  And open-source Merlin firmware version 1.00 or later

config EC_STARLABS_ADD_ITE_BIN
	bool "Add Star Labs EC binary file"
	default n
	depends on EC_STARLABS_ITE
	help
	  Select to add an EC firmware binary into the coreboot image. EC firmware
	  is necessary, flashing a coreboot image without EC firmware will render
	  your laptop unusable.

config EC_STARLABS_ITE_BIN_PATH
	string "Star Labs EC binary file path"
	depends on EC_STARLABS_ADD_ITE_BIN

config EC_STARLABS_FAN
	bool
	help
	  Select if the mainboard has a fan.

config EC_STARLABS_KBL_LEVELS
	bool
	default n
	depends on EC_STARLABS_ITE || EC_STARLABS_NUVOTON
	help
	  Select if the mainboard supports multiple levels of brightness for the keyboard.

config EC_VARIANT_DIR
	string
	default "merlin" if EC_STARLABS_MERLIN

config EC_GPE_SCI
	hex
	default 0x50

config EC_STARLABS_BATTERY_MODEL
	string
	default "Unknown"

config EC_STARLABS_BATTERY_TYPE
	string
	default "LION"

config EC_STARLABS_BATTERY_OEM
	string
	default "Unknown"

config EC_STARLABS_MERLIN
	bool "Use open-source Merlin EC Firmware"
	default n
	help
	  Use open source embedded controller firmware. Both firmwares have the
	  same features but differ in licensing and compilers.

if EC_STARLABS_MERLIN

config EC_STARLABS_MAX_CHARGE
	bool
	default y
	help
	  Select if the mainboard supports limiting the maximum charge of the battery.

config EC_STARLABS_CHARGING_SPEED
	bool "Enable setting the charging speed"
	default y
	help
	  Select if the mainboard supports configuring the charging speed.

config EC_STARLABS_LID_SWITCH
	bool "Enable disabling the lid switch"
	default y
	help
	  Select if the mainboard supports disabling the lid switch

config EC_STARLABS_POWER_LED
	bool "Enable lowering the brightess of the Power LED"
	default y
	help
	  Select the in the mainboard supports reducing the LED brightness

endif
```

## src/ec/system76/ec/Kconfig
```kconfig
## SPDX-License-Identifier: GPL-2.0-only

config EC_SYSTEM76_EC
	bool
	help
	  System76 EC

if EC_SYSTEM76_EC

config EC_SYSTEM76_EC_BAT_THRESHOLDS
	bool
	default y

config EC_SYSTEM76_EC_FAN2
	bool
	default n

config EC_SYSTEM76_EC_DGPU
	bool
	default n
	select EC_SYSTEM76_EC_FAN2

config EC_SYSTEM76_EC_OLED
	bool
	default n

endif # EC_SYSTEM76_EC
```
