## src/mainboard/51nb/Kconfig
```kconfig
# SPDX-License-Identifier: GPL-2.0-or-later

if VENDOR_51NB

choice
	prompt "Mainboard model"

source "src/mainboard/51nb/*/Kconfig.name"

endchoice

source "src/mainboard/51nb/*/Kconfig"

config MAINBOARD_VENDOR
	default "51NB"

endif # VENDOR_51NB
```

## src/mainboard/51nb/x210/Kconfig
```kconfig
## SPDX-License-Identifier: GPL-2.0-only

if BOARD_51NB_X210

config BOARD_SPECIFIC_OPTIONS
	def_bool y
	select BOARD_ROMSIZE_KB_8192
	select EC_51NB_NPCE985LA0DX
	select HAVE_ACPI_RESUME
	select HAVE_ACPI_TABLES
	select MAINBOARD_HAS_LIBGFXINIT
	select SOC_INTEL_COMMON_BLOCK_HDA_VERB
	select SOC_INTEL_KABYLAKE
	select SPD_READ_BY_WORD
	select SYSTEM_TYPE_LAPTOP

config MAINBOARD_FAMILY
	string
	default "X210"

config MAINBOARD_PART_NUMBER
	default "X210"

config MAINBOARD_VERSION
	string
	default "1.0"

config MAINBOARD_DIR
	default "51nb/x210"

config VGA_BIOS_ID
	string
	default "8086,5917"

config DIMM_MAX
	default 2

config DIMM_SPD_SIZE
	default 512

config FMDFILE
	default "src/mainboard/\$(CONFIG_MAINBOARD_DIR)/board.fmd"

config NO_POST
	default y

endif
```

## src/mainboard/51nb/x210/Kconfig.name
```kconfig
## SPDX-License-Identifier: GPL-2.0-only

config BOARD_51NB_X210
	bool "51NB X210"
```

## src/mainboard/Kconfig
```kconfig
comment "Important: Run 'make distclean' before switching boards"

choice
	prompt "Mainboard vendor"
	default VENDOR_EMULATION

source "src/mainboard/*/Kconfig.name"

endchoice

source "src/mainboard/*/Kconfig"

config MAINBOARD_DIR
	string

config MAINBOARD_PART_NUMBER
	string "Mainboard part number"

config MAINBOARD_VENDOR
	string "Mainboard vendor name"

config VARIANT_DIR
	string

config BOARD_ROMSIZE_KB_256
	bool
config BOARD_ROMSIZE_KB_512
	bool
config BOARD_ROMSIZE_KB_1024
	bool
config BOARD_ROMSIZE_KB_2048
	bool
config BOARD_ROMSIZE_KB_4096
	bool
config BOARD_ROMSIZE_KB_5120
	bool
config BOARD_ROMSIZE_KB_6144
	bool
config BOARD_ROMSIZE_KB_8192
	bool
config BOARD_ROMSIZE_KB_10240
	bool
config BOARD_ROMSIZE_KB_12288
	bool
config BOARD_ROMSIZE_KB_16384
	bool
config BOARD_ROMSIZE_KB_32768
	bool
config BOARD_ROMSIZE_KB_65536
	bool

# TODO: No help text possible for choice fields?
choice
	prompt "ROM chip size"
	default COREBOOT_ROMSIZE_KB_256   if BOARD_ROMSIZE_KB_256
	default COREBOOT_ROMSIZE_KB_512   if BOARD_ROMSIZE_KB_512
	default COREBOOT_ROMSIZE_KB_1024  if BOARD_ROMSIZE_KB_1024
	default COREBOOT_ROMSIZE_KB_2048  if BOARD_ROMSIZE_KB_2048
	default COREBOOT_ROMSIZE_KB_4096  if BOARD_ROMSIZE_KB_4096
	default COREBOOT_ROMSIZE_KB_5120  if BOARD_ROMSIZE_KB_5120
	default COREBOOT_ROMSIZE_KB_6144  if BOARD_ROMSIZE_KB_6144
	default COREBOOT_ROMSIZE_KB_8192  if BOARD_ROMSIZE_KB_8192
	default COREBOOT_ROMSIZE_KB_10240 if BOARD_ROMSIZE_KB_10240
	default COREBOOT_ROMSIZE_KB_12288 if BOARD_ROMSIZE_KB_12288
	default COREBOOT_ROMSIZE_KB_16384 if BOARD_ROMSIZE_KB_16384
	default COREBOOT_ROMSIZE_KB_32768 if BOARD_ROMSIZE_KB_32768
	default COREBOOT_ROMSIZE_KB_65536 if BOARD_ROMSIZE_KB_65536
	help
	  Select the size of the ROM chip you intend to flash coreboot on.

	  The build system will take care of creating a coreboot.rom file
	  of the matching size.

config COREBOOT_ROMSIZE_KB_256
	bool "256 KB"
	help
	  Choose this option if you have a 256 KB ROM chip.

config COREBOOT_ROMSIZE_KB_512
	bool "512 KB"
	help
	  Choose this option if you have a 512 KB ROM chip.

config COREBOOT_ROMSIZE_KB_1024
	bool "1024 KB (1 MB)"
	help
	  Choose this option if you have a 1024 KB (1 MB) ROM chip.

config COREBOOT_ROMSIZE_KB_2048
	bool "2048 KB (2 MB)"
	help
	  Choose this option if you have a 2048 KB (2 MB) ROM chip.

config COREBOOT_ROMSIZE_KB_4096
	bool "4096 KB (4 MB)"
	help
	  Choose this option if you have a 4096 KB (4 MB) ROM chip.

config COREBOOT_ROMSIZE_KB_5120
	bool "5120 KB (5 MB)"
	help
	  Choose this option if you have a 5120 KB (5 MB) ROM chip.

config COREBOOT_ROMSIZE_KB_6144
	bool "6144 KB (6 MB)"
	help
	  Choose this option if you have a 6144 KB (6 MB) ROM chip.

config COREBOOT_ROMSIZE_KB_8192
	bool "8192 KB (8 MB)"
	help
	  Choose this option if you have a 8192 KB (8 MB) ROM chip.

config COREBOOT_ROMSIZE_KB_10240
	bool "10240 KB (10 MB)"
	help
	  Choose this option if you have a 10240 KB (10 MB) ROM chip.

config COREBOOT_ROMSIZE_KB_12288
	bool "12288 KB (12 MB)"
	help
	  Choose this option if you have a 12288 KB (12 MB) ROM chip.

config COREBOOT_ROMSIZE_KB_16384
	bool "16384 KB (16 MB)"
	help
	  Choose this option if you have a 16384 KB (16 MB) ROM chip.

config COREBOOT_ROMSIZE_KB_32768
	bool "32768 KB (32 MB)"
	help
	  Choose this option if you have a 32768 KB (32 MB) ROM chip.

config COREBOOT_ROMSIZE_KB_65536
	bool "65536 KB (64 MB)"
	help
	  Choose this option if you have a 65536 KB (64 MB) ROM chip.

endchoice

# Map the config names to an integer (KB).
config COREBOOT_ROMSIZE_KB
	int
	default   256 if COREBOOT_ROMSIZE_KB_256
	default   512 if COREBOOT_ROMSIZE_KB_512
	default  1024 if COREBOOT_ROMSIZE_KB_1024
	default  2048 if COREBOOT_ROMSIZE_KB_2048
	default  4096 if COREBOOT_ROMSIZE_KB_4096
	default  5120 if COREBOOT_ROMSIZE_KB_5120
	default  6144 if COREBOOT_ROMSIZE_KB_6144
	default  8192 if COREBOOT_ROMSIZE_KB_8192
	default 10240 if COREBOOT_ROMSIZE_KB_10240
	default 12288 if COREBOOT_ROMSIZE_KB_12288
	default 16384 if COREBOOT_ROMSIZE_KB_16384
	default 32768 if COREBOOT_ROMSIZE_KB_32768
	default 65536 if COREBOOT_ROMSIZE_KB_65536

# Map the config names to a hex value (bytes).
config ROM_SIZE
	hex
	default 0x00040000 if COREBOOT_ROMSIZE_KB_256
	default 0x00080000 if COREBOOT_ROMSIZE_KB_512
	default 0x00100000 if COREBOOT_ROMSIZE_KB_1024
	default 0x00200000 if COREBOOT_ROMSIZE_KB_2048
	default 0x00400000 if COREBOOT_ROMSIZE_KB_4096
	default 0x00500000 if COREBOOT_ROMSIZE_KB_5120
	default 0x00600000 if COREBOOT_ROMSIZE_KB_6144
	default 0x00800000 if COREBOOT_ROMSIZE_KB_8192
	default 0x00a00000 if COREBOOT_ROMSIZE_KB_10240
	default 0x00c00000 if COREBOOT_ROMSIZE_KB_12288
	default 0x01000000 if COREBOOT_ROMSIZE_KB_16384
	default 0x02000000 if COREBOOT_ROMSIZE_KB_32768
	default 0x04000000 if COREBOOT_ROMSIZE_KB_65536

config ENABLE_POWER_BUTTON
	bool "Enable the power button" if POWER_BUTTON_IS_OPTIONAL
	default y if POWER_BUTTON_DEFAULT_ENABLE
	default n if POWER_BUTTON_DEFAULT_DISABLE
	help
	  The selected mainboard can optionally have the power button tied
	  to ground with a jumper so that the button appears to be
	  constantly depressed. If this option is enabled and the jumper is
	  installed then the board will turn on, but turn off again after a
	  short timeout, usually 4 seconds.

	  Select Y here if you have removed the jumper and want to use an
	  actual power button. Select N if you have the jumper installed.

config ENABLE_POWER_BUTTON
	def_bool y if !POWER_BUTTON_IS_OPTIONAL && POWER_BUTTON_FORCE_ENABLE
	def_bool n if !POWER_BUTTON_IS_OPTIONAL && POWER_BUTTON_FORCE_DISABLE

config HAVE_POWER_STATE_AFTER_FAILURE
	bool

if HAVE_POWER_STATE_AFTER_FAILURE

config HAVE_POWER_STATE_PREVIOUS_AFTER_FAILURE
	bool

config POWER_STATE_DEFAULT_ON_AFTER_FAILURE
	bool
	help
	  Selected by platforms or mainboards that want a "default on"
	  behaviour.

choice
	prompt "System Power State after Failure"
	default POWER_STATE_ON_AFTER_FAILURE \
		if POWER_STATE_DEFAULT_ON_AFTER_FAILURE
	default POWER_STATE_OFF_AFTER_FAILURE
	help
	  Provides a default for the power state the system should
	  go into after G3 (power loss). On many boards this can be
	  overridden by an NVRAM option.

config POWER_STATE_OFF_AFTER_FAILURE
	bool "S5 Soft Off"
	help
	  Choose this option if you want to put system into
	  S5 after reapplying power after failure.

config POWER_STATE_ON_AFTER_FAILURE
	bool "S0 Full On"
	help
	  Choose this option if you want to keep system in
	  S0 after reapplying power after failure.

config POWER_STATE_PREVIOUS_AFTER_FAILURE
	bool "Keep Previous State"
	depends on HAVE_POWER_STATE_PREVIOUS_AFTER_FAILURE
	help
	  Choose this option if you want to keep system in the
	  same power state as before failure after reapplying
	  power.

endchoice

config MAINBOARD_POWER_FAILURE_STATE
	int
	default 2 if POWER_STATE_PREVIOUS_AFTER_FAILURE
	default 1 if POWER_STATE_ON_AFTER_FAILURE
	default 0

endif # HAVE_POWER_STATE_AFTER_FAILURE
```

## src/mainboard/a-trend/Kconfig
```kconfig
##
## This file is part of the coreboot project.
##
## Copyright (C) 2009 Uwe Hermann <uwe@hermann-uwe.de>
##
## This program is free software; you can redistribute it and/or modify
## it under the terms of the GNU General Public License as published by
## the Free Software Foundation; version 2 of the License.
##
## This program is distributed in the hope that it will be useful,
## but WITHOUT ANY WARRANTY; without even the implied warranty of
## MERCHANTABILITY or FITNESS FOR A PARTICULAR PURPOSE.  See the
## GNU General Public License for more details.
##
## You should have received a copy of the GNU General Public License
## along with this program; if not, write to the Free Software
## Foundation, Inc., 51 Franklin St, Fifth Floor, Boston, MA 02110-1301 USA
##
if VENDOR_A_TREND

choice
	prompt "Mainboard model"

config BOARD_A_TREND_ATC_6220
	bool "ATC-6220"
config BOARD_A_TREND_ATC_6240
	bool "ATC-6240"

endchoice

source "src/mainboard/a-trend/atc-6220/Kconfig"
source "src/mainboard/a-trend/atc-6240/Kconfig"

config MAINBOARD_VENDOR
	string
	default "A-Trend"

endif # VENDOR_A_TREND
```

## src/mainboard/aaeon/Kconfig
```kconfig
if VENDOR_AAEON

choice
	prompt "Mainboard model"

source "src/mainboard/aaeon/*/Kconfig.name"

endchoice

source "src/mainboard/aaeon/*/Kconfig"

config MAINBOARD_VENDOR
	string
	default "Aaeon"

endif # VENDOR_AAEON
```

## src/mainboard/aaeon/pfm-540i_revb/Kconfig
```kconfig
if BOARD_AAEON_PFM_540I_REVB

config BOARD_SPECIFIC_OPTIONS # dummy
	def_bool y
	select ARCH_X86
	select CPU_AMD_GEODE_LX
	select NORTHBRIDGE_AMD_LX
	select SOUTHBRIDGE_AMD_CS5536
	select SUPERIO_SMSC_SMSCSUPERIO
	select HAVE_PIRQ_TABLE
	select PIRQ_ROUTE
	select UDELAY_TSC
	select BOARD_ROMSIZE_KB_1024
	select POWER_BUTTON_FORCE_ENABLE

config MAINBOARD_DIR
	string
	default aaeon/pfm-540i_revb

config MAINBOARD_PART_NUMBER
	string
	default "PFM-540I_REVB"

config IRQ_SLOT_COUNT
	int
	default 4

endif # BOARD_AAEON_PFM_540I_REVB
```

## src/mainboard/abit/Kconfig
```kconfig
##
## This file is part of the coreboot project.
##
## Copyright (C) 2009 Uwe Hermann <uwe@hermann-uwe.de>
##
## This program is free software; you can redistribute it and/or modify
## it under the terms of the GNU General Public License as published by
## the Free Software Foundation; version 2 of the License.
##
## This program is distributed in the hope that it will be useful,
## but WITHOUT ANY WARRANTY; without even the implied warranty of
## MERCHANTABILITY or FITNESS FOR A PARTICULAR PURPOSE.  See the
## GNU General Public License for more details.
##
## You should have received a copy of the GNU General Public License
## along with this program; if not, write to the Free Software
## Foundation, Inc., 51 Franklin St, Fifth Floor, Boston, MA 02110-1301 USA
##
if VENDOR_ABIT

choice
	prompt "Mainboard model"

config BOARD_ABIT_BE6_II_V2_0
	bool "BE6-II V2.0"

endchoice

source "src/mainboard/abit/be6-ii_v2_0/Kconfig"

config MAINBOARD_VENDOR
	string
	default "Abit"

endif # VENDOR_ABIT
```

## src/mainboard/abit/be6-ii_v2_0/Kconfig
```kconfig
##
## This file is part of the coreboot project.
##
## Copyright (C) 2009 Uwe Hermann <uwe@hermann-uwe.de>
##
## This program is free software; you can redistribute it and/or modify
## it under the terms of the GNU General Public License as published by
## the Free Software Foundation; either version 2 of the License, or
## (at your option) any later version.
##
## This program is distributed in the hope that it will be useful,
## but WITHOUT ANY WARRANTY; without even the implied warranty of
## MERCHANTABILITY or FITNESS FOR A PARTICULAR PURPOSE.  See the
## GNU General Public License for more details.
##
## You should have received a copy of the GNU General Public License
## along with this program; if not, write to the Free Software
## Foundation, Inc., 51 Franklin St, Fifth Floor, Boston, MA  02110-1301 USA
##

config BOARD_ABIT_BE6_II_V2_0
	bool "BE6-II V2.0"
	select ARCH_X86
	select CPU_INTEL_SLOT_2
	select NORTHBRIDGE_INTEL_I440BX
	select SOUTHBRIDGE_INTEL_I82371EB
	select SUPERIO_WINBOND_W83977TF
	select HAVE_PIRQ_TABLE
	select UDELAY_IO
	select PCI_ROM_RUN
	select CONSOLE_VGA
	help
	  Abit BE6-II V2.0 mainboard.

config MAINBOARD_DIR
	string
	default abit/be6-ii_v2_0
	depends on BOARD_ABIT_BE6_II_V2_0

config MAINBOARD_PART_NUMBER
	string
	default "BE6-II V2.0"
	depends on BOARD_ABIT_BE6_II_V2_0

config HAVE_OPTION_TABLE
	bool
	default n
	depends on BOARD_ABIT_BE6_II_V2_0

config IRQ_SLOT_COUNT
	int
	default 9
	depends on BOARD_ABIT_BE6_II_V2_0
```

## src/mainboard/acer/Kconfig
```kconfig
## SPDX-License-Identifier: GPL-2.0-only

if VENDOR_ACER

choice
	prompt "Mainboard model"

source "src/mainboard/acer/*/Kconfig.name"

endchoice

source "src/mainboard/acer/*/Kconfig"

config MAINBOARD_VENDOR
	string
	default "Acer"

endif # VENDOR_ACER
```

## src/mainboard/acer/aspire_vn7_572g/Kconfig
```kconfig
## SPDX-License-Identifier: GPL-2.0-only

if BOARD_ACER_VN7_572G

config BOARD_SPECIFIC_OPTIONS
	def_bool y
	select BOARD_ROMSIZE_KB_8192
	select DRIVERS_I2C_HID
	select DRIVERS_USB_ACPI
	select EC_ACPI
	select HAVE_ACPI_RESUME
	select HAVE_ACPI_TABLES
	select HAVE_CMOS_DEFAULT
	select HAVE_INTEL_PTT
	select HAVE_OPTION_TABLE
	select INTEL_GMA_HAVE_VBT
	select INTEL_INT15
	select INTEL_LPSS_UART_FOR_CONSOLE
	select CRB_TPM
	select MAINBOARD_HAS_LIBGFXINIT
	select MAINBOARD_HAS_TPM2
	select NO_UART_ON_SUPERIO
	select SOC_INTEL_COMMON_BLOCK_HDA_VERB
	select SOC_INTEL_SKYLAKE
	select SPD_READ_BY_WORD
	select SYSTEM_TYPE_LAPTOP

config CBFS_SIZE
	default 0x600000

config CONSOLE_SERIAL
	default n

config DIMM_MAX
	default 2

config DIMM_SPD_SIZE
	default 512

config FMDFILE
	default "src/mainboard/\$(CONFIG_MAINBOARD_DIR)/board.fmd" if INCLUDE_EC_FIRMWARE

config INCLUDE_EC_FIRMWARE
	bool "Include EC firmware blob"
	help
	  If corrupted, the EC can recover its firmware from the SPI flash.

config EC_FIRMWARE_FILE
	string "Location of EC firmware blob"
	depends on INCLUDE_EC_FIRMWARE
	default "3rdparty/blobs/mainboard/\$(MAINBOARDDIR)/ec.bin"

config EC_USE_LGMR
	bool "Use LPC generic memory range for EC"
	help
	  Using MMIO accesses for EC range can improve performance.

config INCLUDE_NHLT_BLOBS
	bool "Include blobs for audio"
	select NHLT_DMIC_1CH
	# It appears OS chooses blob?
	select NHLT_DMIC_2CH
#	select NHLT_DMIC_4CH	# Wrong lie to tell? Double-check blob.

config LINEAR_FRAMEBUFFER_MAX_HEIGHT
	default 1080

config LINEAR_FRAMEBUFFER_MAX_WIDTH
	default 1920

config MAINBOARD_DIR
	default "acer/aspire_vn7_572g"

config MAINBOARD_FAMILY
	default "Aspire V Nitro"

config MAINBOARD_PART_NUMBER
	default "Aspire VN7-572G"

config MAINBOARD_SUPPORTS_KABYLAKE_DUAL
	default n

config MAINBOARD_SUPPORTS_KABYLAKE_QUAD
	default n

config MAX_CPUS
	default 4

config ME_CLEANER_ARGS
	default "-s"

config ONBOARD_VGA_IS_PRIMARY
	default y

config POST_DEVICE
	default n

config POST_IO
	default n

config UART_FOR_CONSOLE
	default 2

config VGA_BIOS_DGPU_ID
	default "10de,139a"

config VGA_BIOS_ID
	default "8086,1916"

endif
```

## src/mainboard/acer/aspire_vn7_572g/Kconfig.name
```kconfig
## SPDX-License-Identifier: GPL-2.0-only

config BOARD_ACER_VN7_572G
	bool "Aspire VN7-572G"
```
