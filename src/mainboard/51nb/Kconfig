## src/mainboard/acer/fuquene/Kconfig
```kconfig
##
## This file is part of the coreboot project.
##
## Copyright (C) 2013 Edward O'Callaghan <eocallaghan@alterapraxis.com>
##
## This program is free software; you can redistribute it and/or modify
## it under the terms of the GNU General Public License as published by
## the Free Software Foundation; version 2 of the License.
##
## This program is distributed in the hope that it will be useful,
## but WITHOUT ANY WARRANTY; without even the implied warranty of
## MERCHANTABILITY or FITNESS FOR A PARTICULAR PURPOSE.  See the
## GNU General Public License for more details.
##
## You should have received a copy of the GNU General Public License
## along with this program; if not, write to the Free Software
## Foundation, Inc., 51 Franklin St, Fifth Floor, Boston, MA 02110-1301 USA
##
if BOARD_ACER_FUQUENE

config BOARD_SPECIFIC_OPTIONS # dummy
	def_bool y
	select ARCH_X86
	select CPU_AMD_SOCKET_S1G1
	select NORTHBRIDGE_AMD_AMDK8
	select SOUTHBRIDGE_AMD_RS690
	select SOUTHBRIDGE_AMD_SB600
	select SUPERIO_ITE_IT8712F
#	select HAVE_ACPI_TABLES
#	select HAVE_MP_TABLE
#	select HAVE_PIRQ_TABLE
#	select HAVE_OPTION_TABLE
	select SB_HT_CHAIN_UNITID_OFFSET_ONLY
	select BOARD_ROMSIZE_KB_1024
	select RAMINIT_SYSINFO
	select QRANK_DIMM_SUPPORT
	select SET_FIDVID


config MAINBOARD_DIR
	string
	default acer/fuquene

config MAINBOARD_PART_NUMBER
	string
	default "FUQUENE"

config IRQ_SLOT_COUNT
	int
	default 9

endif # BOARD_ACER_FUQUENE
```

## src/mainboard/acer/g43t-am3/Kconfig
```kconfig
# SPDX-License-Identifier: GPL-2.0-only

if BOARD_ACER_G43T_AM3 || BOARD_ACER_Q45T_AM

config BOARD_SPECIFIC_OPTIONS
	def_bool y
	select CPU_INTEL_SOCKET_LGA775
	select NORTHBRIDGE_INTEL_X4X
	select SOUTHBRIDGE_INTEL_I82801JX
	select SUPERIO_ITE_IT8720F
	select HAVE_ACPI_TABLES
	select BOARD_ROMSIZE_KB_2048 if BOARD_ACER_G43T_AM3
	select BOARD_ROMSIZE_KB_4096 if BOARD_ACER_Q45T_AM
	select PCIEXP_ASPM
	select PCIEXP_CLK_PM
	select HAVE_OPTION_TABLE
	select HAVE_CMOS_DEFAULT
	select HAVE_ACPI_RESUME
	select DRIVERS_I2C_CK505
	select INTEL_GMA_HAVE_VBT
	select MAINBOARD_HAS_LIBGFXINIT
	select MAINBOARD_USES_IFD_GBE_REGION

config VGA_BIOS_ID
	string
	default "8086,2e22" if BOARD_ACER_G43T_AM3
	default "8086,2e12" if BOARD_ACER_Q45T_AM

config MAINBOARD_DIR
	default "acer/g43t-am3"

config VARIANT_DIR
	default "g43t-am3" if BOARD_ACER_G43T_AM3
	default "q45t-am"  if BOARD_ACER_Q45T_AM

config MAINBOARD_PART_NUMBER
	default "G43T-AM3" if BOARD_ACER_G43T_AM3
	default "Q45T-AM"  if BOARD_ACER_Q45T_AM

config OVERRIDE_DEVICETREE
	string
	default "variants/\$(CONFIG_VARIANT_DIR)/overridetree.cb"

endif # BOARD_ACER_G43T_AM3 || BOARD_ACER_Q45T_AM
```

## src/mainboard/acer/g43t-am3/Kconfig.name
```kconfig
## SPDX-License-Identifier: GPL-2.0-only

config BOARD_ACER_G43T_AM3
	bool "G43T-AM3"

config BOARD_ACER_Q45T_AM
	bool "Q45T-AM"
```

## src/mainboard/adi/Kconfig
```kconfig
if VENDOR_ADI

choice
	prompt "Mainboard model"

source "src/mainboard/adi/*/Kconfig.name"

endchoice

source "src/mainboard/adi/*/Kconfig"

config MAINBOARD_VENDOR
	string
	default "ADI"

endif # VENDOR_ADI
```
