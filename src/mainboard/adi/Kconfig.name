## src/mainboard/amd/birman_plus/Kconfig
```kconfig
# SPDX-License-Identifier: GPL-2.0-only

config BOARD_AMD_BIRMANPLUS_COMMON
	def_bool n
	select BOARD_ROMSIZE_KB_65536
	select EC_ACPI
	select SOC_AMD_COMMON_BLOCK_USE_ESPI if !SOC_AMD_COMMON_BLOCK_SIMNOW_BUILD
	select DRIVERS_PCIE_RTD3_DEVICE
	select DRIVERS_I2C_GENERIC
	select MAINBOARD_HAS_CHROMEOS
	select PCIEXP_ASPM
	select PCIEXP_CLK_PM
	select PCIEXP_COMMON_CLOCK
	select PCIEXP_L1_SUB_STATE
	select SOC_AMD_COMMON_BLOCK_ESPI_RETAIN_PORT80_EN if !SOC_AMD_COMMON_BLOCK_SIMNOW_BUILD
	select SOC_AMD_COMMON_BLOCK_SIMNOW_SUPPORTED
	select SPI_FLASH_EXIT_4_BYTE_ADDR_MODE


config BOARD_AMD_BIRMANPLUS_PHOENIX
	select BOARD_AMD_BIRMANPLUS_COMMON
	select SOC_AMD_PHOENIX_FSP

config BOARD_AMD_BIRMANPLUS_GLINDA
	select BOARD_AMD_BIRMANPLUS_COMMON
	select SOC_AMD_GLINDA

if BOARD_AMD_BIRMANPLUS_COMMON

config FMDFILE
	default "src/mainboard/amd/birman_plus/chromeos_phoenix.fmd" if CHROMEOS && BOARD_AMD_BIRMANPLUS_PHOENIX
	default "src/mainboard/amd/birman_plus/chromeos_glinda.fmd" if CHROMEOS && BOARD_AMD_BIRMANPLUS_GLINDA
	default "src/mainboard/amd/birman_plus/board_phoenix.fmd" if BOARD_AMD_BIRMANPLUS_PHOENIX
	default "src/mainboard/amd/birman_plus/board_glinda.fmd" if BOARD_AMD_BIRMANPLUS_GLINDA

config MAINBOARD_DIR
	default "amd/birman_plus" if BOARD_AMD_BIRMANPLUS_PHOENIX || BOARD_AMD_BIRMANPLUS_GLINDA

config MAINBOARD_PART_NUMBER
	default "Birmanplus_Phoenix" if BOARD_AMD_BIRMANPLUS_PHOENIX
	default "Birmanplus_Glinda"  if BOARD_AMD_BIRMANPLUS_GLINDA

config DEVICETREE
	default "devicetree_phoenix.cb" if BOARD_AMD_BIRMANPLUS_PHOENIX
	default "devicetree_glinda.cb"  if BOARD_AMD_BIRMANPLUS_GLINDA

config BIRMANPLUS_HAVE_MCHP_FW
	bool "Have Microchip EC firmware?"
	default n

config AMD_SOC_CONSOLE_UART
	default y if !SOC_AMD_COMMON_BLOCK_SIMNOW_BUILD

config BIRMANPLUS_MCHP_FW_FILE
	string "Microchip EC firmware file"
	depends on BIRMANPLUS_HAVE_MCHP_FW
	default "3rdparty/blobs/mainboard/amd/birman_plus/EC_birmanplus.bin"
	help
	  The EC firmware blob is at the EC_BODY FMAP region of the firmware image.

config VBOOT
	select VBOOT_NO_BOARD_SUPPORT
	select VBOOT_SEPARATE_VERSTAGE
	select VBOOT_STARTS_IN_BOOTBLOCK

config VBOOT_VBNV_OFFSET
	hex
	default 0x2A

config RO_REGION_ONLY
	string
	depends on VBOOT_SLOTS_RW_AB || VBOOT_SLOTS_RW_A
	# Add the EFS and EC to the RO region only
	# This is a birmanplus specific override of soc/amd/(phoenix | glinda)/Kconfig
	default "apu/amdfw apu/ecfw"

config CHROMEOS
	# Use default libpayload config
	select LP_DEFCONFIG_OVERRIDE if PAYLOAD_DEPTHCHARGE
	# We don't have recovery buttons, so we can't manually enable devmode.
	select GBB_FLAG_FORCE_DEV_SWITCH_ON

config ENABLE_EVAL_CARD
	bool "Enable Eval Card"
	help
	  Enable the Eval Card PCIe slot

config ENABLE_EVAL_19V
	bool "Enable 19V rail for Eval Card"
	depends on ENABLE_EVAL_CARD
	help
	  Enable the 19V rail for Eval Card PCIe slot

config ENABLE_SSD1_BIRMANPLUS
	bool "Enable M.2 SSD1 Slot"
	help
	  Enable M.2 SSD1 Slot. For Glinda SoC this will downgrade
	  PCIe x8 slot to x4.

choice
	prompt "GBE Enable/WWAN LANE1 Selection"
	default ENABLE_GBE_BIRMANPLUS
	help
	  When the M.2 x2 WWAN slot is enabled, the GbE LAN is disabled.

config ENABLE_GBE_BIRMANPLUS
	bool "Enable GBE (1 Lane WWAN)"

config ENABLE_WWAN02_BIRMANPLUS
	bool "Enable only WWAN (2 Lanes WWAN)"

config DISABLE_WWAN_GBE_BIRMANPLUS
	bool "Disable both WWAN and GBE"
endchoice

choice
	prompt "SD Card Enable/WLAN LANE1 Selection"
	default ENABLE_SDCARD_BIRMANPLUS
	help
	  When the M.2 x2 WLAN slot is enabled, the SD Card Reader is disabled.

config ENABLE_SDCARD_BIRMANPLUS
	bool "Enable SD Card (1 Lane WLAN)"

config ENABLE_WLAN02_BIRMANPLUS
	bool "Enable only WLAN (2 Lanes WLAN)"

config DISABLE_WLAN_SD_BIRMANPLUS
	bool "Disable both WLAN and SD Card"
endchoice

if !EM100	# EM100 defaults in soc/amd/common/blocks/spi/Kconfig
config EFS_SPI_READ_MODE
	default 3	# Quad IO (1-1-4)

config EFS_SPI_SPEED
	default 0	# 66MHz

config EFS_SPI_MICRON_FLAG
	default 0

config NORMAL_READ_SPI_SPEED
	default 1	# 33MHz

config ALT_SPI_SPEED
	default 1	# 33MHz

config TPM_SPI_SPEED
	default 1	# 33MHz

endif # !EM100

endif # BOARD_AMD_BIRMANPLUS_COMMON
```

## src/mainboard/amd/birman_plus/Kconfig.name
```kconfig
comment "BirmanPlus"

config BOARD_AMD_BIRMANPLUS_PHOENIX
	bool "->  BirmanPlus for Phoenix SoC"

config BOARD_AMD_BIRMANPLUS_GLINDA
	bool "->  BirmanPlus for Glinda SoC"
```

## src/mainboard/amd/chausie/Kconfig
```kconfig
# SPDX-License-Identifier: GPL-2.0-only

if BOARD_AMD_CHAUSIE

config BOARD_SPECIFIC_OPTIONS
	def_bool y
	select BOARD_ROMSIZE_KB_16384
	select EC_ACPI
	select SOC_AMD_MENDOCINO
	select SOC_AMD_COMMON_BLOCK_USE_ESPI
	select AMD_SOC_CONSOLE_UART
	select MAINBOARD_HAS_CHROMEOS
	select PCIEXP_ASPM
	select PCIEXP_CLK_PM
	select PCIEXP_COMMON_CLOCK
	select PCIEXP_L1_SUB_STATE
	select SOC_AMD_COMMON_BLOCK_ESPI_RETAIN_PORT80_EN

config FMDFILE
	default "src/mainboard/amd/chausie/chromeos.fmd" if CHROMEOS
	default "src/mainboard/amd/chausie/board.fmd"

config MAINBOARD_DIR
	default "amd/chausie"

config MAINBOARD_PART_NUMBER
	default "CHAUSIE"

config AMD_FWM_POSITION_INDEX
	int
	default 3 if CHROMEOS
	help
	  TODO: might need to be adapted for better placement of files in cbfs

config CHAUSIE_HAVE_MCHP_FW
	bool "Have Microchip EC firmware?"
	default n

config CHAUSIE_MCHP_SIG_FILE
	string "Microchip EC signature file"
	depends on CHAUSIE_HAVE_MCHP_FW
	default "3rdparty/blobs/mainboard/amd/chausie/EC_chausie_sig.bin"
	help
	  The EC sig blob is the first 4kBytes of the firmware image.
	  The first 4 bytes form a pointer (with CRC) to where the EC firmware
	  is located

config CHAUSIE_MCHP_FW_FILE
	string "Microchip EC firmware file"
	depends on CHAUSIE_HAVE_MCHP_FW
	default "3rdparty/blobs/mainboard/amd/chausie/EC_chausie.bin"
	help
	  The EC firmware blob is at the CHAUSIE_MCHP_FW_OFFSET offset of the
	  firmware image.

config CHAUSIE_MCHP_FW_OFFSET
	hex
	depends on CHAUSIE_HAVE_MCHP_FW
	default 0xB80000
	help
	  The EC firmware blob defaults to the 4MByte offset of the firmware
	  image. If this offset needs to change, a new signature block must be
	  generated with the updated offset.

config VBOOT
	select VBOOT_NO_BOARD_SUPPORT
	select VBOOT_SEPARATE_VERSTAGE
	select VBOOT_STARTS_IN_BOOTBLOCK

config VBOOT_VBNV_OFFSET
	hex
	default 0x2A

config RO_REGION_ONLY
	string
	depends on VBOOT_SLOTS_RW_AB || VBOOT_SLOTS_RW_A
	# Add the EFS and EC to the RO region only
	# This is a chausie-specific override of soc/amd/mendocino/Kconfig
	default "apu/amdfw ec/ecfw"

config CHROMEOS
	# Use default libpayload config
	select LP_DEFCONFIG_OVERRIDE if PAYLOAD_DEPTHCHARGE
	# We don't have recovery buttons, so we can't manually enable devmode.
	select GBB_FLAG_FORCE_DEV_SWITCH_ON

if !EM100	# EM100 defaults in soc/amd/common/blocks/spi/Kconfig
config EFS_SPI_READ_MODE
	default 3	# Quad IO (1-1-4)

config EFS_SPI_SPEED
	default 0	# 66MHz

config EFS_SPI_MICRON_FLAG
	default 0

config NORMAL_READ_SPI_SPEED
	default 1	# 33MHz

config ALT_SPI_SPEED
	default 1	# 33MHz

config TPM_SPI_SPEED
	default 1	# 33MHz

endif # !EM100

endif # BOARD_AMD_CHAUSIE
```

## src/mainboard/amd/chausie/Kconfig.name
```kconfig
## SPDX-License-Identifier: GPL-2.0-only

config BOARD_AMD_CHAUSIE
	bool "Chausie"
```

## src/mainboard/amd/crater/Kconfig
```kconfig
# SPDX-License-Identifier: GPL-2.0-only

config BOARD_AMD_CRATER_COMMON
	def_bool n
	select BOARD_ROMSIZE_KB_16384
	select EC_ACPI
	select SOC_AMD_COMMON_BLOCK_USE_ESPI if !SOC_AMD_COMMON_BLOCK_SIMNOW_BUILD
	select DRIVERS_PCIE_RTD3_DEVICE
	select DRIVERS_I2C_HID
	select MAINBOARD_HAS_CHROMEOS
	select HAVE_ACPI_RESUME
	select PCIEXP_ASPM
	select PCIEXP_CLK_PM
	select PCIEXP_COMMON_CLOCK
	select PCIEXP_L1_SUB_STATE
	select SOC_AMD_COMMON_BLOCK_ESPI_RETAIN_PORT80_EN if !SOC_AMD_COMMON_BLOCK_SIMNOW_BUILD
	select SOC_AMD_COMMON_BLOCK_SIMNOW_SUPPORTED
	select SPI_FLASH_EXIT_4_BYTE_ADDR_MODE
	select SOC_AMD_COMMON_BLOCK_PSP_RPMC
	select SOC_AMD_COMMON_BLOCK_PSP_SMI
	select KEEP_ACP_RUNNING_IN_S3

config BOARD_AMD_CRATER_RENOIR
	select BOARD_AMD_CRATER_COMMON
	select SOC_AMD_RENOIR

if BOARD_AMD_CRATER_RENOIR

config FMDFILE
	default "src/mainboard/amd/crater/chromeos_renoir.fmd" if CHROMEOS
	default "src/mainboard/amd/crater/board_renoir.fmd"

config MAINBOARD_DIR
	default "amd/crater"

config MAINBOARD_PART_NUMBER
	default "Crater_RENOIR"

config DEVICETREE
	default "devicetree_renoir.cb"

config CRATER_HAVE_MCHP_FW
	bool "Have Microchip EC firmware?"
	default n

config AMD_SOC_CONSOLE_UART
	default y if !SOC_AMD_COMMON_BLOCK_SIMNOW_BUILD

config CRATER_MCHP_FW_FILE
	string "Microchip EC firmware file"
	depends on CRATER_HAVE_MCHP_FW
	default "3rdparty/blobs/mainboard/amd/crater/EcSig_Crater.bin"
	help
	  The EC firmware blob is at the EC_BODY FMAP region of the firmware image.

config PSP_RECOVERY_AB
	default y

config VBOOT
	select VBOOT_NO_BOARD_SUPPORT
	select VBOOT_SEPARATE_VERSTAGE
	select VBOOT_STARTS_IN_BOOTBLOCK

config VBOOT_VBNV_OFFSET
	hex
	default 0x2A

config RO_REGION_ONLY
	string
	depends on VBOOT_SLOTS_RW_AB || VBOOT_SLOTS_RW_A
	# Add the EFS and EC to the RO region only
	# This is a crater specific override of soc/amd/cezanne/Kconfig
	default "apu/amdfw apu/ecfw"

config CHROMEOS
	# Use default libpayload config
	select LP_DEFCONFIG_OVERRIDE if PAYLOAD_DEPTHCHARGE
	# We don't have recovery buttons, so we can't manually enable devmode.
	select GBB_FLAG_FORCE_DEV_SWITCH_ON

config ENABLE_EDP
	bool "Enable EDP display"
	default n
	help
	  Select this option to enable EDP display on DDI1 interface

config ENABLE_EVAL_CARD
	bool "Enable Eval Card"
	help
	  Enable the Eval Card PCIe slot

config ENABLE_EVAL_19V
	bool "Enable 19V rail for Eval Card"
	depends on ENABLE_EVAL_CARD
	help
	  Enable the 19V rail for Eval Card PCIe slot

config ENABLE_M2_SSD
	bool "Enable M.2 SSD Slot"
	default y
	help
	  Use GPP[8:11] connected to M.2 SSD

config NVME_RST_GPIO40
	bool "NVMe Reset on GPIO40"
	help
	  Select if the NVMe reset pin is connected to GPIO40.
	  Otherwise its assumed to be connected to GPIO24.

choice
	prompt "XGBE/WWAN/WLAN/DT Selection"
	default XGBE_WWAN_WLAN
	help
	  Select the configuration for GPP[0:3] lanes

config XGBE_WWAN_WLAN
	bool "XGBE_WWAN_WLAN"
	help
	  Use GPP[0:1] connected to ETH AIC  (PCIe x4 Slot)
	  Use GPP[2]   connected to WWAN/GPS (M.2 B-Key)
	  Use GPP[3]   connected to WiFi/BT  (M.2 E-Key)

config PCIE_DT_SLOT
	bool "PCIe Slot"
	help
	  Use GPP[0:3] connected to PCIe x4 Slot

endchoice

choice
	prompt "SGMII lanes interface"
	depends on XGBE_WWAN_WLAN
	default GBE_PATH_SELECT_AIC2
	help
	  Option to select either AIC2 card (Marvell Phy), AIC3 card (Broadcom Phy) or
	  Backplane mode for SGMII

config GBE_PATH_SELECT_AIC2
	bool "AIC2 PHY"
	help
	  Select to use AIC2 Marvell Phy card

config GBE_PATH_SELECT_AIC3
	bool "AIC3 PHY"
	help
	  Select to use AIC3 Boradcom Phy card

config XGBE_PATH_SELECT_BACKPLANE
	bool "BackPlane"
	help
	  Select to use BackPlane Mode

endchoice # "SGMII lanes interface"

choice
	prompt "XGBE port speed"
	depends on XGBE_WWAN_WLAN && !XGBE_PATH_SELECT_BACKPLANE
	default XGBE_10_100_1000MB_SPEED

config XGBE_10_100_1000MB_SPEED
	bool "10/100/1000MB"
	help
	  Set XGBE port speed to support 10/100/1000MB.

config XGBE_10MB_SPEED
	bool "10MB Port Speed"
	help
	  Set XGBE port speed to support 10MBps.

config XGBE_100MB_SPEED
	bool "100 MBps port speed"
	help
	  Set XGBE port speed to support 1000MBps.

config XGBE_1G_SPEED
	bool "1G Port Speed"
	help
	  Set XGBE port speed to support 1GBps.

endchoice # "XGBE port speed"

if !EM100	# EM100 defaults in soc/amd/common/blocks/spi/Kconfig
config EFS_SPI_READ_MODE
	default 3	# Quad IO (1-1-4)

config EFS_SPI_SPEED
	default 0	# 66MHz

config EFS_SPI_MICRON_FLAG
	default 0

config NORMAL_READ_SPI_SPEED
	default 1	# 33MHz

config ALT_SPI_SPEED
	default 1	# 33MHz

config TPM_SPI_SPEED
	default 1	# 33MHz

endif # !EM100

endif # BOARD_AMD_CRATER_COMMON
```
