## src/mainboard/adi/rcc-dff/Kconfig
```kconfig
##
## This file is part of the coreboot project.
##
## Copyright (C) 2013-2014 Sage Electronic Engineering, LLC.
##
## This program is free software; you can redistribute it and/or modify
## it under the terms of the GNU General Public License as published by
## the Free Software Foundation; version 2 of the License.
##
## This program is distributed in the hope that it will be useful,
## but WITHOUT ANY WARRANTY; without even the implied warranty of
## MERCHANTABILITY or FITNESS FOR A PARTICULAR PURPOSE.  See the
## GNU General Public License for more details.
##

if BOARD_ADI_RCC_DFF

config BOARD_SPECIFIC_OPTIONS # dummy
	def_bool y
	select CPU_INTEL_SOCKET_RPGA989
	select NORTHBRIDGE_INTEL_FSP_RANGELEY
	select SOUTHBRIDGE_INTEL_FSP_RANGELEY
	select BOARD_ROMSIZE_KB_2048 #actual chip is 8MB
	select HAVE_ACPI_TABLES
	select HAVE_OPTION_TABLE
	select HAVE_FSP_BIN if FSP_PACKAGE_DEFAULT

config MAINBOARD_DIR
	string
	default adi/rcc-dff

config MAINBOARD_PART_NUMBER
	string
	default "ADI RCC-DFF"

config MAX_CPUS
	int
	default 16

config FSP_FILE
	string
	default "../intel/fsp/rangeley/FvFsp.bin"

config CBFS_SIZE
	hex
	default 0x00200000

config ENABLE_FSP_FAST_BOOT
	bool
	depends on HAVE_FSP_BIN
	default y

config VIRTUAL_ROM_SIZE
	hex
	depends on ENABLE_FSP_FAST_BOOT
	default 0x400000

config FSP_PACKAGE_DEFAULT
	bool "Configure defaults for the Intel FSP package"
	default n

config UART_FOR_CONSOLE
	int
	default 1
	help
	  The Mohon Peak board uses COM2 (2f8) for the serial console.

config PAYLOAD_CONFIGFILE
	string
	depends on PAYLOAD_SEABIOS
	default "$(top)/src/mainboard/$(MAINBOARDDIR)/config_seabios"
	help
	  The Avoton/Rangeley chip does not allow devices to write into the 0xe000
	  segment.  This means that USB/SATA devices will not work in SeaBIOS unless
	  we put the SeaBIOS buffer area down in the 0x9000 segment.

endif # BOARD_ADI_RCC_DFF
```

## src/mainboard/adlink/cexpress-gfr/Kconfig
```kconfig
if BOARD_ADLINK_CEXPRESS_GFR

# Dummy for abuild
#select ARCH_X86

config MAINBOARD_PART_NUMBER
	string
	default "cExpress-GFR"

endif
```

## src/mainboard/adlink/coremodule2-gf/Kconfig
```kconfig
if BOARD_ADLINK_COREMODULE2_GF

# Dummy for abuild
#select ARCH_X86

config MAINBOARD_PART_NUMBER
	string
	default "FrontRunner-AF"

endif
```

## src/mainboard/advansus/a785e-i/Kconfig
```kconfig
if BOARD_ADVANSUS_A785E_I

config BOARD_SPECIFIC_OPTIONS # dummy
	def_bool y
	select ARCH_X86
	select CPU_AMD_SOCKET_ASB2
	select DIMM_DDR3
	select DIMM_REGISTERED
	select QRANK_DIMM_SUPPORT
	select NORTHBRIDGE_AMD_AMDFAM10
	select SOUTHBRIDGE_AMD_RS780
	select SOUTHBRIDGE_AMD_CIMX_SB800
	select SUPERIO_WINBOND_W83627HF #COM1, COM2
	#select SUPERIO_FINTEK_F81216AD #COM3, COM4
	select SB_SUPERIO_HWM
	select HAVE_OPTION_TABLE
	select HAVE_PIRQ_TABLE
	select SB_HT_CHAIN_UNITID_OFFSET_ONLY
	select LIFT_BSP_APIC_ID
	select SERIAL_CPU_INIT
	select AMDMCT
	select HAVE_MP_TABLE
	select HAVE_ACPI_TABLES
	select BOARD_ROMSIZE_KB_1024
	select RAMINIT_SYSINFO
	select ENABLE_APIC_EXT_ID
	select GFXUMA
	select HAVE_DEBUG_CAR
	select SET_FIDVID

config MAINBOARD_DIR
	string
	default advansus/a785e-i

config APIC_ID_OFFSET
	hex
	default 0x0

config MAINBOARD_PART_NUMBER
	string
	default "A785E-I"

config HW_MEM_HOLE_SIZEK
	hex
	default 0x100000

config MAX_CPUS
	int
	default 8

config MAX_PHYSICAL_CPUS
	int
	default 1

config HW_MEM_HOLE_SIZE_AUTO_INC
	bool
	default n

config MEM_TRAIN_SEQ
	int
	default 2

config SB_HT_CHAIN_ON_BUS0
	int
	default 1

config HT_CHAIN_END_UNITID_BASE
	hex
	default 0x1

config HT_CHAIN_UNITID_BASE
	hex
	default 0x0

config IRQ_SLOT_COUNT
	int
	default 11

config AMD_UCODE_PATCH_FILE
	string
	default "mc_patch_010000b6.h"

config RAMTOP
	hex
	default 0x2000000

config HEAP_SIZE
	hex
	default 0xc0000

config RAMBASE
	hex
	default 0x200000

config VGA_BIOS_ID
        string
        default "1002,9712"

endif #BOARD_ADVANSUS_A785E_I
```

## src/mainboard/advantech/Kconfig
```kconfig
##
## This file is part of the coreboot project.
##
## Copyright (C) 2009 Uwe Hermann <uwe@hermann-uwe.de>
##
## This program is free software; you can redistribute it and/or modify
## it under the terms of the GNU General Public License as published by
## the Free Software Foundation; version 2 of the License.
##
## This program is distributed in the hope that it will be useful,
## but WITHOUT ANY WARRANTY; without even the implied warranty of
## MERCHANTABILITY or FITNESS FOR A PARTICULAR PURPOSE.  See the
## GNU General Public License for more details.
##
## You should have received a copy of the GNU General Public License
## along with this program; if not, write to the Free Software
## Foundation, Inc., 51 Franklin St, Fifth Floor, Boston, MA 02110-1301 USA
##
if VENDOR_ADVANTECH

choice
	prompt "Mainboard model"

config BOARD_ADVANTECH_PCM_5820
	bool "PCM-5820"

endchoice

source "src/mainboard/advantech/pcm-5820/Kconfig"

config MAINBOARD_VENDOR
	string
	default "Advantech"

endif # VENDOR_ADVANTECH
```

## src/mainboard/advantech/pcm-5820/Kconfig
```kconfig
##
## This file is part of the coreboot project.
##
## Copyright (C) 2009 Uwe Hermann <uwe@hermann-uwe.de>
##
## This program is free software; you can redistribute it and/or modify
## it under the terms of the GNU General Public License as published by
## the Free Software Foundation; version 2 of the License.
##
## This program is distributed in the hope that it will be useful,
## but WITHOUT ANY WARRANTY; without even the implied warranty of
## MERCHANTABILITY or FITNESS FOR A PARTICULAR PURPOSE.  See the
## GNU General Public License for more details.
##
## You should have received a copy of the GNU General Public License
## along with this program; if not, write to the Free Software
## Foundation, Inc., 51 Franklin St, Fifth Floor, Boston, MA 02110-1301 USA
##
if BOARD_ADVANTECH_PCM_5820

config BOARD_SPECIFIC_OPTIONS # dummy
	def_bool y
	select ARCH_X86
	select CPU_AMD_GEODE_GX1
	select NORTHBRIDGE_AMD_GX1
	select SOUTHBRIDGE_AMD_CS5530
	select SUPERIO_WINBOND_W83977F
	select ROMCC
	select HAVE_PIRQ_TABLE
	select PIRQ_ROUTE
	select UDELAY_TSC
	select BOARD_ROMSIZE_KB_256

config MAINBOARD_DIR
	string
	default advantech/pcm-5820

config MAINBOARD_PART_NUMBER
	string
	default "PCM-5820"

config IRQ_SLOT_COUNT
	int
	default 2

endif # BOARD_ADVANTECH_PCM_5820
```

## src/mainboard/amd/Kconfig
```kconfig
if VENDOR_AMD

choice
	prompt "Mainboard model"

source "src/mainboard/amd/*/Kconfig.name"

endchoice

source "src/mainboard/amd/*/Kconfig"

config MAINBOARD_VENDOR
	string
	default "AMD"

endif # VENDOR_AMD
```

## src/mainboard/amd/bettong/Kconfig
```kconfig
#
# This file is part of the coreboot project.
#
# Copyright (C) 2015 Advanced Micro Devices, Inc.
#
# This program is free software; you can redistribute it and/or modify
# it under the terms of the GNU General Public License as published by
# the Free Software Foundation; version 2 of the License.
#
# This program is distributed in the hope that it will be useful,
# but WITHOUT ANY WARRANTY; without even the implied warranty of
# MERCHANTABILITY or FITNESS FOR A PARTICULAR PURPOSE.  See the
# GNU General Public License for more details.
#
# You should have received a copy of the GNU General Public License
# along with this program; if not, write to the Free Software
# Foundation, Inc.
#

if BOARD_AMD_BETTONG

config BOARD_SPECIFIC_OPTIONS # dummy
	def_bool y
	select CPU_AMD_PI_00660F01
	select NORTHBRIDGE_AMD_PI_00660F01
	select SOUTHBRIDGE_AMD_PI_KERN
	select HAVE_OPTION_TABLE
	select HAVE_PIRQ_TABLE
	select HAVE_MP_TABLE
	select HAVE_ACPI_TABLES
	select BOARD_ROMSIZE_KB_8192
	select GFXUMA

config MAINBOARD_DIR
	string
	default amd/bettong

config MAINBOARD_PART_NUMBER
	string
	default "FP4"

config MAX_CPUS
	int
	default 4

config IRQ_SLOT_COUNT
	int
	default 11

config ONBOARD_VGA_IS_PRIMARY
	bool
	default y

config HUDSON_LEGACY_FREE
	bool
	default y

endif # BOARD_AMD_BETTONG
```

## src/mainboard/amd/bilby/Kconfig
```kconfig
# SPDX-License-Identifier: GPL-2.0-only

if BOARD_AMD_BILBY

config BOARD_SPECIFIC_OPTIONS
	def_bool y
	select SOC_AMD_PICASSO
	select BOARD_ROMSIZE_KB_16384
	select AZALIA_HDA_CODEC_SUPPORT
	select HAVE_ACPI_RESUME
	select DRIVERS_UART_ACPI
	select AMD_SOC_CONSOLE_UART if !AMD_LPC_DEBUG_CARD

config FMDFILE
	default "src/mainboard/amd/bilby/board.fmd"

config AMD_LPC_DEBUG_CARD
	bool "Enable LPC-Serial debug card on the debug header"
	default n
	select BILBY_LPC
	select SUPERIO_SMSC_SIO1036
	help
	  AMD's debug card contains an SMSC SIO1036 device which provides an
	  I/O-mapped UART in the system. This is mutually exclusive with
	  AMD_SOC_CONSOLE_UART which selects the SoC's integrated memory-mapped
	  UART for coreboot console output.

choice
	prompt "SMSC/Microchip 1036 SuperIO config address"
	depends on SUPERIO_SMSC_SIO1036
	default BILBY_SMSC_SIO1036_BASE_164E

config BILBY_SMSC_SIO1036_BASE_4E
	bool "0x4e/0x4d base address"

config BILBY_SMSC_SIO1036_BASE_164E
	bool "0x164e/0x164d base address"

endchoice

config SUPERIO_ADDR_BASE
	hex
	default 0x4e	if BILBY_SMSC_SIO1036_BASE_4E
	default 0x164e	if BILBY_SMSC_SIO1036_BASE_164E

config CBFS_SIZE
	default 0xfef000 # Maximum size for the Bilby FMAP

config MAINBOARD_DIR
	default "amd/bilby"

config MAINBOARD_PART_NUMBER
	default "BILBY"

config ONBOARD_VGA_IS_PRIMARY
	bool
	default y

if !AMD_LPC_DEBUG_CARD
choice
	prompt "State of IOMux for LPC/eMMC signals"
	default BILBY_IOMUX_USE_EMMC
	help
	  Bilby is designed to use either LPC or eMMC signals.  Use this
	  selection to determine which are configured for this image.

config BILBY_IOMUX_USE_LPC
	bool "LPC signals"

config BILBY_IOMUX_USE_EMMC
	bool "eMMC signals"

endchoice
endif # !AMD_LPC_DEBUG_CARD

config BILBY_LPC
	bool
	default y if BILBY_IOMUX_USE_LPC
	help
	  Picasso's LPC bus signals are MUXed with some of the EMMC signals.
	  Select this option if LPC signals are required.

if !EM100	# EM100 defaults in soc/amd/common/blocks/spi/Kconfig
config EFS_SPI_READ_MODE
	default 3	# Quad IO (1-1-4)

config EFS_SPI_SPEED
	default 0	# 66MHz

config EFS_SPI_MICRON_FLAG
	default 0

config NORMAL_READ_SPI_SPEED
	default 1	# 33MHz

config ALT_SPI_SPEED
	default 1	# 33MHz

config TPM_SPI_SPEED
	default 1	# 33MHz

endif # !EM100

choice
	prompt "DDI-0 connector type"
	default CONNECT_DP_ON_DDI_0

config CONNECT_HDMI_ON_DDI_0
	bool "Use HDMI interface"

config CONNECT_DP_ON_DDI_0
	bool "Use Displayport interface"
endchoice

config DDI0_CONNECTOR_TYPE
	int
	default 0 if CONNECT_DP_ON_DDI_0
	default 4 if CONNECT_HDMI_ON_DDI_0

choice
	prompt "DDI-1 connector type"
	default CONNECT_DP_ON_DDI_1

config CONNECT_HDMI_ON_DDI_1
	bool "Use HDMI interface"

config CONNECT_DP_ON_DDI_1
	bool "Use Displayport interface"
endchoice

config DDI1_CONNECTOR_TYPE
	int
	default 0 if CONNECT_DP_ON_DDI_1
	default 4 if CONNECT_HDMI_ON_DDI_1

endif # BOARD_AMD_BILBY
```

## src/mainboard/amd/birman/Kconfig
```kconfig
# SPDX-License-Identifier: GPL-2.0-only

config BOARD_AMD_BIRMAN_COMMON
	def_bool n
	select BOARD_ROMSIZE_KB_32768
	select EC_ACPI
	select SOC_AMD_COMMON_BLOCK_USE_ESPI if !SOC_AMD_COMMON_BLOCK_SIMNOW_BUILD
	select DRIVERS_PCIE_RTD3_DEVICE
	select MAINBOARD_HAS_CHROMEOS
	select PCIEXP_ASPM
	select PCIEXP_CLK_PM
	select PCIEXP_COMMON_CLOCK
	select PCIEXP_L1_SUB_STATE
	select SOC_AMD_COMMON_BLOCK_ESPI_RETAIN_PORT80_EN if !SOC_AMD_COMMON_BLOCK_SIMNOW_BUILD
	select SOC_AMD_COMMON_BLOCK_SIMNOW_SUPPORTED
	select SPI_FLASH_EXIT_4_BYTE_ADDR_MODE

config BOARD_AMD_BIRMAN_PHOENIX_FSP
	select BOARD_AMD_BIRMAN_COMMON
	select SOC_AMD_PHOENIX_FSP

config BOARD_AMD_BIRMAN_PHOENIX_OPENSIL
	select BOARD_AMD_BIRMAN_COMMON
	select SOC_AMD_PHOENIX_OPENSIL

config BOARD_AMD_BIRMAN_GLINDA
	select BOARD_AMD_BIRMAN_COMMON
	select SOC_AMD_GLINDA

if BOARD_AMD_BIRMAN_COMMON

config FMDFILE
	default "src/mainboard/amd/birman/chromeos_glinda.fmd" if CHROMEOS && BOARD_AMD_BIRMAN_GLINDA
	default "src/mainboard/amd/birman/chromeos_phoenix.fmd" if CHROMEOS
	default "src/mainboard/amd/birman/board_glinda.fmd" if BOARD_AMD_BIRMAN_GLINDA
	default "src/mainboard/amd/birman/board_phoenix.fmd"

config MAINBOARD_DIR
	default "amd/birman"

config MAINBOARD_PART_NUMBER
	default "Birman_Glinda" if BOARD_AMD_BIRMAN_GLINDA
	default "Birman_Phoenix_FSP" if BOARD_AMD_BIRMAN_PHOENIX_FSP
	default "Birman_Phoenix_openSIL" if BOARD_AMD_BIRMAN_PHOENIX_OPENSIL

config DEVICETREE
	default "devicetree_glinda.cb" if BOARD_AMD_BIRMAN_GLINDA
	default "devicetree_phoenix_fsp.cb" if BOARD_AMD_BIRMAN_PHOENIX_FSP
	default "devicetree_phoenix_opensil.cb" if BOARD_AMD_BIRMAN_PHOENIX_OPENSIL

config BIRMAN_HAVE_MCHP_FW
	bool "Have Microchip EC firmware?"
	default n

config AMD_SOC_CONSOLE_UART
	default y if !SOC_AMD_COMMON_BLOCK_SIMNOW_BUILD

config BIRMAN_MCHP_FW_FILE
	string "Microchip EC firmware file"
	depends on BIRMAN_HAVE_MCHP_FW
	default "3rdparty/blobs/mainboard/amd/birman/EC_birman.bin"
	help
	  The EC firmware blob is at the EC_BODY FMAP region of the firmware image.

config VBOOT
	select VBOOT_NO_BOARD_SUPPORT
	select VBOOT_SEPARATE_VERSTAGE
	select VBOOT_STARTS_IN_BOOTBLOCK

config VBOOT_VBNV_OFFSET
	hex
	default 0x2A

config RO_REGION_ONLY
	string
	depends on VBOOT_SLOTS_RW_AB || VBOOT_SLOTS_RW_A
	# Add the EFS and EC to the RO region only
	# This is a birman-specific override of soc/amd/(phoenix | glinda)/Kconfig
	default "apu/amdfw apu/ecfw"

config CHROMEOS
	# Use default libpayload config
	select LP_DEFCONFIG_OVERRIDE if PAYLOAD_DEPTHCHARGE
	# We don't have recovery buttons, so we can't manually enable devmode.
	select GBB_FLAG_FORCE_DEV_SWITCH_ON

config ENABLE_EVAL_CARD
	bool "Enable Eval Card"
	help
	  Enable the Eval Card PCIe slot

config ENABLE_EVAL_19V
	bool "Enable 19V rail for Eval Card"
	depends on ENABLE_EVAL_CARD
	help
	  Enable the 19V rail for Eval Card PCIe slot

choice
	prompt "DT SLOT/M.2 SSD1 ENABLE"
	default ENABLE_DT_SLOT
	help
	  Either DT slot or M.2 SSD1 can be used, as they are sharing PCIe lanes.

config ENABLE_DT_SLOT
	bool "Enable DT slot"

config ENABLE_M2_SSD1
	bool "Enable M.2 SSD1"

config DISABLE_DT_M2
	bool "Disable both DT and M.2 slot"

endchoice

choice
	prompt "WLAN/WWAN Selection"
	default WLAN0_WWAN0
	help
	  WLAN and WWAN lane configuration

config WLAN0_WWAN0
	bool "Both WLAN and WWAN Enabled (1 lane each)"

config WLAN01
	bool "Only WLAN Enabled (2 lanes WLAN, 0 lanes WWAN)"

config WWAN01
	bool "Only WWAN Enabled (2 lanes WWAN, 0 lanes WLAN)"

endchoice

if !EM100	# EM100 defaults in soc/amd/common/blocks/spi/Kconfig
config EFS_SPI_READ_MODE
	default 3	# Quad IO (1-1-4)

config EFS_SPI_SPEED
	default 0	# 66MHz

config EFS_SPI_MICRON_FLAG
	default 0

config NORMAL_READ_SPI_SPEED
	default 1	# 33MHz

config ALT_SPI_SPEED
	default 1	# 33MHz

config TPM_SPI_SPEED
	default 1	# 33MHz

endif # !EM100

endif # BOARD_AMD_BIRMAN_COMMON
```

## src/mainboard/amd/birman/Kconfig.name
```kconfig
## SPDX-License-Identifier: GPL-2.0-only

comment "Birman"

config BOARD_AMD_BIRMAN_PHOENIX_FSP
	bool "->  Birman for Phoenix SoC using FSP"

config BOARD_AMD_BIRMAN_PHOENIX_OPENSIL
	bool "->  Birman for Phoenix SoC using openSIL"

config BOARD_AMD_BIRMAN_GLINDA
	bool "->  Birman for Glinda SoC"
```
