## src/mainboard/amd/crater/Kconfig.name
```kconfig
comment "Crater"

config BOARD_AMD_CRATER_RENOIR
	bool "->  Crater for Renoir SoC"
```

## src/mainboard/amd/db-ft3b-lc/Kconfig
```kconfig
#
# This file is part of the coreboot project.
#
# Copyright (C) 2012 Advanced Micro Devices, Inc.
# Copyright (C) 2015 Kyösti Mälkki <kyosti.malkki@gmail.com>
#
# This program is free software; you can redistribute it and/or modify
# it under the terms of the GNU General Public License as published by
# the Free Software Foundation; version 2 of the License.
#
# This program is distributed in the hope that it will be useful,
# but WITHOUT ANY WARRANTY; without even the implied warranty of
# MERCHANTABILITY or FITNESS FOR A PARTICULAR PURPOSE.  See the
# GNU General Public License for more details.
#

config BOARD_AMD_DB_FT3B_LC
	def_bool n

if BOARD_AMD_DB_FT3B_LC

config BOARD_SPECIFIC_OPTIONS
	def_bool y
	#select BINARYPI_LEGACY_WRAPPER
	select ROMCC_BOOTBLOCK
	select CPU_AMD_PI_00730F01
	select NORTHBRIDGE_AMD_PI_00730F01
	select SOUTHBRIDGE_AMD_PI_AVALON
	select HAVE_OPTION_TABLE
	select HAVE_PIRQ_TABLE
	select HAVE_MP_TABLE
	select HAVE_ACPI_TABLES
	select BOARD_ROMSIZE_KB_8192
	select GFXUMA

config MAINBOARD_DIR
	string
	default "amd/db-ft3b-lc"

config MAINBOARD_PART_NUMBER
	string
	default "DB-FT3b-LC"

config MAX_CPUS
	int
	default 4

config IRQ_SLOT_COUNT
	int
	default 11

config ONBOARD_VGA_IS_PRIMARY
	bool
	default y

config HUDSON_LEGACY_FREE
	bool
	default y

config DIMM_SPD_SIZE
	int
	default 128

endif # BOARD_AMD_DB_FT3B_LC
```

## src/mainboard/amd/db800/Kconfig
```kconfig
if BOARD_AMD_DB800

config BOARD_SPECIFIC_OPTIONS # dummy
	def_bool y
	select ARCH_X86
	select CPU_AMD_LX
	select NORTHBRIDGE_AMD_LX
	select SOUTHBRIDGE_AMD_CS5536
	select SUPERIO_WINBOND_W83627HF
	select HAVE_PIRQ_TABLE
	select PIRQ_ROUTE
	select UDELAY_TSC
	select CACHE_AS_RAM
	select BOARD_ROMSIZE_KB_256

config MAINBOARD_DIR
	string
	default amd/db800

config MAINBOARD_PART_NUMBER
	string
	default "DB800"

config IRQ_SLOT_COUNT
	int
	default 4

config RAMBASE
	hex
	default 0x4000

endif # BOARD_AMD_DB800
```

## src/mainboard/amd/dbm690t/Kconfig
```kconfig
if BOARD_AMD_DBM690T

config BOARD_SPECIFIC_OPTIONS # dummy
	def_bool y
	select ARCH_X86
	select CPU_AMD_SOCKET_S1G1
	select NORTHBRIDGE_AMD_AMDK8
	select SOUTHBRIDGE_AMD_RS690
	select SOUTHBRIDGE_AMD_SB600
	select SUPERIO_ITE_IT8712F
	select HAVE_ACPI_TABLES
	select HAVE_MP_TABLE
	select HAVE_PIRQ_TABLE
	select HAVE_OPTION_TABLE
	select SB_HT_CHAIN_UNITID_OFFSET_ONLY
	select BOARD_ROMSIZE_KB_1024
	select RAMINIT_SYSINFO
	select QRANK_DIMM_SUPPORT
	select SET_FIDVID

config MAINBOARD_DIR
	string
	default amd/dbm690t

config APIC_ID_OFFSET
	hex
	default 0x0

config MAINBOARD_PART_NUMBER
	string
	default "DBM690T"

config MAX_CPUS
	int
	default 2

config MAX_PHYSICAL_CPUS
	int
	default 1

config SB_HT_CHAIN_ON_BUS0
	int
	default 1

config HT_CHAIN_END_UNITID_BASE
	hex
	default 0x1

config HT_CHAIN_UNITID_BASE
	hex
	default 0x0

config IRQ_SLOT_COUNT
	int
	default 11

endif # BOARD_AMD_DBM690T
```

## src/mainboard/amd/dinar/Kconfig
```kconfig
#
# This file is part of the coreboot project.
#
# Copyright (C) 2012 Advanced Micro Devices, Inc.
#
# This program is free software; you can redistribute it and/or modify
# it under the terms of the GNU General Public License as published by
# the Free Software Foundation; version 2 of the License.
#
# This program is distributed in the hope that it will be useful,
# but WITHOUT ANY WARRANTY; without even the implied warranty of
# MERCHANTABILITY or FITNESS FOR A PARTICULAR PURPOSE.  See the
# GNU General Public License for more details.
#
# You should have received a copy of the GNU General Public License
# along with this program; if not, write to the Free Software
# Foundation, Inc., 51 Franklin St, Fifth Floor, Boston, MA 02110-1301 USA
#

if BOARD_AMD_DINAR

config BOARD_SPECIFIC_OPTIONS # dummy
	def_bool y
	select ARCH_X86
	select CPU_AMD_AGESA_FAMILY15
	select CPU_AMD_SOCKET_G34
	select NORTHBRIDGE_AMD_AGESA_FAMILY15
	select NORTHBRIDGE_AMD_CIMX_RD890
	select SOUTHBRIDGE_AMD_CIMX_SB700
	select SUPERIO_SMSC_SCH4037
	select SB_HT_CHAIN_UNITID_OFFSET_ONLY
	select LIFT_BSP_APIC_ID
	select SERIAL_CPU_INIT
	select BOARD_ROMSIZE_KB_2048
	select HAVE_OPTION_TABLE
	select HAVE_PIRQ_TABLE
	select HAVE_MP_TABLE
	select HAVE_ACPI_TABLES
	#TODO select HAVE_ACPI_RESUME
	select ENABLE_APIC_EXT_ID
	select GFXUMA

config MAINBOARD_DIR
	string
	default amd/dinar

config APIC_ID_OFFSET
	hex
	default 0x0

config MAINBOARD_PART_NUMBER
	string
	default "Dinar"

config HW_MEM_HOLE_SIZEK
	hex
	default 0x200000

config MAX_CPUS
	int
	default 64

config MAX_PHYSICAL_CPUS
	int
	default 16

config HW_MEM_HOLE_SIZE_AUTO_INC
	bool
	default n

config IRQ_SLOT_COUNT
	int
	default 11

config RAMTOP
	hex
	default 0x1000000

config HEAP_SIZE
	hex
	default 0xc0000

config RAMBASE
	hex
	default 0x200000

config SIO_PORT
	hex
	default 0x2e

config DRIVERS_PS2_KEYBOARD
	bool
	default y

config ONBOARD_VGA_IS_PRIMARY
	bool
	default y

config VGA_BIOS
	bool
	default n

config VGA_BIOS_ID
	depends on VGA_BIOS
	default "1002,515e"

config AHCI_BIOS
	bool
	default y

config AHCI_BIOS_FILE
	string "AHCI ROM path and filename"
	depends on AHCI_BIOS
	default "site-local/ahci/sb700.bin"

config AHCI_BIOS_ID
	string "AHCI device PCI IDs"
	depends on AHCI_BIOS
	default "1002,4391"

config XHC_BIOS
	bool
	default n

config XHC_BIOS_FILE
	string "XHC BIOS path and filename"
	depends on XHC_BIOS
	default "site-local/xhc/Xhc.rom"

config XHC_BIOS_ID
	string "XHC device PCI IDs"
	depends on XHC_BIOS
	default "1022,7812"

config CONSOLE_POST
	bool
	depends on !NO_POST
	default n

config SATA_CONTROLLER_MODE
	hex
	default 0x0

config ONBOARD_LAN
	bool
	default y

config ONBOARD_1394
	bool
	default y

config ONBOARD_USB30
	bool
	default n

config ONBOARD_BLUETOOTH
	bool
	default y

config ONBOARD_WEBCAM
	bool
	default y

config ONBOARD_TRAVIS
	bool
	default y

config ONBOARD_LIGHTSENSOR
	bool
	default n

config PCI_ROM_RUN
	bool
	default n

config UDELAY_IO
	bool
	default n

config REDIRECT_CIMX_TRACE_TO_SERIAL
	bool "Redirect CIMX Trace to serial console"
	default y

endif # BOARD_AMD_DINAR
```

## src/mainboard/amd/gardenia/Kconfig
```kconfig
# SPDX-License-Identifier: GPL-2.0-only

if BOARD_AMD_GARDENIA

config BOARD_SPECIFIC_OPTIONS
	def_bool y
	select SOC_AMD_STONEYRIDGE
	select AMD_APU_STONEYRIDGE
	select AMD_APU_PKG_FP4
	select HAVE_ACPI_TABLES
	select BOARD_ROMSIZE_KB_8192
	select GFXUMA

config MAINBOARD_DIR
	default "amd/gardenia"

config MAINBOARD_PART_NUMBER
	default "GARDENIA"

config MAX_CPUS
	int
	default 4

config IRQ_SLOT_COUNT
	int
	default 11

config ONBOARD_VGA_IS_PRIMARY
	bool
	default y

config STONEYRIDGE_LEGACY_FREE
	bool
	default y

if !EM100
config EFS_SPI_READ_MODE
	default 4          # Dual IO (1-2-2)

config EFS_SPI_SPEED
	default 0	# 66MHz
endif

endif # BOARD_AMD_GARDENIA
```

## src/mainboard/amd/gardenia/Kconfig.name
```kconfig
## SPDX-License-Identifier: GPL-2.0-only

config BOARD_AMD_GARDENIA
	bool "Gardenia"
```

## src/mainboard/amd/inagua/Kconfig
```kconfig
# SPDX-License-Identifier: GPL-2.0-only

if BOARD_AMD_INAGUA

config BOARD_SPECIFIC_OPTIONS
	def_bool y
	select CPU_AMD_AGESA_FAMILY14
	select NORTHBRIDGE_AMD_AGESA_FAMILY14
	select SOUTHBRIDGE_AMD_CIMX_SB800
	select SUPERIO_SMSC_KBC1100
	select HAVE_OPTION_TABLE
	select HAVE_PIRQ_TABLE
	select HAVE_MP_TABLE
	select HAVE_ACPI_TABLES
	select BOARD_ROMSIZE_KB_2048
	select GFXUMA

config MAINBOARD_DIR
	string
	default "amd/inagua"

config MAINBOARD_PART_NUMBER
	string
	default "Inagua"

config HW_MEM_HOLE_SIZEK
	hex
	default 0x200000

config MAX_CPUS
	int
	default 2

config IRQ_SLOT_COUNT
	int
	default 11

config ONBOARD_VGA_IS_PRIMARY
	bool
	default y

#config VGA_BIOS_FILE
#        string "VGA BIOS path and filename"
#        depends on VGA_BIOS
#        default "rom/video/OntarioGenericVBios.bin"

config VGA_BIOS_ID
	string "VGA device PCI IDs"
	depends on VGA_BIOS
	default "1002,9802"

config SB800_AHCI_ROM
	bool
	default n

endif # BOARD_AMD_INAGUA
```
