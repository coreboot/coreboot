## src/mainboard/amd/mayan/Kconfig
```kconfig
# SPDX-License-Identifier: GPL-2.0-only

if BOARD_AMD_MAYAN_PHOENIX

config BOARD_SPECIFIC_OPTIONS
	def_bool y
	select BOARD_ROMSIZE_KB_32768
	select EC_ACPI
	select SOC_AMD_COMMON_BLOCK_USE_ESPI
	select AMD_SOC_CONSOLE_UART
	select MAINBOARD_HAS_CHROMEOS
	select PCIEXP_ASPM
	select PCIEXP_CLK_PM
	select PCIEXP_COMMON_CLOCK
	select PCIEXP_L1_SUB_STATE
	select SOC_AMD_COMMON_BLOCK_ESPI_RETAIN_PORT80_EN
	select SOC_AMD_PHOENIX_FSP

config FMDFILE
	default "src/mainboard/amd/mayan/chromeos.fmd" if CHROMEOS
	default "src/mainboard/amd/mayan/board.fmd"

config MAINBOARD_DIR
	default "amd/mayan"

config MAINBOARD_PART_NUMBER
	default "Mayan_Phoenix"

config DEVICETREE
	default "devicetree_phoenix.cb"

config MAYAN_HAVE_MCHP_FW
	bool "Have Microchip EC firmware?"
	default n

config MAYAN_MCHP_SIG_FILE
	string "Microchip EC signature file"
	depends on MAYAN_HAVE_MCHP_FW
	default "3rdparty/blobs/mainboard/amd/mayan/EC_mayan_sig.bin"
	help
	  The EC sig blob is the first 4kBytes of the firmware image.
	  The first 4 bytes form a pointer (with CRC) to where the EC firmware
	  is located

config MAYAN_MCHP_FW_FILE
	string "Microchip EC firmware file"
	depends on MAYAN_HAVE_MCHP_FW
	default "3rdparty/blobs/mainboard/amd/mayan/EC_mayan.bin"
	help
	  The EC firmware blob is at the MAYAN_MCHP_FW_OFFSET offset of the
	  firmware image.

config MAYAN_MCHP_FW_OFFSET
	hex
	depends on MAYAN_HAVE_MCHP_FW
	default 0x81000
	help
	  The EC firmware blob defaults to the 4MByte offset of the firmware
	  image. If this offset needs to change, a new signature block must be
	  generated with the updated offset.

config VBOOT
	select VBOOT_NO_BOARD_SUPPORT
	select VBOOT_SEPARATE_VERSTAGE
	select VBOOT_STARTS_IN_BOOTBLOCK

config VBOOT_VBNV_OFFSET
	hex
	default 0x2A

config RO_REGION_ONLY
	string
	depends on VBOOT_SLOTS_RW_AB || VBOOT_SLOTS_RW_A
	# Add the EFS and EC to the RO region only
	# This is a mayan-specific override of soc/amd/phoenix/Kconfig
	default "apu/amdfw ec/ecfw"

config CHROMEOS
	# Use default libpayload config
	select LP_DEFCONFIG_OVERRIDE if PAYLOAD_DEPTHCHARGE
	# We don't have recovery buttons, so we can't manually enable devmode.
	select GBB_FLAG_FORCE_DEV_SWITCH_ON

choice
	prompt "DT SLOT/M.2 SSD1 ENABLE"
	default ENABLE_DT_SLOT_MAYAN
	help
	  Either DT slot or M.2 SSD1 can be used to boot on Mayan,
	  as they are sharing IO lanes.

config ENABLE_DT_SLOT_MAYAN
	bool "Enable DT slot"

config ENABLE_M2_SSD1_MAYAN
	bool "Enable M.2 SSD1"

config DISABLE_DT_M2_MAYAN
	bool "Disable both DT and M.2 slot"

endchoice

if !EM100	# EM100 defaults in soc/amd/common/blocks/spi/Kconfig
config EFS_SPI_READ_MODE
	default 3	# Quad IO (1-1-4)

config EFS_SPI_SPEED
	default 0	# 66MHz

config EFS_SPI_MICRON_FLAG
	default 0

config NORMAL_READ_SPI_SPEED
	default 1	# 33MHz

config ALT_SPI_SPEED
	default 1	# 33MHz

config TPM_SPI_SPEED
	default 1	# 33MHz

endif # !EM100

endif # BOARD_AMD_MAYAN_PHOENIX
```

## src/mainboard/amd/mayan/Kconfig.name
```kconfig
## SPDX-License-Identifier: GPL-2.0-only

comment "Mayan"

config BOARD_AMD_MAYAN_PHOENIX
	bool "->  Mayan for Phoenix SoC"
```

## src/mainboard/amd/norwich/Kconfig
```kconfig
if BOARD_AMD_NORWICH

config BOARD_SPECIFIC_OPTIONS # dummy
	def_bool y
	select ARCH_X86
	select CPU_AMD_GEODE_LX
	select NORTHBRIDGE_AMD_LX
	select SOUTHBRIDGE_AMD_CS5536
	select HAVE_PIRQ_TABLE
	select PIRQ_ROUTE
	select UDELAY_TSC
	select BOARD_ROMSIZE_KB_256
	select POWER_BUTTON_FORCE_ENABLE

config MAINBOARD_DIR
	string
	default amd/norwich

config MAINBOARD_PART_NUMBER
	string
	default "Norwich"

config IRQ_SLOT_COUNT
	int
	default 6

endif # BOARD_AMD_NORWICH
```

## src/mainboard/amd/olivehill/Kconfig
```kconfig
# SPDX-License-Identifier: GPL-2.0-only

if BOARD_AMD_OLIVEHILL

config BOARD_SPECIFIC_OPTIONS
	def_bool y
	select CPU_AMD_AGESA_FAMILY16_KB
	select NORTHBRIDGE_AMD_AGESA_FAMILY16_KB
	select SOUTHBRIDGE_AMD_AGESA_YANGTZE
	select DEFAULT_POST_ON_LPC
	select HAVE_OPTION_TABLE
	select HAVE_PIRQ_TABLE
	select HAVE_ACPI_RESUME
	select HAVE_ACPI_TABLES
	select BOARD_ROMSIZE_KB_4096
	select GFXUMA

config MAINBOARD_DIR
	string
	default "amd/olivehill"

config MAINBOARD_PART_NUMBER
	string
	default "DB-FT3"

config HW_MEM_HOLE_SIZEK
	hex
	default 0x200000

config MAX_CPUS
	int
	default 4

config IRQ_SLOT_COUNT
	int
	default 11

config ONBOARD_VGA_IS_PRIMARY
	bool
	default y

config HUDSON_LEGACY_FREE
	bool
	default y

endif # BOARD_AMD_OLIVEHILL
```

## src/mainboard/amd/olivehillplus/Kconfig
```kconfig
#
# This file is part of the coreboot project.
#
# Copyright (C) 2012 Advanced Micro Devices, Inc.
#
# This program is free software; you can redistribute it and/or modify
# it under the terms of the GNU General Public License as published by
# the Free Software Foundation; version 2 of the License.
#
# This program is distributed in the hope that it will be useful,
# but WITHOUT ANY WARRANTY; without even the implied warranty of
# MERCHANTABILITY or FITNESS FOR A PARTICULAR PURPOSE.  See the
# GNU General Public License for more details.
#

if BOARD_AMD_OLIVEHILLPLUS

config BOARD_SPECIFIC_OPTIONS # dummy
	def_bool y
	select CPU_AMD_PI_00730F01
	select NORTHBRIDGE_AMD_PI_00730F01
	select SOUTHBRIDGE_AMD_PI_AVALON
	select HAVE_OPTION_TABLE
	select HAVE_PIRQ_TABLE
	select HAVE_MP_TABLE
	select HAVE_ACPI_TABLES
	select BOARD_ROMSIZE_KB_8192
	select GFXUMA

config MAINBOARD_DIR
	string
	default amd/olivehillplus

config MAINBOARD_PART_NUMBER
	string
	default "DB-FT3b"

config MAX_CPUS
	int
	default 4

config IRQ_SLOT_COUNT
	int
	default 11

config ONBOARD_VGA_IS_PRIMARY
	bool
	default y

config HUDSON_LEGACY_FREE
	bool
	default y

endif # BOARD_AMD_OLIVEHILLPLUS
```

## src/mainboard/amd/onyx/Kconfig
```kconfig
if BOARD_AMD_ONYX

config BOARD_SPECIFIC_OPTIONS
	def_bool y
	select SOC_AMD_GENOA
	select BOARD_ROMSIZE_KB_32768
	select AMD_SOC_CONSOLE_UART

config FMDFILE
	default "src/mainboard/amd/onyx/board.fmd"


config MAINBOARD_DIR
	default "amd/onyx"

config MAINBOARD_PART_NUMBER
	default "Onyx"

# Use BMC SOL console on SoC UART1 by default
config UART_FOR_CONSOLE
	default 1

endif
```

## src/mainboard/amd/onyx_poc/Kconfig
```kconfig
## SPDX-License-Identifier: GPL-2.0-only

if BOARD_AMD_ONYX_POC

config BOARD_SPECIFIC_OPTIONS
	def_bool y
	select SOC_AMD_GENOA_POC
	select BOARD_ROMSIZE_KB_32768
	select AMD_SOC_CONSOLE_UART

config FMDFILE
	default "src/mainboard/amd/onyx_poc/board.fmd"


config MAINBOARD_DIR
	default "amd/onyx_poc"

config MAINBOARD_PART_NUMBER
	default "Onyx_poc"

# Use BMC SOL console on SoC UART1 by default
config UART_FOR_CONSOLE
	default 1

endif
```

## src/mainboard/amd/onyx_poc/Kconfig.name
```kconfig
## SPDX-License-Identifier: GPL-2.0-only

config BOARD_AMD_ONYX_POC
	bool "Onyx_poc"
```

## src/mainboard/amd/pademelon/Kconfig
```kconfig
# SPDX-License-Identifier: GPL-2.0-only

if BOARD_AMD_PADEMELON

config BOARD_SPECIFIC_OPTIONS
	def_bool y
	select SOC_AMD_STONEYRIDGE
	select AMD_APU_PKG_FP4
	select BOARD_ROMSIZE_KB_8192
	select DRIVERS_I2C_GENERIC
	select HAVE_ACPI_TABLES
	select GFXUMA
	select STONEYRIDGE_LEGACY_FREE
	select ONBOARD_VGA_IS_PRIMARY
	select SUPERIO_FINTEK_F81803A
	select SUPERIO_FINTEK_COMMON_PRE_RAM
	select SUPERIO_FINTEK_FAN_CONTROL
	select SUPERIO_FINTEK_FAN_API_CALL
	select AZALIA_PLUGIN_SUPPORT

config MAINBOARD_DIR
	default "amd/pademelon"

config MAINBOARD_PART_NUMBER
	default "Pademelon"

choice
	prompt "SOC used in pademelon board"
	default PADEMELON_MERLIN_FALCON

config PADEMELON_MERLIN_FALCON
	bool "Merlin Falcon"
	select AMD_APU_MERLINFALCON

config PADEMELON_PRAIRIE_FALCON
	bool "Prairie Falcon"
	select AMD_APU_PRAIRIEFALCON

endchoice


config OVERRIDE_DEVICETREE
	default "override-merlinfalcon.cb" if PADEMELON_MERLIN_FALCON
	default "override-prairiefalcon.cb" if PADEMELON_PRAIRIE_FALCON

config MAX_CPUS
	int
	default 4

config IRQ_SLOT_COUNT
	int
	default 11

config VGA_BIOS
	default y if USE_AMD_BLOBS

config HWM_PORT
	hex
	default 0x0225
	help
	  HWM base address must be an odd address. Hardware monitor used
	  addresses are HWM_PORT for index an HWM_PORT + 1 for data.
	  If changed, make sure fan_init.c IO window setting. The HWM
	  (Hardware Monitor) is used for fan control within pademelon.

if !EM100
config EFS_SPI_READ_MODE
	default 4          # Dual IO (1-2-2)

config EFS_SPI_SPEED
	default 0	# 66MHz
endif

endif # BOARD_AMD_PADEMELON
```

## src/mainboard/amd/padmelon/Kconfig
```kconfig
# SPDX-License-Identifier: GPL-2.0-only

if BOARD_AMD_PADMELON

config BOARD_SPECIFIC_OPTIONS # dummy
	def_bool y
	select SOC_AMD_STONEYRIDGE
	select AMD_APU_PKG_FP4
	select BOARD_ROMSIZE_KB_8192
	select DRIVERS_I2C_GENERIC
	select HAVE_ACPI_TABLES
	select GFXUMA
	select STONEYRIDGE_LEGACY_FREE
	select ONBOARD_VGA_IS_PRIMARY
	select SUPERIO_FINTEK_F81803A
	select SUPERIO_FINTEK_COMMON_PRE_RAM
	select SUPERIO_FINTEK_FAN_CONTROL
	select SUPERIO_FINTEK_FAN_API_CALL
	select VGA_BIOS
	select AZALIA_PLUGIN_SUPPORT

config MAINBOARD_DIR
	string
	default "amd/padmelon"

config MAINBOARD_PART_NUMBER
	string
	default "Padmelon"

choice
	prompt "SOC used in padmelon board"
	default PADMELON_MERLIN_FALCON

config PADMELON_MERLIN_FALCON
	bool "Merlin Falcon"

config PADMELON_PRAIRIE_FALCON
	bool "Prairie Falcon"

endchoice

config PADMELON_SOC_IN_USE
	def_bool y
	select AMD_APU_MERLINFALCON if PADMELON_MERLIN_FALCON
	select AMD_APU_PRAIRIEFALCON if PADMELON_PRAIRIE_FALCON

config HAVE_S3_SUPPORT
	bool
	default n

config MAX_CPUS
	int
	default 4

config IRQ_SLOT_COUNT
	int
	default 11

config HWM_PORT
	hex
	default 0x0225
	help
	  HWM base address must be an odd address. Hardware monitor used
	  addresses are HWM_PORT for index an HWM_PORT + 1 for data.
	  If changed, make sure fan_init.c IO window setting. The HWM
	  (Hardware Monitor) is used for fan control within padmelon.

endif # BOARD_AMD_PADMELON
```

## src/mainboard/amd/parmer/Kconfig
```kconfig
# SPDX-License-Identifier: GPL-2.0-only

if BOARD_AMD_PARMER

config BOARD_SPECIFIC_OPTIONS
	def_bool y
	select CPU_AMD_AGESA_FAMILY15_TN
	select NORTHBRIDGE_AMD_AGESA_FAMILY15_TN
	select SOUTHBRIDGE_AMD_AGESA_HUDSON
	select DEFAULT_POST_ON_LPC
	select HAVE_OPTION_TABLE
	select HAVE_PIRQ_TABLE
	select HAVE_ACPI_RESUME
	select HAVE_ACPI_TABLES
	select BOARD_ROMSIZE_KB_4096
	select GFXUMA

config MAINBOARD_DIR
	string
	default "amd/parmer"

config MAINBOARD_PART_NUMBER
	string
	default "Parmer"

config HW_MEM_HOLE_SIZEK
	hex
	default 0x200000

config MAX_CPUS
	int
	default 4

config IRQ_SLOT_COUNT
	int
	default 11

config ONBOARD_VGA_IS_PRIMARY
	bool
	default y

config VGA_BIOS_ID
	string
	default "1002,9900"

config HUDSON_LEGACY_FREE
	bool
	default y

endif # BOARD_AMD_PARMER
```

## src/mainboard/amd/persimmon/Kconfig
```kconfig
# SPDX-License-Identifier: GPL-2.0-only

if BOARD_AMD_PERSIMMON

config BOARD_SPECIFIC_OPTIONS
	def_bool y
	select CPU_AMD_AGESA_FAMILY14
	select NORTHBRIDGE_AMD_AGESA_FAMILY14
	select SOUTHBRIDGE_AMD_CIMX_SB800
	select SUPERIO_FINTEK_F81865F
	select HAVE_OPTION_TABLE
	select HAVE_PIRQ_TABLE
	select HAVE_MP_TABLE
	select HAVE_ACPI_RESUME
	select HAVE_ACPI_TABLES
	select BOARD_ROMSIZE_KB_4096
	select GFXUMA

config MAINBOARD_DIR
	string
	default "amd/persimmon"

config MAINBOARD_PART_NUMBER
	string
	default "Persimmon"

config HW_MEM_HOLE_SIZEK
	hex
	default 0x200000

config MAX_CPUS
	int
	default 2

config IRQ_SLOT_COUNT
	int
	default 11

config ONBOARD_VGA_IS_PRIMARY
	bool
	default y

#config VGA_BIOS_FILE
#	string "VGA BIOS path and filename"
#	depends on VGA_BIOS
#	default "rom/video/OntarioGenericVbios.bin"

config VGA_BIOS_ID
	string
	default "1002,9802"

config SB800_AHCI_ROM
	bool
	default n

endif # BOARD_AMD_PERSIMMON
```

## src/mainboard/amd/pistachio/Kconfig
```kconfig
if BOARD_AMD_PISTACHIO

config BOARD_SPECIFIC_OPTIONS # dummy
	def_bool y
	select ARCH_X86
	select CPU_AMD_SOCKET_AM2
	select DIMM_DDR2
	select NORTHBRIDGE_AMD_AMDK8
	select SOUTHBRIDGE_AMD_RS690
	select SOUTHBRIDGE_AMD_SB600
	select HAVE_OPTION_TABLE
	select HAVE_PIRQ_TABLE
	select HAVE_MP_TABLE
	select SB_HT_CHAIN_UNITID_OFFSET_ONLY
	select HAVE_ACPI_TABLES
	select BOARD_ROMSIZE_KB_1024
	select RAMINIT_SYSINFO
	select QRANK_DIMM_SUPPORT
	select SET_FIDVID

config MAINBOARD_DIR
	string
	default amd/pistachio

config DCACHE_RAM_BASE
	hex
	default 0xc8000

config DCACHE_RAM_SIZE
	hex
	default 0x08000

config APIC_ID_OFFSET
	hex
	default 0x0

config MAINBOARD_PART_NUMBER
	string
	default "Pistachio"

config MAX_CPUS
	int
	default 2

config MAX_PHYSICAL_CPUS
	int
	default 1

config SB_HT_CHAIN_ON_BUS0
	int
	default 1

config HT_CHAIN_END_UNITID_BASE
	hex
	default 0x1

config HT_CHAIN_UNITID_BASE
	hex
	default 0x0

config IRQ_SLOT_COUNT
	int
	default 11

endif # BOARD_AMD_PISTACHIO
```

## src/mainboard/amd/rumba/Kconfig
```kconfig
##
## This file is part of the coreboot project.
##
## Copyright (C) 2009 Uwe Hermann <uwe@hermann-uwe.de>
##
## This program is free software; you can redistribute it and/or modify
## it under the terms of the GNU General Public License as published by
## the Free Software Foundation; either version 2 of the License, or
## (at your option) any later version.
##
## This program is distributed in the hope that it will be useful,
## but WITHOUT ANY WARRANTY; without even the implied warranty of
## MERCHANTABILITY or FITNESS FOR A PARTICULAR PURPOSE.  See the
## GNU General Public License for more details.
##
## You should have received a copy of the GNU General Public License
## along with this program; if not, write to the Free Software
## Foundation, Inc., 51 Franklin St, Fifth Floor, Boston, MA  02110-1301 USA
##
config BOARD_AMD_RUMBA
	bool "Rumba"
	select ARCH_X86
	select CPU_AMD_GX2
	select NORTHBRIDGE_AMD_GX2
	select SOUTHBRIDGE_AMD_CS5536
	select UDELAY_TSC
	select TSC_X86RDTSC_CALIBRATE_WITH_TIMER2
	select HAVE_PIRQ_TABLE
	help
	  AMD Rumba mainboard.

config MAINBOARD_DIR
	string
	default amd/rumba
	depends on BOARD_AMD_RUMBA

config MAINBOARD_PART_NUMBER
	string
	default "Rumba"
	depends on BOARD_AMD_RUMBA

config HAVE_OPTION_TABLE
	bool
	default n
	depends on BOARD_AMD_RUMBA

config IRQ_SLOT_COUNT
	int
	default 2
	depends on BOARD_AMD_RUMBA

config USE_INIT
	int
	default 0
	depends on BOARD_AMD_RUMBA
```

## src/mainboard/amd/serengeti_cheetah/Kconfig
```kconfig
if BOARD_AMD_SERENGETI_CHEETAH

config BOARD_SPECIFIC_OPTIONS # dummy
	def_bool y
	select ARCH_X86
	select SOUTHBRIDGE_AMD_AMD8132
	select SOUTHBRIDGE_AMD_AMD8151
	select CPU_AMD_SOCKET_F
	select DIMM_DDR2
	select DIMM_REGISTERED
	select NORTHBRIDGE_AMD_AMDK8
	select SOUTHBRIDGE_AMD_AMD8111
	select SOUTHBRIDGE_AMD_AMD8131
	select SUPERIO_WINBOND_W83627HF
	select HAVE_OPTION_TABLE
	select HAVE_PIRQ_TABLE
	select HAVE_MP_TABLE
	select LIFT_BSP_APIC_ID
	select SB_HT_CHAIN_UNITID_OFFSET_ONLY
	select WAIT_BEFORE_CPUS_INIT
	select HAVE_ACPI_TABLES
	select BOARD_ROMSIZE_KB_512
	select RAMINIT_SYSINFO
	select QRANK_DIMM_SUPPORT
	select DRIVERS_I2C_I2CMUX

config MAINBOARD_DIR
	string
	default amd/serengeti_cheetah

config DCACHE_RAM_BASE
	hex
	default 0xc8000

config DCACHE_RAM_SIZE
	hex
	default 0x08000

config APIC_ID_OFFSET
	hex
	default 0x8

config MAINBOARD_PART_NUMBER
	string
	default "Serengeti Cheetah"

config MAX_CPUS
	int
	default 8

config MAX_PHYSICAL_CPUS
	int
	default 4

config MEM_TRAIN_SEQ
	int
	default 1

config SB_HT_CHAIN_ON_BUS0
	int
	default 2

config HT_CHAIN_END_UNITID_BASE
	hex
	default 0x6

config HT_CHAIN_UNITID_BASE
	hex
	default 0xa

config SERIAL_CPU_INIT
	bool
	default n

config IRQ_SLOT_COUNT
	int
	default 11

config ACPI_SSDTX_NUM
	int
	default 4

endif # BOARD_AMD_SERENGETI_CHEETAH
```
