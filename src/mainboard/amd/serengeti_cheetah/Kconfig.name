## src/mainboard/amd/serengeti_cheetah_fam10/Kconfig
```kconfig
if BOARD_AMD_SERENGETI_CHEETAH_FAM10

config BOARD_SPECIFIC_OPTIONS # dummy
	def_bool y
	select CPU_AMD_SOCKET_F_1207
	select DIMM_DDR2
	select DIMM_REGISTERED
	select NORTHBRIDGE_AMD_AMDFAM10
	select SOUTHBRIDGE_AMD_AMD8111
	select SOUTHBRIDGE_AMD_AMD8132
	select HT_CHAIN_DISTRIBUTE
	select SUPERIO_WINBOND_W83627HF
	select HAVE_OPTION_TABLE
	select HAVE_PIRQ_TABLE
	select HAVE_MP_TABLE
	select SB_HT_CHAIN_UNITID_OFFSET_ONLY
	select HAVE_ACPI_TABLES
	select BOARD_ROMSIZE_KB_1024
	select ENABLE_APIC_EXT_ID
	select LIFT_BSP_APIC_ID
	select DRIVERS_I2C_I2CMUX2

config MAINBOARD_DIR
	string
	default amd/serengeti_cheetah_fam10

config APIC_ID_OFFSET
	hex
	default 0x0

config MAINBOARD_PART_NUMBER
	string
	default "Serengeti Cheetah (Fam10)"

# 6 * MAX_PHYSICAL_CPUS
config MAX_CPUS
	int
	default 48

config MAX_PHYSICAL_CPUS
	int
	default 8

config HT_CHAIN_END_UNITID_BASE
	hex
	default 0x6

config HT_CHAIN_UNITID_BASE
	hex
	default 0xa

config IRQ_SLOT_COUNT
	int
	default 11

endif # BOARD_AMD_SERENGETI_CHEETAH_FAM10
```

## src/mainboard/amd/south_station/Kconfig
```kconfig
# SPDX-License-Identifier: GPL-2.0-only

if BOARD_AMD_SOUTHSTATION

config BOARD_SPECIFIC_OPTIONS
	def_bool y
	select CPU_AMD_AGESA_FAMILY14
	select NORTHBRIDGE_AMD_AGESA_FAMILY14
	select SOUTHBRIDGE_AMD_CIMX_SB800
	select SUPERIO_FINTEK_F81865F
	select HAVE_OPTION_TABLE
	select HAVE_PIRQ_TABLE
	select HAVE_MP_TABLE
	select HAVE_ACPI_TABLES
	select BOARD_ROMSIZE_KB_4096
	select GFXUMA

config MAINBOARD_DIR
	string
	default "amd/south_station"

config MAINBOARD_PART_NUMBER
	string
	default "Southstation"

config HW_MEM_HOLE_SIZEK
	hex
	default 0x200000

config MAX_CPUS
	int
	default 4

config IRQ_SLOT_COUNT
	int
	default 11

config ONBOARD_VGA_IS_PRIMARY
	bool
	default y

config VGA_BIOS_FILE
	string
	default "site-local/vgabios.bin"

config VGA_BIOS_ID
	string
	default "1002,9806"

endif # BOARD_AMD_SOUTHSTATION
```

## src/mainboard/amd/thatcher/Kconfig
```kconfig
# SPDX-License-Identifier: GPL-2.0-only

if BOARD_AMD_THATCHER

config BOARD_SPECIFIC_OPTIONS
	def_bool y
	select CPU_AMD_AGESA_FAMILY15_TN
	select NORTHBRIDGE_AMD_AGESA_FAMILY15_TN
	select SOUTHBRIDGE_AMD_AGESA_HUDSON
	select DEFAULT_POST_ON_LPC
	select HAVE_OPTION_TABLE
	select HAVE_PIRQ_TABLE
	select HAVE_ACPI_RESUME
	select HAVE_ACPI_TABLES
	select SUPERIO_SMSC_LPC47N217
	select BOARD_ROMSIZE_KB_4096
	select GFXUMA

config MAINBOARD_DIR
	string
	default "amd/thatcher"

config MAINBOARD_PART_NUMBER
	string
	default "Thatcher"

config HW_MEM_HOLE_SIZEK
	hex
	default 0x200000

config MAX_CPUS
	int
	default 4

config IRQ_SLOT_COUNT
	int
	default 11

config ONBOARD_VGA_IS_PRIMARY
	bool
	default y

config VGA_BIOS_ID
	string
	default "1002,9917"

config HUDSON_LEGACY_FREE
	bool
	default y

endif # BOARD_AMD_THATCHER
```

## src/mainboard/amd/tilapia_fam10/Kconfig
```kconfig
if BOARD_AMD_TILAPIA_FAM10

config BOARD_SPECIFIC_OPTIONS # dummy
	def_bool y
	select ARCH_X86
	select CPU_AMD_SOCKET_AM3
	select DIMM_DDR3
	select DIMM_REGISTERED
	select NORTHBRIDGE_AMD_AMDFAM10
	select SOUTHBRIDGE_AMD_RS780
	select SOUTHBRIDGE_AMD_SB700
	select SUPERIO_ITE_IT8718F
	select HAVE_OPTION_TABLE
	select HAVE_PIRQ_TABLE
	select HAVE_MP_TABLE
	select SB_HT_CHAIN_UNITID_OFFSET_ONLY
	select LIFT_BSP_APIC_ID
	select SERIAL_CPU_INIT
	select AMDMCT
	select HAVE_ACPI_TABLES
	select BOARD_ROMSIZE_KB_1024
	select RAMINIT_SYSINFO
	select ENABLE_APIC_EXT_ID
	select GFXUMA
	select QRANK_DIMM_SUPPORT

config MAINBOARD_DIR
	string
	default amd/tilapia_fam10

config APIC_ID_OFFSET
	hex
	default 0x0

config MAINBOARD_PART_NUMBER
	string
	default "Tilapia (Fam10)"

config MAX_CPUS
	int
	default 8

config MAX_PHYSICAL_CPUS
	int
	default 2

config MEM_TRAIN_SEQ
	int
	default 2

config SB_HT_CHAIN_ON_BUS0
	int
	default 1

config HT_CHAIN_END_UNITID_BASE
	hex
	default 0x1

config HT_CHAIN_UNITID_BASE
	hex
	default 0x0

config IRQ_SLOT_COUNT
	int
	default 11

config AMD_UCODE_PATCH_FILE
	string
	default "mc_patch_010000b6.h"

config RAMTOP
	hex
	default 0x2000000

config HEAP_SIZE
	hex
	default 0xc0000

config RAMBASE
	hex
	default 0x200000

config VGA_BIOS
        bool
        default n

config VGA_BIOS_ID
        string
        depends on VGA_BIOS
        default "1002,9615"

endif # BOARD_AMD_TILAPIA_FAM10
```

## src/mainboard/amd/torpedo/Kconfig
```kconfig
#
# This file is part of the coreboot project.
#
# Copyright (C) 2011 Advanced Micro Devices, Inc.
#
# This program is free software; you can redistribute it and/or modify
# it under the terms of the GNU General Public License as published by
# the Free Software Foundation; version 2 of the License.
#
# This program is distributed in the hope that it will be useful,
# but WITHOUT ANY WARRANTY; without even the implied warranty of
# MERCHANTABILITY or FITNESS FOR A PARTICULAR PURPOSE.  See the
# GNU General Public License for more details.
#
# You should have received a copy of the GNU General Public License
# along with this program; if not, write to the Free Software
# Foundation, Inc.
#

if BOARD_AMD_TORPEDO

config BOARD_SPECIFIC_OPTIONS # dummy
	def_bool y
	select CPU_AMD_AGESA_FAMILY12
	select NORTHBRIDGE_AMD_AGESA_FAMILY12
	select SOUTHBRIDGE_AMD_CIMX_SB900
	select SUPERIO_SMSC_KBC1100
	select HAVE_OPTION_TABLE
	select HAVE_PIRQ_TABLE
	select HAVE_MP_TABLE
	select HAVE_ACPI_TABLES
	select BOARD_ROMSIZE_KB_2048
	select ENABLE_APIC_EXT_ID
	select GFXUMA

config MAINBOARD_DIR
	string
	default amd/torpedo

config MAINBOARD_PART_NUMBER
	string
	default "Torpedo"

config HW_MEM_HOLE_SIZEK
	hex
	default 0x200000

config MAX_CPUS
	int
	default 4

config HW_MEM_HOLE_SIZE_AUTO_INC
	bool
	default n

config HT_CHAIN_END_UNITID_BASE
	hex
	default 0x1

config HT_CHAIN_UNITID_BASE
	hex
	default 0x0

config IRQ_SLOT_COUNT
	int
	default 11

config ONBOARD_VGA_IS_PRIMARY
	bool
	default y

config VGA_BIOS
	bool
	default n

#config VGA_BIOS_FILE
#	string "VGA BIOS path and filename"
#	depends on VGA_BIOS
#	default "rom/video/LlanoGenericVbios.bin"

config VGA_BIOS_ID
	string "VGA device PCI IDs"
	depends on VGA_BIOS
	default "1002,9641"

config AHCI_BIOS
	bool
	default n

#config AHCI_BIOS_FILE
#	string "AHCI ROM path and filename"
#	depends on AHCI_BIOS
#	default "rom/ahci/sb900.bin"

config AHCI_BIOS_ID
	string "AHCI device PCI IDs"
	depends on AHCI_BIOS
	default "1022,7801"

config XHC_BIOS
	bool
	default n

#config XHC_BIOS_FILE
#	string "XHC BIOS path and filename"
#	depends on XHC_BIOS
#	default "rom/xhc/Xhc.rom"

config XHC_BIOS_ID
	string "XHC device PCI IDs"
	depends on XHC_BIOS
	default "1022,7812"

config SATA_CONTROLLER_MODE
	hex
	default 0x0

config ONBOARD_LAN
	bool
	default y

config ONBOARD_1394
	bool
	default y

config ONBOARD_USB30
	bool
	default n

config ONBOARD_BLUETOOTH
	bool
	default y

config ONBOARD_WEBCAM
	bool
	default y

config ONBOARD_TRAVIS
	bool
	default y

config ONBOARD_LIGHTSENSOR
	bool
	default n

endif # BOARD_AMD_TORPEDO
```

## src/mainboard/amd/union_station/Kconfig
```kconfig
# SPDX-License-Identifier: GPL-2.0-only

if BOARD_AMD_UNIONSTATION

config BOARD_SPECIFIC_OPTIONS
	def_bool y
	select CPU_AMD_AGESA_FAMILY14
	select NORTHBRIDGE_AMD_AGESA_FAMILY14
	select SOUTHBRIDGE_AMD_CIMX_SB800
	select HAVE_OPTION_TABLE
	select HAVE_PIRQ_TABLE
	select HAVE_MP_TABLE
	select HAVE_ACPI_TABLES
	select BOARD_ROMSIZE_KB_2048
	select GFXUMA

config MAINBOARD_DIR
	string
	default "amd/union_station"

config MAINBOARD_PART_NUMBER
	string
	default "Unionstation"

config HW_MEM_HOLE_SIZEK
	hex
	default 0x200000

config MAX_CPUS
	int
	default 4

config IRQ_SLOT_COUNT
	int
	default 11

config ONBOARD_VGA_IS_PRIMARY
	bool
	default y

config VGA_BIOS_FILE
	string
	default "site-local/vgabios.bin"

config VGA_BIOS_ID
	string
	default "1002,9802"

endif # BOARD_AMD_UNIONSTATION
```

## src/mainboard/aoostar/Kconfig
```kconfig
## SPDX-License-Identifier: GPL-2.0-only

if VENDOR_AOOSTAR

choice
	prompt "Mainboard model"

source "src/mainboard/aoostar/*/Kconfig.name"

endchoice

source "src/mainboard/aoostar/*/Kconfig"

config MAINBOARD_VENDOR
	string
	default "AOOSTAR"

endif # VENDOR_AOOSTAR
```

## src/mainboard/aoostar/wtr_r1/Kconfig
```kconfig
## SPDX-License-Identifier: GPL-2.0-only

if BOARD_AOOSTAR_WTR_R1

config BOARD_SPECIFIC_OPTIONS
	def_bool y
	select BOARD_ROMSIZE_KB_16384
	select DRIVERS_I2C_GENERIC
	select DRIVERS_INTEL_DPTF
	select DRIVERS_SPI_ACPI
	select DRIVERS_USB_ACPI
	select HAVE_ACPI_RESUME
	select HAVE_ACPI_TABLES
	select INTEL_GMA_HAVE_VBT
	select SOC_INTEL_COMMON_BLOCK_IPU
	select SOC_INTEL_ENABLE_USB4_PCIE_RESOURCES
	select SUPERIO_ITE_IT8613E
	select DRIVERS_UART_8250IO
	select USE_LEGACY_8254_TIMER
	select SOC_INTEL_ALDERLAKE_PCH_N

config MAINBOARD_DIR
	default "aoostar/wtr_r1"

config MAINBOARD_PART_NUMBER
	default "WTR R1"

config MAINBOARD_FAMILY
	string
	default "AOOSTAR_WTR_R1"

config PCIEXP_ASPM
	default y

# Setting this makes NVMe SSD not work
config PCIEXP_L1_SUB_STATE
	default n

# Setting this makes 2.5Gb NICs not work
config PCIEXP_CLK_PM
	default n

# This platform has limited means to display POST codes
config NO_POST
	default y

endif #BOARD_AOOSTAR_WTR_R1
```

## src/mainboard/aoostar/wtr_r1/Kconfig.name
```kconfig
## SPDX-License-Identifier: GPL-2.0-only

config BOARD_AOOSTAR_WTR_R1
	bool "WTR R1"
```

## src/mainboard/aopen/Kconfig
```kconfig
if VENDOR_AOPEN

choice
	prompt "Mainboard model"

source "src/mainboard/aopen/*/Kconfig.name"

endchoice

source "src/mainboard/aopen/*/Kconfig"

config MAINBOARD_VENDOR
	default "AOpen"

endif # VENDOR_AOPEN
```

## src/mainboard/aopen/dxplplusu/Kconfig
```kconfig
if BOARD_AOPEN_DXPLPLUSU

config BOARD_SPECIFIC_OPTIONS
	def_bool y
	select CPU_INTEL_SOCKET_MPGA604
	select NORTHBRIDGE_INTEL_E7505
	select SOUTHBRIDGE_INTEL_I82870
	select SOUTHBRIDGE_INTEL_I82801DX
	select SUPERIO_SMSC_LPC47M10X
	select HAVE_ACPI_TABLES
	select BOARD_ROMSIZE_KB_2048

config MAINBOARD_DIR
	default "aopen/dxplplusu"

config MAINBOARD_PART_NUMBER
	default "DXPL Plus-U"

config IRQ_SLOT_COUNT
	int
	default 12

config MAX_CPUS
	int
	default 4

endif # BOARD_AOPEN_DXPLPLUSU
```

## src/mainboard/aopen/dxplplusu/Kconfig.name
```kconfig
## SPDX-License-Identifier: GPL-2.0-only

config BOARD_AOPEN_DXPLPLUSU
	bool "DXPL Plus-U"
```

## src/mainboard/apple/Kconfig
```kconfig
if VENDOR_APPLE

choice
	prompt "Mainboard model"

source "src/mainboard/apple/*/Kconfig.name"

endchoice

source "src/mainboard/apple/*/Kconfig"

config MAINBOARD_VENDOR
	string
	default "Apple"

endif # VENDOR_APPLE
```

## src/mainboard/apple/imac52/Kconfig
```kconfig
if BOARD_APPLE_IMAC52

config MAINBOARD_PART_NUMBER
	string
	default "iMac5,2"

endif
```
