## src/mainboard/apple/macbook11/Kconfig
```kconfig
if BOARD_APPLE_MACBOOK11

config MAINBOARD_PART_NUMBER
	string
	default "MacBook1,1"

endif
```

## src/mainboard/apple/macbook21/Kconfig
```kconfig
## SPDX-License-Identifier: GPL-2.0-only

if BOARD_APPLE_MACBOOK11 || BOARD_APPLE_MACBOOK21 || BOARD_APPLE_IMAC52

config BOARD_SPECIFIC_OPTIONS
	def_bool y
	select SYSTEM_TYPE_LAPTOP
	select CPU_INTEL_SOCKET_M
	select NORTHBRIDGE_INTEL_I945
	select NORTHBRIDGE_INTEL_SUBTYPE_I945GM
	select SOUTHBRIDGE_INTEL_I82801GX
	select EC_ACPI
	select HAVE_OPTION_TABLE
	select HAVE_CMOS_DEFAULT
	select HAVE_MP_TABLE
	select BOARD_ROMSIZE_KB_2048
	select INTEL_INT15
	select HAVE_ACPI_TABLES
	select HAVE_ACPI_RESUME
	select I945_LVDS

config MAINBOARD_DIR
	default "apple/macbook21"

config MAINBOARD_PART_NUMBER
	default "Macbook1,1" if BOARD_APPLE_MACBOOK11
	default "MacBook2,1" if BOARD_APPLE_MACBOOK21
	default "iMac5,2" if BOARD_APPLE_IMAC52

config MAX_CPUS
	int
	default 2

config MAINBOARD_SMBIOS_MANUFACTURER
	string
	default "Apple Inc."

endif
```

## src/mainboard/apple/macbook21/Kconfig.name
```kconfig
config BOARD_APPLE_MACBOOK21
	bool "Macbook2,1"

config BOARD_APPLE_MACBOOK11
	bool "Macbook1,1"

config BOARD_APPLE_IMAC52
	bool "iMac5,2"
```

## src/mainboard/apple/macbookair4_2/Kconfig
```kconfig
## SPDX-License-Identifier: GPL-2.0-only

if BOARD_APPLE_MACBOOKAIR4_2

config BOARD_SPECIFIC_OPTIONS
	def_bool y
	select AZALIA_USE_LEGACY_VERB_TABLE
	select BOARD_ROMSIZE_KB_8192
	select EC_ACPI
	select HAVE_ACPI_RESUME
	select HAVE_ACPI_TABLES
	select INTEL_INT15
	select NORTHBRIDGE_INTEL_SANDYBRIDGE
	select USE_NATIVE_RAMINIT
	select SERIRQ_CONTINUOUS_MODE
	select SOUTHBRIDGE_INTEL_BD82X6X
	select SYSTEM_TYPE_LAPTOP
	select MAINBOARD_HAS_LIBGFXINIT
	select HAVE_CMOS_DEFAULT
	select HAVE_OPTION_TABLE
	select HAVE_SPD_IN_CBFS

config MAINBOARD_DIR
	default "apple/macbookair4_2"

config MAINBOARD_PART_NUMBER
	default "MacBookAir4,2"

config VGA_BIOS_ID
	string
	default "8086,0116"

config DRAM_RESET_GATE_GPIO
	int
	default 28
endif
```

## src/mainboard/apple/macbookair4_2/Kconfig.name
```kconfig
## SPDX-License-Identifier: GPL-2.0-only

config BOARD_APPLE_MACBOOKAIR4_2
	bool "MacBookAir4,2"
```

## src/mainboard/arima/Kconfig
```kconfig
if VENDOR_ARIMA

choice
	prompt "Mainboard model"

source "src/mainboard/arima/*/Kconfig.name"

endchoice

source "src/mainboard/arima/*/Kconfig"

config MAINBOARD_VENDOR
	string
	default "Arima"

endif # VENDOR_ARIMA
```

## src/mainboard/arima/hdama/Kconfig
```kconfig
if BOARD_ARIMA_HDAMA

config BOARD_SPECIFIC_OPTIONS # dummy
	def_bool y
	select ARCH_X86
	select CPU_AMD_SOCKET_940
	select NORTHBRIDGE_AMD_AMDK8
	select SOUTHBRIDGE_AMD_AMD8111
	select SOUTHBRIDGE_AMD_AMD8131
	select SUPERIO_NSC_PC87360
	select HAVE_PIRQ_TABLE
	select HAVE_OPTION_TABLE
	select HAVE_MP_TABLE
	select SB_HT_CHAIN_UNITID_OFFSET_ONLY
	select BOARD_ROMSIZE_KB_512
	select QRANK_DIMM_SUPPORT

config MAINBOARD_DIR
	string
	default arima/hdama

config APIC_ID_OFFSET
	hex
	default 0x0

config MAINBOARD_PART_NUMBER
	string
	default "HDAMA"

config HW_MEM_HOLE_SIZEK
	hex
	default 0x0

config MAX_CPUS
	int
	default 4

config MAX_PHYSICAL_CPUS
	int
	default 2

config SB_HT_CHAIN_ON_BUS0
	int
	default 1

config HT_CHAIN_END_UNITID_BASE
	hex
	default 0x20

config HT_CHAIN_UNITID_BASE
	hex
	default 0x1

config IRQ_SLOT_COUNT
	int
	default 9

endif # BOARD_ARIMA_HDAMA
```

## src/mainboard/arm/Kconfig
```kconfig
## SPDX-License-Identifier: GPL-2.0-only

if VENDOR_ARM

choice
	prompt "Mainboard model"
	default BOARD_ARM_RDN2

source "src/mainboard/arm/*/Kconfig.name"

endchoice

source "src/mainboard/arm/*/Kconfig"

config MAINBOARD_VENDOR
	default "Arm"

endif # VENDOR_ARM
```

## src/mainboard/arm/rdn2/Kconfig
```kconfig
# SPDX-License-Identifier: GPL-2.0-or-later

if BOARD_ARM_RDN2

config BOARD_SPECIFIC_OPTIONS
	def_bool y
	select ARCH_BOOTBLOCK_ARMV8_64
	select ARCH_VERSTAGE_ARMV8_64
	select ARCH_ROMSTAGE_ARMV8_64
	select ARCH_RAMSTAGE_ARMV8_64
	select ARM64_USE_ARCH_TIMER
	select BOARD_ROMSIZE_KB_65536
	select BOOTBLOCK_CUSTOM
	select DRIVERS_UART_PL011
	select HAVE_ACPI_TABLES
	select ACPI_GTDT
	select ACPI_COMMON_MADT_GICC_V3
	select MISSING_BOARD_RESET
	select PCI
	select PROBE_RAM
	select ACPI_IORT
	select ACPI_GTDT
	select ACPI_COMMON_MADT_GICC_V3
	select ACPI_PPTT
	select GENERATE_SMBIOS_TABLES

config ARM64_CURRENT_EL
	default 2

config ECAM_MMCONF_BASE_ADDRESS
	default 0x1010000000

config ECAM_MMCONF_BUS_NUMBER
	default 256

config MEMLAYOUT_LD_FILE
	string
	default "src/mainboard/arm/rdn2/memlayout.ld"

config FATAL_ASSERTS
	default y

config FMDFILE
	default "src/mainboard/arm/rdn2/flash.fmd"

config MAINBOARD_DIR
	default "arm/rdn2"

config MAINBOARD_PART_NUMBER
	default "Neoverse N2"

config MAX_CPUS
	int
	default 128

config MAINBOARD_VENDOR
	string
	default "Arm"

config DRAM_SIZE_MB
	int
	default 2048

endif #  BOARD_ARM_RDN2
```

## src/mainboard/arm/rdn2/Kconfig.name
```kconfig
# SPDX-License-Identifier: GPL-2.0-or-later

config BOARD_ARM_RDN2
	bool "Neoverse N2"
	help
	  To execute, do:
	  FVP_RD_N2\models\Win64_VC2019\FVP_RD_N2 -C board.flashloader0.fname=coreboot.rom \
	  -C css.trustedBootROMloader.fname=bl1.bin
```

## src/mainboard/artecgroup/Kconfig
```kconfig
if VENDOR_ARTECGROUP

choice
	prompt "Mainboard model"

source "src/mainboard/artecgroup/*/Kconfig.name"

endchoice

config MAINBOARD_VENDOR
	string
	default "Artec Group"

endif # VENDOR_ARTECGROUP

if VENDOR_ARTECGROUP || VENDOR_LINUTOP
source "src/mainboard/artecgroup/*/Kconfig"
endif # VENDOR_ARTECGROUP || VENDOR_LINUTOP
```

## src/mainboard/artecgroup/dbe61/Kconfig
```kconfig
if BOARD_ARTECGROUP_DBE61

config BOARD_SPECIFIC_OPTIONS # dummy
	def_bool y
	select ARCH_X86
	select CPU_AMD_GEODE_LX
	select NORTHBRIDGE_AMD_LX
	select SOUTHBRIDGE_AMD_CS5536
	select HAVE_PIRQ_TABLE
	select PIRQ_ROUTE
	select UDELAY_TSC
	select BOARD_ROMSIZE_KB_256
	select POWER_BUTTON_FORCE_DISABLE

config MAINBOARD_DIR
	string
	default artecgroup/dbe61

config MAINBOARD_PART_NUMBER
	string
	default "DBE61"

config IRQ_SLOT_COUNT
	int
	default 3

endif # BOARD_ARTECGROUP_DBE61
```

## src/mainboard/asi/Kconfig
```kconfig
##
## This file is part of the coreboot project.
##
## Copyright (C) 2009 Uwe Hermann <uwe@hermann-uwe.de>
##
## This program is free software; you can redistribute it and/or modify
## it under the terms of the GNU General Public License as published by
## the Free Software Foundation; version 2 of the License.
##
## This program is distributed in the hope that it will be useful,
## but WITHOUT ANY WARRANTY; without even the implied warranty of
## MERCHANTABILITY or FITNESS FOR A PARTICULAR PURPOSE.  See the
## GNU General Public License for more details.
##
## You should have received a copy of the GNU General Public License
## along with this program; if not, write to the Free Software
## Foundation, Inc., 51 Franklin St, Fifth Floor, Boston, MA 02110-1301 USA
##
if VENDOR_ASI

choice
	prompt "Mainboard model"

config BOARD_ASI_MB_5BLGP
	bool "MB-5BLGP"
config BOARD_ASI_MB_5BLMP
	bool "MB-5BLMP"

endchoice

source "src/mainboard/asi/mb_5blgp/Kconfig"
source "src/mainboard/asi/mb_5blmp/Kconfig"

config MAINBOARD_VENDOR
	string
	default "ASI"

endif # VENDOR_ASI
```

## src/mainboard/asi/mb_5blmp/Kconfig
```kconfig
##
## This file is part of the coreboot project.
##
## Copyright (C) 2009 Uwe Hermann <uwe@hermann-uwe.de>
##
## This program is free software; you can redistribute it and/or modify
## it under the terms of the GNU General Public License as published by
## the Free Software Foundation; version 2 of the License.
##
## This program is distributed in the hope that it will be useful,
## but WITHOUT ANY WARRANTY; without even the implied warranty of
## MERCHANTABILITY or FITNESS FOR A PARTICULAR PURPOSE.  See the
## GNU General Public License for more details.
##
## You should have received a copy of the GNU General Public License
## along with this program; if not, write to the Free Software
## Foundation, Inc., 51 Franklin St, Fifth Floor, Boston, MA  02110-1301 USA
##

config BOARD_ASI_MB_5BLMP
	bool "MB-5BLMP"
	select ARCH_X86
	select CPU_AMD_GX1
	select NORTHBRIDGE_AMD_GX1
	select SOUTHBRIDGE_AMD_CS5530
	select SUPERIO_NSC_PC87351
	select ROMCC
	select HAVE_PIRQ_TABLE
	select PIRQ_ROUTE
	select UDELAY_TSC
	select BOARD_ROMSIZE_KB_256

config MAINBOARD_DIR
	string
	default asi/mb_5blmp
	depends on BOARD_ASI_MB_5BLMP

config MAINBOARD_PART_NUMBER
	string
	default "MB-5BLMP"
	depends on BOARD_ASI_MB_5BLMP

config IRQ_SLOT_COUNT
	int
	default 5
	depends on BOARD_ASI_MB_5BLMP
```

## src/mainboard/asrock/939a785gmh/Kconfig
```kconfig
if BOARD_ASROCK_939A785GMH

config BOARD_SPECIFIC_OPTIONS # dummy
	def_bool y
	select ARCH_X86
	select CPU_AMD_SOCKET_939
	select K8_HT_FREQ_1G_SUPPORT
	select NORTHBRIDGE_AMD_AMDK8
	select SOUTHBRIDGE_AMD_RS780
	select SOUTHBRIDGE_AMD_SB700
	select SUPERIO_WINBOND_W83627DHG
	select HAVE_ACPI_TABLES
	select HAVE_ACPI_RESUME
	select HAVE_MP_TABLE
	select HAVE_PIRQ_TABLE
	select HAVE_OPTION_TABLE
	select LIFT_BSP_APIC_ID
	select SB_HT_CHAIN_UNITID_OFFSET_ONLY
	select BOARD_ROMSIZE_KB_1024
	select GFXUMA
	select RAMINIT_SYSINFO
	select QRANK_DIMM_SUPPORT
	select SET_FIDVID

config MAINBOARD_DIR
	string
	default asrock/939a785gmh

config DCACHE_RAM_BASE
	hex
	default 0xc8000

config DCACHE_RAM_SIZE
	hex
	default 0x08000

config APIC_ID_OFFSET
	hex
	default 0x0

config MAINBOARD_PART_NUMBER
	string
	default "939A785GMH"

config MAX_CPUS
	int
	default 8

config MAX_PHYSICAL_CPUS
	int
	default 2

config SB_HT_CHAIN_ON_BUS0
	int
	default 1

config HT_CHAIN_END_UNITID_BASE
	hex
	default 0x1

config HT_CHAIN_UNITID_BASE
	hex
	default 0x0

config IRQ_SLOT_COUNT
	int
	default 11

endif # BOARD_ASROCK_939A785GMH
```

## src/mainboard/asrock/Kconfig
```kconfig
## SPDX-License-Identifier: GPL-2.0-only

if VENDOR_ASROCK

choice
	prompt "Mainboard model"

source "src/mainboard/asrock/*/Kconfig.name"

endchoice

source "src/mainboard/asrock/*/Kconfig"

config MAINBOARD_VENDOR
	default "ASROCK"

endif # VENDOR_ASROCK
```

## src/mainboard/asrock/b75m-itx/Kconfig
```kconfig
# SPDX-License-Identifier: GPL-2.0-or-later

if BOARD_ASROCK_B75M_ITX

config BOARD_SPECIFIC_OPTIONS
	def_bool y
	select AZALIA_USE_LEGACY_VERB_TABLE
	select BOARD_ROMSIZE_KB_8192
	select HAVE_ACPI_RESUME
	select HAVE_ACPI_TABLES
	select HAVE_CMOS_DEFAULT
	select HAVE_OPTION_TABLE
	select INTEL_GMA_HAVE_VBT
	select INTEL_INT15
	select MAINBOARD_HAS_LIBGFXINIT
	select NO_UART_ON_SUPERIO
	select NORTHBRIDGE_INTEL_SANDYBRIDGE
	select SERIRQ_CONTINUOUS_MODE
	select SOUTHBRIDGE_INTEL_C216
	select SUPERIO_NUVOTON_NCT6776
	select USE_NATIVE_RAMINIT

config MAINBOARD_DIR
	default "asrock/b75m-itx"

config MAINBOARD_PART_NUMBER
	default "B75M-ITX"

endif
```

## src/mainboard/asrock/b75m-itx/Kconfig.name
```kconfig
## SPDX-License-Identifier: GPL-2.0-only

config BOARD_ASROCK_B75M_ITX
	bool "B75M-ITX"
```
