## src/mainboard/asrock/b75pro3-m/Kconfig
```kconfig
# SPDX-License-Identifier: GPL-2.0-only

if BOARD_ASROCK_B75PRO3_M

config BOARD_SPECIFIC_OPTIONS
	def_bool y
	select BOARD_ROMSIZE_KB_8192
	select DRIVERS_ASMEDIA_ASM1061
	select HAVE_ACPI_RESUME
	select HAVE_ACPI_TABLES
	select HAVE_CMOS_DEFAULT
	select HAVE_OPTION_TABLE
	select INTEL_GMA_HAVE_VBT
	select INTEL_INT15
	select MAINBOARD_HAS_LIBGFXINIT
	select NORTHBRIDGE_INTEL_SANDYBRIDGE
	select SERIRQ_CONTINUOUS_MODE
	select SOUTHBRIDGE_INTEL_C216
	select SUPERIO_NUVOTON_NCT6776
	select USE_NATIVE_RAMINIT

config MAINBOARD_DIR
	default "asrock/b75pro3-m"

config MAINBOARD_PART_NUMBER
	default "B75 Pro3-M"

endif
```

## src/mainboard/asrock/b85m_pro4/Kconfig
```kconfig
## SPDX-License-Identifier: GPL-2.0-or-later

if BOARD_ASROCK_B85M_PRO4

config BOARD_SPECIFIC_OPTIONS
	def_bool y
	select BOARD_ROMSIZE_KB_8192
	select HAVE_ACPI_RESUME
	select HAVE_ACPI_TABLES
	select HAVE_CMOS_DEFAULT
	select HAVE_OPTION_TABLE
	select INTEL_GMA_HAVE_VBT
	select MAINBOARD_HAS_LIBGFXINIT
	select MAINBOARD_USES_IFD_GBE_REGION
	select MEMORY_MAPPED_TPM
	select NORTHBRIDGE_INTEL_HASWELL
	select SERIRQ_CONTINUOUS_MODE
	select SOUTHBRIDGE_INTEL_LYNXPOINT
	select SUPERIO_NUVOTON_NCT6776

config CBFS_SIZE
	default 0x200000

config MAINBOARD_DIR
	default "asrock/b85m_pro4"

config MAINBOARD_PART_NUMBER
	default "B85M Pro4"

endif
```

## src/mainboard/asrock/e350m1/Kconfig
```kconfig
# SPDX-License-Identifier: GPL-2.0-only

if BOARD_ASROCK_E350M1

config BOARD_SPECIFIC_OPTIONS
	def_bool y
	select CPU_AMD_AGESA_FAMILY14
	select NORTHBRIDGE_AMD_AGESA_FAMILY14
	select SOUTHBRIDGE_AMD_CIMX_SB800
	select SUPERIO_NUVOTON_NCT5572D
	select SB_SUPERIO_HWM
	select HAVE_OPTION_TABLE
	select HAVE_PIRQ_TABLE
	select HAVE_ACPI_RESUME
	select HAVE_ACPI_TABLES
	select BOARD_ROMSIZE_KB_4096
	select GFXUMA

config MAINBOARD_DIR
	string
	default "asrock/e350m1"

config MAINBOARD_PART_NUMBER
	string
	default "E350M1"

config HW_MEM_HOLE_SIZEK
	hex
	default 0x200000

config MAX_CPUS
	int
	default 2

config IRQ_SLOT_COUNT
	int
	default 11

config ONBOARD_VGA_IS_PRIMARY
	bool
	default y

config VGA_BIOS_ID
	string
	default "1002,9802"

endif # BOARD_ASROCK_E350M1
```

## src/mainboard/asrock/fatal1ty_z87_professional/Kconfig
```kconfig
## SPDX-License-Identifier: GPL-2.0-only
if BOARD_ASROCK_FATAL1TY_Z87_PROFESSIONAL

config BOARD_SPECIFIC_OPTIONS
	def_bool y
	select BOARD_ROMSIZE_KB_8192
	select DRIVERS_ASMEDIA_ASPM_BLACKLIST
	select HAVE_ACPI_RESUME
	select HAVE_ACPI_TABLES
	select INTEL_GMA_HAVE_VBT
	select MAINBOARD_HAS_LIBGFXINIT
	select MAINBOARD_USES_IFD_GBE_REGION
	select NORTHBRIDGE_INTEL_HASWELL
	select SERIRQ_CONTINUOUS_MODE
	select SOUTHBRIDGE_INTEL_LYNXPOINT
	select SUPERIO_NUVOTON_NCT6776

config MAINBOARD_DIR
	default "asrock/fatal1ty_z87_professional"

config MAINBOARD_PART_NUMBER
	default "Fatal1ty Z87 Professional"

config USBDEBUG_HCD_INDEX
	default 2	# Headers:	USB45, USB3_6_7
endif
```

## src/mainboard/asrock/fatal1ty_z87_professional/Kconfig.name
```kconfig
## SPDX-License-Identifier: GPL-2.0-only
config BOARD_ASROCK_FATAL1TY_Z87_PROFESSIONAL
	bool "Fatal1ty Z87 Professional"
```

## src/mainboard/asrock/fatal1ty_z97x_killer/Kconfig
```kconfig
## SPDX-License-Identifier: GPL-2.0-only

if BOARD_ASROCK_FATAL1TY_Z97X_KILLER

config BOARD_SPECIFIC_OPTIONS
	def_bool y
	select BOARD_ROMSIZE_KB_8192
	select HAVE_ACPI_RESUME
	select HAVE_ACPI_TABLES
	select INTEL_GMA_HAVE_VBT
	select MAINBOARD_HAS_LIBGFXINIT
	select MEMORY_MAPPED_TPM
	select NORTHBRIDGE_INTEL_HASWELL
	select SERIRQ_CONTINUOUS_MODE
	select SOUTHBRIDGE_INTEL_LYNXPOINT
	select SUPERIO_NUVOTON_COMMON_COM_A
	select SUPERIO_NUVOTON_COMMON_HWM
	select SUPERIO_NUVOTON_NCT6791D
	select USE_BROADWELL_MRC if !USE_NATIVE_RAMINIT

config CBFS_SIZE
	default 0x600000

config MAINBOARD_DIR
	default "asrock/fatal1ty_z97x_killer"

config MAINBOARD_PART_NUMBER
	default "Fatal1ty Z97X Killer"

config USBDEBUG_HCD_INDEX
	default 2	# Rear:		USB3_0_1
			# Header:	USB4_5
endif
```

## src/mainboard/asrock/fatal1ty_z97x_killer/Kconfig.name
```kconfig
## SPDX-License-Identifier: GPL-2.0-only

config BOARD_ASROCK_FATAL1TY_Z97X_KILLER
	bool "Fatal1ty Z97X Killer"
```

## src/mainboard/asrock/g41c-gs/Kconfig
```kconfig
# SPDX-License-Identifier: GPL-2.0-only

if BOARD_ASROCK_G41C_GS || BOARD_ASROCK_G41C_GS_R2_0 || \
   BOARD_ASROCK_G41M_GS || BOARD_ASROCK_G41M_S3 || \
   BOARD_ASROCK_G41M_VS3_R2_0

config BOARD_SPECIFIC_OPTIONS
	def_bool y
	select AZALIA_USE_LEGACY_VERB_TABLE
	select CPU_INTEL_SOCKET_LGA775
	select NORTHBRIDGE_INTEL_X4X
	select SOUTHBRIDGE_INTEL_I82801GX
	select SUPERIO_NUVOTON_NCT6776 if BOARD_ASROCK_G41C_GS_R2_0
	select SUPERIO_WINBOND_W83627DHG if BOARD_ASROCK_G41C_GS \
		 || BOARD_ASROCK_G41M_GS || BOARD_ASROCK_G41M_S3 \
		 || BOARD_ASROCK_G41M_VS3_R2_0
	select HAVE_ACPI_TABLES
	select BOARD_ROMSIZE_KB_1024
	select HAVE_OPTION_TABLE
	select HAVE_CMOS_DEFAULT
	select HAVE_ACPI_RESUME
	select DRIVERS_I2C_CK505
	select INTEL_GMA_HAVE_VBT
	select MAINBOARD_HAS_LIBGFXINIT

config MAINBOARD_DIR
	default "asrock/g41c-gs"

config VARIANT_DIR
	default "g41c-gs-r2" if BOARD_ASROCK_G41C_GS_R2_0
	default "g41c-gs" if BOARD_ASROCK_G41C_GS
	default "g41m-gs" if BOARD_ASROCK_G41M_GS
	default "g41m-s3" if BOARD_ASROCK_G41M_S3
	default "g41m-vs3-r2" if BOARD_ASROCK_G41M_VS3_R2_0

config MAINBOARD_PART_NUMBER
	default "G41C-GS R2.0" if BOARD_ASROCK_G41C_GS_R2_0
	default "G41C-GS" if BOARD_ASROCK_G41C_GS
	default "G41M-GS" if BOARD_ASROCK_G41M_GS
	default "G41M-S3" if BOARD_ASROCK_G41M_S3
	default "G41M-VS3 R2.0" if BOARD_ASROCK_G41M_VS3_R2_0

config DEVICETREE
	default "variants/\$(CONFIG_VARIANT_DIR)/devicetree.cb"

# Override the default variant behavior, since the data.vbt is the same
config INTEL_GMA_VBT_FILE
	default "src/mainboard/\$(MAINBOARDDIR)/data.vbt"

endif # BOARD_ASROCK_G41*
```

## src/mainboard/asrock/g41c-gs/Kconfig.name
```kconfig
config BOARD_ASROCK_G41C_GS_R2_0
	bool "G41C-GS R2.0"

config BOARD_ASROCK_G41C_GS
	bool "G41C-GS / G41C-S"

config BOARD_ASROCK_G41M_GS
	bool "G41M-GS"

config BOARD_ASROCK_G41M_VS3_R2_0
	bool "G41M-VS3 R2.0"
```

## src/mainboard/asrock/h110m/Kconfig
```kconfig
if BOARD_ASROCK_H110M_DVS

config BOARD_SPECIFIC_OPTIONS
	def_bool y
	select BOARD_ROMSIZE_KB_8192
	select HAVE_ACPI_RESUME
	select HAVE_ACPI_TABLES
	select HAVE_OPTION_TABLE
	select HAVE_CMOS_DEFAULT
	select INTEL_GMA_HAVE_VBT
	select INTEL_INT15
	select SOC_INTEL_KABYLAKE
	select SKYLAKE_SOC_PCH_H
	select SUPERIO_NUVOTON_COMMON_COM_A
	select SUPERIO_NUVOTON_NCT6791D
	select REALTEK_8168_RESET
	select RT8168_SET_LED_MODE
	select MEMORY_MAPPED_TPM

config DISABLE_HECI1_AT_PRE_BOOT
	default y

config MAINBOARD_DIR
	default "asrock/h110m"

config MAINBOARD_PART_NUMBER
	default "H110M"

config PRERAM_CBMEM_CONSOLE_SIZE
	hex
	default 0xd00

config DIMM_SPD_SIZE
	default 512 #DDR4

endif
```

## src/mainboard/asrock/h110m/Kconfig.name
```kconfig
## SPDX-License-Identifier: GPL-2.0-only

config BOARD_ASROCK_H110M_DVS
	bool "H110M-DVS"
```

## src/mainboard/asrock/h77pro4-m/Kconfig
```kconfig
# SPDX-License-Identifier: GPL-2.0-or-later

if BOARD_ASROCK_H77PRO4_M

config BOARD_SPECIFIC_OPTIONS
	def_bool y
	select BOARD_ROMSIZE_KB_8192
	select DRIVERS_ASMEDIA_ASM1061
	select HAVE_ACPI_RESUME
	select HAVE_ACPI_TABLES
	select HAVE_CMOS_DEFAULT
	select HAVE_OPTION_TABLE
	select INTEL_GMA_HAVE_VBT
	select MAINBOARD_HAS_LIBGFXINIT
	select NORTHBRIDGE_INTEL_SANDYBRIDGE
	select SERIRQ_CONTINUOUS_MODE
	select SOUTHBRIDGE_INTEL_C216
	select SUPERIO_NUVOTON_NCT6776
	select USE_NATIVE_RAMINIT

config MAINBOARD_DIR
	default "asrock/h77pro4-m"

config MAINBOARD_PART_NUMBER
	default "H77 Pro4-M"

endif
```

## src/mainboard/asrock/h77pro4-m/Kconfig.name
```kconfig
## SPDX-License-Identifier: GPL-2.0-only

config BOARD_ASROCK_H77PRO4_M
	bool "H77 Pro4-M"
```

## src/mainboard/asrock/h81m-hds/Kconfig
```kconfig
## SPDX-License-Identifier: GPL-2.0-or-later

if BOARD_ASROCK_H81M_HDS

config BOARD_SPECIFIC_OPTIONS
	def_bool y
	select BOARD_ROMSIZE_KB_4096
	select HAVE_ACPI_RESUME
	select HAVE_ACPI_TABLES
	select HAVE_CMOS_DEFAULT
	select HAVE_OPTION_TABLE
	select INTEL_GMA_HAVE_VBT
	select INTEL_INT15
	select MAINBOARD_HAS_LIBGFXINIT
	select NORTHBRIDGE_INTEL_HASWELL
	select REALTEK_8168_RESET
	select RT8168_SET_LED_MODE
	select SERIRQ_CONTINUOUS_MODE
	select SOUTHBRIDGE_INTEL_LYNXPOINT
	select SUPERIO_NUVOTON_COMMON_COM_A
	select SUPERIO_NUVOTON_NCT6776

config CBFS_SIZE
	default 0x200000

config MAINBOARD_DIR
	default "asrock/h81m-hds"

config MAINBOARD_PART_NUMBER
	default "H81M-HDS"

endif
```

## src/mainboard/asrock/h81m-hds/Kconfig.name
```kconfig
## SPDX-License-Identifier: GPL-2.0-only

config BOARD_ASROCK_H81M_HDS
	bool "H81M-HDS"
```

## src/mainboard/asrock/imb-1222/Kconfig
```kconfig
## SPDX-License-Identifier: GPL-2.0-or-later

if BOARD_ASROCK_IMB_1222

config BOARD_SPECIFIC_OPTIONS
	def_bool y
	select AZALIA_USE_LEGACY_VERB_TABLE
	select BOARD_ROMSIZE_KB_32768
	select HAVE_ACPI_RESUME
	select HAVE_ACPI_TABLES
	select HAVE_CMOS_DEFAULT
	select HAVE_OPTION_TABLE
	select MAINBOARD_HAS_LIBGFXINIT
	select MAINBOARD_USES_IFD_GBE_REGION
	select MEMORY_MAPPED_TPM
	select INTEL_GMA_HAVE_VBT
	select INTEL_INT15
	select SOC_INTEL_CANNONLAKE_PCH_H
	select SOC_INTEL_COMETLAKE_S
	select SOC_INTEL_COMMON_BLOCK_HDA_VERB
	select SPD_READ_BY_WORD
	select SUPERIO_FINTEK_COMMON_PRE_RAM

config MAINBOARD_DIR
	default "asrock/imb-1222"

config MAINBOARD_PART_NUMBER
	default "imb-1222"

config MAINBOARD_SMBIOS_PRODUCT_NAME
	default "Asrock"

config MAINBOARD_VERSION
	default "imb-1222"

config CBFS_SIZE
	default 0xc00000

config CONSOLE_POST
	default y

config DIMM_MAX
	default 2

config POST_DEVICE
	default n

config BEEP_ON_BOOT
	bool "Beep on successful boot"
	default y
	help
	  Make the platform beep using the PC speaker in final coreboot phase.
	  May serve as a useful indicator in headless mode that platform is
	  properly booting.

config BEEP_ON_PANIC
	bool "Beep on panic"
	default y
	help
	  Beep when encountered a fatal error.

endif
```

## src/mainboard/asrock/imb-1222/Kconfig.name
```kconfig
## SPDX-License-Identifier: GPL-2.0-or-later

config BOARD_ASROCK_IMB_1222
	bool "IMB-1222"
```

## src/mainboard/asrock/imb-a180/Kconfig
```kconfig
# SPDX-License-Identifier: GPL-2.0-only

if BOARD_ASROCK_IMB_A180

config BOARD_SPECIFIC_OPTIONS
	def_bool y
	select CPU_AMD_AGESA_FAMILY16_KB
	select NORTHBRIDGE_AMD_AGESA_FAMILY16_KB
	select SOUTHBRIDGE_AMD_AGESA_YANGTZE
	select DEFAULT_POST_ON_LPC
	select SUPERIO_WINBOND_W83627UHG
	select HAVE_OPTION_TABLE
	select HAVE_PIRQ_TABLE
	select HAVE_ACPI_RESUME
	select HAVE_ACPI_TABLES
	select BOARD_ROMSIZE_KB_4096
	select GFXUMA

config MAINBOARD_DIR
	string
	default "asrock/imb-a180"

config MAINBOARD_PART_NUMBER
	string
	default "IMB-A180"

config HW_MEM_HOLE_SIZEK
	hex
	default 0x200000

config MAX_CPUS
	int
	default 4

config IRQ_SLOT_COUNT
	int
	default 11

config ONBOARD_VGA_IS_PRIMARY
	bool
	default y

config HUDSON_LEGACY_FREE
	bool
	default y

# bit 1,0 - pin 0
# bit 3,2 - pin 1
# bit 5,4 - pin 2
# bit 7,6 - pin 3
config AZ_PIN
	hex
	default 0x2

endif # BOARD_ASROCK_IMB_A180
```

## src/mainboard/asrock/p4i65gv/Kconfig
```kconfig
##
## This file is part of the coreboot project.
##
## Copyright (C) 2009 Uwe Hermann <uwe@hermann-uwe.de>
##
## This program is free software; you can redistribute it and/or modify it under the terms of the GNU General 
## Public License as published by the Free Software Foundation; version 2 of the License.
##
## This program is distributed in the hope that it will be useful, but WITHOUT ANY WARRANTY; without even the 
## implied warranty of MERCHANTABILITY or FITNESS FOR A PARTICULAR PURPOSE.  See the GNU General Public License 
## for more details.
##
## You should have received a copy of the GNU General Public License along with this program; if not, write to 
## the Free Software Foundation, Inc., 51 Franklin St, Fifth Floor, Boston, MA 02110-1301 USA
##
if BOARD_ASROCK_P4I65GV

config BOARD_SPECIFIC_OPTIONS # dummy
	def_bool y
	select ARCH_X86
	select CPU_INTEL_SOCKET_MPGA478
	select NORTHBRIDGE_INTEL_I865
	select SOUTHBRIDGE_INTEL_I82801EX
	select SUPERIO_WINBOND_W83627HF
	select HAVE_HARD_RESET
#	select HAVE_PIRQ_TABLE
	select UDELAY_TSC
	select BOARD_ROMSIZE_KB_512
	select USE_WATCHDOG_ON_BOOT
#	select HAVE_ACPI_TABLES
#	select CACHE_AS_RAM # inherited from the socket option

config MAINBOARD_DIR
	string
	default asrock/p4i65gv

config MAINBOARD_PART_NUMBER
	string
	default "P4i65GV"

config DCACHE_RAM_BASE
	hex
	default 0xfff00000

config DCACHE_RAM_SIZE
	hex
	default 0x8000 # ok?

config IRQ_SLOT_COUNT
	int
	default 6 # no idea

endif # BOARD_ASROCK_P4I65GV
```

## src/mainboard/asrock/spc741d8/Kconfig
```kconfig
if BOARD_ASROCK_SPC741D8

config BOARD_SPECIFIC_OPTIONS
	def_bool y
	select BOARD_ROMSIZE_KB_65536
	select IPMI_KCS
	select IPMI_KCS_ROMSTAGE
	select IPMI_OCP
	select MEMORY_MAPPED_TPM
	select MAINBOARD_HAS_TPM2
	select PLATFORM_USES_FSP2_X86_32
	select SOC_INTEL_SAPPHIRERAPIDS_SP
	select SUPERIO_ASPEED_AST2400
	select DRIVERS_ASPEED_AST2050
	select SUPERIO_NUVOTON_NCT6791D
	select HAVE_ACPI_TABLES
	select OCP_EWL
	select HAVE_INTEL_FSP_REPO
	select HAVE_X86_64_SUPPORT
	select PAGE_TABLES_IN_CBFS

config MAINBOARD_DIR
	default "asrock/spc741d8"

config MAINBOARD_PART_NUMBER
	default "SPC741D8-2L2T/BCM"

config FMDFILE
	string
	default "src/mainboard/\$(CONFIG_MAINBOARD_DIR)/board.fmd"

config FSP_FD_PATH
	default "3rdparty/fsp/EagleStreamFspBinPkg/Fsp.fd"

config MAX_SOCKET
	int
	default 1

endif
```
