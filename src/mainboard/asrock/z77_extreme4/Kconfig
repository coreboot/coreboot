## src/mainboard/asrock/z77_extreme4/Kconfig
```kconfig
# SPDX-License-Identifier: GPL-2.0-only

if BOARD_ASROCK_Z77_EXTREME4

config BOARD_SPECIFIC_OPTIONS
	def_bool y
	select BOARD_ROMSIZE_KB_8192
	select DRIVERS_ASMEDIA_ASM1061
	select HAVE_ACPI_RESUME
	select HAVE_ACPI_TABLES
	select HAVE_CMOS_DEFAULT
	select HAVE_OPTION_TABLE
	select INTEL_GMA_HAVE_VBT
	select INTEL_INT15
	select MAINBOARD_HAS_LIBGFXINIT
	select NORTHBRIDGE_INTEL_SANDYBRIDGE
	select SERIRQ_CONTINUOUS_MODE
	select SOUTHBRIDGE_INTEL_C216
	select SUPERIO_NUVOTON_COMMON_COM_A
	select SUPERIO_NUVOTON_NCT6776
	select USE_NATIVE_RAMINIT

config CBFS_SIZE
	default 0x600000

config MAINBOARD_DIR
	default "asrock/z77_extreme4"

config MAINBOARD_PART_NUMBER
	default "Z77 Extreme4"

endif
```

## src/mainboard/asrock/z77_extreme4/Kconfig.name
```kconfig
## SPDX-License-Identifier: GPL-2.0-only

config BOARD_ASROCK_Z77_EXTREME4
	bool "Z77 Extreme4"
```

## src/mainboard/asrock/z87_extreme3/Kconfig
```kconfig
## SPDX-License-Identifier: GPL-2.0-only

if BOARD_ASROCK_Z87_EXTREME3

config BOARD_SPECIFIC_OPTIONS
	def_bool y
	select BOARD_ROMSIZE_KB_8192
	select HAVE_ACPI_RESUME
	select HAVE_ACPI_TABLES
	select INTEL_GMA_HAVE_VBT
	select MAINBOARD_HAS_LIBGFXINIT
	select MAINBOARD_USES_IFD_GBE_REGION
	select NORTHBRIDGE_INTEL_HASWELL
	select SERIRQ_CONTINUOUS_MODE
	select SOUTHBRIDGE_INTEL_LYNXPOINT
	select SUPERIO_NUVOTON_NCT6776

config MAINBOARD_DIR
	default "asrock/z87_extreme3"

config MAINBOARD_PART_NUMBER
	default "Z87 Extreme3"

config USBDEBUG_HCD_INDEX
	default 2	# Rear:		USB3_0_1 (Upper)
			# Header:	USB2_3
endif
```

## src/mainboard/asrock/z87_extreme3/Kconfig.name
```kconfig
## SPDX-License-Identifier: GPL-2.0-only

config BOARD_ASROCK_Z87_EXTREME3
	bool "Z87 Extreme3"
```

## src/mainboard/asrock/z87_extreme4/Kconfig
```kconfig
## SPDX-License-Identifier: GPL-2.0-only

if BOARD_ASROCK_Z87_EXTREME4

config BOARD_SPECIFIC_OPTIONS
	def_bool y
	select AZALIA_USE_LEGACY_VERB_TABLE
	select BOARD_ROMSIZE_KB_8192
	select DRIVERS_ASMEDIA_ASM1061
	select HAVE_ACPI_RESUME
	select HAVE_ACPI_TABLES
	select INTEL_GMA_HAVE_VBT
	select MAINBOARD_HAS_LIBGFXINIT
	select MAINBOARD_USES_IFD_GBE_REGION
	select NORTHBRIDGE_INTEL_HASWELL
	select SERIRQ_CONTINUOUS_MODE
	select SOUTHBRIDGE_INTEL_LYNXPOINT
	select SUPERIO_NUVOTON_NCT6776

config MAINBOARD_DIR
	default "asrock/z87_extreme4"

config MAINBOARD_PART_NUMBER
	default "Z87 Extreme4"

config USBDEBUG_HCD_INDEX
	default 2	# Rear:		USB3_23 (Upper)
			# Header:	USB2_3
endif
```

## src/mainboard/asrock/z87_extreme4/Kconfig.name
```kconfig
## SPDX-License-Identifier: GPL-2.0-only

config BOARD_ASROCK_Z87_EXTREME4
	bool "Z87 Extreme4"
```

## src/mainboard/asrock/z87_extreme6/Kconfig
```kconfig
## SPDX-License-Identifier: GPL-2.0-only

if BOARD_ASROCK_Z87_EXTREME6

config BOARD_SPECIFIC_OPTIONS
	def_bool y
	select BOARD_ROMSIZE_KB_8192
	select DRIVERS_ASMEDIA_ASM1061
	select GFX_GMA_ANALOG_I2C_HDMI_B
	select HAVE_ACPI_RESUME
	select HAVE_ACPI_TABLES
	select INTEL_GMA_HAVE_VBT
	select MAINBOARD_HAS_LIBGFXINIT
	select MAINBOARD_USES_IFD_GBE_REGION
	select NORTHBRIDGE_INTEL_HASWELL
	select SERIRQ_CONTINUOUS_MODE
	select SOUTHBRIDGE_INTEL_LYNXPOINT
	select SUPERIO_NUVOTON_NCT6776

config MAINBOARD_DIR
	default "asrock/z87_extreme6"

config MAINBOARD_PART_NUMBER
	default "Z87 Extreme6"

config USBDEBUG_HCD_INDEX
	default 2	# Header1:	USB2_3
			# Header2:	USB3_6_7
endif
```

## src/mainboard/asrock/z87_extreme6/Kconfig.name
```kconfig
## SPDX-License-Identifier: GPL-2.0-only

config BOARD_ASROCK_Z87_EXTREME6
	bool "Z87 Extreme6"
```

## src/mainboard/asrock/z87_pro4/Kconfig.name
```kconfig
## SPDX-License-Identifier: GPL-2.0-only

config BOARD_ASROCK_Z87_PRO4
	bool "Z87 Pro4"
```

## src/mainboard/asrock/z87e-itx/Kconfig
```kconfig
## SPDX-License-Identifier: GPL-2.0-or-later

if BOARD_ASROCK_Z87E_ITX

config BOARD_SPECIFIC_OPTIONS
	def_bool y
	select AZALIA_USE_LEGACY_VERB_TABLE
	select BOARD_ROMSIZE_KB_8192
	select GFX_GMA_ANALOG_I2C_HDMI_B
	select HAVE_ACPI_RESUME
	select HAVE_ACPI_TABLES
	select INTEL_GMA_HAVE_VBT
	select MAINBOARD_HAS_LIBGFXINIT
	select MAINBOARD_USES_IFD_GBE_REGION
	select NORTHBRIDGE_INTEL_HASWELL
	select SERIRQ_CONTINUOUS_MODE
	select SOUTHBRIDGE_INTEL_LYNXPOINT
	select SUPERIO_NUVOTON_NCT6776

config MAINBOARD_DIR
	default "asrock/z87e-itx"

config MAINBOARD_PART_NUMBER
	default "Z87E-ITX"

config USBDEBUG_HCD_INDEX
	default 1 # This is the top most of the USB-2.0-only ports
endif
```

## src/mainboard/asrock/z87e-itx/Kconfig.name
```kconfig
## SPDX-License-Identifier: GPL-2.0-or-later

config BOARD_ASROCK_Z87E_ITX
	bool "Z87E-ITX"
```

## src/mainboard/asrock/z87m_extreme4/Kconfig
```kconfig
## SPDX-License-Identifier: GPL-2.0-only

if BOARD_ASROCK_Z87M_EXTREME4

config BOARD_SPECIFIC_OPTIONS
	def_bool y
	select BOARD_ROMSIZE_KB_8192
	select HAVE_ACPI_RESUME
	select HAVE_ACPI_TABLES
	select INTEL_GMA_HAVE_VBT
	select MAINBOARD_HAS_LIBGFXINIT
	select MAINBOARD_USES_IFD_GBE_REGION
	select NORTHBRIDGE_INTEL_HASWELL
	select SERIRQ_CONTINUOUS_MODE
	select SOUTHBRIDGE_INTEL_LYNXPOINT
	select SUPERIO_NUVOTON_NCT6776

config MAINBOARD_DIR
	default "asrock/z87m_extreme4"

config MAINBOARD_PART_NUMBER
	default "Z87M Extreme4"

config USBDEBUG_HCD_INDEX
	default 2	# Rear:		LAN_USB3_23 (Upper)
			# Header:	USB4_5
endif
```

## src/mainboard/asrock/z87m_extreme4/Kconfig.name
```kconfig
## SPDX-License-Identifier: GPL-2.0-only

config BOARD_ASROCK_Z87M_EXTREME4
	bool "Z87M Extreme4"
```

## src/mainboard/asrock/z87m_oc_formula/Kconfig
```kconfig
# SPDX-License-Identifier: GPL-2.0-or-later

if BOARD_ASROCK_Z87M_OC_FORMULA

config BOARD_SPECIFIC_OPTIONS
	def_bool y
	select BOARD_ROMSIZE_KB_8192
	select HAVE_ACPI_RESUME
	select HAVE_ACPI_TABLES
	select INTEL_GMA_HAVE_VBT
	select MAINBOARD_HAS_LIBGFXINIT
	select MAINBOARD_USES_IFD_GBE_REGION
	select NORTHBRIDGE_INTEL_HASWELL
	select SERIRQ_CONTINUOUS_MODE
	select SOUTHBRIDGE_INTEL_LYNXPOINT
	select SUPERIO_NUVOTON_NCT6776

config MAINBOARD_DIR
	default "asrock/z87m_oc_formula"

config MAINBOARD_PART_NUMBER
	default "Z87M OC Formula"

config USBDEBUG_HCD_INDEX
	default 1 # This is the top-most of the two USB-3.0-Ports beneath the RJ45 jack.
endif
```

## src/mainboard/asrock/z87m_oc_formula/Kconfig.name
```kconfig
# SPDX-License-Identifier: GPL-2.0-or-later

config BOARD_ASROCK_Z87M_OC_FORMULA
	bool "Z87M OC Formula"
```

## src/mainboard/asrock/z97_extreme6/Kconfig
```kconfig
## SPDX-License-Identifier: GPL-2.0-or-later

if BOARD_ASROCK_Z97_EXTREME6

config BOARD_SPECIFIC_OPTIONS
	def_bool y
	select BOARD_ROMSIZE_KB_8192
	select HAVE_ACPI_RESUME
	select HAVE_ACPI_TABLES
	select INTEL_GMA_HAVE_VBT
	select MAINBOARD_HAS_LIBGFXINIT
	select MAINBOARD_USES_IFD_GBE_REGION
	select MEMORY_MAPPED_TPM
	select NORTHBRIDGE_INTEL_HASWELL
	select SERIRQ_CONTINUOUS_MODE
	select SOUTHBRIDGE_INTEL_LYNXPOINT
	select SUPERIO_NUVOTON_NCT6791D
	select USE_BROADWELL_MRC if !USE_NATIVE_RAMINIT

config CBFS_SIZE
	default 0x200000

config MAINBOARD_DIR
	default "asrock/z97_extreme6"

config MAINBOARD_PART_NUMBER
	default "Z97 Extreme6"

endif
```

## src/mainboard/asrock/z97_extreme6/Kconfig.name
```kconfig
## SPDX-License-Identifier: GPL-2.0-or-later

config BOARD_ASROCK_Z97_EXTREME6
	bool "Z97 Extreme6"
```

## src/mainboard/asrock/z97e-itx_ac/Kconfig
```kconfig
## SPDX-License-Identifier: GPL-2.0-or-later
if BOARD_ASROCK_Z97E_ITX_AC

config BOARD_SPECIFIC_OPTIONS
	def_bool y
	select BOARD_ROMSIZE_KB_8192
	select GFX_GMA_ANALOG_I2C_HDMI_B
	select HAVE_ACPI_RESUME
	select HAVE_ACPI_TABLES
	select INTEL_GMA_HAVE_VBT
	select MAINBOARD_HAS_LIBGFXINIT
	select MAINBOARD_USES_IFD_GBE_REGION
	select NORTHBRIDGE_INTEL_HASWELL
	select SERIRQ_CONTINUOUS_MODE
	select SOUTHBRIDGE_INTEL_LYNXPOINT
	select SUPERIO_NUVOTON_NCT6776
	select USE_BROADWELL_MRC if !USE_NATIVE_RAMINIT

config MAINBOARD_DIR
	default "asrock/z97e-itx_ac"

config MAINBOARD_PART_NUMBER
	default "Z97E-ITX/ac"

config USBDEBUG_HCD_INDEX # This is the top-most of the USB-2.0-Ports above the PS/2 port.
	default 1
endif
```

## src/mainboard/asrock/z97e-itx_ac/Kconfig.name
```kconfig
## SPDX-License-Identifier: GPL-2.0-or-later

config BOARD_ASROCK_Z97E_ITX_AC
	bool "Z97E-ITX/ac"
```

## src/mainboard/asus/Kconfig
```kconfig
## SPDX-License-Identifier: GPL-2.0-only

if VENDOR_ASUS

choice
	prompt "Mainboard model"

source "src/mainboard/asus/*/Kconfig.name"

endchoice

source "src/mainboard/asus/*/Kconfig"

config MAINBOARD_VENDOR
	default "ASUS"

endif # VENDOR_ASUS
```

## src/mainboard/asus/a88xm-e/Kconfig
```kconfig
# SPDX-License-Identifier: GPL-2.0-only

if BOARD_ASUS_A88XM_E

config BOARD_SPECIFIC_OPTIONS
	def_bool y
	select CPU_AMD_AGESA_FAMILY15_TN
	select NORTHBRIDGE_AMD_AGESA_FAMILY15_TN
	select SOUTHBRIDGE_AMD_AGESA_HUDSON
	select HAVE_OPTION_TABLE
	select HAVE_PIRQ_TABLE
	select HAVE_MP_TABLE
	select HAVE_ACPI_RESUME
	select HAVE_ACPI_TABLES
	select SUPERIO_ITE_IT8728F
	select BOARD_ROMSIZE_KB_8192
	select GFXUMA

config MAINBOARD_DIR
	string
	default "asus/a88xm-e"

config MAINBOARD_PART_NUMBER
	string
	default "A88XM-E"

config HW_MEM_HOLE_SIZEK
	hex
	default 0x200000

config MAX_CPUS
	int
	default 4

config HUDSON_XHCI_FWM
	bool
	default n

config HUDSON_IMC_FWM
	bool
	default n

config IRQ_SLOT_COUNT
	int
	default 11

config VGA_BIOS_ID
	string
	default "1002,990e"

config HUDSON_XHCI_ENABLE
	bool
	default n

config HUDSON_LEGACY_FREE
	bool
	default n

endif # BOARD_ASUS_A88XM_E
```

## src/mainboard/asus/a8n_e/Kconfig
```kconfig
if BOARD_ASUS_A8N_E || BOARD_ASUS_A8N_SLI

config BOARD_SPECIFIC_OPTIONS # dummy
	def_bool y
	select CPU_AMD_SOCKET_939
	select NORTHBRIDGE_AMD_AMDK8
	select SOUTHBRIDGE_NVIDIA_CK804
	select HT_CHAIN_DISTRIBUTE
	select SUPERIO_ITE_IT8712F
	select HAVE_OPTION_TABLE
	select HAVE_CMOS_DEFAULT
	select HAVE_PIRQ_TABLE
	select HAVE_MP_TABLE
	select BOARD_ROMSIZE_KB_512
	select CK804_USE_NIC
	select CK804_USE_ACI
	select QRANK_DIMM_SUPPORT
	select HAVE_ACPI_TABLES

config MAINBOARD_DIR
	string
	default asus/a8n_e

config DCACHE_RAM_BASE
	hex
	default 0xcf000

config DCACHE_RAM_SIZE
	hex
	default 0x01000

config APIC_ID_OFFSET
	hex
	default 0x0

if BOARD_ASUS_A8N_E
config MAINBOARD_PART_NUMBER
	string
	default "A8N-E"
endif

config MAX_CPUS
	int
	default 2

config MAX_PHYSICAL_CPUS
	int
	default 1

config HT_CHAIN_END_UNITID_BASE
	hex
	default 0x20

config HT_CHAIN_UNITID_BASE
	hex
	default 0x0

config IRQ_SLOT_COUNT
	int
	default 13

endif # BOARD_ASUS_A8N_E
```
