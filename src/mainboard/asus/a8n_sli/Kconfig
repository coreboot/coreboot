## src/mainboard/asus/a8n_sli/Kconfig
```kconfig
if BOARD_ASUS_A8N_SLI

# Dummy for abuild

config MAINBOARD_PART_NUMBER
	string
	default "A8N-SLI"

endif
```

## src/mainboard/asus/a8v-e_se/Kconfig
```kconfig
if BOARD_ASUS_A8V_E_SE

config BOARD_SPECIFIC_OPTIONS # dummy
	def_bool y
	select ARCH_X86
	select CPU_AMD_SOCKET_939
	select K8_HT_FREQ_1G_SUPPORT
	select NORTHBRIDGE_AMD_AMDK8
	select SOUTHBRIDGE_VIA_VT8237R
	select SOUTHBRIDGE_VIA_K8T890
	select SOUTHBRIDGE_VIA_SUBTYPE_K8T890
	select SUPERIO_WINBOND_W83627EHG
	select HAVE_OPTION_TABLE
	select HAVE_ACPI_TABLES
	select HAVE_MP_TABLE
	select BOARD_ROMSIZE_KB_512
	select RAMINIT_SYSINFO
	select QRANK_DIMM_SUPPORT
	select SET_FIDVID

config MAINBOARD_DIR
	string
	default asus/a8v-e_se

config DCACHE_RAM_BASE
	hex
	default 0xcc000

config DCACHE_RAM_SIZE
	hex
	default 0x4000

config APIC_ID_OFFSET
	hex
	default 0x10

config SB_HT_CHAIN_ON_BUS0
	int
	default 1

config MAINBOARD_PART_NUMBER
	string
	default "A8V-E SE"

config HW_MEM_HOLE_SIZEK
	hex
	default 0

config MAX_CPUS
	int
	default 2

config MAX_PHYSICAL_CPUS
	int
	default 1

config HEAP_SIZE
	hex
	default 0x40000

config HT_CHAIN_END_UNITID_BASE
	hex
	default 0x20

config HT_CHAIN_UNITID_BASE
	hex
	default 0x0

endif # BOARD_ASUS_A8V_E_SE
```

## src/mainboard/asus/am1i-a/Kconfig
```kconfig
if BOARD_ASUS_AM1I_A

config IGNORE_IASL_MISSING_DEPENDENCY
	def_bool y

config BOARD_SPECIFIC_OPTIONS
	def_bool y
	select BOARD_ROMSIZE_KB_8192
	select CPU_AMD_AGESA_FAMILY16_KB
	select FORCE_AM1_SOCKET_SUPPORT
	select GFXUMA
	select HAVE_OPTION_TABLE
	select HAVE_CMOS_DEFAULT
	select HAVE_PIRQ_TABLE
	select HAVE_ACPI_RESUME
	select HAVE_ACPI_TABLES
	select NORTHBRIDGE_AMD_AGESA_FAMILY16_KB
	select SOUTHBRIDGE_AMD_AGESA_YANGTZE
	select DEFAULT_POST_ON_LPC
	select SUPERIO_ITE_IT8623E
	select MEMORY_MAPPED_TPM

config MAINBOARD_DIR
	default "asus/am1i-a"

config MAINBOARD_PART_NUMBER
	default "AM1I-A"

config HW_MEM_HOLE_SIZEK
	hex
	default 0x200000

config MAX_CPUS
	int
	default 4

config IRQ_SLOT_COUNT
	int
	default 10

config ONBOARD_VGA_IS_PRIMARY
	bool
	default y

config HUDSON_LEGACY_FREE
	bool
	default n

config HUDSON_IMC_FWM
	bool
	default n

endif # BOARD_ASUS_AM1I_A
```

## src/mainboard/asus/b85m-e/Kconfig
```kconfig
## SPDX-License-Identifier: GPL-2.0-only

if BOARD_ASUS_B85M_E

config BOARD_SPECIFIC_OPTIONS
	def_bool y
	select BOARD_ROMSIZE_KB_16384
	select HAVE_ACPI_RESUME
	select HAVE_ACPI_TABLES
	select INTEL_GMA_HAVE_VBT
	select MAINBOARD_HAS_LIBGFXINIT
	select MAINBOARD_USES_IFD_GBE_REGION
	select MEMORY_MAPPED_TPM
	select NORTHBRIDGE_INTEL_HASWELL
	select SERIRQ_CONTINUOUS_MODE
	select SOUTHBRIDGE_INTEL_LYNXPOINT
	select SUPERIO_NUVOTON_COMMON_COM_A
	select SUPERIO_NUVOTON_NCT6791D

config CBFS_SIZE
	default 0xB00000

config MAINBOARD_DIR
	default "asus/b85m-e"

config MAINBOARD_PART_NUMBER
	default "B85M-E"

config USBDEBUG_HCD_INDEX
	default 2	# Rear:		LAN_USB910 (bottom)
			# Header:	USB3_12
endif
```

## src/mainboard/asus/b85m-e/Kconfig.name
```kconfig
## SPDX-License-Identifier: GPL-2.0-only

config BOARD_ASUS_B85M_E
	bool "B85M-E"
```

## src/mainboard/asus/f2a85-m/Kconfig
```kconfig
# SPDX-License-Identifier: GPL-2.0-only

if BOARD_ASUS_F2A85_M || BOARD_ASUS_F2A85_M_PRO || BOARD_ASUS_F2A85_M_LE

config BOARD_SPECIFIC_OPTIONS
	def_bool y
	select CPU_AMD_AGESA_FAMILY15_TN
	select NORTHBRIDGE_AMD_AGESA_FAMILY15_TN
	select SOUTHBRIDGE_AMD_AGESA_HUDSON
	select HAVE_OPTION_TABLE
	select HAVE_PIRQ_TABLE
	select HAVE_ACPI_RESUME
	select HAVE_ACPI_TABLES
	select SUPERIO_ITE_IT8728F if BOARD_ASUS_F2A85_M || BOARD_ASUS_F2A85_M_LE
	select SUPERIO_NUVOTON_NCT6779D if BOARD_ASUS_F2A85_M_PRO
	select SUPERIO_NUVOTON_COMMON_COM_A if BOARD_ASUS_F2A85_M_PRO
	select BOARD_ROMSIZE_KB_8192
	select GFXUMA

choice
	prompt "DDR3 memory voltage"
	default BOARD_ASUS_F2A85_M_DDR3_VOLT_150

config BOARD_ASUS_F2A85_M_DDR3_VOLT_135
	bool "1.35V"
	help
	  Set DRR3 memory voltage to 1.35V
config BOARD_ASUS_F2A85_M_DDR3_VOLT_150
	bool "1.50V"
	help
	  Set DRR3 memory voltage to 1.50V
config BOARD_ASUS_F2A85_M_DDR3_VOLT_165
	bool "1.65V"
	help
	  Set DRR3 memory voltage to 1.65V
endchoice

config BOARD_ASUS_F2A85_M_DDR3_VOLT_VAL
	hex
	default 0x9e if BOARD_ASUS_F2A85_M_DDR3_VOLT_135
	default 0x0 if BOARD_ASUS_F2A85_M_DDR3_VOLT_150
	default 0x1e if BOARD_ASUS_F2A85_M_DDR3_VOLT_165

config MAINBOARD_DIR
	string
	default "asus/f2a85-m"

config MAINBOARD_PART_NUMBER
	string
	default "F2A85-M" if BOARD_ASUS_F2A85_M
	default "F2A85-M_LE" if BOARD_ASUS_F2A85_M_LE
	default "F2A85-M_PRO" if BOARD_ASUS_F2A85_M_PRO

config HW_MEM_HOLE_SIZEK
	hex
	default 0x200000

config MAX_CPUS
	int
	default 4

config HUDSON_XHCI_FWM
	bool
	default n

config HUDSON_IMC_FWM
	bool
	default n

config IRQ_SLOT_COUNT
	int
	default 11

config ONBOARD_VGA_IS_PRIMARY
	bool
	default y

if BOARD_ASUS_F2A85_M || BOARD_ASUS_F2A85_M_PRO

config VGA_BIOS_ID
	string
	default "1002,9993"

config HUDSON_LEGACY_FREE
	bool
	default n

config POST_IO
	bool
	default n

endif # BOARD_ASUS_F2A85_M || BOARD_ASUS_F2A85_M_PRO

if BOARD_ASUS_F2A85_M_LE

config VGA_BIOS_ID
	string
	default "1002,9901"

config VGA_BIOS_FILE
	string
	default "pci1002,9901.rom"

endif

config DEVICETREE
	string
	default "devicetree_f2a85-m_pro.cb" if BOARD_ASUS_F2A85_M_PRO
	default "devicetree_f2a85-m.cb" if BOARD_ASUS_F2A85_M
	default "devicetree_f2a85-m_le.cb" if BOARD_ASUS_F2A85_M_LE

endif # BOARD_ASUS_F2A85_M || BOARD_ASUS_F2A85_M_PRO || BOARD_ASUS_F2A85_M_LE
```

## src/mainboard/asus/f2a85-m/Kconfig.name
```kconfig
config BOARD_ASUS_F2A85_M
	bool "F2A85-M"

config BOARD_ASUS_F2A85_M_PRO
	bool "F2A85-M PRO"

config BOARD_ASUS_F2A85_M_LE
	bool "F2A85-M LE"
```

## src/mainboard/asus/h61-series/Kconfig
```kconfig
## SPDX-License-Identifier: GPL-2.0-only

config BOARD_ASUS_H61_SERIES
	bool
	select HAVE_ACPI_RESUME
	select HAVE_ACPI_TABLES
	select INTEL_GMA_HAVE_VBT
	select INTEL_INT15
	select MAINBOARD_HAS_LIBGFXINIT
	select NORTHBRIDGE_INTEL_SANDYBRIDGE
	select SERIRQ_CONTINUOUS_MODE
	select SOUTHBRIDGE_INTEL_BD82X6X
	select USE_NATIVE_RAMINIT

config BOARD_ASUS_H61M_A_USB3
	select BOARD_ASUS_H61_SERIES
	select BOARD_ROMSIZE_KB_8192
	select HAVE_CMOS_DEFAULT
	select HAVE_OPTION_TABLE
	select NO_UART_ON_SUPERIO
	select REALTEK_8168_RESET
	select RT8168_SET_LED_MODE
	select SUPERIO_NUVOTON_NCT6779D

config BOARD_ASUS_H61M_CS
	select BOARD_ASUS_H61_SERIES
	select BOARD_ROMSIZE_KB_8192
	select HAVE_CMOS_DEFAULT
	select HAVE_OPTION_TABLE
	select NO_UART_ON_SUPERIO
	select SUPERIO_NUVOTON_NCT6779D

config BOARD_ASUS_P8H61_M_LX
	select BOARD_ASUS_H61_SERIES
	select BOARD_ROMSIZE_KB_4096
	select HAVE_CMOS_DEFAULT
	select HAVE_OPTION_TABLE
	select REALTEK_8168_RESET
	select RT8168_SET_LED_MODE
	select SUPERIO_NUVOTON_COMMON_COM_A
	select SUPERIO_NUVOTON_NCT6776

config BOARD_ASUS_P8H61_M_LX3_R2_0
	select BOARD_ASUS_H61_SERIES
	select BOARD_ROMSIZE_KB_8192
	select NO_UART_ON_SUPERIO
	select REALTEK_8168_RESET
	select RT8168_SET_LED_MODE
	select SUPERIO_NUVOTON_NCT6779D

config BOARD_ASUS_P8H61_M_PRO
	select BOARD_ASUS_H61_SERIES
	select BOARD_ROMSIZE_KB_4096
	select DRIVERS_ASMEDIA_ASM1061
	select HAVE_CMOS_DEFAULT
	select HAVE_OPTION_TABLE
	select MEMORY_MAPPED_TPM
	select REALTEK_8168_RESET
	select RT8168_SET_LED_MODE
	select SUPERIO_NUVOTON_NCT6776

config BOARD_ASUS_P8H61_M_PRO_CM6630
	select BOARD_ASUS_H61_SERIES
	select BOARD_ROMSIZE_KB_4096
	select DRIVERS_ASMEDIA_ASM1061
	select HAVE_CMOS_DEFAULT
	select HAVE_OPTION_TABLE
	select MEMORY_MAPPED_TPM
	select REALTEK_8168_RESET
	select RT8168_SET_LED_MODE
	select SUPERIO_NUVOTON_NCT6776

config BOARD_ASUS_P8H67_I_DELUXE
	select BOARD_ASUS_H61_SERIES
	select BOARD_ROMSIZE_KB_4096
	select HAVE_CMOS_DEFAULT
	select HAVE_OPTION_TABLE
	select NO_UART_ON_SUPERIO
	select REALTEK_8168_RESET
	select SUPERIO_NUVOTON_NCT6776

if BOARD_ASUS_H61_SERIES

config MAINBOARD_DIR
	default "asus/h61-series"

config VARIANT_DIR
	default "h61m-a_usb3"        if BOARD_ASUS_H61M_A_USB3
	default "h61m-cs"            if BOARD_ASUS_H61M_CS
	default "p8h61-m_lx"         if BOARD_ASUS_P8H61_M_LX
	default "p8h61-m_lx3_r2_0"   if BOARD_ASUS_P8H61_M_LX3_R2_0
	default "p8h61-m_pro"        if BOARD_ASUS_P8H61_M_PRO
	default "p8h61-m_pro_cm6630" if BOARD_ASUS_P8H61_M_PRO_CM6630
	default "p8h67-i_deluxe"     if BOARD_ASUS_P8H67_I_DELUXE

config MAINBOARD_PART_NUMBER
	default "H61M-CS"          if BOARD_ASUS_H61M_CS
	default "P8H61-M LX"       if BOARD_ASUS_P8H61_M_LX
	default "P8H61-M LX3 R2.0" if BOARD_ASUS_P8H61_M_LX3_R2_0
	default "P8H61-M PRO"      if BOARD_ASUS_P8H61_M_PRO
	default "P8H61-M PRO CM6630" if BOARD_ASUS_P8H61_M_PRO_CM6630
	default "P8H67-I DELUXE"   if BOARD_ASUS_P8H67_I_DELUXE

config OVERRIDE_DEVICETREE
	default "variants/\$(CONFIG_VARIANT_DIR)/overridetree.cb"

config CMOS_DEFAULT_FILE
	default "src/mainboard/\$(MAINBOARDDIR)/variants/\$(CONFIG_VARIANT_DIR)/cmos.default"

config CMOS_LAYOUT_FILE
	default "src/mainboard/\$(MAINBOARDDIR)/variants/\$(CONFIG_VARIANT_DIR)/cmos.layout"

config CBFS_SIZE
	default 0x280000 if BOARD_ASUS_P8H67_I_DELUXE

#
# These ME partitions need to be whitelisted for correct system
# operation. Example issues from removing them include: no serial output
# and kernel warnings about loading audio codecs.
#
config ME_CLEANER_ARGS
	string
	depends on USE_ME_CLEANER
	default "-S --whitelist EFFS,FCRS" if BOARD_ASUS_P8H61_M_LX

endif
```

## src/mainboard/asus/h61-series/Kconfig.name
```kconfig
## SPDX-License-Identifier: GPL-2.0-only

config BOARD_ASUS_H61M_CS
	bool "H61M-CS"

config BOARD_ASUS_P8H61_M_LX
	bool "P8H61-M LX"

config BOARD_ASUS_P8H61_M_LX3_R2_0
	bool "P8H61-M LX3 R2.0"

config BOARD_ASUS_P8H61_M_PRO
	bool "P8H61-M PRO"

config BOARD_ASUS_P8H61_M_PRO_CM6630
	bool "P8H61-M PRO CM6630"

config BOARD_ASUS_P8H67_I_DELUXE
	bool "P8H67-I DELUXE"
```

## src/mainboard/asus/h610i-plus-d4/Kconfig
```kconfig
## SPDX-License-Identifier: GPL-2.0-only

config BOARD_ASUS_H610I_PLUS_D4
	select AZALIA_USE_LEGACY_VERB_TABLE
	select BOARD_ROMSIZE_KB_16384
	select DRIVERS_UART_8250IO
	select HAVE_ACPI_RESUME
	select HAVE_ACPI_TABLES
	select INTEL_GMA_HAVE_VBT
	select SOC_INTEL_ALDERLAKE_PCH_S
	select SOC_INTEL_COMMON_BLOCK_HDA_VERB
	select SUPERIO_NUVOTON_NCT6791D
	select USE_LEGACY_8254_TIMER

if BOARD_ASUS_H610I_PLUS_D4

config MAINBOARD_DIR
	default "asus/h610i-plus-d4"

config MAINBOARD_PART_NUMBER
	default "PRIME H610I-PLUS D4"

config MAINBOARD_VENDOR
	default "ASUS"

config UART_FOR_CONSOLE
	default 0

config USE_PM_ACPI_TIMER
	default n

config CBFS_SIZE
	default 0xB00000

endif
```

## src/mainboard/asus/h610i-plus-d4/Kconfig.name
```kconfig
## SPDX-License-Identifier: GPL-2.0-only

config BOARD_ASUS_H610I_PLUS_D4
	bool "PRIME H610I-PLUS D4"
```

## src/mainboard/asus/h61m-cs/Kconfig
```kconfig
if BOARD_ASUS_H61M_CS

config BOARD_SPECIFIC_OPTIONS
	def_bool y
	select BOARD_ROMSIZE_KB_8192
	select HAVE_ACPI_RESUME
	select HAVE_ACPI_TABLES
	select HAVE_CMOS_DEFAULT
	select HAVE_OPTION_TABLE
	select INTEL_GMA_HAVE_VBT
	select INTEL_INT15
	select MAINBOARD_HAS_LIBGFXINIT
	select NO_UART_ON_SUPERIO
	select NORTHBRIDGE_INTEL_SANDYBRIDGE
	select SERIRQ_CONTINUOUS_MODE
	select SOUTHBRIDGE_INTEL_BD82X6X
	select SUPERIO_NUVOTON_NCT6779D
	select USE_NATIVE_RAMINIT

config MAINBOARD_DIR
	string
	default "asus/h61m-cs"

config MAINBOARD_PART_NUMBER
	string
	default "H61M-CS"
endif
```

## src/mainboard/asus/h81m_k/Kconfig
```kconfig
## SPDX-License-Identifier: GPL-2.0-only

if BOARD_ASUS_H81M_K

config BOARD_SPECIFIC_OPTIONS
	def_bool y
	select BOARD_ROMSIZE_KB_8192
	select HAVE_ACPI_RESUME
	select HAVE_ACPI_TABLES
	select INTEL_GMA_HAVE_VBT
	select MAINBOARD_HAS_LIBGFXINIT
	select NORTHBRIDGE_INTEL_HASWELL
	select REALTEK_8168_RESET
	select RT8168_SET_LED_MODE
	select SERIRQ_CONTINUOUS_MODE
	select SOUTHBRIDGE_INTEL_LYNXPOINT
	select SUPERIO_NUVOTON_COMMON_COM_A
	select SUPERIO_NUVOTON_NCT5539D

config CBFS_SIZE
	default 0x680000

config MAINBOARD_DIR
	default "asus/h81m_k"

config MAINBOARD_PART_NUMBER
	default "H81M-K"

endif
```

## src/mainboard/asus/k8v-x/Kconfig
```kconfig
if BOARD_ASUS_K8V_X

config BOARD_SPECIFIC_OPTIONS # dummy
	def_bool y
	select ARCH_X86
	select CPU_AMD_SOCKET_754
	select NORTHBRIDGE_AMD_AMDK8
	select SOUTHBRIDGE_VIA_VT8237R
	select SOUTHBRIDGE_VIA_K8T890
	select SOUTHBRIDGE_VIA_SUBTYPE_K8T800_OLD
	select SUPERIO_WINBOND_W83697HF
	select HAVE_OPTION_TABLE
	select HAVE_ACPI_TABLES
	select HAVE_MP_TABLE
	select BOARD_ROMSIZE_KB_512
	select RAMINIT_SYSINFO
	select SET_FIDVID
	select K8_FORCE_2T_DRAM_TIMING

config MAINBOARD_DIR
	string
	default asus/k8v-x

config DCACHE_RAM_BASE
	hex
	default 0xcc000

config DCACHE_RAM_SIZE
	hex
	default 0x4000

config APIC_ID_OFFSET
	hex
	default 0x10

config SB_HT_CHAIN_ON_BUS0
	int
	default 1

config MAINBOARD_PART_NUMBER
	string
	default "K8V-X"

config AGP_APERTURE_SIZE
	hex
	default 0x10000000

config HW_MEM_HOLE_SIZEK
	hex
	default 0

config MAX_CPUS
	int
	default 2

config MAX_PHYSICAL_CPUS
	int
	default 1

config HEAP_SIZE
	hex
	default 0x40000

config HT_CHAIN_END_UNITID_BASE
	hex
	default 0x20

config HT_CHAIN_UNITID_BASE
	hex
	default 0x0

endif # BOARD_ASUS_K8V_X
```

## src/mainboard/asus/kfsn4-dre/Kconfig
```kconfig
if BOARD_ASUS_KFSN4_DRE

config BOARD_SPECIFIC_OPTIONS # dummy
	def_bool y
	select CPU_AMD_SOCKET_F_1207
	select DIMM_DDR2
	select DIMM_REGISTERED
	select NORTHBRIDGE_AMD_AMDFAM10
	select SOUTHBRIDGE_NVIDIA_CK804
	select SUPERIO_WINBOND_W83627THG
	select PARALLEL_CPU_INIT
	select HAVE_HARD_RESET
	select HAVE_OPTION_TABLE
	select HAVE_CMOS_DEFAULT
	select HAVE_PIRQ_TABLE
	select HAVE_MP_TABLE
	select HAVE_ACPI_TABLES
	select LIFT_BSP_APIC_ID
	select BOARD_ROMSIZE_KB_1024
	select ENABLE_APIC_EXT_ID
	select DRIVERS_I2C_W83793
	select DRIVERS_XGI_Z9S
	select VGA
	select MAINBOARD_HAS_NATIVE_VGA_INIT
	select MAINBOARD_HAS_NATIVE_VGA_INIT_TEXTMODECFG

config MAINBOARD_DIR
	string
	default asus/kfsn4-dre

config BOOTBLOCK_MAINBOARD_INIT
	string
	default "mainboard/asus/kfsn4-dre/bootblock.c"

config DCACHE_RAM_BASE
	hex
	default 0xc4000

config DCACHE_RAM_SIZE
	hex
	default 0x0c000

config APIC_ID_OFFSET
	hex
	default 0x0

config MAINBOARD_PART_NUMBER
	string
	default "KFSN4-DRE"

config HW_MEM_HOLE_SIZEK
	hex
	default 0x100000

config MAX_CPUS
	int
	default 12

config MAX_PHYSICAL_CPUS
	int
	default 2

config HT_CHAIN_UNITID_BASE
	hex
	default 0x0

config HT_CHAIN_END_UNITID_BASE
	hex
	default 0x20

config IRQ_SLOT_COUNT
	int
	default 13

config CK804_PCI_E_X
	int
	default 1

config CK804_PCIE_PME_WAKE
	bool
	default y

config ONBOARD_VGA_IS_PRIMARY
	bool
	default y

config MAINBOARD_DO_NATIVE_VGA_INIT
	bool
	default y

config MAINBOARD_POWER_ON_AFTER_POWER_FAIL
	bool
	default y

config MAX_REBOOT_CNT
	int
	default 10

endif # BOARD_ASUS_KFSN4_DRE
```
