## src/mainboard/asus/kfsn4-dre_k8/Kconfig
```kconfig
if BOARD_ASUS_KFSN4_DRE_K8

config BOARD_SPECIFIC_OPTIONS # dummy
	def_bool y
	select CPU_AMD_SOCKET_F
	select DIMM_DDR2
	select DIMM_REGISTERED
	select QRANK_DIMM_SUPPORT
	select NORTHBRIDGE_AMD_AMDK8
	select SOUTHBRIDGE_NVIDIA_CK804
	select SUPERIO_WINBOND_W83627THG
	select PARALLEL_CPU_INIT
	select HAVE_HARD_RESET
	select HAVE_OPTION_TABLE
	select HAVE_CMOS_DEFAULT
	select HAVE_PIRQ_TABLE
	select HAVE_MP_TABLE
	select HAVE_ACPI_TABLES
	select LIFT_BSP_APIC_ID
	select BOARD_ROMSIZE_KB_1024
	select ENABLE_APIC_EXT_ID
	select K8_ALLOCATE_IO_RANGE
	select DRIVERS_I2C_W83793
	select DRIVERS_XGI_Z9S
	select VGA
	select MAINBOARD_HAS_NATIVE_VGA_INIT
	select MAINBOARD_HAS_NATIVE_VGA_INIT_TEXTMODECFG

config MAINBOARD_DIR
	string
	default "asus/kfsn4-dre_k8"

config BOOTBLOCK_MAINBOARD_INIT
	string
	default "mainboard/asus/kfsn4-dre_k8/bootblock.c"

config DCACHE_RAM_BASE
	hex
	default 0xc8000

config DCACHE_RAM_SIZE
	hex
	default 0x08000

config APIC_ID_OFFSET
	hex
	default 0x10

config MAINBOARD_PART_NUMBER
	string
	default "KFSN4-DRE_K8"

config HW_MEM_HOLE_SIZEK
	hex
	default 0x100000

config MAX_CPUS
	int
	default 4

config MAX_PHYSICAL_CPUS
	int
	default 2

config MEM_TRAIN_SEQ
	int
	default 1

config HT_CHAIN_UNITID_BASE
	hex
	default 0x0

config HT_CHAIN_END_UNITID_BASE
	hex
	default 0x20

config IRQ_SLOT_COUNT
	int
	default 13

config CK804_PCI_E_X
	int
	default 1

config CK804_PCIE_PME_WAKE
	bool
	default y

config ONBOARD_VGA_IS_PRIMARY
	bool
	default y

config MAINBOARD_DO_NATIVE_VGA_INIT
	bool
	default y

config MAINBOARD_POWER_ON_AFTER_POWER_FAIL
	bool
	default y

config MAX_REBOOT_CNT
	int
	default 10

endif # BOARD_ASUS_KFSN4_DRE_K8
```

## src/mainboard/asus/kgpe-d16/Kconfig
```kconfig
if BOARD_ASUS_KGPE_D16

config BOARD_SPECIFIC_OPTIONS # dummy
	def_bool y
	select CPU_AMD_SOCKET_G34_NON_AGESA
	select DIMM_DDR3
	select DIMM_REGISTERED
	# select QRANK_DIMM_SUPPORT
	select DIMM_VOLTAGE_SET_SUPPORT
	select NORTHBRIDGE_AMD_AMDFAM10
	select SOUTHBRIDGE_AMD_SR5650
	select SOUTHBRIDGE_AMD_SB700
	select SOUTHBRIDGE_AMD_SB700_DISABLE_ISA_DMA
	select SOUTHBRIDGE_AMD_SUBTYPE_SP5100
	select SUPERIO_WINBOND_W83667HG_A
	select PARALLEL_CPU_INIT
	select HAVE_ROMSTAGE_CONSOLE_SPINLOCK
	select HAVE_ROMSTAGE_NVRAM_CBFS_SPINLOCK
	select HAVE_ROMSTAGE_MICROCODE_CBFS_SPINLOCK
	select HAVE_HARD_RESET
	select HAVE_OPTION_TABLE
	select HAVE_CMOS_DEFAULT
	select HAVE_PIRQ_TABLE
	select HAVE_MP_TABLE
	select HAVE_ACPI_TABLES
	select SB_HT_CHAIN_UNITID_OFFSET_ONLY
	select LIFT_BSP_APIC_ID
	select BOARD_ROMSIZE_KB_2048
	select ENABLE_APIC_EXT_ID
	select SPI_FLASH
	select SPI_FLASH_WINBOND
	select MAINBOARD_HAS_LPC_TPM
	select HAVE_ACPI_RESUME
	select DRIVERS_I2C_W83795
	select DRIVERS_ASPEED_AST2050
	select MAINBOARD_DO_NATIVE_VGA_INIT
	select MAINBOARD_HAS_NATIVE_VGA_INIT

config MAINBOARD_DIR
	string
	default "asus/kgpe-d16"

config BOOTBLOCK_MAINBOARD_INIT
	string
	default "mainboard/asus/kgpe-d16/bootblock.c"

config DCACHE_RAM_BASE
	hex
	default 0xc2000

config DCACHE_RAM_SIZE
	hex
	default 0x1e000

config APIC_ID_OFFSET
	hex
	default 0x0

config MAINBOARD_PART_NUMBER
	string
	default "KGPE-D16"

config HW_MEM_HOLE_SIZEK
	hex
	default 0x100000

config MAX_CPUS
	int
	default 32

# 2 (internal) processors per G34 socket
config MAX_PHYSICAL_CPUS
	int
	default 4

config HT_CHAIN_UNITID_BASE
	hex
	default 0x0

config HT_CHAIN_END_UNITID_BASE
	hex
	default 0x20

config IRQ_SLOT_COUNT
	int
	default 13

config SOUTHBRIDGE_AMD_SB700_SATA_PORT_COUNT_BITFIELD
	hex
	default 0x3f

config ONBOARD_VGA_IS_PRIMARY
	bool
	default y

config MAINBOARD_POWER_ON_AFTER_POWER_FAIL
	bool
	default y

config MAX_REBOOT_CNT
	int
	default 10

endif # BOARD_ASUS_KGPE_D16
```

## src/mainboard/asus/m2n-e/Kconfig
```kconfig
##
## This file is part of the coreboot project.
##
## Copyright (C) 2010 Uwe Hermann <uwe@hermann-uwe.de>
##
## This program is free software; you can redistribute it and/or modify
## it under the terms of the GNU General Public License as published by
## the Free Software Foundation; either version 2 of the License, or
## (at your option) any later version.
##
## This program is distributed in the hope that it will be useful,
## but WITHOUT ANY WARRANTY; without even the implied warranty of
## MERCHANTABILITY or FITNESS FOR A PARTICULAR PURPOSE.  See the
## GNU General Public License for more details.
##
## You should have received a copy of the GNU General Public License
## along with this program; if not, write to the Free Software
## Foundation, Inc.
##

if BOARD_ASUS_M2N_E

config BOARD_SPECIFIC_OPTIONS # dummy
	def_bool y
	select CPU_AMD_SOCKET_AM2
	select DIMM_DDR2
	select NORTHBRIDGE_AMD_AMDK8
	select SOUTHBRIDGE_NVIDIA_MCP55
	select HT_CHAIN_DISTRIBUTE
	select MCP55_USE_NIC
	select MCP55_USE_AZA
	select SUPERIO_ITE_IT8716F
	select SUPERIO_ITE_IT8716F_OVERRIDE_FANCTL
	select PARALLEL_CPU_INIT
	select HAVE_OPTION_TABLE
	select HAVE_MP_TABLE
	select LIFT_BSP_APIC_ID
	select BOARD_ROMSIZE_KB_512
	select K8_ALLOCATE_IO_RANGE

config MAINBOARD_DIR
	string
	default asus/m2n-e

config DCACHE_RAM_BASE
	hex
	default 0xc8000

config DCACHE_RAM_SIZE
	hex
	default 0x08000

config APIC_ID_OFFSET
	hex
	default 0x10

config MEM_TRAIN_SEQ
	int
	default 2

config MAINBOARD_PART_NUMBER
	string
	default "M2N-E"

config MAX_CPUS
	int
	default 2

config MAX_PHYSICAL_CPUS
	int
	default 1

config HT_CHAIN_UNITID_BASE
	hex
	default 0x0

config HT_CHAIN_END_UNITID_BASE
	hex
	default 0x20

endif # BOARD_ASUS_M2N_E
```

## src/mainboard/asus/m2v-mx_se/Kconfig
```kconfig
##
## This file is part of the coreboot project.
##
## Copyright (C) 2009 Cristi Măgherușan <cristi.magherusan@net.utcluj.ro>
##
## This program is free software; you can redistribute it and/or modify
## it under the terms of the GNU General Public License as published by
## the Free Software Foundation; version 2 of the License.
##
## This program is distributed in the hope that it will be useful,
## but WITHOUT ANY WARRANTY; without even the implied warranty of
## MERCHANTABILITY or FITNESS FOR A PARTICULAR PURPOSE.  See the
## GNU General Public License for more details.
##
## You should have received a copy of the GNU General Public License
## along with this program; if not, write to the Free Software
## Foundation, Inc., 51 Franklin St, Fifth Floor, Boston, MA 02110-1301 USA
##
if BOARD_ASUS_M2V_MX_SE

config BOARD_SPECIFIC_OPTIONS # dummy
	def_bool y
	select ARCH_X86
	select CPU_AMD_SOCKET_AM2
	select DIMM_DDR2
	select NORTHBRIDGE_AMD_AMDK8
	select SOUTHBRIDGE_VIA_VT8237R
	select SOUTHBRIDGE_VIA_K8T890
	select SOUTHBRIDGE_VIA_SUBTYPE_K8M890
	select SUPERIO_ITE_IT8712F
	select HAVE_OPTION_TABLE
	select HAVE_ACPI_TABLES
	select BOARD_ROMSIZE_KB_512
	select RAMINIT_SYSINFO
	select VGA
	select HAVE_ACPI_RESUME
	select QRANK_DIMM_SUPPORT
	select SET_FIDVID

config MAINBOARD_DIR
	string
	default asus/m2v-mx_se

config DCACHE_RAM_BASE
	hex
	default 0xcc000

config DCACHE_RAM_SIZE
	hex
	default 0x4000

config APIC_ID_OFFSET
	hex
	default 0x10

config MAINBOARD_PART_NUMBER
	string
	default "M2V-MX SE"

config MAX_CPUS
	int
	default 2

config MAX_PHYSICAL_CPUS
	int
	default 1

config HEAP_SIZE
	hex
	default 0x40000

config HT_CHAIN_UNITID_BASE
	hex
	default 0x0

config SB_HT_CHAIN_ON_BUS0
	int
	default 1

config HT_CHAIN_END_UNITID_BASE
	hex
	default 0x20

endif # BOARD_ASUS_M2V_MX_SE
```

## src/mainboard/asus/m2v/Kconfig
```kconfig
if BOARD_ASUS_M2V

config BOARD_SPECIFIC_OPTIONS # dummy
	def_bool y
	select ARCH_X86
	select CPU_AMD_SOCKET_AM2
	select DIMM_DDR2
	select QRANK_DIMM_SUPPORT
	select HAVE_OPTION_TABLE
	select K8_HT_FREQ_1G_SUPPORT
	select NORTHBRIDGE_AMD_AMDK8
	select SOUTHBRIDGE_VIA_VT8237R
	select SOUTHBRIDGE_VIA_K8T890
	select SOUTHBRIDGE_VIA_SUBTYPE_K8T890
	select SUPERIO_ITE_IT8712F
	select BOARD_ROMSIZE_KB_512
	select RAMINIT_SYSINFO
	select HAVE_ACPI_RESUME
	select HAVE_PIRQ_TABLE
	select PIRQ_ROUTE
	select HAVE_ACPI_TABLES
	select HAVE_MP_TABLE
	select SET_FIDVID

config MAINBOARD_DIR
	string
	default asus/m2v

config DCACHE_RAM_BASE
	hex
	default 0xcc000

config DCACHE_RAM_SIZE
	hex
	default 0x4000

config APIC_ID_OFFSET
	hex
	default 0x10

config SB_HT_CHAIN_ON_BUS0
	int
	default 1

config MAINBOARD_PART_NUMBER
	string
	default "M2V"

config HW_MEM_HOLE_SIZEK
	hex
	default 0

config MAX_CPUS
	int
	default 2

config MAX_PHYSICAL_CPUS
	int
	default 1

config HEAP_SIZE
	hex
	default 0x40000

config HT_CHAIN_END_UNITID_BASE
	hex
	default 0x20

config HT_CHAIN_UNITID_BASE
	hex
	default 0x0

config IRQ_SLOT_COUNT
	int
	default 14

endif # BOARD_ASUS_M2V
```

## src/mainboard/asus/m4a78-em/Kconfig
```kconfig
if BOARD_ASUS_M4A78_EM

config BOARD_SPECIFIC_OPTIONS # dummy
	def_bool y
	select CPU_AMD_SOCKET_AM3
	select DIMM_DDR2
	select NORTHBRIDGE_AMD_AMDFAM10
	select SOUTHBRIDGE_AMD_RS780
	select SOUTHBRIDGE_AMD_SB700
	select SUPERIO_ITE_IT8712F
	select HAVE_OPTION_TABLE
	select HAVE_PIRQ_TABLE
	select HAVE_MP_TABLE
	select SB_HT_CHAIN_UNITID_OFFSET_ONLY
	select LIFT_BSP_APIC_ID
	select HAVE_ACPI_TABLES
	select BOARD_ROMSIZE_KB_1024
	select ENABLE_APIC_EXT_ID
	select GFXUMA

config MAINBOARD_DIR
	string
	default asus/m4a78-em

config APIC_ID_OFFSET
	hex
	default 0x0

config MAINBOARD_PART_NUMBER
	string
	default "M4A78-EM"

config MAX_CPUS
	int
	default 8

config MAX_PHYSICAL_CPUS
	int
	default 2

config HT_CHAIN_END_UNITID_BASE
	hex
	default 0x1

config HT_CHAIN_UNITID_BASE
	hex
	default 0x0

config IRQ_SLOT_COUNT
	int
	default 18

endif
```

## src/mainboard/asus/m4a785-m/Kconfig
```kconfig
if BOARD_ASUS_M4A785M

config BOARD_SPECIFIC_OPTIONS # dummy
	def_bool y
	select CPU_AMD_SOCKET_AM3
	select DIMM_DDR2
	select NORTHBRIDGE_AMD_AMDFAM10
	select SOUTHBRIDGE_AMD_RS780
	select SOUTHBRIDGE_AMD_SB700
	select SOUTHBRIDGE_AMD_SB700_SKIP_ISA_DMA_INIT
	select SUPERIO_ITE_IT8712F
	select HAVE_OPTION_TABLE
	select HAVE_PIRQ_TABLE
	select HAVE_MP_TABLE
	select SB_HT_CHAIN_UNITID_OFFSET_ONLY
	select LIFT_BSP_APIC_ID
	select HAVE_ACPI_TABLES
	select BOARD_ROMSIZE_KB_1024
	select ENABLE_APIC_EXT_ID
	select GFXUMA
	select QRANK_DIMM_SUPPORT

config MAINBOARD_DIR
	string
	default asus/m4a785-m

config APIC_ID_OFFSET
	hex
	default 0x0

config MAINBOARD_PART_NUMBER
	string
	default "M4A785-M"

config MAX_CPUS
	int
	default 8

config MAX_PHYSICAL_CPUS
	int
	default 2

config SB_HT_CHAIN_ON_BUS0
	int
	default 1

config HT_CHAIN_END_UNITID_BASE
	hex
	default 0x1

config HT_CHAIN_UNITID_BASE
	hex
	default 0x0

config IRQ_SLOT_COUNT
	int
	default 19

config VGA_BIOS_ID
	string
	default "1002,9710"

endif
```

## src/mainboard/asus/m4a785t-m/Kconfig
```kconfig
if BOARD_ASUS_M4A785TM

config BOARD_SPECIFIC_OPTIONS # dummy
	def_bool y
	select ARCH_X86
	select CPU_AMD_SOCKET_AM3
	select DIMM_DDR3
	select DIMM_REGISTERED
	select NORTHBRIDGE_AMD_AMDFAM10
	select SOUTHBRIDGE_AMD_RS780
	select SOUTHBRIDGE_AMD_SB700
	select SOUTHBRIDGE_AMD_SB700_SKIP_ISA_DMA_INIT
	select SUPERIO_ITE_IT8712F
	select HAVE_OPTION_TABLE
	select HAVE_CMOS_DEFAULT
	select HAVE_PIRQ_TABLE
	select HAVE_MP_TABLE
	select SB_HT_CHAIN_UNITID_OFFSET_ONLY
	select LIFT_BSP_APIC_ID
	select SERIAL_CPU_INIT
	select AMDMCT
	select HAVE_ACPI_TABLES
	select BOARD_ROMSIZE_KB_1024
	select RAMINIT_SYSINFO
	select ENABLE_APIC_EXT_ID
	select GFXUMA
	select QRANK_DIMM_SUPPORT

config MAINBOARD_DIR
	string
	default asus/m4a785t-m

config APIC_ID_OFFSET
	hex
	default 0x0

config MAINBOARD_PART_NUMBER
	string
	default "M4A785T-M"

config MAX_CPUS
	int
	default 8

config MAX_PHYSICAL_CPUS
	int
	default 2

config MEM_TRAIN_SEQ
	int
	default 2

config SB_HT_CHAIN_ON_BUS0
	int
	default 1

config HT_CHAIN_END_UNITID_BASE
	hex
	default 0x1

config HT_CHAIN_UNITID_BASE
	hex
	default 0x0

config IRQ_SLOT_COUNT
	int
	default 19

config AMD_UCODE_PATCH_FILE
	string
	default "mc_patch_0100009f.h"

config RAMTOP
	hex
	default 0x2000000

config HEAP_SIZE
	hex
	default 0xc0000

config RAMBASE
	hex
	default 0x200000

endif
```

## src/mainboard/asus/m5a88-v/Kconfig
```kconfig
if BOARD_ASUS_M5A88_V

config BOARD_SPECIFIC_OPTIONS # dummy
	def_bool y
	select ARCH_X86
	select CPU_AMD_SOCKET_AM3
	select DIMM_DDR3
	select DIMM_REGISTERED
	select QRANK_DIMM_SUPPORT
	select NORTHBRIDGE_AMD_AMDFAM10
	select SOUTHBRIDGE_AMD_RS780
	select SOUTHBRIDGE_AMD_CIMX_SB800
	select SUPERIO_ITE_IT8721F
	select HAVE_OPTION_TABLE
	select HAVE_PIRQ_TABLE
	select SB_HT_CHAIN_UNITID_OFFSET_ONLY
	select LIFT_BSP_APIC_ID
	select SERIAL_CPU_INIT
	select AMDMCT
	select HAVE_MP_TABLE
	select HAVE_ACPI_TABLES
	select BOARD_ROMSIZE_KB_2048
	select RAMINIT_SYSINFO
	select ENABLE_APIC_EXT_ID
	select GFXUMA
	select HAVE_DEBUG_CAR
	select SET_FIDVID

config MAINBOARD_DIR
	string
	default asus/m5a88-v

config APIC_ID_OFFSET
	hex
	default 0x0

config MAINBOARD_PART_NUMBER
	string
	default "M5A88-V"

config HW_MEM_HOLE_SIZEK
	hex
	default 0x100000

config MAX_CPUS
	int
	default 8

config MAX_PHYSICAL_CPUS
	int
	default 1

config HW_MEM_HOLE_SIZE_AUTO_INC
	bool
	default n

config MEM_TRAIN_SEQ
	int
	default 2

config SB_HT_CHAIN_ON_BUS0
	int
	default 1

config HT_CHAIN_END_UNITID_BASE
	hex
	default 0x1

config HT_CHAIN_UNITID_BASE
	hex
	default 0x0

config IRQ_SLOT_COUNT
	int
	default 11

config AMD_UCODE_PATCH_FILE
	string
	default "mc_patch_010000bf.h"

config RAMTOP
	hex
	default 0x2000000

config HEAP_SIZE
	hex
	default 0xc0000

config RAMBASE
	hex
	default 0x200000

config VGA_BIOS_ID
        string
        default "1002,9715"

endif #BOARD_ASUS_M5A88_V
```

## src/mainboard/asus/maximus_iv_gene-z/Kconfig
```kconfig
## SPDX-License-Identifier: GPL-2.0-or-later

if BOARD_ASUS_MAXIMUS_IV_GENE_Z

config BOARD_SPECIFIC_OPTIONS
	def_bool y
	select AZALIA_USE_LEGACY_VERB_TABLE
	select BOARD_ROMSIZE_KB_8192
	select HAVE_ACPI_RESUME
	select HAVE_ACPI_TABLES
	select HAVE_OPTION_TABLE
	select HAVE_CMOS_DEFAULT
	select INTEL_GMA_HAVE_VBT
	select INTEL_INT15
	select MAINBOARD_HAS_LIBGFXINIT
	select NORTHBRIDGE_INTEL_SANDYBRIDGE
	select NO_UART_ON_SUPERIO
	select SERIRQ_CONTINUOUS_MODE
	select SOUTHBRIDGE_INTEL_BD82X6X
	select SUPERIO_NUVOTON_NCT6776
	select USE_NATIVE_RAMINIT
	select MAINBOARD_USES_IFD_GBE_REGION

config MAINBOARD_DIR
	default "asus/maximus_iv_gene-z"

config MAINBOARD_PART_NUMBER
	default "Maximus IV GENE-Z"

config USBDEBUG_HCD_INDEX
	int
	default 1

endif
```

## src/mainboard/asus/maximus_vi_extreme/Kconfig
```kconfig
## SPDX-License-Identifier: GPL-2.0-only

if BOARD_ASUS_MAXIMUS_VI_EXTREME

config BOARD_SPECIFIC_OPTIONS
	def_bool y
	select BOARD_ROMSIZE_KB_8192
	select DRIVERS_ASMEDIA_ASM1061
	select HAVE_ACPI_RESUME
	select HAVE_ACPI_TABLES
	select INTEL_GMA_HAVE_VBT
	select MAINBOARD_HAS_LIBGFXINIT
	select MAINBOARD_USES_IFD_GBE_REGION
	select NORTHBRIDGE_INTEL_HASWELL
	select NO_UART_ON_SUPERIO
	select SERIRQ_CONTINUOUS_MODE
	select SOUTHBRIDGE_INTEL_LYNXPOINT
	select SUPERIO_NUVOTON_NCT6791D

config CBFS_SIZE
	default 0x680000

config MAINBOARD_DIR
	default "asus/maximus_vi_extreme"

config MAINBOARD_PART_NUMBER
	default "Maximus VI EXTREME"

config USBDEBUG_HCD_INDEX
	default 2	# Header:	USB3_12
endif
```

## src/mainboard/asus/maximus_vi_extreme/Kconfig.name
```kconfig
## SPDX-License-Identifier: GPL-2.0-only

config BOARD_ASUS_MAXIMUS_VI_EXTREME
	bool "Maximus VI EXTREME"
```
