## src/mainboard/asus/maximus_vi_gene/Kconfig
```kconfig
## SPDX-License-Identifier: GPL-2.0-only

if BOARD_ASUS_MAXIMUS_VI_GENE

config BOARD_SPECIFIC_OPTIONS
	def_bool y
	select BOARD_ROMSIZE_KB_8192
	select DRIVERS_ASMEDIA_ASM1061
	select HAVE_ACPI_RESUME
	select HAVE_ACPI_TABLES
	select INTEL_GMA_HAVE_VBT
	select MEMORY_MAPPED_TPM
	select MAINBOARD_HAS_LIBGFXINIT
	select MAINBOARD_USES_IFD_GBE_REGION
	select NORTHBRIDGE_INTEL_HASWELL
	select NO_UART_ON_SUPERIO
	select SERIRQ_CONTINUOUS_MODE
	select SOUTHBRIDGE_INTEL_LYNXPOINT
	select SUPERIO_NUVOTON_NCT6791D

config CBFS_SIZE
	default 0x680000

config MAINBOARD_DIR
	default "asus/maximus_vi_gene"

config MAINBOARD_PART_NUMBER
	default "Maximus VI GENE"

config USBDEBUG_HCD_INDEX
	default 2	# Rear:		USB7~10 (Top)
			# Header:	USB3_12
endif
```

## src/mainboard/asus/maximus_vi_gene/Kconfig.name
```kconfig
## SPDX-License-Identifier: GPL-2.0-only

config BOARD_ASUS_MAXIMUS_VI_GENE
	bool "Maximus VI GENE"
```

## src/mainboard/asus/maximus_vii_gene/Kconfig
```kconfig
## SPDX-License-Identifier: GPL-2.0-only

if BOARD_ASUS_MAXIMUS_VII_GENE

config BOARD_SPECIFIC_OPTIONS
	def_bool y
	select BOARD_ROMSIZE_KB_8192
	select DRIVERS_ASMEDIA_ASM1061
	select HAVE_ACPI_RESUME
	select HAVE_ACPI_TABLES
	select INTEL_GMA_HAVE_VBT
	select MEMORY_MAPPED_TPM
	select MAINBOARD_HAS_LIBGFXINIT
	select MAINBOARD_USES_IFD_GBE_REGION
	select NORTHBRIDGE_INTEL_HASWELL
	select NO_UART_ON_SUPERIO
	select SERIRQ_CONTINUOUS_MODE
	select SOUTHBRIDGE_INTEL_LYNXPOINT
	select SUPERIO_NUVOTON_NCT6791D
	select USE_BROADWELL_MRC if !USE_NATIVE_RAMINIT

config MAINBOARD_DIR
	default "asus/maximus_vii_gene"

config MAINBOARD_PART_NUMBER
	default "Maximus VII GENE"

config USBDEBUG_HCD_INDEX
	default 2	# Rear:		USB910_U3_56
			# Header:	USB3_12
endif
```
