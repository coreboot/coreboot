## src/mainboard/asus/maximus_vii_gene/Kconfig.name
```kconfig
## SPDX-License-Identifier: GPL-2.0-only

config BOARD_ASUS_MAXIMUS_VII_GENE
	bool "Maximus VII GENE"
```

## src/mainboard/asus/maximus_vii_hero/Kconfig
```kconfig
## SPDX-License-Identifier: GPL-2.0-only

if BOARD_ASUS_MAXIMUS_VII_HERO

config BOARD_SPECIFIC_OPTIONS
	def_bool y
	select BOARD_ROMSIZE_KB_8192
	select DRIVERS_ASMEDIA_ASM1061
	select HAVE_ACPI_RESUME
	select HAVE_ACPI_TABLES
	select INTEL_GMA_HAVE_VBT
	select MEMORY_MAPPED_TPM
	select MAINBOARD_HAS_LIBGFXINIT
	select MAINBOARD_USES_IFD_GBE_REGION
	select NORTHBRIDGE_INTEL_HASWELL
	select SERIRQ_CONTINUOUS_MODE
	select SOUTHBRIDGE_INTEL_LYNXPOINT
	select SUPERIO_NUVOTON_NCT6791D
	select USE_BROADWELL_MRC if !USE_NATIVE_RAMINIT

config MAINBOARD_DIR
	default "asus/maximus_vii_hero"

config MAINBOARD_PART_NUMBER
	default "Maximus VII HERO"

config USBDEBUG_HCD_INDEX
	default 2	# Header1:	USB910
			# Header2:	USB3_12
endif
```

## src/mainboard/asus/maximus_vii_hero/Kconfig.name
```kconfig
## SPDX-License-Identifier: GPL-2.0-only

config BOARD_ASUS_MAXIMUS_VII_HERO
	bool "Maximus VII HERO"
```

## src/mainboard/asus/maximus_vii_impact/Kconfig
```kconfig
## SPDX-License-Identifier: GPL-2.0-only

if BOARD_ASUS_MAXIMUS_VII_IMPACT

config BOARD_SPECIFIC_OPTIONS
	def_bool y
	select BOARD_ROMSIZE_KB_8192
	select HAVE_ACPI_RESUME
	select HAVE_ACPI_TABLES
	select INTEL_GMA_HAVE_VBT
	select MEMORY_MAPPED_TPM
	select MAINBOARD_HAS_LIBGFXINIT
	select MAINBOARD_USES_IFD_GBE_REGION
	select NORTHBRIDGE_INTEL_HASWELL
	select SERIRQ_CONTINUOUS_MODE
	select SOUTHBRIDGE_INTEL_LYNXPOINT
	select SUPERIO_NUVOTON_NCT6791D
	select USE_BROADWELL_MRC if !USE_NATIVE_RAMINIT

config CBFS_SIZE
	default 0x680000

config MAINBOARD_DIR
	default "asus/maximus_vii_impact"

config MAINBOARD_PART_NUMBER
	default "Maximus VII IMPACT"

config USBDEBUG_HCD_INDEX
	default 2	# Rear:		KBMS_USB910 (bottom)
			# Header:	USB3_12
endif
```

## src/mainboard/asus/maximus_vii_ranger/Kconfig
```kconfig
## SPDX-License-Identifier: GPL-2.0-only

if BOARD_ASUS_MAXIMUS_VII_RANGER

config BOARD_SPECIFIC_OPTIONS
	def_bool y
	select BOARD_ROMSIZE_KB_8192
	select HAVE_ACPI_RESUME
	select HAVE_ACPI_TABLES
	select INTEL_GMA_HAVE_VBT
	select MEMORY_MAPPED_TPM
	select MAINBOARD_HAS_LIBGFXINIT
	select MAINBOARD_USES_IFD_GBE_REGION
	select NORTHBRIDGE_INTEL_HASWELL
	select SERIRQ_CONTINUOUS_MODE
	select SOUTHBRIDGE_INTEL_LYNXPOINT
	select SUPERIO_NUVOTON_NCT6791D
	select USE_BROADWELL_MRC if !USE_NATIVE_RAMINIT

config CBFS_SIZE
	default 0x680000

config MAINBOARD_DIR
	default "asus/maximus_vii_ranger"

config MAINBOARD_PART_NUMBER
	default "Maximus VII RANGER"

config USBDEBUG_HCD_INDEX
	default 2	# Header1:	USB910
			# Header2:	USB3_12
endif
```

## src/mainboard/asus/mew-vm/Kconfig
```kconfig
##
## This file is part of the coreboot project.
##
## Copyright (C) 2009 Uwe Hermann <uwe@hermann-uwe.de>
##
## This program is free software; you can redistribute it and/or modify
## it under the terms of the GNU General Public License as published by
## the Free Software Foundation; either version 2 of the License, or
## (at your option) any later version.
##
## This program is distributed in the hope that it will be useful,
## but WITHOUT ANY WARRANTY; without even the implied warranty of
## MERCHANTABILITY or FITNESS FOR A PARTICULAR PURPOSE.  See the
## GNU General Public License for more details.
##
## You should have received a copy of the GNU General Public License
## along with this program; if not, write to the Free Software
## Foundation, Inc., 51 Franklin St, Fifth Floor, Boston, MA  02110-1301 USA
##

config BOARD_ASUS_MEW_VM
	bool "MEW-VM"
	select ARCH_X86
	select CPU_INTEL_SOCKET_PGA370
	select NORTHBRIDGE_INTEL_I82810
	select SOUTHBRIDGE_INTEL_I82801AX
	select SUPERIO_SMSC_LPC47B272
	select ROMCC
	select HAVE_PIRQ_TABLE
	select UDELAY_TSC
	select BOARD_ROMSIZE_KB_512

config MAINBOARD_DIR
	string
	default asus/mew-vm
	depends on BOARD_ASUS_MEW_VM

config MAINBOARD_PART_NUMBER
	string
	default "MEW-VM"
	depends on BOARD_ASUS_MEW_VM

config IRQ_SLOT_COUNT
	int
	default 11
	depends on BOARD_ASUS_MEW_VM
```

## src/mainboard/asus/p2b-d/Kconfig
```kconfig
##
## This file is part of the coreboot project.
##
## Copyright (C) 2009 Uwe Hermann <uwe@hermann-uwe.de>
##
## This program is free software; you can redistribute it and/or modify
## it under the terms of the GNU General Public License as published by
## the Free Software Foundation; either version 2 of the License, or
## (at your option) any later version.
##
## This program is distributed in the hope that it will be useful,
## but WITHOUT ANY WARRANTY; without even the implied warranty of
## MERCHANTABILITY or FITNESS FOR A PARTICULAR PURPOSE.  See the
## GNU General Public License for more details.
##
## You should have received a copy of the GNU General Public License
## along with this program; if not, write to the Free Software
## Foundation, Inc., 51 Franklin St, Fifth Floor, Boston, MA  02110-1301 USA
##

config BOARD_ASUS_P2B_D
	bool "P2B-D"
	select ARCH_X86
	select CPU_INTEL_SLOT_2
	select NORTHBRIDGE_INTEL_I440BX
	select SOUTHBRIDGE_INTEL_I82371EB
	select SUPERIO_WINBOND_W83977TF
	select HAVE_PIRQ_TABLE
	select HAVE_MP_TABLE
	select SMP
	select IOAPIC
	select UDELAY_IO
	select PCI_ROM_RUN
	select CONSOLE_VGA
	help
	  ASUS P2B-D mainboard.

config MAINBOARD_DIR
	string
	default asus/p2b-d
	depends on BOARD_ASUS_P2B_D

config MAINBOARD_PART_NUMBER
	string
	default "P2B-D"
	depends on BOARD_ASUS_P2B_D

config HAVE_OPTION_TABLE
	bool
	default n
	depends on BOARD_ASUS_P2B_D

config IRQ_SLOT_COUNT
	int
	default 6
	depends on BOARD_ASUS_P2B_D

config MAX_CPUS
	int
	default 2
	depends on BOARD_ASUS_P2B_D
```

## src/mainboard/asus/p2b-ls/Kconfig
```kconfig
##
## This file is part of the coreboot project.
##
## Copyright (C) 2010 Keith Hui <buurin@gmail.com>
##
## This program is free software; you can redistribute it and/or modify
## it under the terms of the GNU General Public License as published by
## the Free Software Foundation; version 2 of the License.
##
## This program is distributed in the hope that it will be useful,
## but WITHOUT ANY WARRANTY; without even the implied warranty of
## MERCHANTABILITY or FITNESS FOR A PARTICULAR PURPOSE.  See the
## GNU General Public License for more details.
##
## You should have received a copy of the GNU General Public License
## along with this program; if not, write to the Free Software
## Foundation, Inc., 51 Franklin St, Fifth Floor, Boston, MA  02110-1301 USA
##

config BOARD_ASUS_P2B_LS
	bool "P2B-LS"
	select ARCH_X86
	select CPU_INTEL_SLOT_1
	select NORTHBRIDGE_INTEL_I440BX
	select SOUTHBRIDGE_INTEL_I82371EB
	select SUPERIO_WINBOND_W83977TF
	select ROMCC
	select HAVE_PIRQ_TABLE
	select UDELAY_TSC
	select BOARD_ROMSIZE_KB_256
	select SDRAMPWR_4DIMM

config MAINBOARD_DIR
	string
	default asus/p2b-ls
	depends on BOARD_ASUS_P2B_LS

config MAINBOARD_PART_NUMBER
	string
	default "P2B-LS"
	depends on BOARD_ASUS_P2B_LS

config IRQ_SLOT_COUNT
	int
	default 8
	depends on BOARD_ASUS_P2B_LS
```

## src/mainboard/asus/p2b/Kconfig
```kconfig
## SPDX-License-Identifier: GPL-2.0-only

if BOARD_ASUS_P2B || BOARD_ASUS_P2B_D || BOARD_ASUS_P2B_DS || BOARD_ASUS_P2B_F || BOARD_ASUS_P2B_LS || BOARD_ASUS_P3B_F

config BASE_ASUS_P2B_D
	def_bool n
	select SDRAMPWR_4DIMM
	select HAVE_MP_TABLE

config BOARD_SPECIFIC_OPTIONS
	def_bool y
	select ACPI_NO_MADT
	select CPU_INTEL_SLOT_1
	select NORTHBRIDGE_INTEL_I440BX
	select SOUTHBRIDGE_INTEL_I82371EB
	select SUPERIO_WINBOND_W83977TF
	select HAVE_PIRQ_TABLE
	select BOARD_ROMSIZE_KB_256
	select HAVE_OPTION_TABLE
	select SDRAMPWR_4DIMM if BOARD_ASUS_P2B_LS || BOARD_ASUS_P3B_F
	select HAVE_ACPI_TABLES if BOARD_ASUS_P2B || BOARD_ASUS_P2B_LS
	select BASE_ASUS_P2B_D if BOARD_ASUS_P2B_D || BOARD_ASUS_P2B_DS

config MAX_CPUS
	int
	default 2 if BASE_ASUS_P2B_D

config MAINBOARD_DIR
	default "asus/p2b"

config MAINBOARD_PART_NUMBER
	default "P2B" if BOARD_ASUS_P2B
	default "P2B-D" if BOARD_ASUS_P2B_D
	default "P2B-DS" if BOARD_ASUS_P2B_DS
	default "P2B-F" if BOARD_ASUS_P2B_F
	default "P2B-LS" if BOARD_ASUS_P2B_LS
	default "P3B-F" if BOARD_ASUS_P3B_F

config VARIANT_DIR
	default "p2b" if BOARD_ASUS_P2B
	default "p2b-d" if BOARD_ASUS_P2B_D
	default "p2b-ds" if BOARD_ASUS_P2B_DS
	default "p2b-f" if BOARD_ASUS_P2B_F
	default "p2b-ls" if BOARD_ASUS_P2B_LS
	default "p3b-f" if BOARD_ASUS_P3B_F

config OVERRIDE_DEVICETREE
	default "variants/\$(CONFIG_VARIANT_DIR)/overridetree.cb"

config IRQ_SLOT_COUNT
	int
	default 8 if BOARD_ASUS_P2B_LS || BOARD_ASUS_P3B_F
	default 7 if BOARD_ASUS_P2B_F || BOARD_ASUS_P2B_DS
	default 6

endif
```

## src/mainboard/asus/p2b/Kconfig.name
```kconfig
config BOARD_ASUS_P2B
	bool "P2B"

config BOARD_ASUS_P2B_D
	bool "P2B-D"

config BOARD_ASUS_P2B_DS
	bool "P2B-DS"

config BOARD_ASUS_P2B_F
	bool "P2B-F"

config BOARD_ASUS_P2B_LS
	bool "P2B-LS"

config BOARD_ASUS_P3B_F
	bool "P3B-F"
```

## src/mainboard/asus/p5gc-mx/Kconfig
```kconfig
## SPDX-License-Identifier: GPL-2.0-only

if BOARD_ASUS_P5GC_MX

config BOARD_SPECIFIC_OPTIONS
	def_bool y
	select CPU_INTEL_SOCKET_LGA775
	select NORTHBRIDGE_INTEL_I945
	select NORTHBRIDGE_INTEL_SUBTYPE_I945GC
	select SOUTHBRIDGE_INTEL_I82801GX
	select SUPERIO_WINBOND_W83627DHG
	select HAVE_OPTION_TABLE
	select HAVE_CMOS_DEFAULT
	select HAVE_ACPI_TABLES
	select HAVE_ACPI_RESUME
	select BOARD_ROMSIZE_KB_512
	select MAINBOARD_HAS_NATIVE_VGA_INIT
	select INTEL_GMA_HAVE_VBT

config MAINBOARD_DIR
	default "asus/p5gc-mx"

config MAINBOARD_PART_NUMBER
	default "P5GC-MX"

endif # BOARD_ASUS_P5GC_MX
```

## src/mainboard/asus/p5gc-mx/Kconfig.name
```kconfig
## SPDX-License-Identifier: GPL-2.0-only

config BOARD_ASUS_P5GC_MX
	bool "P5GC-MX"
```

## src/mainboard/asus/p5qc/Kconfig
```kconfig
# SPDX-License-Identifier: GPL-2.0-only

if BOARD_ASUS_P5QC || BOARD_ASUS_P5Q_PRO || BOARD_ASUS_P5QL_PRO || BOARD_ASUS_P5Q_SE || BOARD_ASUS_P5Q

config BOARD_SPECIFIC_OPTIONS
	def_bool y
	select CPU_INTEL_SOCKET_LGA775
	select NORTHBRIDGE_INTEL_X4X
	select SOUTHBRIDGE_INTEL_I82801JX
	select SUPERIO_WINBOND_W83667HG_A
	select HAVE_ACPI_TABLES
	select BOARD_ROMSIZE_KB_1024
	select HAVE_OPTION_TABLE
	select HAVE_CMOS_DEFAULT
	select HAVE_ACPI_RESUME
	select ATHEROS_ATL1E_SETMAC

config MAINBOARD_DIR
	default "asus/p5qc"

config VARIANT_DIR
	default "p5qc" if BOARD_ASUS_P5QC
	default "p5q_pro" if BOARD_ASUS_P5Q_PRO
	default "p5ql_pro" if BOARD_ASUS_P5QL_PRO
	default "p5q_se" if BOARD_ASUS_P5Q_SE
	default "p5q" if BOARD_ASUS_P5Q

config MAINBOARD_PART_NUMBER
	default "P5QC" if BOARD_ASUS_P5QC
	default "P5Q PRO" if BOARD_ASUS_P5Q_PRO
	default "P5QL PRO" if BOARD_ASUS_P5QL_PRO
	default "P5Q SE" if BOARD_ASUS_P5Q_SE
	default "P5Q" if BOARD_ASUS_P5Q

config DEVICETREE
	default "variants/\$(CONFIG_VARIANT_DIR)/devicetree.cb"

config GPIO_C
	string
	default "variants/p5q_se/gpio.c" if BOARD_ASUS_P5Q_SE
	default "variants/p5ql_pro/gpio.c" if BOARD_ASUS_P5QL_PRO
	default "gpio.c"

# The MARVELL IDE controller delays SeaBIOS a lot and results in an unbootable
# bogus disk. Compiling SeaBIOS without ATA support is a workaround.

# The Asus P5QL PRO's Marvell controller (88SE6102-NNC2) does not need this, apparently.

config PAYLOAD_CONFIGFILE
	string
	default "" if PAYLOAD_SEABIOS && (BOARD_ASUS_P5QL_PRO || BOARD_ASUS_P5Q_SE)
	default "\$(top)/src/mainboard/\$(MAINBOARDDIR)/config_seabios" if PAYLOAD_SEABIOS

endif # BOARD_ASUS_P5Q*
```

## src/mainboard/asus/p5qc/Kconfig.name
```kconfig
config BOARD_ASUS_P5QC
	bool "P5QC"

config BOARD_ASUS_P5Q_PRO
	bool "P5Q PRO"

config BOARD_ASUS_P5QL_PRO
	bool "P5QL PRO"

config BOARD_ASUS_P5Q
	bool "P5Q"
```

## src/mainboard/asus/p5ql-em/Kconfig
```kconfig
# SPDX-License-Identifier: GPL-2.0-only

if BOARD_ASUS_P5QL_EM

config BOARD_SPECIFIC_OPTIONS
	def_bool y
	select CPU_INTEL_SOCKET_LGA775
	select NORTHBRIDGE_INTEL_X4X
	select SOUTHBRIDGE_INTEL_I82801JX
	select SUPERIO_WINBOND_W83627DHG
	select HAVE_ACPI_TABLES
	select BOARD_ROMSIZE_KB_1024
	select HAVE_OPTION_TABLE
	select HAVE_CMOS_DEFAULT
	select HAVE_ACPI_RESUME
	select INTEL_GMA_HAVE_VBT
	select MAINBOARD_HAS_LIBGFXINIT
	select REALTEK_8168_RESET

config MAINBOARD_DIR
	default "asus/p5ql-em"

config MAINBOARD_PART_NUMBER
	default "P5QL-EM"

endif # BOARD_ASUS_P5QL_EM
```

## src/mainboard/asus/p5ql-em/Kconfig.name
```kconfig
## SPDX-License-Identifier: GPL-2.0-only

config BOARD_ASUS_P5QL_EM
	bool "P5QL-EM"
```

## src/mainboard/asus/p5qpl-am/Kconfig
```kconfig
# SPDX-License-Identifier: GPL-2.0-only

if BOARD_ASUS_P5QPL_AM || BOARD_ASUS_P5G41T_M_LX

config BOARD_SPECIFIC_OPTIONS
	def_bool y
	select CPU_INTEL_SOCKET_LGA775
	select NORTHBRIDGE_INTEL_X4X
	select SOUTHBRIDGE_INTEL_I82801GX
	select SUPERIO_WINBOND_W83627DHG
	select HAVE_ACPI_TABLES
	select BOARD_ROMSIZE_KB_1024
	select HAVE_OPTION_TABLE
	select HAVE_CMOS_DEFAULT
	select HAVE_ACPI_RESUME
	select INTEL_GMA_HAVE_VBT
	select MAINBOARD_HAS_LIBGFXINIT

	# P5G41T-M LX has ATL1C which works fine
	select ATHEROS_ATL1E_SETMAC if BOARD_ASUS_P5QPL_AM

config MAINBOARD_DIR
	default "asus/p5qpl-am"

config VARIANT_DIR
	default "p5qpl-am" if BOARD_ASUS_P5QPL_AM
	default "p5g41t-m_lx" if BOARD_ASUS_P5G41T_M_LX

config MAINBOARD_PART_NUMBER
	default "P5QPL-AM" if BOARD_ASUS_P5QPL_AM
	default "P5G41T-M LX" if BOARD_ASUS_P5G41T_M_LX

config OVERRIDE_DEVICETREE
	default "variants/\$(CONFIG_VARIANT_DIR)/overridetree.cb"

# Override the default variant behavior, since the data.vbt is the same
config INTEL_GMA_VBT_FILE
	default "src/mainboard/\$(MAINBOARDDIR)/data.vbt"

endif # BOARD_ASUS_P5QPL_AM || BOARD_ASUS_P5G41T_M_LX
```

## src/mainboard/asus/p5qpl-am/Kconfig.name
```kconfig
config BOARD_ASUS_P5QPL_AM
	bool "P5QPL-AM"

config BOARD_ASUS_P5G41T_M_LX
	bool "P5G41T-M LX"
```
