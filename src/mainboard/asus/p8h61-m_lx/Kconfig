## src/mainboard/asus/p8h61-m_lx/Kconfig
```kconfig
## SPDX-License-Identifier: GPL-2.0-or-later

if BOARD_ASUS_P8H61_M_LX

config BOARD_SPECIFIC_OPTIONS
	def_bool y
	select BOARD_ROMSIZE_KB_4096
	select HAVE_ACPI_RESUME
	select HAVE_ACPI_TABLES
	select HAVE_OPTION_TABLE
	select HAVE_CMOS_DEFAULT
	select INTEL_GMA_HAVE_VBT
	select INTEL_INT15
	select MAINBOARD_HAS_LIBGFXINIT
	select NORTHBRIDGE_INTEL_SANDYBRIDGE
	select REALTEK_8168_RESET
	select RT8168_SET_LED_MODE
	select SERIRQ_CONTINUOUS_MODE
	select SOUTHBRIDGE_INTEL_BD82X6X
	select SUPERIO_NUVOTON_COMMON_COM_A
	select SUPERIO_NUVOTON_NCT6776
	select USE_NATIVE_RAMINIT

config MAINBOARD_DIR
	string
	default "asus/p8h61-m_lx"

config MAINBOARD_PART_NUMBER
	string
	default "P8H61-M LX"

#
# These ME partitions need to be whitelisted for correct system
# operation. Example issues from removing them include: no serial output
# and kernel warnings about loading audio codecs.
#
config ME_CLEANER_ARGS
	string
	depends on USE_ME_CLEANER
	default "-S --whitelist EFFS,FCRS"

endif
```

## src/mainboard/asus/p8h61-m_lx3_r2_0/Kconfig
```kconfig
## SPDX-License-Identifier: GPL-2.0-only
## This file is part of the coreboot project.

if BOARD_ASUS_P8H61_M_LX3_R2_0

config BOARD_SPECIFIC_OPTIONS
	def_bool y
	select BOARD_ROMSIZE_KB_8192
	select HAVE_ACPI_RESUME
	select HAVE_ACPI_TABLES
	select INTEL_GMA_HAVE_VBT
	select MAINBOARD_HAS_LIBGFXINIT
	select NO_UART_ON_SUPERIO
	select NORTHBRIDGE_INTEL_SANDYBRIDGE
	select REALTEK_8168_RESET
	select RT8168_SET_LED_MODE
	select SERIRQ_CONTINUOUS_MODE
	select SOUTHBRIDGE_INTEL_BD82X6X
	select SUPERIO_NUVOTON_NCT6779D
	select USE_NATIVE_RAMINIT

config MAINBOARD_DIR
	string
	default asus/p8h61-m_lx3_r2_0

config MAINBOARD_PART_NUMBER
	string
	default "P8H61-M LX3 R2.0"

config MAX_CPUS
	int
	default 8

endif
```

## src/mainboard/asus/p8h61-m_pro/Kconfig
```kconfig
## SPDX-License-Identifier: GPL-2.0-only

if BOARD_ASUS_P8H61_M_PRO

config BOARD_SPECIFIC_OPTIONS
	def_bool y
	select BOARD_ROMSIZE_KB_4096
	select DRIVERS_ASMEDIA_ASPM_BLACKLIST
	select HAVE_ACPI_RESUME
	select HAVE_ACPI_TABLES
	select HAVE_CMOS_DEFAULT
	select HAVE_OPTION_TABLE
	select INTEL_GMA_HAVE_VBT
	select MAINBOARD_HAS_LIBGFXINIT
	select MAINBOARD_HAS_LPC_TPM
	select NORTHBRIDGE_INTEL_SANDYBRIDGE
	select REALTEK_8168_RESET
	select RT8168_SET_LED_MODE
	select SERIRQ_CONTINUOUS_MODE
	select SOUTHBRIDGE_INTEL_BD82X6X
	select SUPERIO_NUVOTON_NCT6776
	select USE_NATIVE_RAMINIT

config MAINBOARD_DIR
	string
	default "asus/p8h61-m_pro"

config MAINBOARD_PART_NUMBER
	string
	default "P8H61-M PRO"

endif # BOARD_ASUS_P8H61_M_PRO
```

## src/mainboard/asus/p8x7x-series/Kconfig
```kconfig
## SPDX-License-Identifier: GPL-2.0-only

config BOARD_ASUS_P8X7X_SERIES
	bool
	select HAVE_ACPI_RESUME
	select HAVE_ACPI_TABLES
	select HAVE_CMOS_DEFAULT
	select HAVE_OPTION_TABLE
	select INTEL_GMA_HAVE_VBT
	select INTEL_INT15
	select MAINBOARD_HAS_LIBGFXINIT
	select NORTHBRIDGE_INTEL_SANDYBRIDGE
	select SERIRQ_CONTINUOUS_MODE
	select SOUTHBRIDGE_INTEL_C216

config BOARD_ASUS_P8C_WS
	select BOARD_ASUS_P8X7X_SERIES
	select BOARD_ROMSIZE_KB_8192
	select MEMORY_MAPPED_TPM
	select SUPERIO_NUVOTON_NCT6776
	select USE_NATIVE_RAMINIT

config BOARD_ASUS_P8H77_V
	select BOARD_ASUS_P8X7X_SERIES
	select BOARD_ROMSIZE_KB_8192
	select SUPERIO_NUVOTON_NCT6779D
	select USE_NATIVE_RAMINIT
	select POWER_LED_USES_GPIO8

config BOARD_ASUS_P8Z77_M_PRO
	select BOARD_ASUS_P8X7X_SERIES
	select BOARD_ROMSIZE_KB_8192
	select DRIVERS_ASMEDIA_ASM1061 # for ASM1061 eSATA
	select MEMORY_MAPPED_TPM
	select SUPERIO_NUVOTON_NCT6779D

config BOARD_ASUS_P8Z77_V_LX2
	select BOARD_ASUS_P8X7X_SERIES
	select BOARD_ROMSIZE_KB_8192
	select REALTEK_8168_RESET
	select SUPERIO_NUVOTON_NCT6779D
	select USE_NATIVE_RAMINIT
	select POWER_LED_USES_GPIO8

config BOARD_ASUS_P8Z77_V
	select BOARD_ASUS_P8X7X_SERIES
	select BOARD_ROMSIZE_KB_8192
	select DRIVERS_ASMEDIA_ASM1061 # for ASM1061 eSATA
	select MEMORY_MAPPED_TPM
	select MAINBOARD_USES_IFD_GBE_REGION
	select SUPERIO_NUVOTON_NCT6779D
	select USE_NATIVE_RAMINIT

config BOARD_ASUS_P8Z77_M
	select BOARD_ASUS_P8X7X_SERIES
	select BOARD_ROMSIZE_KB_8192
	select MEMORY_MAPPED_TPM
	select SUPERIO_NUVOTON_NCT6779D
	select SUPERIO_NUVOTON_COMMON_COM_A

config BOARD_ASUS_P8Z77_V_LE_PLUS
	select BOARD_ASUS_P8X7X_SERIES
	select BOARD_ROMSIZE_KB_8192
	select RT8168_SET_LED_MODE
	select SUPERIO_NUVOTON_NCT6779D
	select USE_NATIVE_RAMINIT
	select POWER_LED_USES_GPIO8
	select HAVE_SHARED_PS2_PORT

if BOARD_ASUS_P8X7X_SERIES

config POWER_LED_USES_GPIO8
	bool
	help
	  If power LED doesn't blink when entering S3 suspend, try setting this.

config MAINBOARD_DIR
	default "asus/p8x7x-series"

config VARIANT_DIR
	default "p8c_ws"      if BOARD_ASUS_P8C_WS
	default "p8h77-v"     if BOARD_ASUS_P8H77_V
	default "p8z77-m_pro" if BOARD_ASUS_P8Z77_M_PRO
	default "p8z77-v_lx2" if BOARD_ASUS_P8Z77_V_LX2
	default "p8z77-v"     if BOARD_ASUS_P8Z77_V
	default "p8z77-m"     if BOARD_ASUS_P8Z77_M
	default "p8z77-v_le_plus" if BOARD_ASUS_P8Z77_V_LE_PLUS

config MAINBOARD_PART_NUMBER
	default "P8C WS"      if BOARD_ASUS_P8C_WS
	default "P8H77-V"     if BOARD_ASUS_P8H77_V
	default "P8Z77-M PRO" if BOARD_ASUS_P8Z77_M_PRO
	default "P8Z77-V LX2" if BOARD_ASUS_P8Z77_V_LX2
	default "P8Z77-V"     if BOARD_ASUS_P8Z77_V
	default "P8Z77-M"     if BOARD_ASUS_P8Z77_M
	default "P8Z77-V LE PLUS" if BOARD_ASUS_P8Z77_V_LE_PLUS

config OVERRIDE_DEVICETREE
	default "variants/\$(CONFIG_VARIANT_DIR)/overridetree.cb"

config CMOS_DEFAULT_FILE
	default "src/mainboard/\$(MAINBOARDDIR)/variants/\$(CONFIG_VARIANT_DIR)/cmos.default"

config CMOS_LAYOUT_FILE
	default "src/mainboard/\$(MAINBOARDDIR)/variants/\$(CONFIG_VARIANT_DIR)/cmos.layout"

config SUPERIO_PNP_BASE
	hex
	default 0x2e

endif
```

## src/mainboard/asus/p8x7x-series/Kconfig.name
```kconfig
## SPDX-License-Identifier: GPL-2.0-only

config BOARD_ASUS_P8C_WS
	bool "P8C_WS"

config BOARD_ASUS_P8H77_V
	bool "P8H77-V"

config BOARD_ASUS_P8Z77_M_PRO
	bool "P8Z77-M PRO"

config BOARD_ASUS_P8Z77_V_LX2
	bool "P8Z77-V LX2"

config BOARD_ASUS_P8Z77_V
	bool "P8Z77-V"

config BOARD_ASUS_P8Z77_M
	bool "P8Z77-M"

config BOARD_ASUS_P8Z77_V_LE_PLUS
	bool "P8Z77-V LE PLUS"
```

## src/mainboard/asus/p8z77-m_pro/Kconfig
```kconfig
## SPDX-License-Identifier: GPL-2.0-only

if BOARD_ASUS_P8Z77_M_PRO

config BOARD_SPECIFIC_OPTIONS
	def_bool y
	select BOARD_ROMSIZE_KB_8192
	select HAVE_ACPI_RESUME
	select HAVE_ACPI_TABLES
	select INTEL_INT15
	select NORTHBRIDGE_INTEL_SANDYBRIDGE
	select SERIRQ_CONTINUOUS_MODE
	select SOUTHBRIDGE_INTEL_C216
	select MAINBOARD_HAS_LPC_TPM
	select MAINBOARD_HAS_TPM1
	select HAVE_OPTION_TABLE
	select HAVE_CMOS_DEFAULT
	select MAINBOARD_HAS_LIBGFXINIT
	select INTEL_GMA_HAVE_VBT
	select SUPERIO_NUVOTON_NCT6779D
	select DRIVERS_ASMEDIA_ASPM_BLACKLIST # for ASM1061 eSATA

config MAINBOARD_DIR
	string
	default "asus/p8z77-m_pro"

config MAINBOARD_PART_NUMBER
	string
	default "P8Z77-M PRO"

config MAX_CPUS
	int
	default 8

endif # BOARD_ASUS_P8Z77_M_PRO
```

## src/mainboard/asus/p8z77-m_pro/Kconfig.name
```kconfig
## SPDX-License-Identifier: GPL-2.0-only

config BOARD_ASUS_P8Z77_M_PRO
	bool "P8Z77-M PRO"
```

## src/mainboard/asus/p8z77-series/Kconfig
```kconfig
## SPDX-License-Identifier: GPL-2.0-only

config BOARD_ASUS_P8Z77_SERIES
	bool
	select HAVE_ACPI_RESUME
	select HAVE_ACPI_TABLES
	select HAVE_CMOS_DEFAULT
	select HAVE_OPTION_TABLE
	select INTEL_GMA_HAVE_VBT
	select INTEL_INT15
	select MAINBOARD_HAS_LIBGFXINIT
	select NORTHBRIDGE_INTEL_SANDYBRIDGE
	select SERIRQ_CONTINUOUS_MODE
	select SOUTHBRIDGE_INTEL_C216

if BOARD_ASUS_P8Z77_SERIES

config MAINBOARD_DIR
	string
	default "asus/p8z77-series"

config VARIANT_DIR
	string
	default "p8z77-m_pro" if BOARD_ASUS_P8Z77_M_PRO
	default "p8z77-v_lx2" if BOARD_ASUS_P8Z77_V_LX2
	default "p8z77-v"     if BOARD_ASUS_P8Z77_V

config MAINBOARD_PART_NUMBER
	string
	default "P8Z77-M PRO" if BOARD_ASUS_P8Z77_M_PRO
	default "P8Z77-V LX2" if BOARD_ASUS_P8Z77_V_LX2
	default "P8Z77-V"     if BOARD_ASUS_P8Z77_V

config OVERRIDE_DEVICETREE
	string
	default "variants/\$(CONFIG_VARIANT_DIR)/overridetree.cb"

config CMOS_DEFAULT_FILE
	default "src/mainboard/\$(MAINBOARDDIR)/variants/\$(CONFIG_VARIANT_DIR)/cmos.default"

config CMOS_LAYOUT_FILE
	default "src/mainboard/\$(MAINBOARDDIR)/variants/\$(CONFIG_VARIANT_DIR)/cmos.layout"

endif
```

## src/mainboard/asus/p8z77-series/Kconfig.name
```kconfig
config BOARD_ASUS_P8Z77_M_PRO
	bool "P8Z77-M PRO"
	select BOARD_ASUS_P8Z77_SERIES
	select BOARD_ROMSIZE_KB_8192
	select DRIVERS_ASMEDIA_ASPM_BLACKLIST # for ASM1061 eSATA
	select MAINBOARD_HAS_LPC_TPM
	select SUPERIO_NUVOTON_NCT6779D

config BOARD_ASUS_P8Z77_V_LX2
	bool "P8Z77-V LX2"
	select BOARD_ASUS_P8Z77_SERIES
	select BOARD_ROMSIZE_KB_8192
	select REALTEK_8168_RESET
	select SUPERIO_NUVOTON_NCT6779D
	select USE_NATIVE_RAMINIT
```

## src/mainboard/asus/p8z77-v_lx2/Kconfig
```kconfig
## SPDX-License-Identifier: GPL-2.0-only

if BOARD_ASUS_P8Z77_V_LX2

config BOARD_SPECIFIC_OPTIONS
	def_bool y
	select BOARD_ROMSIZE_KB_8192
	select HAVE_ACPI_RESUME
	select HAVE_ACPI_TABLES
	select INTEL_GMA_HAVE_VBT
	select MAINBOARD_HAS_LIBGFXINIT
	select NORTHBRIDGE_INTEL_SANDYBRIDGE
	select REALTEK_8168_RESET
	select SERIRQ_CONTINUOUS_MODE
	select SOUTHBRIDGE_INTEL_C216
	select SUPERIO_NUVOTON_NCT6779D
	select USE_NATIVE_RAMINIT

config MAINBOARD_DIR
	string
	default "asus/p8z77-v_lx2"

config MAINBOARD_PART_NUMBER
	string
	default "P8Z77-V LX2"

endif
```

## src/mainboard/asus/z87-k/Kconfig
```kconfig
## SPDX-License-Identifier: GPL-2.0-only

if BOARD_ASUS_Z87_K

config BOARD_SPECIFIC_OPTIONS
	def_bool y
	select BOARD_ROMSIZE_KB_8192
	select HAVE_ACPI_RESUME
	select HAVE_ACPI_TABLES
	select INTEL_GMA_HAVE_VBT
	select MAINBOARD_HAS_LIBGFXINIT
	select MAINBOARD_USES_IFD_GBE_REGION
	select MEMORY_MAPPED_TPM
	select NORTHBRIDGE_INTEL_HASWELL
	select SERIRQ_CONTINUOUS_MODE
	select SOUTHBRIDGE_INTEL_LYNXPOINT
	select SUPERIO_NUVOTON_COMMON_COM_A
	select SUPERIO_NUVOTON_NCT6791D

config CBFS_SIZE
	default 0x680000

config MAINBOARD_DIR
	default "asus/z87-k"

config MAINBOARD_PART_NUMBER
	default "Z87-K"

config USBDEBUG_HCD_INDEX
	default 2	# Rear:		USB910 (Bottom)
			# Header:	USB3_12
endif
```

## src/mainboard/axus/tc320/Kconfig
```kconfig
##
## This file is part of the coreboot project.
##
## Copyright (C) 2009 Uwe Hermann <uwe@hermann-uwe.de>
##
## This program is free software; you can redistribute it and/or modify
## it under the terms of the GNU General Public License as published by
## the Free Software Foundation; version 2 of the License.
##
## This program is distributed in the hope that it will be useful,
## but WITHOUT ANY WARRANTY; without even the implied warranty of
## MERCHANTABILITY or FITNESS FOR A PARTICULAR PURPOSE.  See the
## GNU General Public License for more details.
##
## You should have received a copy of the GNU General Public License
## along with this program; if not, write to the Free Software
## Foundation, Inc., 51 Franklin St, Fifth Floor, Boston, MA 02110-1301 USA
##
if BOARD_AXUS_TC320

config BOARD_SPECIFIC_OPTIONS # dummy
	def_bool y
	select ARCH_X86
	select CPU_AMD_GEODE_GX1
	select NORTHBRIDGE_AMD_GX1
	select SOUTHBRIDGE_AMD_CS5530
	select SUPERIO_NSC_PC97317
	select ROMCC
	select HAVE_PIRQ_TABLE
	select PIRQ_ROUTE
	select UDELAY_TSC
	select BOARD_ROMSIZE_KB_256

config MAINBOARD_DIR
	string
	default axus/tc320

config MAINBOARD_PART_NUMBER
	string
	default "TC320"

# Soldered NIC, internal USB, no real PCI slots.
config IRQ_SLOT_COUNT
	int
	default 2

endif # BOARD_AXUS_TC320
```

## src/mainboard/azza/pt-6ibd/Kconfig
```kconfig
##
## This file is part of the coreboot project.
##
## Copyright (C) 2009 Uwe Hermann <uwe@hermann-uwe.de>
##
## This program is free software; you can redistribute it and/or modify
## it under the terms of the GNU General Public License as published by
## the Free Software Foundation; either version 2 of the License, or
## (at your option) any later version.
##
## This program is distributed in the hope that it will be useful,
## but WITHOUT ANY WARRANTY; without even the implied warranty of
## MERCHANTABILITY or FITNESS FOR A PARTICULAR PURPOSE.  See the
## GNU General Public License for more details.
##
## You should have received a copy of the GNU General Public License
## along with this program; if not, write to the Free Software
## Foundation, Inc., 51 Franklin St, Fifth Floor, Boston, MA  02110-1301 USA
##

config BOARD_AZZA_PT_6IBD
	bool "PT-6IBD"
	select ARCH_X86
	select CPU_INTEL_SLOT_2
	select NORTHBRIDGE_INTEL_I440BX
	select SOUTHBRIDGE_INTEL_I82371EB
	select SUPERIO_WINBOND_W83977TF
	select HAVE_PIRQ_TABLE
	select UDELAY_TSC
	select TSC_X86RDTSC_CALIBRATE_WITH_TIMER2

config MAINBOARD_DIR
	string
	default azza/pt-6ibd
	depends on BOARD_AZZA_PT_6IBD

config MAINBOARD_PART_NUMBER
	string
	default "PT-6IBD"
	depends on BOARD_AZZA_PT_6IBD

config HAVE_OPTION_TABLE
	bool
	default n
	depends on BOARD_AZZA_PT_6IBD

config IRQ_SLOT_COUNT
	int
	default 7
	depends on BOARD_AZZA_PT_6IBD
```

## src/mainboard/bachmann/Kconfig
```kconfig
if VENDOR_BACHMANN

choice
	prompt "Mainboard model"

source "src/mainboard/bachmann/*/Kconfig.name"

endchoice

source "src/mainboard/bachmann/*/Kconfig"

config MAINBOARD_VENDOR
	string
	default "Bachmann electronic"

endif # VENDOR_BACHMANN
```

## src/mainboard/bachmann/ot200/Kconfig
```kconfig
if BOARD_BACHMANN_OT200

config BOARD_SPECIFIC_OPTIONS # dummy
	def_bool y
	select ARCH_X86
	select CPU_AMD_GEODE_LX
	select NORTHBRIDGE_AMD_LX
	select SOUTHBRIDGE_AMD_CS5536
	select HAVE_PIRQ_TABLE
	select PIRQ_ROUTE
	select UDELAY_TSC
	select BOARD_ROMSIZE_KB_2048
	select POWER_BUTTON_DEFAULT_DISABLE
	select DRIVERS_I2C_IDREG
	select PLL_MANUAL_CONFIG
	select CORE_GLIU_500_266
	select HAVE_OPTION_TABLE

config MAINBOARD_DIR
	string
	default bachmann/ot200

config MAINBOARD_PART_NUMBER
	string
	default "OT200"

config IRQ_SLOT_COUNT
	int
	default 6

config PLLMSRlo
	hex
	default 0x07de001e

endif # BOARD_BACHMANN_OT200
```
