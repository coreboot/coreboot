## src/mainboard/bap/Kconfig
```kconfig
## SPDX-License-Identifier: GPL-2.0-only

if VENDOR_BAP

choice
	prompt "Mainboard model"

source "src/mainboard/bap/*/Kconfig.name"

endchoice

source "src/mainboard/bap/*/Kconfig"

config MAINBOARD_VENDOR
	default "BAP"

endif # VENDOR_BAP
```

## src/mainboard/bap/ode_e20XX/Kconfig
```kconfig
# SPDX-License-Identifier: GPL-2.0-only

if BOARD_ODE_E20XX

config BOARD_SPECIFIC_OPTIONS
	def_bool y
	select CPU_AMD_AGESA_FAMILY16_KB
	select NORTHBRIDGE_AMD_AGESA_FAMILY16_KB
	select SOUTHBRIDGE_AMD_AGESA_YANGTZE
	select DEFAULT_POST_ON_LPC
	select HAVE_OPTION_TABLE
	select HAVE_PIRQ_TABLE
	select HAVE_ACPI_TABLES
	select BOARD_ROMSIZE_KB_4096
	select GFXUMA
	select SUPERIO_FINTEK_F81866D
	select HAVE_SPD_IN_CBFS

config MAINBOARD_DIR
	default "bap/ode_e20XX"

config MAINBOARD_PART_NUMBER
	default "ODE_E20XX"

config HW_MEM_HOLE_SIZEK
	hex
	default 0x200000

config MAX_CPUS
	int
	default 4

config IRQ_SLOT_COUNT
	int
	default 11

config ONBOARD_VGA_IS_PRIMARY
	bool
	default y

config HUDSON_LEGACY_FREE
	bool
	default y

choice
	prompt "Select DDR3 clock"
	default BAP_E20_DDR3_1066
	help
	  Select your preferred DDR3 clock setting.

	  Note: This option changes the total power consumption.

	  If unsure, use DDR3-1066.

config BAP_E20_DDR3_800
	bool "Select DDR3-800"

config BAP_E20_DDR3_1066
	bool "Select DDR3-1066"

endchoice

config DIMM_SPD_SIZE
	default 128

endif # BOARD_ODE_E20XX
```

## src/mainboard/bap/ode_e21XX/Kconfig
```kconfig
# SPDX-License-Identifier: GPL-2.0-only

config BOARD_ODE_E21XX
	def_bool n

if BOARD_ODE_E21XX

config BOARD_SPECIFIC_OPTIONS
	def_bool y
	#select BINARYPI_LEGACY_WRAPPER
	#select ROMCC_BOOTBLOCK
	select CPU_AMD_PI_00730F01
	select NORTHBRIDGE_AMD_PI_00730F01
	select SOUTHBRIDGE_AMD_PI_AVALON
	select DEFAULT_POST_ON_LPC
	select HAVE_OPTION_TABLE
	select HAVE_PIRQ_TABLE
	select HAVE_MP_TABLE
	select HAVE_ACPI_TABLES
	select BOARD_ROMSIZE_KB_8192
	select GFXUMA
	select SUPERIO_FINTEK_F81866D

config MAINBOARD_DIR
	string
	default "bap/ode_e21XX"

config MAINBOARD_PART_NUMBER
	string
	default "ODE_E21XX"

config MAX_CPUS
	int
	default 4

config IRQ_SLOT_COUNT
	int
	default 11

config ONBOARD_VGA_IS_PRIMARY
	bool
	default y

config HUDSON_LEGACY_FREE
	bool
	default y

choice
	prompt "Select DDR3 clock"
	default BAP_E21_DDR3_1333
	help
	  Select your preferenced DDR3 clock setting.

	  Note: This option changes the total power consumption.

	  If unsure, use DDR3-1333.

config BAP_E21_DDR3_800
	bool "Select DDR3-800"

config BAP_E21_DDR3_1066
	bool "Select DDR3-1066"

config BAP_E21_DDR3_1333
	bool "Select DDR3-1333"

endchoice

config DIMM_SPD_SIZE
	int
	default 128

endif # BOARD_ODE_E21XX
```

## src/mainboard/bcom/Kconfig
```kconfig
##
## This file is part of the coreboot project.
##
## Copyright (C) 2009 Uwe Hermann <uwe@hermann-uwe.de>
##
## This program is free software; you can redistribute it and/or modify
## it under the terms of the GNU General Public License as published by
## the Free Software Foundation; version 2 of the License.
##
## This program is distributed in the hope that it will be useful,
## but WITHOUT ANY WARRANTY; without even the implied warranty of
## MERCHANTABILITY or FITNESS FOR A PARTICULAR PURPOSE.  See the
## GNU General Public License for more details.
##
## You should have received a copy of the GNU General Public License
## along with this program; if not, write to the Free Software
## Foundation, Inc., 51 Franklin St, Fifth Floor, Boston, MA 02110-1301 USA
##
if VENDOR_BCOM

choice
	prompt "Mainboard model"

config BOARD_BCOM_WINNET100
	bool "WinNET100"
config BOARD_BCOM_WINNETP680
	bool "WinNET P680"

endchoice

source "src/mainboard/bcom/winnet100/Kconfig"
source "src/mainboard/bcom/winnetp680/Kconfig"

config MAINBOARD_VENDOR
	string
	default "BCOM"

endif # VENDOR_BCOM
```

## src/mainboard/bcom/winnetp680/Kconfig
```kconfig
if BOARD_BCOM_WINNETP680

config BOARD_SPECIFIC_OPTIONS # dummy
	def_bool y
	select ARCH_X86
	select CPU_VIA_C7
	select NORTHBRIDGE_VIA_CN700
	select SOUTHBRIDGE_VIA_VT8237R
	select SUPERIO_WINBOND_W83697HF
	select HAVE_PIRQ_TABLE
	select HAVE_OPTION_TABLE
	select UDELAY_TSC
	select BOARD_ROMSIZE_KB_512

config MAINBOARD_DIR
	string
	default bcom/winnetp680

config MAINBOARD_PART_NUMBER
	string
	default "WinNET P680"

config IRQ_SLOT_COUNT
	int
	default 10

endif # BOARD_BCOM_WINNETP680
```

## src/mainboard/bifferos/bifferboard/Kconfig
```kconfig
if BOARD_BIFFEROS_BIFFERBOARD

config BOARD_SPECIFIC_OPTIONS
	def_bool y
	select BOARD_ROMSIZE_KB_128
	select SOC_RDC_R8610

config MAINBOARD_DIR
	string
	default bifferos/bifferboard

config MAINBOARD_PART_NUMBER
	string
	default "Bifferboard"

endif # BOARD_BIFFEROS_BIFFERBOARD
```

## src/mainboard/biostar/Kconfig
```kconfig
## SPDX-License-Identifier: GPL-2.0-only

if VENDOR_BIOSTAR

choice
	prompt "Mainboard model"

source "src/mainboard/biostar/*/Kconfig.name"

endchoice

source "src/mainboard/biostar/*/Kconfig"

config MAINBOARD_VENDOR
	default "Biostar"

endif # VENDOR_BIOSTAR
```

## src/mainboard/biostar/a68n_5200/Kconfig
```kconfig
# SPDX-License-Identifier: GPL-2.0-only

if BOARD_BIOSTAR_A68N5200

config BOARD_SPECIFIC_OPTIONS
	def_bool y
	select CPU_AMD_AGESA_FAMILY16_KB
	select NORTHBRIDGE_AMD_AGESA_FAMILY16_KB
	select SOUTHBRIDGE_AMD_AGESA_YANGTZE
	select SUPERIO_ITE_IT8728F
	select HAVE_OPTION_TABLE
	select HAVE_PIRQ_TABLE
	select HAVE_ACPI_TABLES
	select BOARD_ROMSIZE_KB_4096
	select GFXUMA

config MAINBOARD_DIR
	string
	default "biostar/a68n_5200"

config MAINBOARD_PART_NUMBER
	string
	default "A68N5200"

config HW_MEM_HOLE_SIZEK
	hex
	default 0x200000

config MAX_CPUS
	int
	default 4

config IRQ_SLOT_COUNT
	int
	default 11

config ONBOARD_VGA_IS_PRIMARY
	bool
	default y

config HUDSON_LEGACY_FREE
	bool
	default n

endif # BOARD_BIOSTAR_A68N5200
```

## src/mainboard/biostar/am1ml/Kconfig
```kconfig
# SPDX-License-Identifier: GPL-2.0-only

if BOARD_BIOSTAR_AM1ML

config BOARD_SPECIFIC_OPTIONS
	def_bool y
	select BOARD_ROMSIZE_KB_4096
	select CPU_AMD_AGESA_FAMILY16_KB
	select FORCE_AM1_SOCKET_SUPPORT
	select GFXUMA
	select HAVE_OPTION_TABLE
	select HAVE_PIRQ_TABLE
	select HAVE_ACPI_RESUME
	select HAVE_ACPI_TABLES
	select NORTHBRIDGE_AMD_AGESA_FAMILY16_KB
	select SOUTHBRIDGE_AMD_AGESA_YANGTZE
	select DEFAULT_POST_ON_LPC
	select SUPERIO_ITE_IT8728F

config MAINBOARD_DIR
	string
	default "biostar/am1ml"

config MAINBOARD_PART_NUMBER
	string
	default "AM1ML"

config HW_MEM_HOLE_SIZEK
	hex
	default 0x200000

config MAX_CPUS
	int
	default 4

config IRQ_SLOT_COUNT
	int
	default 10

config ONBOARD_VGA_IS_PRIMARY
	bool
	default y

config HUDSON_LEGACY_FREE
	bool
	default n

endif # BOARD_BIOSTAR_AM1ML
```

## src/mainboard/biostar/m6tba/Kconfig
```kconfig
##
## This file is part of the coreboot project.
##
## Copyright (C) 2009 Uwe Hermann <uwe@hermann-uwe.de>
##
## This program is free software; you can redistribute it and/or modify
## it under the terms of the GNU General Public License as published by
## the Free Software Foundation; either version 2 of the License, or
## (at your option) any later version.
##
## This program is distributed in the hope that it will be useful,
## but WITHOUT ANY WARRANTY; without even the implied warranty of
## MERCHANTABILITY or FITNESS FOR A PARTICULAR PURPOSE.  See the
## GNU General Public License for more details.
##
## You should have received a copy of the GNU General Public License
## along with this program; if not, write to the Free Software
## Foundation, Inc., 51 Franklin St, Fifth Floor, Boston, MA  02110-1301 USA
##

config BOARD_BIOSTAR_M6TBA
	bool "M6TBA"
	select ARCH_X86
	select CPU_INTEL_SLOT_2
	select NORTHBRIDGE_INTEL_I440BX
	select SOUTHBRIDGE_INTEL_I82371EB
	select SUPERIO_SMSC_SMSCSUPERIO
	select HAVE_PIRQ_TABLE
	select UDELAY_TSC
	select TSC_X86RDTSC_CALIBRATE_WITH_TIMER2

config MAINBOARD_DIR
	string
	default biostar/m6tba
	depends on BOARD_BIOSTAR_M6TBA

config MAINBOARD_PART_NUMBER
	string
	default "M6TBA"
	depends on BOARD_BIOSTAR_M6TBA

config HAVE_OPTION_TABLE
	bool
	default n
	depends on BOARD_BIOSTAR_M6TBA

config IRQ_SLOT_COUNT
	int
	default 7
	depends on BOARD_BIOSTAR_M6TBA
```

## src/mainboard/biostar/th61-itx/Kconfig
```kconfig
## SPDX-License-Identifier: GPL-2.0-only

if BOARD_BIOSTAR_TH61_ITX

config BOARD_SPECIFIC_OPTIONS
	def_bool y
	select AZALIA_USE_LEGACY_VERB_TABLE
	select BOARD_ROMSIZE_KB_4096
	select HAVE_ACPI_RESUME
	select HAVE_ACPI_TABLES
	select NORTHBRIDGE_INTEL_SANDYBRIDGE
	select SERIRQ_CONTINUOUS_MODE
	select SOUTHBRIDGE_INTEL_BD82X6X
	select USE_NATIVE_RAMINIT
	select SUPERIO_ITE_IT8728F
	select MAINBOARD_HAS_LIBGFXINIT
	select INTEL_GMA_HAVE_VBT
	select HAVE_OPTION_TABLE
	select HAVE_CMOS_DEFAULT
	select NO_UART_ON_SUPERIO

config MAINBOARD_DIR
	default "biostar/th61-itx"

config MAINBOARD_PART_NUMBER
	default "TH61-ITX"

config USBDEBUG_HCD_INDEX
	int
	default 2

endif # BOARD_BIOSTAR_TH61_ITX
```

## src/mainboard/biostar/th61-itx/Kconfig.name
```kconfig
## SPDX-License-Identifier: GPL-2.0-only

config BOARD_BIOSTAR_TH61_ITX
	bool "TH61-ITX"
```

## src/mainboard/bostentech/Kconfig
```kconfig
if VENDOR_BOSTENTECH

choice
	prompt "Mainboard model"

source "src/mainboard/bostentech/*/Kconfig.name"

endchoice

source "src/mainboard/bostentech/*/Kconfig"

config MAINBOARD_VENDOR
	default "Shenzhen Bostrontium Teng Technology"

config MAINBOARD_FAMILY
	string
	default MAINBOARD_PART_NUMBER

endif # VENDOR_BOSTENTECH
```

## src/mainboard/bostentech/Kconfig.name
```kconfig
## SPDX-License-Identifier: GPL-2.0-only

config VENDOR_BOSTENTECH
	bool "Bostentech (Shenzhen Bostrontium Teng Technology)"
```

## src/mainboard/bostentech/gbyt4/Kconfig
```kconfig
## SPDX-License-Identifier: GPL-2.0-only

if BOARD_BOSTENTECH_GBYT4

config BOARD_SPECIFIC_OPTIONS
	def_bool y
	select BOARD_ROMSIZE_KB_8192
	select HAVE_ACPI_RESUME
	select HAVE_ACPI_TABLES
	select HAVE_OPTION_TABLE
	select INTEL_GMA_HAVE_VBT
	select SOC_INTEL_BAYTRAIL
	select SUPERIO_ITE_IT8728F

config CBFS_SIZE
	default 0x500000

config MAINBOARD_DIR
	default "bostentech/gbyt4"

config MAINBOARD_PART_NUMBER
	default "GBYT4-4L"

config MAINBOARD_SMBIOS_MANUFACTURER
	string
	default "Shenzhen Bostrontium Teng Technology"

endif # BOARD_BOSTENTECH_GBYT4
```
