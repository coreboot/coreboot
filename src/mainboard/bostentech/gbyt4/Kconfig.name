## src/mainboard/bostentech/gbyt4/Kconfig.name
```kconfig
## SPDX-License-Identifier: GPL-2.0-only

config BOARD_BOSTENTECH_GBYT4
	bool "GBYT4"
```

## src/mainboard/broadcom/Kconfig
```kconfig
if VENDOR_BROADCOM

choice
	prompt "Mainboard model"

source "src/mainboard/broadcom/*/Kconfig.name"

endchoice

source "src/mainboard/broadcom/*/Kconfig"

config MAINBOARD_VENDOR
	string
	default "Broadcom"

endif # VENDOR_BROADCOM
```

## src/mainboard/broadcom/blast/Kconfig
```kconfig
if BOARD_BROADCOM_BLAST

config BOARD_SPECIFIC_OPTIONS # dummy
	def_bool y
	select ARCH_X86
	select CPU_AMD_SOCKET_940
	select NORTHBRIDGE_AMD_AMDK8
	select SOUTHBRIDGE_BROADCOM_BCM5780
	select SOUTHBRIDGE_BROADCOM_BCM5785
	select SUPERIO_NSC_PC87417
	select HAVE_OPTION_TABLE
	select HAVE_PIRQ_TABLE
	select HAVE_MP_TABLE
	select BOARD_ROMSIZE_KB_512
	select SB_HT_CHAIN_UNITID_OFFSET_ONLY
	select QRANK_DIMM_SUPPORT
	select DRIVERS_I2C_I2CMUX2

config MAINBOARD_DIR
	string
	default broadcom/blast

config DCACHE_RAM_BASE
	hex
	default 0xcf000

config DCACHE_RAM_SIZE
	hex
	default 0x01000

config APIC_ID_OFFSET
	hex
	default 0x0

config SB_HT_CHAIN_ON_BUS0
	int
	default 1

config MAINBOARD_PART_NUMBER
	string
	default "Blast"

config MAX_CPUS
	int
	default 4

config MAX_PHYSICAL_CPUS
	int
	default 2

config HT_CHAIN_END_UNITID_BASE
	hex
	default 0x1

config HT_CHAIN_UNITID_BASE
	hex
	default 0x6

config SB_HT_CHAIN_ON_BUS0
	int
	default 2

config IRQ_SLOT_COUNT
	int
	default 11

endif # BOARD_BROADCOM_BLAST
```

## src/mainboard/bytedance/Kconfig
```kconfig
if VENDOR_BYTEDANCE

choice
	prompt "Mainboard model"

source "src/mainboard/bytedance/*/Kconfig.name"

endchoice

source "src/mainboard/bytedance/*/Kconfig"

config MAINBOARD_VENDOR
	default "ByteDance"

endif # VENDOR_BYTEDANCE
```

## src/mainboard/bytedance/Kconfig.name
```kconfig
## SPDX-License-Identifier: GPL-2.0-only

config VENDOR_BYTEDANCE
	bool "ByteDance"
```

## src/mainboard/bytedance/bd_egs/Kconfig
```kconfig
if BOARD_BYTEDANCE_BD_EGS

config BOARD_SPECIFIC_OPTIONS
	def_bool y
	select BOARD_ROMSIZE_KB_65536
	select MAINBOARD_USES_FSP2_0
	select SOC_INTEL_SAPPHIRERAPIDS_SP
	select SUPERIO_ASPEED_AST2400
	select HAVE_ACPI_TABLES
	select MAINBOARD_USES_IFD_GBE_REGION
	select IPMI_KCS
	select MEMORY_MAPPED_TPM
	select MAINBOARD_HAS_TPM2
	select INTEL_DESCRIPTOR_MODE_CAPABLE

config MAINBOARD_DIR
	default "bytedance/bd_egs"

config MAINBOARD_PART_NUMBER
	default "ByteDance bd_egs"

config MAINBOARD_FAMILY
	default "Intel Eagle Stream Server"

config FMDFILE
	default "src/mainboard/\$(CONFIG_MAINBOARD_DIR)/board.fmd"

config MAX_SOCKET
	default 2

endif
```

## src/mainboard/bytedance/bd_egs/Kconfig.name
```kconfig
## SPDX-License-Identifier: GPL-2.0-only

config BOARD_BYTEDANCE_BD_EGS
	bool "ByteDance bd_egs"
```

## src/mainboard/cavium/Kconfig
```kconfig
## SPDX-License-Identifier: GPL-2.0-only

if VENDOR_CAVIUM

choice
	prompt "Mainboard model"

source "src/mainboard/cavium/*/Kconfig.name"

endchoice

source "src/mainboard/cavium/*/Kconfig"

config MAINBOARD_VENDOR
	default "Cavium"

endif # VENDOR_CAVIUM
```

## src/mainboard/cavium/cn8100_sff_evb/Kconfig
```kconfig
##
## This file is part of the coreboot project.
##
## Copyright 2018 Facebook, Inc.
##
## This program is free software; you can redistribute it and/or modify
## it under the terms of the GNU General Public License as published by
## the Free Software Foundation; version 2 of the License.
##
## This program is distributed in the hope that it will be useful,
## but WITHOUT ANY WARRANTY; without even the implied warranty of
## MERCHANTABILITY or FITNESS FOR A PARTICULAR PURPOSE.  See the
## GNU General Public License for more details.
##

if BOARD_CAVIUM_CN8100_SFF_EVB

config BOARD_SPECIFIC_OPTIONS
	def_bool y
	select BOARD_ROMSIZE_KB_16384
	select COMMON_CBFS_SPI_WRAPPER
	select RTC
	select SOC_CAVIUM_CN81XX
	select SPI_FLASH
	select SPI_FLASH_STMICRO

config MAINBOARD_DIR
	string
	default "cavium/cn8100_sff_evb"

config MAINBOARD_VENDOR
	string
	default "Cavium"

config DRAM_SIZE_MB
	int
	default 8192

config BOOT_DEVICE_SPI_FLASH_BUS
	int
	default 0

config CONSOLE_SERIAL_UART_ADDRESS
	hex
	depends on DRIVERS_UART
	default 0x87E028000000

config UART_FOR_CONSOLE
	int
	depends on DRIVERS_UART
	default 0

config FMDFILE
	string
	default "src/mainboard/$(CONFIG_MAINBOARD_DIR)/board.fmd"

config MAX_CPUS
	default 4

##########################################################
#### Update below when adding a new derivative board. ####
##########################################################
config DEVICETREE
	string
	default "devicetree.cb"

config MAINBOARD_PART_NUMBER
	string
	default "CN8100_SFF_EVB"

endif
```

## src/mainboard/cavium/cn8100_sff_evb/Kconfig.name
```kconfig
## SPDX-License-Identifier: GPL-2.0-only

config BOARD_CAVIUM_CN8100_SFF_EVB
	bool "CN8100 SFF EVB"
```

## src/mainboard/clevo/Kconfig
```kconfig
if VENDOR_CLEVO

choice
	prompt "Mainboard model"

source "src/mainboard/clevo/*/Kconfig.name"

endchoice

source "src/mainboard/clevo/*/Kconfig"

config MAINBOARD_VENDOR
	default "Clevo"

endif
```

## src/mainboard/clevo/cml-u/Kconfig
```kconfig
config BOARD_CLEVO_CMLU_COMMON
	def_bool n
	select BOARD_ROMSIZE_KB_16384
	select DRIVERS_I2C_HID
	select HAVE_ACPI_RESUME
	select HAVE_ACPI_TABLES
	select HAVE_CMOS_DEFAULT
	select HAVE_OPTION_TABLE
	select INTEL_GMA_HAVE_VBT
	select INTEL_LPSS_UART_FOR_CONSOLE
	select MAINBOARD_HAS_LIBGFXINIT
	select MEMORY_MAPPED_TPM
	select MAINBOARD_HAS_TPM2
	select NO_UART_ON_SUPERIO
	select SOC_INTEL_COMETLAKE_1
	select SOC_INTEL_COMMON_BLOCK_HDA_VERB
	select SPD_READ_BY_WORD
	select SYSTEM_TYPE_LAPTOP

config BOARD_CLEVO_L140CU_BASE
	bool
	select BOARD_CLEVO_CMLU_COMMON
	select EC_SYSTEM76_EC
	select HAVE_SPD_IN_CBFS

if BOARD_CLEVO_CMLU_COMMON

config MAINBOARD_DIR
	default "clevo/cml-u"

config MAINBOARD_PART_NUMBER
	default "L140CU" if BOARD_CLEVO_L140CU

config MAINBOARD_VERSION
	string
	default "2.1A" if BOARD_CLEVO_L140CU_BASE

config DEVICETREE
	default "variants/\$(CONFIG_VARIANT_DIR)/devicetree.cb"

config CBFS_SIZE
	default 0xc00000 if BOARD_CLEVO_L140CU_BASE

config CONSOLE_POST
	bool
	default y

config UART_FOR_CONSOLE
	int
	default 2

config DIMM_MAX
	default 2 if BOARD_CLEVO_L140CU_BASE

config VGA_BIOS_ID
	string
	default "8086,9b41"

config TPM_PIRQ
	hex
	default 0x10 if BOARD_CLEVO_L140CU_BASE # GPP_A7/PIRQA#

config POST_DEVICE
	bool
	default n

config VARIANT_DIR
	default "l140cu" if BOARD_CLEVO_L140CU_BASE

config SEABIOS_PS2_TIMEOUT
	int
	depends on PAYLOAD_SEABIOS
	default 500

config EC_SYSTEM76_EC_BAT_THRESHOLDS
	default n if BOARD_CLEVO_L140CU_BASE

endif
```

## src/mainboard/clevo/cml-u/Kconfig.name
```kconfig
## SPDX-License-Identifier: GPL-2.0-only

comment "Comet Lake U"

config BOARD_CLEVO_L140CU
	bool "L140CU / L141CU"
```

## src/mainboard/clevo/kbl-u/Kconfig
```kconfig
# SPDX-License-Identifier: GPL-2.0-only

config BOARD_CLEVO_KBLU_COMMON
	def_bool n
	select BOARD_ROMSIZE_KB_8192
	select EC_ACPI
	select HAVE_ACPI_RESUME
	select HAVE_ACPI_TABLES
#	select HAVE_CMOS_DEFAULT
	select INTEL_GMA_HAVE_VBT
	select INTEL_LPSS_UART_FOR_CONSOLE
	select MAINBOARD_HAS_LIBGFXINIT
	select MEMORY_MAPPED_TPM
	select MAINBOARD_HAS_TPM2
	select NO_UART_ON_SUPERIO
	select SOC_INTEL_COMMON_BLOCK_HDA_VERB
	select SOC_INTEL_KABYLAKE
	select SPD_READ_BY_WORD
	select SYSTEM_TYPE_LAPTOP

config BOARD_CLEVO_N130WU_OPTIONS
	bool
	select BOARD_CLEVO_KBLU_COMMON

if BOARD_CLEVO_KBLU_COMMON

config VBOOT
	select VBOOT_NO_BOARD_SUPPORT
	select GBB_FLAG_DISABLE_LID_SHUTDOWN
	select GBB_FLAG_DISABLE_EC_SOFTWARE_SYNC
	select GBB_FLAG_DISABLE_PD_SOFTWARE_SYNC
	select GBB_FLAG_DISABLE_FWMP

config MAINBOARD_DIR
	default "clevo/kbl-u"

config VARIANT_DIR
	default "n13xwu" if BOARD_CLEVO_N130WU

config MAINBOARD_PART_NUMBER
	default "N130WU" if BOARD_CLEVO_N130WU

config CBFS_SIZE
	default 0x600000 if BOARD_CLEVO_N130WU

config DEVICETREE
	default "variants/\$(CONFIG_VARIANT_DIR)/devicetree.cb"

config FMDFILE
	default "src/mainboard/\$(CONFIG_MAINBOARD_DIR)/variants/\$(CONFIG_VARIANT_DIR)/fmds/vboot-ro.fmd"	if VBOOT && !VBOOT_SLOTS_RW_A
	# TODO
#	default "src/mainboard/\$(CONFIG_MAINBOARD_DIR)/fmds/vboot-roa.fmd"	if VBOOT_SLOTS_RW_A && !VBOOT_SLOTS_RW_AB
#	default "src/mainboard/\$(CONFIG_MAINBOARD_DIR)/fmds/vboot-roab.fmd"	if VBOOT_SLOTS_RW_AB

config DIMM_MAX
	default 2

config DIMM_SPD_SIZE
	default 512

config VGA_BIOS_ID
	string
	default "8086,5917" if BOARD_CLEVO_N130WU

config PXE_ROM_ID
	string
	default "10ec,8168"

config UART_FOR_CONSOLE
	int
	default 2

config POST_DEVICE
	bool
	default n

config CONSOLE_POST
	bool
	default y

config LINEAR_FRAMEBUFFER_MAX_WIDTH
	int
	default 1920

config LINEAR_FRAMEBUFFER_MAX_HEIGHT
	int
	default 1080

endif
```

## src/mainboard/clevo/kbl-u/Kconfig.name
```kconfig
# SPDX-License-Identifier: GPL-2.0-only

comment "Kaby Lake U"

config BOARD_CLEVO_N130WU
	bool "N130WU / N131WU"
```

## src/mainboard/clevo/tgl-u/Kconfig
```kconfig
config BOARD_CLEVO_TGLU_COMMON
	def_bool n
	select BOARD_ROMSIZE_KB_16384
	select DRIVERS_I2C_HID
	select DRIVERS_INTEL_PMC
	select DRIVERS_INTEL_USB4_RETIMER
	select HAVE_ACPI_TABLES
	select HAVE_CMOS_DEFAULT
	select HAVE_OPTION_TABLE
	select INTEL_GMA_HAVE_VBT
	select INTEL_LPSS_UART_FOR_CONSOLE
	select MEMORY_MAPPED_TPM
	select MAINBOARD_HAS_TPM2
	select NO_UART_ON_SUPERIO
	select SOC_INTEL_COMMON_BLOCK_HDA_VERB
	select SOC_INTEL_ENABLE_USB4_PCIE_RESOURCES
	select SOC_INTEL_TIGERLAKE
	select SPD_READ_BY_WORD
	select SYSTEM_TYPE_LAPTOP

config BOARD_CLEVO_L140MU
	select BOARD_CLEVO_TGLU_COMMON
	select HAVE_SPD_IN_CBFS

if BOARD_CLEVO_TGLU_COMMON

config MAINBOARD_DIR
	default "clevo/tgl-u"

config VARIANT_DIR
	default "l140mu" if BOARD_CLEVO_L140MU

config MAINBOARD_PART_NUMBER
	default "L140MU" if BOARD_CLEVO_L140MU

config MAINBOARD_VERSION
	default "2.2A" if BOARD_CLEVO_L140MU

config DEVICETREE
	default "variants/\$(CONFIG_VARIANT_DIR)/devicetree.cb"

config CBFS_SIZE
	default 0xb00000 if BOARD_CLEVO_L140MU

config CONSOLE_POST
	default y

config UART_FOR_CONSOLE
	default 2

config TPM_PIRQ
	default 0x77 if BOARD_CLEVO_L140MU # GPP_C9_IRQ

config POST_DEVICE
	default n

config SEABIOS_PS2_TIMEOUT
	default 500

config USE_PM_ACPI_TIMER
	default n

endif
```

## src/mainboard/clevo/tgl-u/Kconfig.name
```kconfig
## SPDX-License-Identifier: GPL-2.0-only

comment "Tiger Lake U"

config BOARD_CLEVO_L140MU
	bool "L140MU / L141MU / L142MU"
```

## src/mainboard/compaq/deskpro_en_sff_p600/Kconfig
```kconfig
##
## This file is part of the coreboot project.
##
## Copyright (C) 2009 Uwe Hermann <uwe@hermann-uwe.de>
##
## This program is free software; you can redistribute it and/or modify
## it under the terms of the GNU General Public License as published by
## the Free Software Foundation; version 2 of the License.
##
## This program is distributed in the hope that it will be useful,
## but WITHOUT ANY WARRANTY; without even the implied warranty of
## MERCHANTABILITY or FITNESS FOR A PARTICULAR PURPOSE.  See the
## GNU General Public License for more details.
##
## You should have received a copy of the GNU General Public License
## along with this program; if not, write to the Free Software
## Foundation, Inc., 51 Franklin St, Fifth Floor, Boston, MA 02110-1301 USA
##
if BOARD_COMPAQ_DESKPRO_EN_SFF_P600

config BOARD_SPECIFIC_OPTIONS # dummy
	def_bool y
	select ARCH_X86
	select CPU_INTEL_SLOT_1
	select NORTHBRIDGE_INTEL_I440BX
	select SOUTHBRIDGE_INTEL_I82371EB
	# should be SUPERIO_NSC_PC97307!
	select SUPERIO_NSC_PC97317
	select HAVE_PIRQ_TABLE
	select UDELAY_TSC
	select BOARD_ROMSIZE_KB_256

config MAINBOARD_DIR
	string
	default compaq/deskpro_en_sff_p600

config MAINBOARD_PART_NUMBER
	string
	default "Deskpro EN SFF P600"

config IRQ_SLOT_COUNT
	int
	default 5

endif # BOARD_COMPAQ_DESKPRO_EN_SFF_P600
```
