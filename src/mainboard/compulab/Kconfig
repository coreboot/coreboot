## src/mainboard/compulab/Kconfig
```kconfig
if VENDOR_COMPULAB

choice
	prompt "Mainboard model"

source "src/mainboard/compulab/*/Kconfig.name"

endchoice

source "src/mainboard/compulab/*/Kconfig"

config MAINBOARD_VENDOR
	default "CompuLab"

endif # VENDOR_COMPULAB
```

## src/mainboard/compulab/Kconfig.name
```kconfig
## SPDX-License-Identifier: GPL-2.0-only

config VENDOR_COMPULAB
	bool "CompuLab"
```

## src/mainboard/compulab/intense_pc/Kconfig
```kconfig
## SPDX-License-Identifier: GPL-2.0-only

if BOARD_COMPULAB_INTENSE_PC

config BOARD_SPECIFIC_OPTIONS
	def_bool y
	select AZALIA_USE_LEGACY_VERB_TABLE
	select BOARD_ROMSIZE_KB_16384
	select EC_ACPI
	select HAVE_ACPI_RESUME
	select HAVE_ACPI_TABLES
	select INTEL_INT15
	select NORTHBRIDGE_INTEL_SANDYBRIDGE
	select SERIRQ_CONTINUOUS_MODE
	select SOUTHBRIDGE_INTEL_C216
	select SYSTEM_TYPE_LAPTOP
	select USE_NATIVE_RAMINIT
	select SUPERIO_SMSC_SIO1007
	select MAINBOARD_HAS_LIBGFXINIT
	select MAINBOARD_USES_IFD_GBE_REGION

config MAINBOARD_DIR
	default "compulab/intense_pc"

config MAINBOARD_PART_NUMBER
	default "Intense-PC"

config VGA_BIOS_ID
	string
	default "8086,0166"

config DRAM_RESET_GATE_GPIO # FIXME: check this
	int
	default 60

config USBDEBUG_HCD_INDEX # FIXME: check this
	int
	default 2

config ENABLE_MSATA # enable mSATA instead of mPCIe on full height slot
	bool "Use full-height mini-PCIe for mSATA"
	default n
endif
```

## src/mainboard/compulab/intense_pc/Kconfig.name
```kconfig
## SPDX-License-Identifier: GPL-2.0-only

config BOARD_COMPULAB_INTENSE_PC
	bool "Intense-PC"
```

## src/mainboard/cubietech/Kconfig
```kconfig
if VENDOR_CUBIETECH

# Auto select common options
choice
	prompt "Mainboard model"

source "src/mainboard/cubietech/*/Kconfig.name"

endchoice

source "src/mainboard/cubietech/*/Kconfig"

config MAINBOARD_VENDOR
	string
	default "Cubietech"

endif # VENDOR_CUBIETECH
```

## src/mainboard/cubietech/cubieboard/Kconfig
```kconfig
if BOARD_CUBIETECH_CUBIEBOARD

config BOARD_SPECIFIC_OPTIONS # dummy
	def_bool y
	select CPU_ALLWINNER_A10
	select BOARD_ROMSIZE_KB_4096
	select DRIVER_XPOWERS_AXP209

config MAINBOARD_DIR
	string
	default cubietech/cubieboard

config MAINBOARD_PART_NUMBER
	string
	default "Cubieboard A10"

config MAX_CPUS
	int
	default 1

config DRAM_SIZE_MB
	int
	default 1024

config UART_FOR_CONSOLE
	int
	default 0

endif # BOARD_CUBIETECH_CUBIEBOARD
```

## src/mainboard/cwwk/Kconfig
```kconfig
## SPDX-License-Identifier: GPL-2.0-or-later

if VENDOR_CWWK

choice
	prompt "Mainboard model"

source "src/mainboard/cwwk/*/Kconfig.name"

endchoice

source "src/mainboard/cwwk/*/Kconfig"

config MAINBOARD_VENDOR
	default "CWWK"

endif # VENDOR_CWWK
```

## src/mainboard/cwwk/adl/Kconfig
```kconfig
## SPDX-License-Identifier: GPL-2.0-or-later

config BOARD_CWWK_ADL_N_COMMON
	def_bool y
	select BOARD_ROMSIZE_KB_16384
	select CRB_TPM
	select DRIVERS_UART_8250IO
	select FSP_TYPE_IOT
	select HAVE_ACPI_RESUME
	select HAVE_ACPI_TABLES
	select HAVE_INTEL_PTT
	select INTEL_GMA_HAVE_VBT
	select SOC_INTEL_ALDERLAKE_PCH_N
	select SUPERIO_ITE_IT8613E

config BOARD_CWWK_CW_ADL_4L_V1
	select BOARD_CWWK_ADL_N_COMMON

config BOARD_CWWK_CW_ADLNTB_1C2L_V3
	select BOARD_CWWK_ADL_N_COMMON

if BOARD_CWWK_ADL_N_COMMON

config MAINBOARD_DIR
	default "cwwk/adl"

config VARIANT_DIR
	default "cw-adl-4l-v1.0"      if BOARD_CWWK_CW_ADL_4L_V1
	default "cw-adlntb-1c2l-v3.0" if BOARD_CWWK_CW_ADLNTB_1C2L_V3

config MAINBOARD_PART_NUMBER
	default "CW-ADL-4L-V1.0"      if BOARD_CWWK_CW_ADL_4L_V1
	default "CW-ADLNTB-1C2L-V3.0" if BOARD_CWWK_CW_ADLNTB_1C2L_V3

config MAINBOARD_SMBIOS_PRODUCT_NAME
	default "CW-ADL-4L-V1.0"      if BOARD_CWWK_CW_ADL_4L_V1
	default "CW-X86-P5-V3"        if BOARD_CWWK_CW_ADLNTB_1C2L_V3

config MAINBOARD_VERSION
	default "CW-ADL-4L-V1.0"      if BOARD_CWWK_CW_ADL_4L_V1
	default "CW-ADLNTB-1C2L-V3.0" if BOARD_CWWK_CW_ADLNTB_1C2L_V3

# Override the default variant behavior, since the data.vbt is the same
config INTEL_GMA_VBT_FILE
	default "src/mainboard/\$(MAINBOARDDIR)/data.vbt"

config NO_POST
	default y

endif
```

## src/mainboard/cwwk/adl/Kconfig.name
```kconfig
## SPDX-License-Identifier: GPL-2.0-or-later

config BOARD_CWWK_CW_ADL_4L_V1
	bool "CW-ADL-4L-V1.0"

config BOARD_CWWK_CW_ADLNTB_1C2L_V3
	bool "CW-ADLNTB-1C2L-V3.0"
```

## src/mainboard/dell/Kconfig
```kconfig
## SPDX-License-Identifier: GPL-2.0-only

if VENDOR_DELL

choice
	prompt "Mainboard model"

source "src/mainboard/dell/*/Kconfig.name"

endchoice

source "src/mainboard/dell/*/Kconfig"

config MAINBOARD_VENDOR
	string
	default "Dell Inc."

endif # VENDOR_DELL
```

## src/mainboard/dell/e6400/Kconfig
```kconfig
## SPDX-License-Identifier: GPL-2.0-only

if BOARD_DELL_E6400

config BOARD_SPECIFIC_OPTIONS
	def_bool y
	select SYSTEM_TYPE_LAPTOP
	select CPU_INTEL_SOCKET_P
	select NORTHBRIDGE_INTEL_GM45
	select SOUTHBRIDGE_INTEL_I82801IX
	select BOARD_ROMSIZE_KB_4096
	select HAVE_ACPI_TABLES
	select HAVE_OPTION_TABLE
	select HAVE_CMOS_DEFAULT
	select HAVE_ACPI_RESUME
	select INTEL_INT15
	select MAINBOARD_HAS_LIBGFXINIT
	select MAINBOARD_USES_IFD_GBE_REGION
	select INTEL_GMA_HAVE_VBT
	select EC_DELL_MEC5035

config MAINBOARD_DIR
	default "dell/e6400"

config MAINBOARD_PART_NUMBER
	default "Latitude E6400" if BOARD_DELL_E6400

config USBDEBUG_HCD_INDEX
	default 1

config CBFS_SIZE
	default 0x1A0000

endif # BOARD_DELL_E6400
```

## src/mainboard/dell/e7240/Kconfig
```kconfig
## SPDX-License-Identifier: GPL-2.0-only

if BOARD_DELL_LATITUDE_E7240

config BOARD_SPECIFIC_OPTIONS
	def_bool y
	select BOARD_ROMSIZE_KB_8192
	select EC_DELL_MEC5035
	select HAVE_ACPI_RESUME
	select HAVE_ACPI_TABLES
	select INTEL_LYNXPOINT_LP
	select MAINBOARD_HAS_LIBGFXINIT
	select MAINBOARD_USES_IFD_GBE_REGION
	select NORTHBRIDGE_INTEL_HASWELL
	select SERIRQ_CONTINUOUS_MODE
	select SOUTHBRIDGE_INTEL_LYNXPOINT
	select SYSTEM_TYPE_LAPTOP

config MAINBOARD_DIR
	default "dell/e7240"

config MAINBOARD_PART_NUMBER
	default "Latitude E7240"

config VGA_BIOS_ID
	default "8086,0a16"

config USBDEBUG_HCD_INDEX
	default 1

endif
```

## src/mainboard/dell/gm45_latitude/Kconfig
```kconfig
## SPDX-License-Identifier: GPL-2.0-only

config BOARD_DELL_GM45_LATITUDE_COMMON
	def_bool n
	select AZALIA_USE_LEGACY_VERB_TABLE
	select SYSTEM_TYPE_LAPTOP
	select CPU_INTEL_SOCKET_P
	select NORTHBRIDGE_INTEL_GM45
	select SOUTHBRIDGE_INTEL_I82801IX
	select BOARD_ROMSIZE_KB_4096
	select HAVE_ACPI_TABLES
	select HAVE_OPTION_TABLE
	select HAVE_CMOS_DEFAULT
	select HAVE_ACPI_RESUME
	select INTEL_INT15
	select MAINBOARD_HAS_LIBGFXINIT
	select MAINBOARD_USES_IFD_GBE_REGION
	select INTEL_GMA_HAVE_VBT
	select EC_DELL_MEC5035

config BOARD_DELL_E6400
	select BOARD_DELL_GM45_LATITUDE_COMMON

if BOARD_DELL_GM45_LATITUDE_COMMON

config MAINBOARD_DIR
	default "dell/gm45_latitude"

config MAINBOARD_PART_NUMBER
	default "Latitude E6400" if BOARD_DELL_E6400

config OVERRIDE_DEVICETREE
	default "variants/\$(CONFIG_VARIANT_DIR)/overridetree.cb"

config VARIANT_DIR
	default "e6400" if BOARD_DELL_E6400

config USBDEBUG_HCD_INDEX
	default 1

config CBFS_SIZE
	default 0x1A0000

endif # BOARD_DELL_GM45_LATITUDE_COMMON
```

## src/mainboard/dell/gm45_latitude/Kconfig.name
```kconfig
## SPDX-License-Identifier: GPL-2.0-only

config BOARD_DELL_E6400
	bool "Latitude E6400"
```

## src/mainboard/dell/haswell_latitude/Kconfig
```kconfig
## SPDX-License-Identifier: GPL-2.0-only

config BOARD_DELL_HASWELL_LATITUDE_COMMON
	def_bool n
	select AZALIA_USE_LEGACY_VERB_TABLE
	select EC_DELL_MEC5035
	select HAVE_ACPI_RESUME
	select HAVE_ACPI_TABLES
	select MAINBOARD_HAS_LIBGFXINIT
	select NORTHBRIDGE_INTEL_HASWELL
	select SERIRQ_CONTINUOUS_MODE
	select SOUTHBRIDGE_INTEL_LYNXPOINT
	select SYSTEM_TYPE_LAPTOP

config BOARD_DELL_LATITUDE_E7240
	select BOARD_DELL_HASWELL_LATITUDE_COMMON
	select BOARD_ROMSIZE_KB_12288
	select INTEL_LYNXPOINT_LP
	select MAINBOARD_USES_IFD_GBE_REGION

if BOARD_DELL_HASWELL_LATITUDE_COMMON

config MAINBOARD_DIR
	default "dell/haswell_latitude"

config MAINBOARD_PART_NUMBER
	default "Latitude E7240" if BOARD_DELL_LATITUDE_E7240

config DEVICETREE
	default "devicetree_lp.cb" if INTEL_LYNXPOINT_LP

config VARIANT_DIR
	default "e7240" if BOARD_DELL_LATITUDE_E7240

config OVERRIDE_DEVICETREE
	default "variants/\$(CONFIG_VARIANT_DIR)/overridetree.cb"

config VGA_BIOS_ID
	default "8086,0a16"

config USBDEBUG_HCD_INDEX
	default 1

endif
```

## src/mainboard/dell/haswell_latitude/Kconfig.name
```kconfig
## SPDX-License-Identifier: GPL-2.0-only

config BOARD_DELL_LATITUDE_E7240
	bool "Latitude E7240"
```

## src/mainboard/dell/optiplex_3050/Kconfig
```kconfig
## SPDX-License-Identifier: GPL-2.0-only

if BOARD_DELL_OPTIPLEX_3050

config BOARD_SPECIFIC_OPTIONS
	def_bool y
	select AZALIA_USE_LEGACY_VERB_TABLE
	select BOARD_ROMSIZE_KB_16384
	select HAVE_ACPI_RESUME
	select HAVE_ACPI_TABLES
	select HAVE_CMOS_DEFAULT
	select HAVE_OPTION_TABLE
	select INTEL_GMA_ADD_VBT
	select INTEL_GMA_HAVE_VBT
	select MAINBOARD_HAS_LIBGFXINIT
	select MAINBOARD_SUPPORTS_KABYLAKE_CPU
	select MAINBOARD_SUPPORTS_SKYLAKE_CPU
	select SKYLAKE_SOC_PCH_H
	select SOC_INTEL_COMMON_BLOCK_HDA_VERB
	select SOC_INTEL_KABYLAKE
	select SUPERIO_SMSC_SCH555x

config CBFS_SIZE
	default 0x900000

config MAINBOARD_DIR
	default "dell/optiplex_3050"

config MAINBOARD_PART_NUMBER
	default "OptiPlex 3050 Micro"

config INTEL_GMA_VBT_FILE
	default "src/mainboard/\$(MAINBOARDDIR)/data.vbt"

config DIMM_SPD_SIZE
	default 512	# DDR4

endif
```

## src/mainboard/dell/optiplex_9010/Kconfig
```kconfig
if BOARD_DELL_OPTIPLEX_9010

config BOARD_SPECIFIC_OPTIONS
	def_bool y
	select BOARD_ROMSIZE_KB_12288
	select HAVE_ACPI_RESUME
	select HAVE_ACPI_TABLES
	select INTEL_INT15
	select NORTHBRIDGE_INTEL_SANDYBRIDGE
	select SERIRQ_CONTINUOUS_MODE
	select SOUTHBRIDGE_INTEL_C216
	select USE_NATIVE_RAMINIT
	select MAINBOARD_HAS_LPC_TPM
	select MAINBOARD_HAS_TPM1
	select MAINBOARD_USES_IFD_GBE_REGION
	select SUPERIO_SMSC_SCH5545
	select MAINBOARD_HAS_LIBGFXINIT
	select INTEL_GMA_HAVE_VBT
	select HAVE_OPTION_TABLE
	select HAVE_CMOS_DEFAULT
	select PCIEXP_L1_SUB_STATE
	select DRIVERS_UART_8250IO

config MAINBOARD_DIR
	default "dell/optiplex_9010"

config MAINBOARD_PART_NUMBER
	default "OptiPlex 9010"

config DRAM_RESET_GATE_GPIO
	int
	default 60

config USBDEBUG_HCD_INDEX
	int
	default 2

config CBFS_SIZE
	default 0x600000

config INCLUDE_SMSC_SCH5545_EC_FW
	bool "Include SMSC SCH5545 EC firmware binary"
	default n
	help
	  This option allows to add the SMSC SCH5545 Environmental Controller
	  firmware binary. The firmware must be loaded after each power failure
	  in order to properly initialize the fan control, because EC loses its
	  configuration when power is cut off. Otherwise the fans will keep
	  running at full speed after power failure.

config SMSC_SCH5545_EC_FW_FILE
	string "File path to the SMSC SCH5545 EC firmware binary"
	depends on INCLUDE_SMSC_SCH5545_EC_FW

endif
```

## src/mainboard/dell/optiplex_9020/Kconfig
```kconfig
## SPDX-License-Identifier: GPL-2.0-only

if BOARD_DELL_OPTIPLEX_9020_SFF || BOARD_DELL_OPTIPLEX_9020_MT

config BOARD_SPECIFIC_OPTIONS
	def_bool y
	select AZALIA_USE_LEGACY_VERB_TABLE
	select BOARD_ROMSIZE_KB_12288
	select HAVE_ACPI_RESUME
	select HAVE_ACPI_TABLES
	select HAVE_CMOS_DEFAULT
	select HAVE_OPTION_TABLE
	select INTEL_GMA_HAVE_VBT
	select INTEL_INT15
	select MAINBOARD_HAS_LIBGFXINIT
	select MAINBOARD_HAS_TPM1
	select MAINBOARD_USES_IFD_GBE_REGION
	select MEMORY_MAPPED_TPM
	select NORTHBRIDGE_INTEL_HASWELL
	select SERIRQ_CONTINUOUS_MODE
	select SOUTHBRIDGE_INTEL_LYNXPOINT
	select SUPERIO_SMSC_SCH555x

config CBFS_SIZE
	default 0x600000

config MAINBOARD_DIR
	default "dell/optiplex_9020"

config MAINBOARD_PART_NUMBER
	default "OptiPlex 7020/9020 SFF" if BOARD_DELL_OPTIPLEX_9020_SFF
	default "OptiPlex 7020/9020 MT" if BOARD_DELL_OPTIPLEX_9020_MT

config OVERRIDE_DEVICETREE
	default "overridetree_mt.cb" if BOARD_DELL_OPTIPLEX_9020_MT

endif
```
