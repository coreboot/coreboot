## src/mainboard/dell/optiplex_9020/Kconfig.name
```kconfig
## SPDX-License-Identifier: GPL-2.0-only

config BOARD_DELL_OPTIPLEX_9020_SFF
	bool "OptiPlex 7020/9020 SFF"
	help
	  The 7020 SFF and 9020 SFF mainboards are physically identical.

config BOARD_DELL_OPTIPLEX_9020_MT
	bool "OptiPlex 7020/9020 MT"
	help
	  The 7020 MT and 9020 MT mainboards are physically identical.
```

## src/mainboard/dell/s1850/Kconfig
```kconfig
if BOARD_DELL_S1850

config BOARD_SPECIFIC_OPTIONS # dummy
	def_bool y
	select ARCH_X86
	select CPU_INTEL_SOCKET_MPGA604
	select NORTHBRIDGE_INTEL_E7520
	select SOUTHBRIDGE_INTEL_I82801EX
	select SOUTHBRIDGE_INTEL_PXHD
	select SUPERIO_NSC_PC8374
	select ROMCC
	select HAVE_HARD_RESET
	select HAVE_OPTION_TABLE
	select BOARD_HAS_HARD_RESET
	select HAVE_PIRQ_TABLE
	select HAVE_MP_TABLE
	select USE_WATCHDOG_ON_BOOT
	select BOARD_ROMSIZE_KB_1024
	select UDELAY_TSC

config MAINBOARD_DIR
	string
	default dell/s1850

config MAINBOARD_PART_NUMBER
	string
	default "PowerEdge 1850"

config MAINBOARD_PCI_SUBSYSTEM_DEVICE_ID
	hex
	default 0x5580

config MAINBOARD_PCI_SUBSYSTEM_VENDOR_ID
	hex
	default 0x15d9

config MAX_CPUS
	int
	default 4

config MAX_PHYSICAL_CPUS
	int
	default 1

config IRQ_SLOT_COUNT
	int
	default 9

config DIMM_MAP_LOGICAL
	hex
	default 0x2841

endif # BOARD_DELL_S1850
```

## src/mainboard/dell/sklkbl_desktops/Kconfig
```kconfig
## SPDX-License-Identifier: GPL-2.0-only

config BOARD_DELL_SKLKBL_DESKTOPS_COMMON
	bool
	select AZALIA_USE_LEGACY_VERB_TABLE
	select BOARD_ROMSIZE_KB_16384
	select HAVE_ACPI_RESUME
	select HAVE_ACPI_TABLES
	select HAVE_CMOS_DEFAULT
	select HAVE_OPTION_TABLE
	select INTEL_GMA_ADD_VBT
	select INTEL_GMA_HAVE_VBT
	select MAINBOARD_HAS_LIBGFXINIT
	select MAINBOARD_SUPPORTS_KABYLAKE_CPU
	select MAINBOARD_SUPPORTS_SKYLAKE_CPU
	select SKYLAKE_SOC_PCH_H
	select SOC_INTEL_COMMON_BLOCK_HDA_VERB
	select SOC_INTEL_KABYLAKE
	select SUPERIO_SMSC_SCH555x

config BOARD_DELL_OPTIPLEX_3050
	bool
	select BOARD_DELL_SKLKBL_DESKTOPS_COMMON

if BOARD_DELL_SKLKBL_DESKTOPS_COMMON

config MAINBOARD_DIR
	default "dell/sklkbl_desktops"

config MAINBOARD_PART_NUMBER
	default "OptiPlex 3050 Micro" if BOARD_DELL_OPTIPLEX_3050

config VARIANT_DIR
	default "optiplex_3050" if BOARD_DELL_OPTIPLEX_3050

config OVERRIDE_DEVICETREE
	default "variants/\$(CONFIG_VARIANT_DIR)/overridetree.cb"

config INTEL_GMA_VBT_FILE
	default "src/mainboard/\$(MAINBOARDDIR)/variants/\$(CONFIG_VARIANT_DIR)/data.vbt"

config CBFS_SIZE
	default 0x900000

config DIMM_SPD_SIZE
	default 512 if BOARD_DELL_OPTIPLEX_3050	# DDR4

endif
```

## src/mainboard/dell/sklkbl_desktops/Kconfig.name
```kconfig
## SPDX-License-Identifier: GPL-2.0-only

config BOARD_DELL_OPTIPLEX_3050
	bool "OptiPlex 3050 Micro"
```

## src/mainboard/dell/snb_ivb_latitude/Kconfig
```kconfig
## SPDX-License-Identifier: GPL-2.0-only

config BOARD_DELL_SNB_IVB_LATITUDE_COMMON
	def_bool n
	select EC_ACPI
	select EC_DELL_MEC5035
	select GFX_GMA_PANEL_1_ON_LVDS
	select HAVE_ACPI_RESUME
	select HAVE_ACPI_TABLES
	select HAVE_CMOS_DEFAULT
	select HAVE_OPTION_TABLE
	select INTEL_GMA_HAVE_VBT
	select INTEL_INT15
	select MAINBOARD_HAS_LIBGFXINIT
	select NORTHBRIDGE_INTEL_SANDYBRIDGE
	select SERIRQ_CONTINUOUS_MODE
	select SYSTEM_TYPE_LAPTOP
	select USE_NATIVE_RAMINIT

config BOARD_DELL_LATITUDE_E5520
	select BOARD_DELL_SNB_IVB_LATITUDE_COMMON
	select BOARD_ROMSIZE_KB_6144
	select SOUTHBRIDGE_INTEL_BD82X6X

config BOARD_DELL_LATITUDE_E6420
	select BOARD_DELL_SNB_IVB_LATITUDE_COMMON
	select BOARD_ROMSIZE_KB_10240
	select MAINBOARD_USES_IFD_GBE_REGION
	select SOUTHBRIDGE_INTEL_BD82X6X

config BOARD_DELL_LATITUDE_E5530
	select BOARD_DELL_SNB_IVB_LATITUDE_COMMON
	select BOARD_ROMSIZE_KB_12288
	select SOUTHBRIDGE_INTEL_C216

config BOARD_DELL_LATITUDE_E6430
	select BOARD_DELL_SNB_IVB_LATITUDE_COMMON
	select BOARD_ROMSIZE_KB_12288
	select MAINBOARD_USES_IFD_GBE_REGION
	select SOUTHBRIDGE_INTEL_C216

config BOARD_DELL_LATITUDE_E6530
	select BOARD_DELL_SNB_IVB_LATITUDE_COMMON
	select BOARD_ROMSIZE_KB_12288
	select MAINBOARD_USES_IFD_GBE_REGION
	select SOUTHBRIDGE_INTEL_C216

if BOARD_DELL_SNB_IVB_LATITUDE_COMMON

config DRAM_RESET_GATE_GPIO
	default 60

config MAINBOARD_DIR
	default "dell/snb_ivb_latitude"

config MAINBOARD_PART_NUMBER
	default "Latitude E5520" if BOARD_DELL_LATITUDE_E5520
	default "Latitude E6420" if BOARD_DELL_LATITUDE_E6420
	default "Latitude E5530" if BOARD_DELL_LATITUDE_E5530
	default "Latitude E6430" if BOARD_DELL_LATITUDE_E6430
	default "Latitude E6530" if BOARD_DELL_LATITUDE_E6530

config OVERRIDE_DEVICETREE
	default "variants/\$(CONFIG_VARIANT_DIR)/overridetree.cb"

config USBDEBUG_HCD_INDEX
	default 2

config VARIANT_DIR
	default "e5520" if BOARD_DELL_LATITUDE_E5520
	default "e6420" if BOARD_DELL_LATITUDE_E6420
	default "e5530" if BOARD_DELL_LATITUDE_E5530
	default "e6430" if BOARD_DELL_LATITUDE_E6430
	default "e6530" if BOARD_DELL_LATITUDE_E6530

config VGA_BIOS_ID
	default "8086,0166" if BOARD_DELL_LATITUDE_E5530
	default "8086,0126" if BOARD_DELL_LATITUDE_E6420 \
		|| BOARD_DELL_LATITUDE_E5520
	default "8086,0166" if BOARD_DELL_LATITUDE_E6430 \
		|| BOARD_DELL_LATITUDE_E6530

endif
```

## src/mainboard/dell/snb_ivb_latitude/Kconfig.name
```kconfig
## SPDX-License-Identifier: GPL-2.0-only

config BOARD_DELL_LATITUDE_E5420
	bool "Latitude E5420"

config BOARD_DELL_LATITUDE_E5520
	bool "Latitude E5520"

config BOARD_DELL_LATITUDE_E6220
	bool "Latitude E6220"

config BOARD_DELL_LATITUDE_E6320
	bool "Latitude E6320"

config BOARD_DELL_LATITUDE_E6420
	bool "Latitude E6420"

config BOARD_DELL_LATITUDE_E6520
	bool "Latitude E6520"

config BOARD_DELL_LATITUDE_E5530
	bool "Latitude E5530"

config BOARD_DELL_LATITUDE_E6230
	bool "Latitude E6230"

config BOARD_DELL_LATITUDE_E6330
	bool "Latitude E6330"

config BOARD_DELL_LATITUDE_E6430
	bool "Latitude E6430"

config BOARD_DELL_LATITUDE_E6530
	bool "Latitude E6530"
```

## src/mainboard/dell/snb_ivb_workstations/Kconfig
```kconfig
config BOARD_DELL_SNB_IVB_WORKSTATIONS
	def_bool n
	select BOARD_ROMSIZE_KB_12288
	select HAVE_ACPI_RESUME
	select HAVE_ACPI_TABLES
	select INTEL_INT15
	select NORTHBRIDGE_INTEL_SANDYBRIDGE
	select SERIRQ_CONTINUOUS_MODE
	select USE_NATIVE_RAMINIT
	select MEMORY_MAPPED_TPM
	select MAINBOARD_HAS_TPM1
	select MAINBOARD_USES_IFD_GBE_REGION
	select SUPERIO_SMSC_SCH5545
	select MAINBOARD_HAS_LIBGFXINIT
	select INTEL_GMA_HAVE_VBT
	select HAVE_OPTION_TABLE
	select HAVE_CMOS_DEFAULT
	select PCIEXP_L1_SUB_STATE
	select DRIVERS_UART_8250IO

if BOARD_DELL_SNB_IVB_WORKSTATIONS

config MAINBOARD_DIR
	default "dell/snb_ivb_workstations"

config MAINBOARD_PART_NUMBER
	default "OptiPlex 9010" if BOARD_DELL_OPTIPLEX_9010
	default "Precision T1650" if BOARD_DELL_PRECISION_T1650

config VARIANT_DIR
	default "optiplex_9010_sff" if BOARD_DELL_OPTIPLEX_9010
	default "precision_t1650" if BOARD_DELL_PRECISION_T1650

config DEVICETREE
	default "variants/baseboard/devicetree.cb"

config OVERRIDE_DEVICETREE
	default "variants/\$(CONFIG_VARIANT_DIR)/overridetree.cb"

config DRAM_RESET_GATE_GPIO
	int
	default 60

config USBDEBUG_HCD_INDEX
	int
	default 2

config CBFS_SIZE
	default 0x600000

config INCLUDE_SMSC_SCH5545_EC_FW
	bool "Include SMSC SCH5545 EC firmware binary"
	default n
	help
	  This option allows to add the SMSC SCH5545 Environmental Controller
	  firmware binary. The firmware must be loaded after each power failure
	  in order to properly initialize the fan control, because EC loses its
	  configuration when power is cut off. Otherwise the fans will keep
	  running at full speed after power failure.

config SMSC_SCH5545_EC_FW_FILE
	string "File path to the SMSC SCH5545 EC firmware binary"
	depends on INCLUDE_SMSC_SCH5545_EC_FW

endif
```

## src/mainboard/dell/snb_ivb_workstations/Kconfig.name
```kconfig
## SPDX-License-Identifier: GPL-2.0-only

config BOARD_DELL_OPTIPLEX_9010
	bool "OptiPlex 9010 SFF"

config BOARD_DELL_PRECISION_T1650
	bool "Dell Precision T1650"
```

## src/mainboard/dell/xps_8300/Kconfig
```kconfig
## SPDX-License-Identifier: GPL-2.0-only

if BOARD_DELL_XPS_8300

config BOARD_SPECIFIC_OPTIONS
	def_bool y
	select AZALIA_USE_LEGACY_VERB_TABLE
	select BOARD_ROMSIZE_KB_4096
	select HAVE_ACPI_RESUME
	select HAVE_ACPI_TABLES
	select INTEL_INT15
	select NORTHBRIDGE_INTEL_SANDYBRIDGE
	select SERIRQ_CONTINUOUS_MODE
	select SOUTHBRIDGE_INTEL_BD82X6X
	select USE_NATIVE_RAMINIT
	select SUPERIO_ITE_IT8772F

config MAINBOARD_DIR
	default "dell/xps_8300"

config MAINBOARD_PART_NUMBER
	default "XPS 8300"

config DRAM_RESET_GATE_GPIO # FIXME: check this
	default 60

config USBDEBUG_HCD_INDEX
	default 2

config VGA_BIOS_DGPU_ID
	default "10de,1082"

config CBFS_SIZE
	default 0x26F000

endif
```

## src/mainboard/dell/xps_8300/Kconfig.name
```kconfig
## SPDX-License-Identifier: GPL-2.0-only

config BOARD_DELL_XPS_8300
	bool "XPS 8300"
```

## src/mainboard/digitallogic/Kconfig
```kconfig
if VENDOR_DIGITALLOGIC

choice
	prompt "Mainboard model"

source "src/mainboard/digitallogic/*/Kconfig.name"

endchoice

source "src/mainboard/digitallogic/*/Kconfig"

config MAINBOARD_VENDOR
	string
	default "DIGITAL-LOGIC"

endif # VENDOR_DIGITALLOGIC
```

## src/mainboard/digitallogic/adl855pc/Kconfig
```kconfig
if BOARD_DIGITALLOGIC_ADL855PC

config BOARD_SPECIFIC_OPTIONS # dummy
	def_bool y
	select ARCH_X86
	select CPU_INTEL_SOCKET_MPGA479M
	select NORTHBRIDGE_INTEL_I855
	select SOUTHBRIDGE_INTEL_I82801DX
	select SUPERIO_WINBOND_W83627HF
	select HAVE_OPTION_TABLE
	select HAVE_PIRQ_TABLE
	select BOARD_ROMSIZE_KB_1024

config MAINBOARD_DIR
	string
	default digitallogic/adl855pc

config MAINBOARD_PART_NUMBER
	string
	default "smartModule855"

config DCACHE_RAM_BASE
	hex
	default 0xffdf8000

config DCACHE_RAM_SIZE
	hex
	default 0x8000

config IRQ_SLOT_COUNT
	int
	default 5

endif # BOARD_DIGITALLOGIC_ADL855PC
```

## src/mainboard/digitallogic/msm586seg/Kconfig
```kconfig
if BOARD_DIGITALLOGIC_MSM586SEG

config BOARD_SPECIFIC_OPTIONS # dummy
	def_bool y
	select ARCH_X86
	select CPU_AMD_SC520
	select HAVE_PIRQ_TABLE
	select HAVE_OPTION_TABLE
	select BOARD_ROMSIZE_KB_512
	select ROMCC

config MAINBOARD_DIR
	string
	default digitallogic/msm586seg

config MAINBOARD_PART_NUMBER
	string
	default "MSM586SEG"

config IRQ_SLOT_COUNT
	int
	default 2

endif # BOARD_DIGITALLOGIC_MSM586SEG
```

## src/mainboard/digitallogic/msm800sev/Kconfig
```kconfig
if BOARD_DIGITALLOGIC_MSM800SEV

config BOARD_SPECIFIC_OPTIONS # dummy
	def_bool y
	select ARCH_X86
	select CPU_AMD_GEODE_LX
	select NORTHBRIDGE_AMD_LX
	select SOUTHBRIDGE_AMD_CS5536
	select SUPERIO_WINBOND_W83627HF
	select HAVE_PIRQ_TABLE
	select PIRQ_ROUTE
	select UDELAY_TSC
	select BOARD_ROMSIZE_KB_256
	select POWER_BUTTON_FORCE_ENABLE

config MAINBOARD_DIR
	string
	default digitallogic/msm800sev

config MAINBOARD_PART_NUMBER
	string
	default "MSM800SEV"

config IRQ_SLOT_COUNT
	int
	default 9

endif # BOARD_DIGITALLOGIC_MSM800SEV
```
