## src/mainboard/eaglelion/5bcm/Kconfig
```kconfig
##
## This file is part of the coreboot project.
##
## Copyright (C) 2009 Uwe Hermann <uwe@hermann-uwe.de>
##
## This program is free software; you can redistribute it and/or modify
## it under the terms of the GNU General Public License as published by
## the Free Software Foundation; either version 2 of the License, or
## (at your option) any later version.
##
## This program is distributed in the hope that it will be useful,
## but WITHOUT ANY WARRANTY; without even the implied warranty of
## MERCHANTABILITY or FITNESS FOR A PARTICULAR PURPOSE.  See the
## GNU General Public License for more details.
##
## You should have received a copy of the GNU General Public License
## along with this program; if not, write to the Free Software
## Foundation, Inc., 51 Franklin St, Fifth Floor, Boston, MA  02110-1301 USA
##

config BOARD_EAGLELION_5BCM
	bool "5BCM"
	select ARCH_X86
	select CPU_AMD_GX1
	select NORTHBRIDGE_AMD_GX1
	select SOUTHBRIDGE_AMD_CS5530
	select SUPERIO_NSC_PC97317
	select HAVE_PIRQ_TABLE
	select PIRQ_ROUTE
	select UDELAY_TSC
	select TSC_X86RDTSC_CALIBRATE_WITH_TIMER2
	select BOARD_ROMSIZE_KB_256

config MAINBOARD_DIR
	string
	default eaglelion/5bcm
	depends on BOARD_EAGLELION_5BCM

config MAINBOARD_PART_NUMBER
	string
	default "5BCM"
	depends on BOARD_EAGLELION_5BCM

config HAVE_OPTION_TABLE
	bool
	default n
	depends on BOARD_EAGLELION_5BCM

config IRQ_SLOT_COUNT
	int
	default 2
	depends on BOARD_EAGLELION_5BCM
```

## src/mainboard/ecs/p6iwp-fe/Kconfig
```kconfig
##
## This file is part of the coreboot project.
##
## Copyright (C) 2010 Anders Jenbo <anders@jenbo.dk>
##
## This program is free software; you can redistribute it and/or modify
## it under the terms of the GNU General Public License as published by
## the Free Software Foundation; either version 2 of the License, or
## (at your option) any later version.
##
## This program is distributed in the hope that it will be useful,
## but WITHOUT ANY WARRANTY; without even the implied warranty of
## MERCHANTABILITY or FITNESS FOR A PARTICULAR PURPOSE.  See the
## GNU General Public License for more details.
##
## You should have received a copy of the GNU General Public License
## along with this program; if not, write to the Free Software
## Foundation, Inc., 51 Franklin St, Fifth Floor, Boston, MA 02110-1301 USA
##
if BOARD_ECS_P6IWP_FE

config BOARD_SPECIFIC_OPTIONS # dummy
	def_bool y
	select ARCH_X86
	select CPU_INTEL_SOCKET_PGA370
	select NORTHBRIDGE_INTEL_I82810
	select SOUTHBRIDGE_INTEL_I82801AX
	select SUPERIO_ITE_IT8712F
	select HAVE_PIRQ_TABLE
	select UDELAY_TSC
	select BOARD_ROMSIZE_KB_512
	select GFXUMA

config MAINBOARD_DIR
	string
	default ecs/p6iwp-fe

config MAINBOARD_PART_NUMBER
	string
	default "P6IWP-FE"

config IRQ_SLOT_COUNT
	int
	default 10

endif # BOARD_ECS_P6IWP_FE
```

## src/mainboard/elmex/Kconfig
```kconfig
if VENDOR_ELMEX

choice
	prompt "Mainboard model"

source "src/mainboard/elmex/*/Kconfig.name"

endchoice

source "src/mainboard/elmex/*/Kconfig"

config MAINBOARD_VENDOR
	default "ELMEX"

endif # VENDOR_ELMEX
```
