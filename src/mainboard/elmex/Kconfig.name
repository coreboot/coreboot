## src/mainboard/emulation/qemu-riscv/Kconfig
```kconfig
## SPDX-License-Identifier: GPL-2.0-only

# To execute, do:
# qemu-system-riscv64 -M virt -m 1024M -nographic -bios build/coreboot.rom \
#                     -drive if=pflash,file=build/coreboot.rom,format=raw

if BOARD_EMULATION_QEMU_RISCV_RV64

config BOARD_EMULATION_QEMU_RISCV
	def_bool y
	select ARCH_RISCV_RV64
endif

if BOARD_EMULATION_QEMU_RISCV_RV32

config BOARD_EMULATION_QEMU_RISCV
	def_bool y
	select ARCH_RISCV_RV32
endif

if BOARD_EMULATION_QEMU_RISCV

config BOARD_SPECIFIC_OPTIONS
	def_bool y
	select BOARD_ROMSIZE_KB_32768
	select FLATTENED_DEVICE_TREE
	select MISSING_BOARD_RESET
	select DRIVERS_UART_8250MEM
	select RISCV_GET_HART_COUNT_AT_RUNTIME
	select RISCV_HAS_OPENSBI
	select ARCH_RISCV_S
	select ARCH_RISCV_U
	select ARCH_RISCV_PMP
	select ARCH_BOOTBLOCK_RISCV
	select ARCH_VERSTAGE_RISCV
	select ARCH_ROMSTAGE_RISCV
	select ARCH_RAMSTAGE_RISCV
	select RISCV_USE_ARCH_TIMER
	select FLATTENED_DEVICE_TREE
	select DRIVERS_EMULATION_QEMU_FW_CFG
	select PCI
	select HAVE_ACPI_TABLES

config MEMLAYOUT_LD_FILE
	string
	default "src/mainboard/emulation/qemu-riscv/memlayout.ld"

config MAINBOARD_DIR
	default "emulation/qemu-riscv"

config MAINBOARD_PART_NUMBER
	default "QEMU RISCV"

config ECAM_MMCONF_BASE_ADDRESS
	default 0x30000000

config ECAM_MMCONF_BUS_NUMBER
	default 256

config MAX_CPUS
	int
	default 512 # QEMUs current limit for the virt target

config RISCV_ARCH
	string
	default "rv64imafd" if ARCH_RISCV_RV64
	default "rv32im" if ARCH_RISCV_RV32

config RISCV_ABI
	string
	default "lp64d" if ARCH_RISCV_RV64
	default "ilp32" if ARCH_RISCV_RV32

config RISCV_CODEMODEL
	string
	default "medany" if ARCH_RISCV_RV64
	default "medany" if ARCH_RISCV_RV32

config RISCV_WORKING_HARTID
	int
	default 0

config OPENSBI_PLATFORM
	string
	default "generic"

config OPENSBI_TEXT_START
	hex
	default 0x80020000

config PCI_IOBASE
	hex
	default 0x3000000

endif #  BOARD_EMULATION_QEMU_RISCV
```

## src/mainboard/emulation/qemu-riscv/Kconfig.name
```kconfig
config BOARD_EMULATION_QEMU_RISCV_RV64
	bool "QEMU RISC-V rv64"

config BOARD_EMULATION_QEMU_RISCV_RV32
	bool "QEMU RISC-V rv32"
```

## src/mainboard/emulation/qemu-sbsa/Kconfig
```kconfig
# SPDX-License-Identifier: GPL-2.0-or-later

if BOARD_EMULATION_QEMU_SBSA

config BOARD_SPECIFIC_OPTIONS
	def_bool y
	select ARCH_BOOTBLOCK_ARMV8_64
	select ARCH_VERSTAGE_ARMV8_64
	select ARCH_ROMSTAGE_ARMV8_64
	select ARCH_RAMSTAGE_ARMV8_64
	select ARM64_USE_ARCH_TIMER
	select BOARD_ROMSIZE_KB_32768
	select BOOTBLOCK_CUSTOM
	select BOOT_DEVICE_NOT_SPI_FLASH
	select DRIVERS_UART_PL011
	select FLATTENED_DEVICE_TREE
	select HAVE_LINEAR_FRAMEBUFFER
	select MAINBOARD_FORCE_NATIVE_VGA_INIT
	select MAINBOARD_HAS_NATIVE_VGA_INIT
	select MISSING_BOARD_RESET
	select PCI
	select HAVE_ACPI_TABLES
	select ACPI_GTDT
	select ACPI_COMMON_MADT_GICC_V3
	select GENERATE_SMBIOS_TABLES

config ARM64_CURRENT_EL
	default 2

config ECAM_MMCONF_BASE_ADDRESS
	default 0xf0000000

config ECAM_MMCONF_BUS_NUMBER
	default 256

config FMDFILE
	default "src/mainboard/emulation/qemu-sbsa/flash.fmd"

config MAINBOARD_DIR
	default "emulation/qemu-sbsa"

config MAINBOARD_PART_NUMBER
	default "QEMU sbsa"

config MAX_CPUS
	default 128

config MAINBOARD_VENDOR
	default "QEMU"

config DRAM_SIZE_MB
	int
	default 8388608 # The maximum dram size is 8192GiB.

endif #  BOARD_EMULATION_QEMU_SBSA
```
