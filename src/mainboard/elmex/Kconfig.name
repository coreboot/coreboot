## src/mainboard/elmex/pcm205400/Kconfig
```kconfig
# SPDX-License-Identifier: GPL-2.0-only

if BOARD_ELMEX_PCM205400

config MAINBOARD_PART_NUMBER
	string
	default "pcm205400"

config VGA_BIOS_ID
	string
	default "1002,9806" # FUSION_G_T56N

endif # BOARD_ELMEX_PCM205400

if BOARD_ELMEX_PCM205400 || BOARD_ELMEX_PCM205401

config BOARD_SPECIFIC_OPTIONS
	def_bool y
	select CPU_AMD_AGESA_FAMILY14
	select NORTHBRIDGE_AMD_AGESA_FAMILY14
	select SOUTHBRIDGE_AMD_CIMX_SB800
	select SUPERIO_FINTEK_F81865F
	select HAVE_OPTION_TABLE
	select HAVE_PIRQ_TABLE
	select HAVE_ACPI_RESUME
	select HAVE_ACPI_TABLES
	select BOARD_ROMSIZE_KB_4096
	select GFXUMA

config MAINBOARD_DIR
	string
	default "elmex/pcm205400"

config HW_MEM_HOLE_SIZEK
	hex
	default 0x200000

config MAX_CPUS
	int
	default 2

config IRQ_SLOT_COUNT
	int
	default 11

config ONBOARD_VGA_IS_PRIMARY
	bool
	default y

config SB800_AHCI_ROM
	bool
	default n

endif # BOARD_ELMEX_PCM205400 | BOARD_ELMEX_PCM205401
```

## src/mainboard/elmex/pcm205401/Kconfig
```kconfig
# SPDX-License-Identifier: GPL-2.0-only

# The code for this board is under elmex/pcm205400

if BOARD_ELMEX_PCM205401

config MAINBOARD_PART_NUMBER
	string
	default "pcm205401"

config VGA_BIOS_ID
	string
	default "1002,9804" # FUSION_G_T40R

endif # BOARD_ELMEX_PCM205401
```

## src/mainboard/elmex/pcm205401/Kconfig.name
```kconfig
# The code for this board is under elmex/pcm205400

config BOARD_ELMEX_PCM205401
	bool "pcm205401"
```

## src/mainboard/emulation/Kconfig
```kconfig
## SPDX-License-Identifier: GPL-2.0-only

# ugly to put it in here, but unavoidable
config SEPARATE_ROMSTAGE
	default n if BOARD_EMULATION_QEMU_RISCV
	default n if BOARD_EMULATION_QEMU_SBSA

if VENDOR_EMULATION

choice
	prompt "Mainboard model"
	default BOARD_EMULATION_QEMU_X86_I440FX

source "src/mainboard/emulation/*/Kconfig.name"

endchoice

source "src/mainboard/emulation/*/Kconfig"

config MAINBOARD_VENDOR
	default "Emulation"

endif # VENDOR_EMULATION
```

## src/mainboard/emulation/Kconfig.name
```kconfig
## SPDX-License-Identifier: GPL-2.0-only

config VENDOR_EMULATION
	bool "Emulation"
```

## src/mainboard/emulation/foundation-armv8/Kconfig
```kconfig
##
## This file is part of the coreboot project.
##
## Copyright (C) 2013 Google Inc.
##
## This software is licensed under the terms of the GNU General Public
## License version 2, as published by the Free Software Foundation, and
## may be copied, distributed, and modified under those terms.
##
## This program is distributed in the hope that it will be useful,
## but WITHOUT ANY WARRANTY; without even the implied warranty of
## MERCHANTABILITY or FITNESS FOR A PARTICULAR PURPOSE.  See the
## GNU General Public License for more details.

if BOARD_EMULATION_FOUNDATION_ARMV8

config BOARD_SPECIFIC_OPTIONS # dummy
	def_bool y
	select ARCH_AARCH64
	select CPU_ARMLTD_ARMV8
	select HAVE_UART_MEMORY_MAPPED
	select HAVE_UART_SPECIAL
	select BOARD_ROMSIZE_KB_4096

config MAINBOARD_DIR
	string
	default emulation/foundation-armv8

config MAINBOARD_PART_NUMBER
	string
	default "FOUNDATION ARMV8"

config MAX_CPUS
	int
	default 1

config MAINBOARD_VENDOR
	string
	default "ARM Ltd."

config BOOTBLOCK_MAINBOARD_INIT
	string
	default "mainboard/emulation/foundation-armv8/bootblock.c"

config DRAM_SIZE_MB
	int
	default 1024

# Memory map
#
# 0xA000_0000: first instruction (called from BL3)

config BOOTBLOCK_BASE
	hex
	default 0xA0000000

config ID_SECTION_BASE
	hex
	default 0xA001f000

config ROMSTAGE_BASE
	hex
	default 0xA0020000

config ROMSTAGE_SIZE
	hex
	default 0x20000

config BOOTBLOCK_ROM_OFFSET
	hex
	default 0x0

config CBFS_HEADER_ROM_OFFSET
	hex
	default 0x0100000

config CBFS_ROM_OFFSET
	hex
	default 0x0110000

config IRAM_STACK
	hex
	default 0x0007ff00

config XIP_ROM_SIZE
	hex
	default ROMSTAGE_SIZE

config SYS_SDRAM_BASE
	hex "SDRAM base address"
	default 0x01000000

config SYS_TEXT_BASE
	hex "Executable code section"
	default 0x04e00000

config RAMBASE
	hex
	default SYS_SDRAM_BASE

# according to stefan, this is RAMBASE + 1M.
config RAMTOP
	hex
	default 0x01100000

endif #  BOARD_EMULATION_FOUNDATION_ARMV8
```

## src/mainboard/emulation/imgvp-pistachio/Kconfig
```kconfig
#
# This file is part of the coreboot project.
#
# Copyright (C) 2014 Imagination Technologies
#
# This program is free software; you can redistribute it and/or
# modify it under the terms of the GNU General Public License as
# published by the Free Software Foundation; version 2 of
# the License.
#
# This program is distributed in the hope that it will be useful,
# but WITHOUT ANY WARRANTY; without even the implied warranty of
# MERCHANTABILITY or FITNESS FOR A PARTICULAR PURPOSE.  See the
# GNU General Public License for more details.
#
# You should have received a copy of the GNU General Public License
# along with this program; if not, write to the Free Software
# Foundation, Inc., 51 Franklin St, Fifth Floor, Boston,
# MA 02110-1301 USA
#

if BOARD_EMULATION_IMGVP_PISTACHIO

config BOARD_SPECIFIC_OPTIONS
	def_bool y
	select BOOTBLOCK_CONSOLE
	select CPU_IMGTEC_PISTACHIO

config MAINBOARD_DIR
	string
	default emulation/imgvp-pistachio

config MAINBOARD_PART_NUMBER
	string
	default "ImgTec Pistachio Virtual Platform"

config BOOTBLOCK_MAINBOARD_INIT
	string
	default "mainboard/emulation/imgvp-pistachio/bootblock.c"

config SYS_SDRAM_BASE
	hex "SDRAM base address"
	default 0x80000000

config DRAM_SIZE_MB
	int
	default 256

config HEAP_SIZE
	hex
	default 0x08000000

endif
```

## src/mainboard/emulation/qemu-aarch64/Kconfig
```kconfig
# SPDX-License-Identifier: GPL-2.0-or-later

# Emulation for QEMU 2.8 ARM Virtual Machine (alias of virt-2.8)
# https://wiki.qemu.org/Documentation/Platforms/ARM

if BOARD_EMULATION_QEMU_AARCH64

config BOARD_SPECIFIC_OPTIONS
	def_bool y
	select ARCH_BOOTBLOCK_ARMV8_64
	select ARCH_VERSTAGE_ARMV8_64
	select ARCH_ROMSTAGE_ARMV8_64
	select ARCH_RAMSTAGE_ARMV8_64
	select FLATTENED_DEVICE_TREE
	select ARM64_USE_ARCH_TIMER
	select BOARD_ROMSIZE_KB_16384
	select BOOTBLOCK_CUSTOM
	select BOOT_DEVICE_NOT_SPI_FLASH
	select DRIVERS_UART_PL011
	select HAVE_LINEAR_FRAMEBUFFER
	select MAINBOARD_FORCE_NATIVE_VGA_INIT
	select MAINBOARD_HAS_NATIVE_VGA_INIT
	select MISSING_BOARD_RESET
	select ARM64_USE_ARM_TRUSTED_FIRMWARE
	select PCI

config ECAM_MMCONF_BASE_ADDRESS
	default 0x4010000000

config ECAM_MMCONF_BUS_NUMBER
	default 256

config PCI_IOBASE
	default 0x3eff0000

config MEMLAYOUT_LD_FILE
	string
	default "src/mainboard/emulation/qemu-aarch64/memlayout.ld"

config MAINBOARD_DIR
	default "emulation/qemu-aarch64"

config MAINBOARD_PART_NUMBER
	default "QEMU AArch64"

config MAX_CPUS
	int
	default 2

config MAINBOARD_VENDOR
	string
	default "QEMU"

config DRAM_SIZE_MB
	int
	default 261120 # The maximum dram size is 255GiB.

endif #  BOARD_EMULATION_QEMU_AARCH64
```

## src/mainboard/emulation/qemu-aarch64/Kconfig.name
```kconfig
config BOARD_EMULATION_QEMU_AARCH64
	bool "QEMU AArch64 (virt)"
	help
	  To execute, do:
	  qemu-system-aarch64 -bios ./build/coreboot.rom -M virt,secure=on,virtualization=on -cpu cortex-a53 -nographic -m 8192M
```

## src/mainboard/emulation/qemu-armv7/Kconfig
```kconfig
## SPDX-License-Identifier: GPL-2.0-only

# Emulation for ARM Ltd Versatile Express Cortex-A9
#  http://www.arm.com/products/tools/development-boards/versatile-express

# To execute, do:
# export QEMU_AUDIO_DRV = none
# qemu-system-arm -M vexpress-a9 -m 1024M -nographic -bios build/coreboot.rom

if BOARD_EMULATION_QEMU_ARMV7

config BOARD_SPECIFIC_OPTIONS
	def_bool y
	select CPU_ARMLTD_CORTEX_A9
	select DRIVERS_UART_PL011
	select MAINBOARD_HAS_NATIVE_VGA_INIT
	select MAINBOARD_FORCE_NATIVE_VGA_INIT
	select HAVE_LINEAR_FRAMEBUFFER
	select ARCH_BOOTBLOCK_ARMV7
	select ARCH_ROMSTAGE_ARMV7
	select ARCH_RAMSTAGE_ARMV7
	select BOARD_ROMSIZE_KB_4096
	select BOOT_DEVICE_NOT_SPI_FLASH
	select MISSING_BOARD_RESET
	select NO_MONOTONIC_TIMER

config MEMLAYOUT_LD_FILE
	string
	default "src/mainboard/emulation/qemu-armv7/memlayout.ld"

config MAINBOARD_DIR
	string
	default "emulation/qemu-armv7"

config MAINBOARD_PART_NUMBER
	string
	default "QEMU ARMv7"

config MAX_CPUS
	int
	default 2

config MAINBOARD_VENDOR
	string
	default "ARM Ltd."

config DRAM_SIZE_MB
	int
	default 1024

endif #  BOARD_EMULATION_QEMU_ARMV7
```

## src/mainboard/emulation/qemu-i386/Kconfig
```kconfig
#
# For a description of the syntax of this configuration file,
# see Documentation/kbuild/kconfig-language.txt.
#

mainmenu "LinuxBIOS Configuration"

config BOOTFLASH
	bool
	default y
	help
	  Build the BOOTFLASH area. This includes all the reset vector, 
	  Cache-As-Ram (CAR) code, early device setup, and the code that 
	  parses the "file system" in the non-BOOTFLASH area. 

config BIOS
	bool
	default y
	help
		Build the rest of the BIOS. This includes memory init, device init, PCI init, and so on. 
```

## src/mainboard/emulation/qemu-i440fx/Kconfig
```kconfig
## SPDX-License-Identifier: GPL-2.0-only

if BOARD_EMULATION_QEMU_X86_I440FX

config BOARD_SPECIFIC_OPTIONS
	def_bool y
	select CPU_QEMU_X86
	select NO_ECAM_MMCONF_SUPPORT
	select SOUTHBRIDGE_INTEL_I82371EB
	select HAVE_OPTION_TABLE
	select HAVE_CMOS_DEFAULT
	select HAVE_PIRQ_TABLE
	select HAVE_ACPI_TABLES
	select BOARD_ROMSIZE_KB_4096 if !VBOOT
	select BOARD_ROMSIZE_KB_16384 if VBOOT
	select MAINBOARD_HAS_NATIVE_VGA_INIT
	select MAINBOARD_FORCE_NATIVE_VGA_INIT
	select HAVE_ASAN_IN_ROMSTAGE
	select NO_SMM
	select BOOT_DEVICE_NOT_SPI_FLASH
	select BOOT_DEVICE_MEMORY_MAPPED
	select BOOT_DEVICE_SUPPORTS_WRITES

config VBOOT
	select VBOOT_MUST_REQUEST_DISPLAY
	select VBOOT_STARTS_IN_BOOTBLOCK
	select VBOOT_VBNV_CMOS
	select GBB_FLAG_DISABLE_LID_SHUTDOWN
	select GBB_FLAG_DISABLE_PD_SOFTWARE_SYNC
	select GBB_FLAG_DISABLE_EC_SOFTWARE_SYNC
	select GBB_FLAG_DISABLE_FWMP

if ARCH_BOOTBLOCK_X86_64

config PAGE_TABLES_IN_CBFS
	bool
	default y

# Need to install page tables in DRAM as the virtual MMU has problems translating paging
# request when the page table resides in emulated ROM. This causes undefined behaviour
# when handling data requests, as well as fetching and decoding instructions
# Real hardware didn't show any problems until now.
config ARCH_X86_64_PGTBL_LOC
	default 0x8000
endif

if VBOOT

config VBOOT_SLOTS_RW_A
	default y

endif

config FMDFILE
	default "src/mainboard/\$(CONFIG_MAINBOARD_DIR)/vboot-rwa-16M.fmd" if VBOOT_SLOTS_RW_A

config VBOOT_VBNV_OFFSET
	hex
	default 0x2c

config MAINBOARD_DIR
	default "emulation/qemu-i440fx"

config MAINBOARD_PART_NUMBER
	default "QEMU x86 i440fx/piix4"

config IRQ_SLOT_COUNT
	int
	default 6

# Skip the first 64KiB as coreboot table pointer is installed
# at address 0
config DCACHE_RAM_BASE
	hex
	default 0x10000

# Memory at 0xa0000 decodes to VGA
config DCACHE_RAM_SIZE
	hex
	default 0x90000

config C_ENV_BOOTBLOCK_SIZE
	hex
	default 0x10000

config DCACHE_BSP_STACK_SIZE
	hex
	default 0x4000

endif # BOARD_EMULATION_QEMU_X86_I440FX
```

## src/mainboard/emulation/qemu-i440fx/Kconfig.name
```kconfig
config BOARD_EMULATION_QEMU_X86_I440FX
	bool "QEMU x86 i440fx/piix4 (aka qemu -M pc)"
```

## src/mainboard/emulation/qemu-power8/Kconfig
```kconfig
## SPDX-License-Identifier: GPL-2.0-only

# To execute, do:
# qemu-system-??

if BOARD_EMULATION_QEMU_POWER8

config BOARD_SPECIFIC_OPTIONS
	def_bool y
	select CPU_QEMU_POWER8
	select BOARD_ROMSIZE_KB_4096
	select ARCH_BOOTBLOCK_PPC64
	select ARCH_VERSTAGE_PPC64
	select ARCH_ROMSTAGE_PPC64
	select ARCH_RAMSTAGE_PPC64
	select HAVE_UART_SPECIAL
	select BOOT_DEVICE_NOT_SPI_FLASH
	select MISSING_BOARD_RESET

config MEMLAYOUT_LD_FILE
	string
	default "src/mainboard/emulation/qemu-power8/memlayout.ld"

config MAINBOARD_DIR
	string
	default "emulation/qemu-power8"

config MAINBOARD_PART_NUMBER
	string
	default "QEMU POWER8"

config MAX_CPUS
	int
	default 1

config MAINBOARD_VENDOR
	string
	default "QEMU"

config DRAM_SIZE_MB
	int
	default 32768

endif #  BOARD_EMULATION_QEMU_POWER8
```

## src/mainboard/emulation/qemu-power8/Kconfig.name
```kconfig
## SPDX-License-Identifier: GPL-2.0-only

config BOARD_EMULATION_QEMU_POWER8
	bool "QEMU power8"
```

## src/mainboard/emulation/qemu-power9/Kconfig
```kconfig
## SPDX-License-Identifier: GPL-2.0-only

# To execute, do:
# qemu-system-ppc64 -M powernv --cpu power9 --bios 'build/coreboot.rom'

if BOARD_EMULATION_QEMU_POWER9

config BOARD_SPECIFIC_OPTIONS
	def_bool y
	select CPU_POWER9
	select BOARD_ROMSIZE_KB_1024
	select ARCH_BOOTBLOCK_PPC64
	select ARCH_VERSTAGE_PPC64
	select ARCH_ROMSTAGE_PPC64
	select ARCH_RAMSTAGE_PPC64
	select BOOT_DEVICE_NOT_SPI_FLASH
	select MISSING_BOARD_RESET

config MEMLAYOUT_LD_FILE
	string
	default "src/mainboard/\$(CONFIG_MAINBOARD_DIR)/memlayout.ld"

config MAINBOARD_DIR
	string
	default "emulation/qemu-power9"

config MAINBOARD_PART_NUMBER
	string
	default "QEMU POWER9"

config MAX_CPUS
	int
	default 1

config MAINBOARD_VENDOR
	string
	default "Emulation"

config DRAM_SIZE_MB
	int
	default 32768

endif #  BOARD_EMULATION_QEMU_POWER9
```

## src/mainboard/emulation/qemu-q35/Kconfig
```kconfig
if BOARD_EMULATION_QEMU_X86_Q35

config BOARD_SPECIFIC_OPTIONS
	def_bool y
	select CPU_QEMU_X86
	select SOUTHBRIDGE_INTEL_I82801IX
	select HAVE_CMOS_DEFAULT
	select HAVE_OPTION_TABLE
#	select HAVE_PIRQ_TABLE
	select HAVE_ACPI_TABLES
	select BOARD_ROMSIZE_KB_2048 if !VBOOT
	select BOARD_ROMSIZE_KB_16384 if VBOOT
	select MAINBOARD_HAS_NATIVE_VGA_INIT
	select MAINBOARD_FORCE_NATIVE_VGA_INIT if !CHROMEOS
	select MEMORY_MAPPED_TPM
	select MAINBOARD_HAS_CHROMEOS
	select SOUTHBRIDGE_INTEL_COMMON_ACPI_MADT
	select BOOT_DEVICE_NOT_SPI_FLASH
	select BOOT_DEVICE_MEMORY_MAPPED

config VBOOT
	select VBOOT_MUST_REQUEST_DISPLAY
	select VBOOT_STARTS_IN_BOOTBLOCK
	select VBOOT_VBNV_CMOS
	select GBB_FLAG_DISABLE_LID_SHUTDOWN
	select GBB_FLAG_DISABLE_PD_SOFTWARE_SYNC
	select GBB_FLAG_DISABLE_EC_SOFTWARE_SYNC
	select GBB_FLAG_DISABLE_FWMP

config FMDFILE
	default "src/mainboard/\$(CONFIG_MAINBOARD_DIR)/vboot-rwa-16M.fmd" if VBOOT_SLOTS_RW_A && !VBOOT_SLOTS_RW_AB
	default "src/mainboard/\$(CONFIG_MAINBOARD_DIR)/vboot-rwab-16M.fmd" if VBOOT_SLOTS_RW_AB

if ARCH_BOOTBLOCK_X86_64
# Need to install page tables in DRAM as the virtual MMU has problems translating paging
# request when the page table resides in emulated ROM. This causes undefined behaviour
# when handling data requests, as well as fetching and decoding instructions
# Real hardware didn't show any problems until now.
config ARCH_X86_64_PGTBL_LOC
	default 0x8000
endif

if VBOOT

config VBOOT_SLOTS_RW_A
	default y

endif

config VBOOT_VBNV_OFFSET
	hex
	default 0x2c

config MAINBOARD_DIR
	default "emulation/qemu-q35"

config MAINBOARD_PART_NUMBER
	default "QEMU x86 q35/ich9"

config ECAM_MMCONF_BASE_ADDRESS
	default 0xb0000000

config ECAM_MMCONF_BUS_NUMBER
	int
	default 256

# fw_cfg tables can be larger than the default when TPM is enabled
config MAX_ACPI_TABLE_SIZE_KB
	int
	default 224

# Skip the first 64KiB as coreboot table pointer is installed
# at address 0
config DCACHE_RAM_BASE
	hex
	default 0x10000

# Memory at 0xa0000 decodes to VGA
config DCACHE_RAM_SIZE
	hex
	default 0x90000

# Do not show IFD/blob options since QEMU doesn't care
config HAVE_INTEL_FIRMWARE
	bool
	default n

config DCACHE_BSP_STACK_SIZE
	hex
	default 0x4000

endif # BOARD_EMULATION_QEMU_X86_Q35
```

## src/mainboard/emulation/qemu-q35/Kconfig.name
```kconfig
config BOARD_EMULATION_QEMU_X86_Q35
	bool "QEMU x86 q35/ich9 (aka qemu -M q35, since v1.4)"
```
