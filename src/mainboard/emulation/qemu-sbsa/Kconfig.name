## src/mainboard/emulation/qemu-sbsa/Kconfig.name
```kconfig
# SPDX-License-Identifier: GPL-2.0-or-later

config BOARD_EMULATION_QEMU_SBSA
	bool "QEMU sbsa"
```

## src/mainboard/emulation/qemu-x86/Kconfig
```kconfig
if BOARD_EMULATION_QEMU_X86

config BOARD_SPECIFIC_OPTIONS # dummy
	def_bool y
	select ARCH_X86
	select SOUTHBRIDGE_INTEL_I82371EB
	select ROMCC
	select HAVE_OPTION_TABLE
	select HAVE_PIRQ_TABLE
	select BOARD_ROMSIZE_KB_256
	select TINY_BOOTBLOCK

config MAINBOARD_DIR
	string
	default emulation/qemu-x86

config MAINBOARD_PART_NUMBER
	string
	default "QEMU x86"

config IRQ_SLOT_COUNT
	int
	default 6

endif # BOARD_EMULATION_QEMU_X86
```

## src/mainboard/emulation/spike-riscv/Kconfig
```kconfig
## SPDX-License-Identifier: GPL-2.0-only

if BOARD_EMULATION_SPIKE_RISCV

config BOARD_SPECIFIC_OPTIONS
	def_bool y
	select ARCH_RISCV_RV64
	select SOC_UCB_RISCV
	select BOARD_ROMSIZE_KB_4096
	select DRIVERS_UART_8250MEM
	select BOOT_DEVICE_NOT_SPI_FLASH
	select MISSING_BOARD_RESET

config MAINBOARD_DIR
	string
	default "emulation/spike-riscv"

config MAINBOARD_PART_NUMBER
	string
	default "SPIKE RISCV"

config MAX_CPUS
	int
	default 1

endif #  BOARD_EMULATION_SPIKE_RISCV
```

## src/mainboard/emulation/spike-riscv/Kconfig.name
```kconfig
## SPDX-License-Identifier: GPL-2.0-only

config BOARD_EMULATION_SPIKE_RISCV
	bool "SPIKE riscv"
```

## src/mainboard/erying/Kconfig
```kconfig
## SPDX-License-Identifier: GPL-2.0-only

if VENDOR_ERYING

choice
	prompt "Mainboard model"

source "src/mainboard/erying/*/Kconfig.name"

endchoice

source "src/mainboard/erying/*/Kconfig"

config MAINBOARD_VENDOR
	default "Erying"

endif # VENDOR_ERYING
```

## src/mainboard/erying/tgl/Kconfig
```kconfig
## SPDX-License-Identifier: GPL-2.0-only

if BOARD_ERYING_POLESTAR_G613_PRO

config BOARD_SPECIFIC_OPTIONS
	def_bool y
	select BOARD_ROMSIZE_KB_16384
	select SOC_INTEL_TIGERLAKE
	select SOC_INTEL_TIGERLAKE_PCH_H
	select SOC_INTEL_COMMON_BLOCK_HDA_VERB
	select SOC_INTEL_COMMON_BLOCK_MEMINIT
	select INTEL_GMA_HAVE_VBT
	select HAVE_ACPI_TABLES
	select SUPERIO_ITE_IT8613E
	select DRIVERS_UART_8250IO
	select HAVE_CMOS_DEFAULT
	select HAVE_OPTION_TABLE
	select HAVE_INTEL_PTT
	select CRB_TPM

config MAINBOARD_SMBIOS_PRODUCT_NAME
	default "POLESTAR G613 Pro"

config MAINBOARD_DIR
	default "erying/tgl"

config MAINBOARD_PART_NUMBER
	default "TigerLake (mATX)"

config CBFS_SIZE
	default 0xA00000

config PCIEXP_ASPM
	default n

config PCIEXP_CLK_PM
	default n

config PCIEXP_L1_SUB_STATE
	default n

endif
```

## src/mainboard/erying/tgl/Kconfig.name
```kconfig
## SPDX-License-Identifier: GPL-2.0-only

config BOARD_ERYING_POLESTAR_G613_PRO
	bool "Polestar G613 Pro (TGL-H)"
```

## src/mainboard/esd/Kconfig
```kconfig
if VENDOR_ESD

choice
	prompt "Mainboard model"

source "src/mainboard/esd/*/Kconfig.name"

endchoice

source "src/mainboard/esd/*/Kconfig"

config MAINBOARD_VENDOR
	string
	default "esd"

endif # VENDOR_ESD
```

## src/mainboard/esd/atom15/Kconfig
```kconfig
##
## This file is part of the coreboot project.
##
## Copyright (C) 2013-2014 Sage Electronic Engineering, LLC.
## Copyright (C) 2014 Intel Corporation
##
## This program is free software; you can redistribute it and/or modify
## it under the terms of the GNU General Public License as published by
## the Free Software Foundation; version 2 of the License.
##
## This program is distributed in the hope that it will be useful,
## but WITHOUT ANY WARRANTY; without even the implied warranty of
## MERCHANTABILITY or FITNESS FOR A PARTICULAR PURPOSE.  See the
## GNU General Public License for more details.
##

if BOARD_ESD_ATOM15

config BOARD_SPECIFIC_OPTIONS # dummy
	def_bool y
	select SOC_INTEL_FSP_BAYTRAIL
	select BOARD_ROMSIZE_KB_8192
	select HAVE_ACPI_TABLES
	select HAVE_OPTION_TABLE
	select TSC_MONOTONIC_TIMER

config MAINBOARD_DIR
	string
	default "esd/atom15"

config MAINBOARD_PART_NUMBER
	string
	default "esd atom15"

config MAX_CPUS
	int
	default 16

config FSP_FILE
	string
	default "../intel/fsp/baytrail/BAYTRAIL_FSP.fd"

config CBFS_SIZE
	hex
	default 0x00300000

config ENABLE_FSP_FAST_BOOT
	bool
	depends on HAVE_FSP_BIN
	default y

config VIRTUAL_ROM_SIZE
	hex
	depends on ENABLE_FSP_FAST_BOOT
	default 0x800000

config POST_DEVICE
	bool
	default n

config VGA_BIOS
	bool
	default y if FSP_PACKAGE_DEFAULT

endif # BOARD_ESD_ATOM15
```

## src/mainboard/example/Kconfig
```kconfig
if VENDOR_EXAMPLE

choice
	prompt "Mainboard model"

source "src/mainboard/example/*/Kconfig.name"

endchoice

source "src/mainboard/example/*/Kconfig"

config MAINBOARD_VENDOR
	default "Example"

endif # VENDOR_EXAMPLE
```

## src/mainboard/example/Kconfig.name
```kconfig
## SPDX-License-Identifier: GPL-2.0-only

config VENDOR_EXAMPLE
	bool "Example boards"
```

## src/mainboard/example/min86/Kconfig
```kconfig
if BOARD_EXAMPLE_MIN86

config BOARD_SPECIFIC_OPTIONS
	def_bool y
	select SOC_EXAMPLE_MIN86
	select MISSING_BOARD_RESET

config MAINBOARD_DIR
	default "example/min86"

config MAINBOARD_PART_NUMBER
	default "Min86"

endif
```

## src/mainboard/example/min86/Kconfig.name
```kconfig
config BOARD_EXAMPLE_MIN86
	bool "Minimal x86 fake board"
	help
	  This example mainboard code along with the example/min86 SoC
	  should serve as a minimal example how a buildable x86 SoC code
	  base can look like.

	  This can serve, for instance, as a basis to add new SoCs to
	  coreboot. Starting with a buildable commit should help with
	  the review of the actual code, and also avoid any regressions
	  when common coreboot code changes.
```

## src/mainboard/facebook/Kconfig
```kconfig
if VENDOR_FACEBOOK

choice
	prompt "Mainboard model"

source "src/mainboard/facebook/*/Kconfig.name"

endchoice

source "src/mainboard/facebook/*/Kconfig"

config MAINBOARD_VENDOR
	default "Facebook"

endif # VENDOR_FACEBOOK
```

## src/mainboard/facebook/Kconfig.name
```kconfig
## SPDX-License-Identifier: GPL-2.0-only

config VENDOR_FACEBOOK
	bool "Facebook"
```

## src/mainboard/facebook/fbg1701/Kconfig
```kconfig
## SPDX-License-Identifier: GPL-2.0-only

if BOARD_FACEBOOK_FBG1701

config BOARD_SPECIFIC_OPTIONS
	def_bool y
	select BOARD_ROMSIZE_KB_8192
	select DISABLE_ACPI_HIBERNATE
	select HAVE_ACPI_TABLES
	select HAVE_IFD_BIN
	select HAVE_ME_BIN
	select HAVE_OPTION_TABLE
	select MAINBOARD_HAS_LPC_TPM
	select MAINBOARD_HAS_TPM2
	select SOC_INTEL_BRASWELL
	select SOC_INTEL_COMMON_BLOCK_HDA_VERB
	select PCIEXP_L1_SUB_STATE
	select DISABLE_HPET
	select INTEL_GMA_HAVE_VBT
	select HAVE_SPD_IN_CBFS

config USE_VENDORCODE_ELTAN
	default y

if VBOOT

config VBOOT_VBNV_CMOS
	default y

config VBOOT_SLOTS_RW_A
	default y

config VBOOT_NO_BOARD_SUPPORT
	default y

config VBOOT_ENABLE_CBFS_FALLBACK
	default y

config FMDFILE
	default "src/mainboard/\$(CONFIG_MAINBOARD_DIR)/vboot-rw.fmd"

config RW_REGION_ONLY
	default "%/payload logo.bmp %/ramstage vbt.bin %/dsdt.aml config %/postcar"

config RO_REGION_ONLY
	default "spd.bin fsp.bin cpu_microcode_blob.bin"

endif # VBOOT

config ONBOARD_SAMSUNG_MEM
	bool "Onboard memory manufacturer Samsung"
	default n
	help
	  Samsung K4B8G1646D memory

config MAINBOARD_DIR
	default "facebook/fbg1701"

config MAINBOARD_PART_NUMBER
	default "FBG-1701"

config CBFS_SIZE
	default 0x00600000

config MRC_SETTINGS_CACHE_SIZE
	hex
	default 0x08000

config FSP_LOC
	hex
	default 0xfff9c000

config VENDORCODE_ELTAN_OEM_MANIFEST_LOC
	depends on VENDORCODE_ELTAN_VBOOT
	hex
	default 0xFFFE9000

config SPI_FLASH_INCLUDE_ALL_DRIVERS
	bool
	default n

config SPI_FLASH_WINBOND
	bool
	default y

config VENDORCODE_ELTAN_VBOOT_SIGNED_MANIFEST
	depends on VENDORCODE_ELTAN_VBOOT
	bool
	default y

config VENDORCODE_ELTAN_VBOOT_MANIFEST
	depends on USE_VENDORCODE_ELTAN
	string
	default "mainboard/facebook/fbg1701/manifest.h"

config VENDORCODE_ELTAN_VBOOT_KEY_LOCATION
	depends on VENDORCODE_ELTAN_VBOOT
	hex
	default 0xFFFF9000

config DRIVERS_INTEL_WIFI
	bool
	default n

endif # BOARD_FACEBOOK_FBG1701
```

## src/mainboard/facebook/fbg1701/Kconfig.name
```kconfig
## SPDX-License-Identifier: GPL-2.0-only

config BOARD_FACEBOOK_FBG1701
	bool "fbg1701"
```

## src/mainboard/facebook/monolith/Kconfig
```kconfig
if BOARD_FACEBOOK_MONOLITH

config BOARD_SPECIFIC_OPTIONS
	def_bool y
	select BOARD_ROMSIZE_KB_16384
	select DISABLE_ACPI_HIBERNATE
	select HAVE_ACPI_TABLES
	select HAVE_OPTION_TABLE
	select SOC_INTEL_KABYLAKE
	select MAINBOARD_HAS_LPC_TPM
	select MAINBOARD_HAS_TPM2
	select MAINBOARD_USES_IFD_GBE_REGION
	select INTEL_GMA_HAVE_VBT
	select VPD

config DISABLE_HECI1_AT_PRE_BOOT
	default y

config CBFS_SIZE
	default 0x00900000

config MAINBOARD_DIR
	default "facebook/monolith"

config MAINBOARD_PART_NUMBER
	default "Monolith"

config MAINBOARD_FAMILY
	string
	default "Facebook Monolith"

config MAX_CPUS
	int
	default 4

config IFD_BIN_PATH
	string
	depends on HAVE_IFD_BIN
	default "3rdparty/blobs/mainboard/\$(MAINBOARDDIR)/descriptor.bin"

config ME_BIN_PATH
	string
	depends on HAVE_ME_BIN
	default "3rdparty/blobs/mainboard/\$(MAINBOARDDIR)/me.bin"

config GBE_BIN_PATH
	string
	depends on HAVE_GBE_BIN
	default "3rdparty/blobs/mainboard/\$(MAINBOARDDIR)/gbe.bin"

config PRERAM_CBMEM_CONSOLE_SIZE
	hex
	default 0xd00

config DIMM_SPD_SIZE
	default 512  #DDR4

config UART_FOR_CONSOLE
	int
	default 0

config DIMM_MAX
	default 2

config MAINBOARD_SUPPORTS_SKYLAKE_CPU
	bool
	default n

config MAINBOARD_SUPPORTS_KABYLAKE_QUAD
	bool
	default n

config VBOOT
	select VBOOT_NO_BOARD_SUPPORT
	select VBOOT_SLOTS_RW_A
	select VBOOT_ALWAYS_ENABLE_DISPLAY
	select VBOOT_ENABLE_CBFS_FALLBACK

config RW_REGION_ONLY
	string "Files in RW only"

config VBOOT_ALWAYS_ALLOW_UDC
	def_bool y
	depends on VBOOT && !CHROMEOS

config USE_PM_ACPI_TIMER
	default n

endif
```

## src/mainboard/facebook/monolith/Kconfig.name
```kconfig
## SPDX-License-Identifier: GPL-2.0-only

config BOARD_FACEBOOK_MONOLITH
	bool "Facebook Monolith"
```

## src/mainboard/facebook/watson/Kconfig
```kconfig
if BOARD_FACEBOOK_WATSON || BOARD_FACEBOOK_WATSON_V2

config VBOOT
	select VBOOT_VBNV_CMOS
	select VBOOT_NO_BOARD_SUPPORT
	select GBB_FLAG_DISABLE_LID_SHUTDOWN
	select GBB_FLAG_DISABLE_PD_SOFTWARE_SYNC
	select GBB_FLAG_DISABLE_EC_SOFTWARE_SYNC
	select GBB_FLAG_DISABLE_FWMP

config BOARD_SPECIFIC_OPTIONS
	def_bool y
	select SOC_INTEL_FSP_BROADWELL_DE
	select BOARD_ROMSIZE_KB_16384
	select GENERATE_SMBIOS_TABLES
	select HAVE_ACPI_TABLES
	select HAVE_OPTION_TABLE
	select INTEGRATED_UART
	select IPMI_KCS if BOARD_FACEBOOK_WATSON_V2
	select SERIRQ_CONTINUOUS_MODE
	select MAINBOARD_USES_IFD_GBE_REGION
	select MAINBOARD_HAS_LPC_TPM
	select MAINBOARD_HAS_TPM1 if BOARD_FACEBOOK_WATSON
	select MAINBOARD_HAS_TPM2 if BOARD_FACEBOOK_WATSON_V2
	select NO_UART_ON_SUPERIO
	select VBOOT if BOARD_FACEBOOK_WATSON_V2
	select VBOOT_MEASURED_BOOT if BOARD_FACEBOOK_WATSON_V2
	select VBOOT_STARTS_IN_ROMSTAGE if BOARD_FACEBOOK_WATSON_V2
	select VPD
	select VPD_SMBIOS_VERSION

config MAINBOARD_DIR
	string
	default "facebook/watson"

config MAINBOARD_PART_NUMBER
	string
	default "Watson"

config DEVICETREE
	string
	default "variants/$(CONFIG_VARIANT_DIR)/devicetree.cb"

config IRQ_SLOT_COUNT
	int
	default 18

config CBFS_SIZE
	hex
	default 0x00800000

config VARIANT_DIR
	string
	default "watson" if BOARD_FACEBOOK_WATSON
	default "watson_v2" if BOARD_FACEBOOK_WATSON_V2

config VBOOT_FWID_MODEL
	string
	default "$(CONFIG_MAINBOARD_VENDOR)_$(CONFIG_MAINBOARD_PART_NUMBER)"

config VBOOT_FIRMWARE_PRIVKEY
	string
	depends on BOARD_FACEBOOK_WATSON_V2
	default "$(VBOOT_SOURCE)/tests/devkeys/firmware_data_key.vbprivk"

config VBOOT_FWID_VERSION
	string
	depends on BOARD_FACEBOOK_WATSON_V2
	default ".$(KERNELVERSION)"

config VBOOT_KERNEL_KEY
	string
	depends on BOARD_FACEBOOK_WATSON_V2
	default "$(VBOOT_SOURCE)/tests/devkeys/kernel_subkey.vbpubk"

config VBOOT_KEYBLOCK
	string
	depends on BOARD_FACEBOOK_WATSON_V2
	default "$(VBOOT_SOURCE)/tests/devkeys/firmware.keyblock"

config VBOOT_KEYBLOCK_VERSION
	int
	depends on BOARD_FACEBOOK_WATSON_V2
	default 1

config VBOOT_KEYBLOCK_PREAMBLE_FLAGS
	hex
	depends on BOARD_FACEBOOK_WATSON_V2
	default 0x0

config VBOOT_RECOVERY_KEY
	string
	depends on BOARD_FACEBOOK_WATSON_V2
	default "$(VBOOT_SOURCE)/tests/devkeys/recovery_key.vbpubk"

config VBOOT_ROOT_KEY
	string
	depends on BOARD_FACEBOOK_WATSON_V2
	default "$(VBOOT_SOURCE)/tests/devkeys/root_key.vbpubk"

config VBOOT_VBNV_OFFSET
	hex
	depends on BOARD_FACEBOOK_WATSON_V2
	default 0x26

config VIRTUAL_ROM_SIZE
	hex
	# Set to CONFIG_ROM_SIZE*2 if using concatenated flash chips.
	# See FSP's Kconfig for details.
	default ROM_SIZE

config DRIVERS_UART_8250IO
	def_bool n

config FMDFILE
	string
	default "src/mainboard/$(CONFIG_MAINBOARD_DIR)/board.fmd" if BOARD_FACEBOOK_WATSON
	default "src/mainboard/$(CONFIG_MAINBOARD_DIR)/vboot-ro.fmd" if BOARD_FACEBOOK_WATSON_V2

config ENABLE_TURBO
	bool "Enable turbo frequency"
	default n

endif # BOARD_FACEBOOK_WATSON*
```

## src/mainboard/facebook/watson/Kconfig.name
```kconfig
config BOARD_FACEBOOK_WATSON
	bool "Watson_v1"

config BOARD_FACEBOOK_WATSON_V2
	bool "Watson_v2"
```

## src/mainboard/foxconn/Kconfig
```kconfig
## SPDX-License-Identifier: GPL-2.0-only

if VENDOR_FOXCONN

choice
	prompt "Mainboard model"

source "src/mainboard/foxconn/*/Kconfig.name"

endchoice

source "src/mainboard/foxconn/*/Kconfig"

config MAINBOARD_VENDOR
	default "Foxconn"

endif # VENDOR_FOXCONN
```
