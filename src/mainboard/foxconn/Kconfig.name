## src/mainboard/foxconn/d41s/Kconfig
```kconfig
# SPDX-License-Identifier: GPL-2.0-only

if BOARD_FOXCONN_D41S

config BOARD_SPECIFIC_OPTIONS
	def_bool y
	select CPU_INTEL_SOCKET_FCBGA559
	select NORTHBRIDGE_INTEL_PINEVIEW
	select SOUTHBRIDGE_INTEL_I82801GX
	select SUPERIO_ITE_IT8721F
	select HAVE_ACPI_TABLES
	select HAVE_ACPI_RESUME
	select BOARD_ROMSIZE_KB_1024
	select INTEL_INT15
	select HAVE_OPTION_TABLE
	select HAVE_CMOS_DEFAULT
	select DRIVERS_I2C_CK505
	select INTEL_GMA_HAVE_VBT

config MAINBOARD_DIR
	default "foxconn/d41s"

config MAINBOARD_PART_NUMBER
	default "D41S"

endif # BOARD_FOXCONN_D41S
```

## src/mainboard/foxconn/d41s/Kconfig.name
```kconfig
## SPDX-License-Identifier: GPL-2.0-only

config BOARD_FOXCONN_D41S
	bool "D41S, D42S, D51S, D52S"
```

## src/mainboard/foxconn/g41s-k/Kconfig
```kconfig
## SPDX-License-Identifier: GPL-2.0-only

if BOARD_FOXCONN_G41S_K || BOARD_FOXCONN_G41M

config BOARD_SPECIFIC_OPTIONS
	def_bool y
	select CPU_INTEL_SOCKET_LGA775
	select NORTHBRIDGE_INTEL_X4X
	select SOUTHBRIDGE_INTEL_I82801GX
	select SUPERIO_ITE_IT8720F
	select BOARD_ROMSIZE_KB_1024
	select HAVE_ACPI_RESUME
	select HAVE_ACPI_TABLES
	select HAVE_CMOS_DEFAULT
	select HAVE_OPTION_TABLE
	select MEMORY_MAPPED_TPM
	select INTEL_GMA_HAVE_VBT
	select MAINBOARD_HAS_LIBGFXINIT

config MAINBOARD_DIR
	default "foxconn/g41s-k"

config VARIANT_DIR
	default "g41s-k" if BOARD_FOXCONN_G41S_K
	default "g41m" if BOARD_FOXCONN_G41M

config MAINBOARD_PART_NUMBER
	default "G41S-K" if BOARD_FOXCONN_G41S_K
	default "G41M/G41M-S/G41M-V" if BOARD_FOXCONN_G41M

config OVERRIDE_DEVICETREE
	default "variants/\$(CONFIG_VARIANT_DIR)/overridetree.cb"

endif # BOARD_FOXCONN_G41S_K
```

## src/mainboard/foxconn/g41s-k/Kconfig.name
```kconfig
## SPDX-License-Identifier: GPL-2.0-only

config BOARD_FOXCONN_G41S_K
	bool "G41S-K"
config BOARD_FOXCONN_G41M
	bool "G41M/G41M-S/G41M-V"
```

## src/mainboard/framework/azalea/Kconfig
```kconfig
# SPDX-License-Identifier: GPL-2.0-only

config BOARD_FRAMEWORK_AZALEA
	select BOARD_ROMSIZE_KB_32768
	select SOC_AMD_PHOENIX_FSP

if BOARD_FRAMEWORK_AZALEA

config MAINBOARD_DIR
	default "framework/azalea"

config MAINBOARD_PART_NUMBER
	default "Azalea"

config FMDFILE
	default "src/mainboard/\$(CONFIG_MAINBOARD_DIR)/coreboot.fmd"

endif
```

## src/mainboard/framework/azalea/Kconfig.name
```kconfig
# SPDX-License-Identifier: GPL-2.0-only

config BOARD_FRAMEWORK_AZALEA
	bool "Azalea (Framework 13 AMD 7040)"
```

## src/mainboard/framework/common/Kconfig
```kconfig
## SPDX-License-Identifier: GPL-2.0-or-later

if VENDOR_FRAMEWORK

config MB_COMMON_DIR
	string
	default "framework/common" if EC_GOOGLE_CHROMEEC

endif # VENDOR_FRAMEWORK
```

## src/mainboard/framework/marigold/Kconfig
```kconfig
## SPDX-License-Identifier: GPL-2.0-or-later

config BOARD_FRAMEWORK_MARIGOLD_COMMON
	def_bool n
	select BOARD_ROMSIZE_KB_32768
	select CRB_TPM
	select DRIVERS_I2C_HID
	select EC_GOOGLE_CHROMEEC
	select EC_GOOGLE_CHROMEEC_ESPI
	select EC_GOOGLE_CHROMEEC_ACPI_MEMMAP
	select DRIVERS_INTEL_USB4_RETIMER
	select DRIVERS_INTEL_WIFI
	select DRIVERS_GFX_GENERIC
	select DRIVERS_INTEL_PMC
	select HAVE_ACPI_TABLES
	select HAVE_INTEL_PTT
	select INTEL_GMA_HAVE_VBT
	select INTEL_LPSS_UART_FOR_CONSOLE
	select MEMORY_MAPPED_TPM
	select PMC_IPC_ACPI_INTERFACE
	select MAINBOARD_HAS_TPM2
	select NO_UART_ON_SUPERIO
	select PCIEXP_SUPPORT_RESIZABLE_BARS
	select SOC_INTEL_COMMON_BLOCK_HDA_VERB
	select SKIP_SEND_CONNECT_TOPOLOGY_CMD
	select SOC_INTEL_ENABLE_USB4_PCIE_RESOURCES
	select SPD_READ_BY_WORD
	select SYSTEM_TYPE_LAPTOP
	select TPM_MEASURED_BOOT

config BOARD_FRAMEWORK_MARIGOLD
	select BOARD_FRAMEWORK_MARIGOLD_COMMON
	select FSP_TYPE_IOT
	select SOC_INTEL_METEORLAKE_U_H

if BOARD_FRAMEWORK_MARIGOLD_COMMON

config FMDFILE
	default "src/mainboard/\$(CONFIG_MAINBOARD_DIR)/board.fmd"

config MAINBOARD_DIR
	default "framework/marigold"

config MAINBOARD_PART_NUMBER
	default "Framework Laptop 13 (Intel Core Ultra Series 1)"

config MAINBOARD_SMBIOS_PRODUCT_NAME
	default "Laptop 13 (Intel Core Ultra Series 1)"

config MAINBOARD_FAMILY
	default "Laptop"

config CONSOLE_POST
	default y

config D3COLD_SUPPORT
	default y

config DIMM_SPD_SIZE
	default 1024

config ONBOARD_VGA_IS_PRIMARY
	default y

config PCIEXP_DEFAULT_MAX_RESIZABLE_BAR_BITS
	default 36

config POST_DEVICE
	default n

config UART_FOR_CONSOLE
	default 0

# PM Timer Disabled, saves power
config USE_PM_ACPI_TIMER
	default n

endif
```

## src/mainboard/framework/marigold/Kconfig.name
```kconfig
## SPDX-License-Identifier: GPL-2.0-or-later

config BOARD_FRAMEWORK_MARIGOLD
	bool "Laptop 13 (Intel Core Ultra Series 1)"
```

## src/mainboard/framework/sakura/Kconfig
```kconfig
## SPDX-License-Identifier: GPL-2.0-or-later

config BOARD_FRAMEWORK_SAKURA_COMMON
	def_bool n
	select BOARD_ROMSIZE_KB_32768
	select CRB_TPM
	select DRIVERS_I2C_HID
	select EC_GOOGLE_CHROMEEC
	select EC_GOOGLE_CHROMEEC_ESPI
	select EC_GOOGLE_CHROMEEC_ACPI_MEMMAP
	select DRIVERS_INTEL_USB4_RETIMER
	select DRIVERS_INTEL_WIFI
	select DRIVERS_GFX_GENERIC
	select DRIVERS_INTEL_PMC
	select HAVE_ACPI_TABLES
	select HAVE_INTEL_PTT
	select INTEL_GMA_HAVE_VBT
	select INTEL_LPSS_UART_FOR_CONSOLE
	select MEMORY_MAPPED_TPM
	select PMC_IPC_ACPI_INTERFACE
	select MAINBOARD_HAS_TPM2
	select NO_UART_ON_SUPERIO
	select PCIEXP_SUPPORT_RESIZABLE_BARS
	select SOC_INTEL_COMMON_BLOCK_HDA_VERB
	select SOC_INTEL_ENABLE_USB4_PCIE_RESOURCES
	select SOC_INTEL_TCSS_USE_PDC_PMC_USBC_MUX_CONFIGURATION
	select SPD_READ_BY_WORD
	select SYSTEM_TYPE_LAPTOP
	select TPM_MEASURED_BOOT

config BOARD_FRAMEWORK_SAKURA
	select BOARD_FRAMEWORK_SAKURA_COMMON
	select FSP_TYPE_IOT
	select SOC_INTEL_PANTHERLAKE_U_H

if BOARD_FRAMEWORK_SAKURA_COMMON

config MAINBOARD_DIR
	default "framework/sakura"

config FMDFILE
	default "src/mainboard/\$(CONFIG_MAINBOARD_DIR)/board.fmd"

# The PTL SoC default (0xd0000) is sized only for FSP-S preloading. Our UEFI
# payload is ~1.44 MB, so cbfs_preload() of the payload fails to allocate and
# trips an assert in commonlib/list.c. Enlarge the cache to fit dsdt.aml + the
# payload.
config RAMSTAGE_CBFS_CACHE_SIZE
	default 0x200000

config MAINBOARD_PART_NUMBER
	default "Framework Laptop 13 Pro (Intel Core Ultra Series 3)"

config MAINBOARD_SMBIOS_PRODUCT_NAME
	default "Laptop 13 Pro (Intel Core Ultra Series 3)"

config MAINBOARD_FAMILY
	default "Laptop"

config CONSOLE_POST
	default y

config D3COLD_SUPPORT
	default y

config DIMM_SPD_SIZE
	default 1024

config ONBOARD_VGA_IS_PRIMARY
	default y

config PCIEXP_DEFAULT_MAX_RESIZABLE_BAR_BITS
	default 36

config POST_DEVICE
	default n

config UART_FOR_CONSOLE
	default 0

# PM Timer Disabled, saves power
config USE_PM_ACPI_TIMER
	default n

endif
```

## src/mainboard/framework/sakura/Kconfig.name
```kconfig
## SPDX-License-Identifier: GPL-2.0-or-later

config BOARD_FRAMEWORK_SAKURA
	bool "Laptop 13 Pro (Intel Core Ultra Series 3)"
```

## src/mainboard/framework/sunflower/Kconfig
```kconfig
## SPDX-License-Identifier: GPL-2.0-or-later

config BOARD_FRAMEWORK_SUNFLOWER_COMMON
	def_bool n
	select BOARD_ROMSIZE_KB_32768
	select CRB_TPM
	select DRIVERS_I2C_HID
	select DRIVERS_INTEL_WIFI
	select EC_GOOGLE_CHROMEEC
	select EC_GOOGLE_CHROMEEC_ESPI
	select EC_GOOGLE_CHROMEEC_ACPI_MEMMAP
	select HAVE_ACPI_RESUME
	select HAVE_ACPI_TABLES
	select HAVE_INTEL_PTT
	select INTEL_GMA_HAVE_VBT
	select INTEL_LPSS_UART_FOR_CONSOLE
	select MEMORY_MAPPED_TPM
	select MAINBOARD_HAS_TPM2
	select NO_UART_ON_SUPERIO
	select SOC_INTEL_COMMON_BLOCK_HDA_VERB
	select SYSTEM_TYPE_CONVERTIBLE
	select TPM_MEASURED_BOOT

config BOARD_FRAMEWORK_SUNFLOWER
	select BOARD_FRAMEWORK_SUNFLOWER_COMMON
	select SOC_INTEL_ALDERLAKE_PCH_P
	select SOC_INTEL_RAPTORLAKE

if BOARD_FRAMEWORK_SUNFLOWER_COMMON

config MAINBOARD_DIR
	default "framework/sunflower"

config MAINBOARD_PART_NUMBER
	default "Framework Laptop 12 (13th Gen Intel Core)"

config MAINBOARD_SMBIOS_PRODUCT_NAME
	default "Laptop 12 (13th Gen Intel Core)"

config MAINBOARD_FAMILY
	default "Laptop 12"

config CONSOLE_POST
	default y

config DIMM_MAX
	default 1

config POST_DEVICE
	default n

config UART_FOR_CONSOLE
	default 0

config FMDFILE
	default "src/mainboard/\$(CONFIG_MAINBOARD_DIR)/board.fmd"

endif
```

## src/mainboard/framework/sunflower/Kconfig.name
```kconfig
## SPDX-License-Identifier: GPL-2.0-or-later

config BOARD_FRAMEWORK_SUNFLOWER
	bool "Laptop 12 (13th Gen Intel Core)"
```

## src/mainboard/fsc/Kconfig
```kconfig
if VENDOR_FSC

choice
	prompt "Mainboard model"

config BOARD_FSC_TX200S3
	bool "TX200 S3"
endchoice

source "src/mainboard/fsc/tx200s3/Kconfig"

config MAINBOARD_VENDOR
	string
	default "FSC (Fujitsu Siemens Computer)"

endif # VENDOR_FSC
```

## src/mainboard/fsc/tx200s3/Kconfig
```kconfig
if BOARD_FSC_TX200S3

config BOARD_SPECIFIC_OPTIONS # dummy
	def_bool y
	select ARCH_X86
	select CPU_INTEL_SOCKET_LGA771
	select SOUTHBRIDGE_INTEL_I3100
	select NORTHBRIDGE_INTEL_I5000
	select SUPERIO_SMSC_SMSCSUPERIO
	select MMCONF_SUPPORT
	select BOARD_ROMSIZE_KB_512
	select HAVE_MP_TABLE
	select HAVE_PIRQ_TABLE
	select IPMI_KCS
	select DRIVERS_GENERIC_IOAPIC

config MAINBOARD_DIR
	string
	default fsc/tx200s3

config DCACHE_RAM_BASE
	hex
	default 0xffdf8000

config DCACHE_RAM_SIZE
	hex
	default 0x8000

config MAINBOARD_PART_NUMBER
	string
	default "TX200 S3"

config MMCONF_BASE_ADDRESS
	hex
	default 0xe0000000

config IRQ_SLOT_COUNT
	int
	default 48

config MAX_CPUS
	int
	default 8

endif
```

## src/mainboard/getac/Kconfig
```kconfig
## SPDX-License-Identifier: GPL-2.0-only

if VENDOR_GETAC

choice
	prompt "Mainboard model"

source "src/mainboard/getac/*/Kconfig.name"

endchoice

source "src/mainboard/getac/*/Kconfig"

config MAINBOARD_VENDOR
	default "Getac"

endif # VENDOR_GETAC
```

## src/mainboard/getac/p470/Kconfig
```kconfig
## SPDX-License-Identifier: GPL-2.0-only

if BOARD_GETAC_P470

config BOARD_SPECIFIC_OPTIONS
	def_bool y
	select AZALIA_USE_LEGACY_VERB_TABLE
	select SYSTEM_TYPE_LAPTOP
	select CPU_INTEL_SOCKET_M
	select NORTHBRIDGE_INTEL_I945
	select NORTHBRIDGE_INTEL_SUBTYPE_I945GM
	select SOUTHBRIDGE_INTEL_I82801GX
	select SOUTHBRIDGE_TI_PCIXX12
	select SUPERIO_SMSC_FDC37N972
	select SUPERIO_SMSC_SIO10N268
	select EC_ACPI
	select HAVE_ACPI_TABLES
	select HAVE_PIRQ_TABLE
	select HAVE_MP_TABLE
	select HAVE_OPTION_TABLE
	select HAVE_ACPI_RESUME
	select BOARD_ROMSIZE_KB_1024
	select INTEL_INT15
	select I945_LVDS

config MAINBOARD_DIR
	default "getac/p470"

config MAINBOARD_PART_NUMBER
	default "P470"

config IRQ_SLOT_COUNT
	int
	default 18

endif # BOARD_GETAC_P470
```

## src/mainboard/gigabyte/Kconfig
```kconfig
## SPDX-License-Identifier: GPL-2.0-only

if VENDOR_GIGABYTE

choice
	prompt "Mainboard model"

source "src/mainboard/gigabyte/*/Kconfig.name"

endchoice

source "src/mainboard/gigabyte/*/Kconfig"

config MAINBOARD_VENDOR
	default "GIGABYTE"

config HAVE_GIGABYTE_BMC_BIOS_UPDATE
	bool
	default n
	help
	  Select this option if the Gigabyte board has a BMC and accepts
	  RBU files as input to update the BIOS. Build system will
	  additionally produce the coreboot ROM packed into a RBU file,
	  that can be diectly passed to BMC for BIOS update.

endif # VENDOR_GIGABYTE
```

## src/mainboard/gigabyte/ga-6bxc/Kconfig
```kconfig
##
## This file is part of the coreboot project.
##
## Copyright (C) 2009 Uwe Hermann <uwe@hermann-uwe.de>
##
## This program is free software; you can redistribute it and/or modify
## it under the terms of the GNU General Public License as published by
## the Free Software Foundation; version 2 of the License.
##
## This program is distributed in the hope that it will be useful,
## but WITHOUT ANY WARRANTY; without even the implied warranty of
## MERCHANTABILITY or FITNESS FOR A PARTICULAR PURPOSE.  See the
## GNU General Public License for more details.
##
if BOARD_GIGABYTE_GA_6BXC

config BOARD_SPECIFIC_OPTIONS # dummy
	def_bool y
	select CPU_INTEL_SLOT_1
	select NORTHBRIDGE_INTEL_I440BX
	select SOUTHBRIDGE_INTEL_I82371EB
	select SUPERIO_ITE_IT8671F
	select HAVE_PIRQ_TABLE
	select UDELAY_TSC
	select BOARD_ROMSIZE_KB_256

config MAINBOARD_DIR
	string
	default gigabyte/ga-6bxc

config MAINBOARD_PART_NUMBER
	string
	default "GA-6BXC"

config IRQ_SLOT_COUNT
	int
	default 6

endif # BOARD_GIGABYTE_GA_6BXC
```

## src/mainboard/gigabyte/ga-6bxe/Kconfig
```kconfig
##
## This file is part of the coreboot project.
##
## Copyright (C) 2010 Anders Jenbo <anders@jenbo.dk>
##
## This program is free software; you can redistribute it and/or modify
## it under the terms of the GNU General Public License as published by
## the Free Software Foundation; either version 2 of the License, or
## (at your option) any later version.
##
## This program is distributed in the hope that it will be useful,
## but WITHOUT ANY WARRANTY; without even the implied warranty of
## MERCHANTABILITY or FITNESS FOR A PARTICULAR PURPOSE.  See the
## GNU General Public License for more details.
##
## You should have received a copy of the GNU General Public License
## along with this program; if not, write to the Free Software
## Foundation, Inc., 51 Franklin St, Fifth Floor, Boston, MA 02110-1301 USA
##
if BOARD_GIGABYTE_GA_6BXE

config BOARD_SPECIFIC_OPTIONS # dummy
	def_bool y
	select ARCH_X86
	select CPU_INTEL_SLOT_1
	select NORTHBRIDGE_INTEL_I440BX
	select SOUTHBRIDGE_INTEL_I82371EB
	select SUPERIO_ITE_IT8671F
	select HAVE_PIRQ_TABLE
	select UDELAY_TSC
	select BOARD_ROMSIZE_KB_256
	select SDRAMPWR_4DIMM

config MAINBOARD_DIR
	string
	default gigabyte/ga-6bxe

config MAINBOARD_PART_NUMBER
	string
	default "GA-6BXE"

config IRQ_SLOT_COUNT
	int
	default 7

endif # BOARD_GIGABYTE_GA_6BXE
```
