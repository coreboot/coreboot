## src/mainboard/gigabyte/ga-945gcm-s2l/Kconfig
```kconfig
## SPDX-License-Identifier: GPL-2.0-only

if BOARD_GIGABYTE_GA_945GCM_S2L || BOARD_GIGABYTE_GA_945GCM_S2C

config BOARD_SPECIFIC_OPTIONS
	def_bool y
	select CPU_INTEL_SOCKET_LGA775
	select NORTHBRIDGE_INTEL_I945
	select NORTHBRIDGE_INTEL_SUBTYPE_I945GC
	select SOUTHBRIDGE_INTEL_I82801GX
	select SUPERIO_ITE_IT8718F
	select HAVE_OPTION_TABLE
	select HAVE_CMOS_DEFAULT
	select HAVE_ACPI_TABLES
	select HAVE_ACPI_RESUME
	select BOARD_ROMSIZE_KB_512
	select MAINBOARD_HAS_NATIVE_VGA_INIT
	select REALTEK_8168_RESET if BOARD_GIGABYTE_GA_945GCM_S2L
	select INTEL_GMA_HAVE_VBT

config MAINBOARD_DIR
	default "gigabyte/ga-945gcm-s2l"

config VARIANT_DIR
	default "ga-945gcm-s2l" if BOARD_GIGABYTE_GA_945GCM_S2L
	default "ga-945gcm-s2c" if BOARD_GIGABYTE_GA_945GCM_S2C

config MAINBOARD_PART_NUMBER
	default "GA-945GCM-S2L" if BOARD_GIGABYTE_GA_945GCM_S2L
	default "GA-945GCM-S2C" if BOARD_GIGABYTE_GA_945GCM_S2C

config IRQ_SLOT_COUNT
	int
	default 18

config MAX_CPUS
	int
	default 2

# Override the default variant behavior, since the data.vbt is the same
config INTEL_GMA_VBT_FILE
	default "src/mainboard/\$(MAINBOARDDIR)/data.vbt"

endif
```

## src/mainboard/gigabyte/ga-945gcm-s2l/Kconfig.name
```kconfig
## SPDX-License-Identifier: GPL-2.0-only

config BOARD_GIGABYTE_GA_945GCM_S2L
	bool "GA-945GCM-S2L"

config BOARD_GIGABYTE_GA_945GCM_S2C
	bool "GA-945GCM-S2C"
```

## src/mainboard/gigabyte/ga-b75m-d3h/Kconfig
```kconfig
if BOARD_GIGABYTE_GA_B75M_D3H || BOARD_GIGABYTE_GA_B75M_D3V || BOARD_GIGABYTE_GA_B75_D3V

config BOARD_SPECIFIC_OPTIONS
	def_bool y
	select NORTHBRIDGE_INTEL_SANDYBRIDGE
	select USE_NATIVE_RAMINIT
	select SOUTHBRIDGE_INTEL_C216
	select SUPERIO_ITE_IT8728F
	select BOARD_ROMSIZE_KB_8192
	select HAVE_ACPI_TABLES
	select HAVE_OPTION_TABLE
	select HAVE_CMOS_DEFAULT
	select HAVE_ACPI_RESUME
	select INTEL_GMA_HAVE_VBT
	select INTEL_INT15
	select SERIRQ_CONTINUOUS_MODE
	select MAINBOARD_HAS_LIBGFXINIT
	select MEMORY_MAPPED_TPM

config DRAM_RESET_GATE_GPIO
	int
	default 25

config USBDEBUG_HCD_INDEX
	int
	default 2

config MAINBOARD_DIR
	default "gigabyte/ga-b75m-d3h"

config VARIANT_DIR
	default "ga-b75m-d3h" if BOARD_GIGABYTE_GA_B75M_D3H
	default "ga-b75m-d3v" if BOARD_GIGABYTE_GA_B75M_D3V
	default "ga-b75-d3v" if BOARD_GIGABYTE_GA_B75_D3V

config MAINBOARD_PART_NUMBER
	default "GA-B75M-D3H" if BOARD_GIGABYTE_GA_B75M_D3H
	default "GA-B75M-D3V" if BOARD_GIGABYTE_GA_B75M_D3V
	default "GA-B75-D3V" if BOARD_GIGABYTE_GA_B75_D3V

config OVERRIDE_DEVICETREE
	default "variants/\$(CONFIG_VARIANT_DIR)/overridetree.cb" if BOARD_GIGABYTE_GA_B75_D3V

# Override the default variant behavior, since the data.vbt is the same
config INTEL_GMA_VBT_FILE
	string
	default "src/mainboard/\$(MAINBOARDDIR)/data.vbt"

endif # BOARD_GIGABYTE_GA_B75*
```

## src/mainboard/gigabyte/ga-b75m-d3h/Kconfig.name
```kconfig
config BOARD_GIGABYTE_GA_B75M_D3H
	bool "GA-B75M-D3H"

config BOARD_GIGABYTE_GA_B75M_D3V
	bool "GA-B75M-D3V"

config BOARD_GIGABYTE_GA_B75_D3V
	bool "GA-B75-D3V"
```

## src/mainboard/gigabyte/ga-b75m-d3v/Kconfig
```kconfig
if BOARD_GIGABYTE_GA_B75M_D3V

config BOARD_SPECIFIC_OPTIONS
	def_bool y
	select ARCH_X86
	select CPU_INTEL_SOCKET_LGA1155
	select NORTHBRIDGE_INTEL_IVYBRIDGE
	select USE_NATIVE_RAMINIT
	select SOUTHBRIDGE_INTEL_C216
	select SUPERIO_ITE_IT8728F
	select BOARD_ROMSIZE_KB_8192
	select HAVE_ACPI_TABLES
	select HAVE_OPTION_TABLE
	select HAVE_CMOS_DEFAULT
	select HAVE_ACPI_RESUME
	select HAVE_SMI_HANDLER
	select INTEL_INT15
	select SERIRQ_CONTINUOUS_MODE
	select MAINBOARD_HAS_LIBGFXINIT

config DRAM_RESET_GATE_GPIO
	int
	default 25

config USBDEBUG_HCD_INDEX
	int
	default 2

config MAINBOARD_DIR
	string
	default gigabyte/ga-b75m-d3v

config MAINBOARD_PART_NUMBER
	string
	default "GA-B75M-D3V"

config MAX_CPUS
	int
	default 8

config VGA_BIOS_ID
	string
	default "8086,0102"

config VGA_BIOS_FILE
	string
	default "pci8086,0102.rom"

endif # BOARD_GIGABYTE_GA_B75M_D3V
```

## src/mainboard/gigabyte/ga-d510ud/Kconfig
```kconfig
## SPDX-License-Identifier: GPL-2.0-only

if BOARD_GIGABYTE_GA_D510UD

config BOARD_SPECIFIC_OPTIONS
	def_bool y
	select BOARD_ROMSIZE_KB_512
	select CPU_INTEL_SOCKET_FCBGA559
	select HAVE_ACPI_RESUME
	select HAVE_ACPI_TABLES
	select HAVE_CMOS_DEFAULT
	select HAVE_OPTION_TABLE
	select INTEL_GMA_HAVE_VBT
	select NORTHBRIDGE_INTEL_PINEVIEW
	select REALTEK_8168_RESET
	select SOUTHBRIDGE_INTEL_I82801GX
	select SUPERIO_ITE_IT8720F

config MAINBOARD_DIR
	default "gigabyte/ga-d510ud"

config MAINBOARD_PART_NUMBER
	default "GA-D510UD"

endif # BOARD_GIGABYTE_GA_D510UD
```

## src/mainboard/gigabyte/ga-d510ud/Kconfig.name
```kconfig
## SPDX-License-Identifier: GPL-2.0-only

config BOARD_GIGABYTE_GA_D510UD
	bool "GA-D510UD"
```

## src/mainboard/gigabyte/ga-g41m-es2l/Kconfig
```kconfig
# SPDX-License-Identifier: GPL-2.0-only

if BOARD_GIGABYTE_GA_G41M_ES2L

config BOARD_SPECIFIC_OPTIONS
	def_bool y
	select AZALIA_USE_LEGACY_VERB_TABLE
	select CPU_INTEL_SOCKET_LGA775
	select NORTHBRIDGE_INTEL_X4X
	select SOUTHBRIDGE_INTEL_I82801GX
	select SUPERIO_ITE_IT8718F
	select HAVE_ACPI_TABLES
	select BOARD_ROMSIZE_KB_1024
	select PCIEXP_ASPM
	select PCIEXP_CLK_PM
	select PCIEXP_L1_SUB_STATE
	select REALTEK_8168_RESET
	select HAVE_OPTION_TABLE
	select HAVE_CMOS_DEFAULT
	select HAVE_ACPI_RESUME
	select INTEL_GMA_HAVE_VBT
	select MAINBOARD_HAS_LIBGFXINIT

config MAINBOARD_DIR
	default "gigabyte/ga-g41m-es2l"

config MAINBOARD_PART_NUMBER
	default "GA-G41M-ES2L"

endif # BOARD_GIGABYTE_GA_G41M_ES2L
```

## src/mainboard/gigabyte/ga-g41m-es2l/Kconfig.name
```kconfig
## SPDX-License-Identifier: GPL-2.0-only

config BOARD_GIGABYTE_GA_G41M_ES2L
	bool "GA-G41M-ES2L"
```

## src/mainboard/gigabyte/ga-h61m-s2pv/Kconfig
```kconfig
##
## This file is part of the coreboot project.
##
## Copyright (C) 2018 Angel Pons <th3fanbus@gmail.com>
##
## This program is free software; you can redistribute it and/or modify
## it under the terms of the GNU General Public License as published by
## the Free Software Foundation; version 2 of the License.
##
## This program is distributed in the hope that it will be useful,
## but WITHOUT ANY WARRANTY; without even the implied warranty of
## MERCHANTABILITY or FITNESS FOR A PARTICULAR PURPOSE.  See the
## GNU General Public License for more details.
##

if BOARD_GIGABYTE_GA_H61M_S2PV || BOARD_GIGABYTE_GA_H61MA_D3V

config BOARD_SPECIFIC_OPTIONS
	def_bool y
	select BOARD_ROMSIZE_KB_4096
	select HAVE_ACPI_RESUME
	select HAVE_ACPI_TABLES
	select INTEL_INT15
	select NORTHBRIDGE_INTEL_SANDYBRIDGE
	select SERIRQ_CONTINUOUS_MODE
	select SOUTHBRIDGE_INTEL_BD82X6X
	select USE_NATIVE_RAMINIT
	select SUPERIO_ITE_IT8728F
	select MAINBOARD_HAS_LIBGFXINIT
	select INTEL_GMA_HAVE_VBT
	select HAVE_OPTION_TABLE
	select HAVE_CMOS_DEFAULT
	select NO_UART_ON_SUPERIO if BOARD_GIGABYTE_GA_H61MA_D3V

config MAINBOARD_DIR
	string
	default "gigabyte/ga-h61m-s2pv"

config VARIANT_DIR
	string
	default "ga-h61m-s2pv" if BOARD_GIGABYTE_GA_H61M_S2PV
	default "ga-h61ma-d3v" if BOARD_GIGABYTE_GA_H61MA_D3V

config MAINBOARD_PART_NUMBER
	string
	default "GA-H61M-S2PV" if BOARD_GIGABYTE_GA_H61M_S2PV
	default "GA-H61MA-D3V" if BOARD_GIGABYTE_GA_H61MA_D3V

config DEVICETREE
	string
	default "variants/$(CONFIG_VARIANT_DIR)/devicetree.cb"

config MAX_CPUS
	int
	default 8

# Override the default variant behavior, since the data.vbt is the same
config INTEL_GMA_VBT_FILE
	default "src/mainboard/$(MAINBOARDDIR)/data.vbt"

config USBDEBUG_HCD_INDEX # Bottom left port seen from rear
	int
	default 2

endif # BOARD_GIGABYTE_GA_H61M_S2PV || BOARD_GIGABYTE_GA_H61MA_D3V
```

## src/mainboard/gigabyte/ga-h61m-series/Kconfig
```kconfig
## SPDX-License-Identifier: GPL-2.0-only

config BOARD_GIGABYTE_GA_H61M_SERIES
	def_bool n
	select BOARD_ROMSIZE_KB_4096
	select HAVE_ACPI_RESUME
	select HAVE_ACPI_TABLES
	select INTEL_INT15
	select NORTHBRIDGE_INTEL_SANDYBRIDGE
	select SERIRQ_CONTINUOUS_MODE
	select SOUTHBRIDGE_INTEL_BD82X6X
	select USE_NATIVE_RAMINIT
	select SUPERIO_ITE_IT8728F
	select MAINBOARD_HAS_LIBGFXINIT
	select INTEL_GMA_HAVE_VBT
	select HAVE_OPTION_TABLE
	select HAVE_CMOS_DEFAULT

config BOARD_GIGABYTE_GA_H61M_S2PV
	select BOARD_GIGABYTE_GA_H61M_SERIES

config BOARD_GIGABYTE_GA_H61M_DS2
	select BOARD_GIGABYTE_GA_H61M_SERIES

config BOARD_GIGABYTE_GA_H61M_DS2V
	select BOARD_GIGABYTE_GA_H61M_SERIES
	select NO_UART_ON_SUPERIO

config BOARD_GIGABYTE_GA_H61MA_D3V
	select BOARD_GIGABYTE_GA_H61M_SERIES
	select NO_UART_ON_SUPERIO

config BOARD_GIGABYTE_GA_H61M_S2P_R3
	select BOARD_GIGABYTE_GA_H61M_SERIES

if BOARD_GIGABYTE_GA_H61M_SERIES

config MAINBOARD_DIR
	default "gigabyte/ga-h61m-series"

config VARIANT_DIR
	default "ga-h61m-s2pv"   if BOARD_GIGABYTE_GA_H61M_S2PV
	default "ga-h61m-ds2v"   if BOARD_GIGABYTE_GA_H61M_DS2V
	default "ga-h61ma-d3v"   if BOARD_GIGABYTE_GA_H61MA_D3V
	default "ga-h61m-ds2"    if BOARD_GIGABYTE_GA_H61M_DS2
	default "ga-h61m-s2p-r3" if BOARD_GIGABYTE_GA_H61M_S2P_R3

config MAINBOARD_PART_NUMBER
	default "GA-H61M-S2PV"   if BOARD_GIGABYTE_GA_H61M_S2PV
	default "GA-H61M-DS2V"   if BOARD_GIGABYTE_GA_H61M_DS2V
	default "GA-H61MA-D3V"   if BOARD_GIGABYTE_GA_H61MA_D3V
	default "GA-H61M-DS2"    if BOARD_GIGABYTE_GA_H61M_DS2
	default "GA-H61M-S2P-R3" if BOARD_GIGABYTE_GA_H61M_S2P_R3

config OVERRIDE_DEVICETREE
	default "variants/\$(CONFIG_VARIANT_DIR)/overridetree.cb"

# Override the default variant behavior, since the data.vbt is the same
config INTEL_GMA_VBT_FILE
	default "src/mainboard/\$(MAINBOARDDIR)/data.vbt" if !BOARD_GIGABYTE_GA_H61M_S2P_R3

config USBDEBUG_HCD_INDEX # Bottom left port seen from rear
	int
	default 2

endif # BOARD_GIGABYTE_GA_H61M_SERIES
```

## src/mainboard/gigabyte/ga-h61m-series/Kconfig.name
```kconfig
## SPDX-License-Identifier: GPL-2.0-only

config BOARD_GIGABYTE_GA_H61M_S2PV
	bool "GA-H61M-S2PV"

config BOARD_GIGABYTE_GA_H61M_DS2
	bool "GA-H61M-DS2"

config BOARD_GIGABYTE_GA_H61M_DS2V
	bool "GA-H61M-DS2V"

config BOARD_GIGABYTE_GA_H61MA_D3V
	bool "GA-H61MA-D3V"

config BOARD_GIGABYTE_GA_H61M_S2P_R3
	bool "GA-H61M-S2P-R3"
```

## src/mainboard/gigabyte/ga-h77m-d3h/Kconfig
```kconfig
## SPDX-License-Identifier: GPL-2.0-only

if BOARD_GIGABYTE_GA_H77M_D3H

config BOARD_SPECIFIC_OPTIONS
	def_bool y
	select AZALIA_USE_LEGACY_VERB_TABLE
	select NORTHBRIDGE_INTEL_SANDYBRIDGE
	select USE_NATIVE_RAMINIT
	select SOUTHBRIDGE_INTEL_C216
	select SUPERIO_ITE_IT8728F
	select BOARD_ROMSIZE_KB_8192
	select HAVE_ACPI_TABLES
	select HAVE_OPTION_TABLE
	select HAVE_CMOS_DEFAULT
	select HAVE_ACPI_RESUME
	select INTEL_GMA_HAVE_VBT
	select SERIRQ_CONTINUOUS_MODE
	select MAINBOARD_HAS_LIBGFXINIT
	select MEMORY_MAPPED_TPM

config DRAM_RESET_GATE_GPIO
	int
	# Use GPIO25 because it does not exist on desktop PCHs and because
	# this board does not use DRAM reset gate GPIO
	default 25

config USBDEBUG_HCD_INDEX
	int
	default 2

config MAINBOARD_DIR
	default "gigabyte/ga-h77m-d3h"

config MAINBOARD_PART_NUMBER
	default "GA-H77M-D3H"

endif # BOARD_GIGABYTE_GA_H77_D3H
```

## src/mainboard/gigabyte/ga-h77m-d3h/Kconfig.name
```kconfig
## SPDX-License-Identifier: GPL-2.0-only

config BOARD_GIGABYTE_GA_H77M_D3H
	bool "GA-H77M-D3H"
```

## src/mainboard/gigabyte/ga-h81m-d2w/Kconfig
```kconfig
## SPDX-License-Identifier: GPL-2.0-only

if BOARD_GIGABYTE_GA_H81M_D2W

config BOARD_SPECIFIC_OPTIONS
	def_bool y
	select BOARD_ROMSIZE_KB_8192
	select CPU_INTEL_HASWELL
	select GFX_GMA_ANALOG_I2C_HDMI_B
	select HAVE_ACPI_RESUME
	select HAVE_ACPI_TABLES
	select INTEL_GMA_HAVE_VBT
	select MAINBOARD_HAS_LIBGFXINIT
	select NORTHBRIDGE_INTEL_HASWELL
	select SERIRQ_CONTINUOUS_MODE
	select SOUTHBRIDGE_INTEL_LYNXPOINT
	select SUPERIO_ITE_IT8625E

config MAINBOARD_DIR
	default "gigabyte/ga-h81m-d2w"

config MAINBOARD_PART_NUMBER
	default "GA_H81M_D2W"

config ME_CLEANER_ARGS
	depends on USE_ME_CLEANER
	default "-S --whitelist EFFS,FCRS"

config USBDEBUG_HCD_INDEX
	default 2

endif
```

## src/mainboard/gigabyte/ga-h81m-d2w/Kconfig.name
```kconfig
## SPDX-License-Identifier: GPL-2.0-only

config BOARD_GIGABYTE_GA_H81M_D2W
	bool "GA_H81M_D2W"
```

## src/mainboard/gigabyte/ga_2761gxdk/Kconfig
```kconfig
config BOARD_GIGABYTE_GA_2761GXDK
	bool "GA-2761GXDK"
	select ARCH_X86
	select CPU_AMD_SOCKET_AM2
	select NORTHBRIDGE_AMD_AMDK8
	select NORTHBRIDGE_AMD_AMDK8_ROOT_COMPLEX
	select SOUTHBRIDGE_SIS_SIS966
	select SUPERIO_ITE_IT8716F
	select HAVE_BUS_CONFIG
	select HAVE_PIRQ_TABLE
	select USE_PRINTK_IN_CAR
	select USE_DCACHE_RAM
	select HAVE_HARD_RESET
	select LIFT_BSP_APIC_ID
	select K8_REV_F_SUPPORT
	select BOARD_ROMSIZE_KB_512
 
config MAINBOARD_DIR
	string
	default gigabyte/ga_2761gxdk
	depends on BOARD_GIGABYTE_GA_2761GXDK

config DCACHE_RAM_BASE
	hex
	default 0xc8000
	depends on BOARD_GIGABYTE_GA_2761GXDK
	
config DCACHE_RAM_SIZE
	hex
	default 0x08000
	depends on BOARD_GIGABYTE_GA_2761GXDK

config DCACHE_RAM_GLOBAL_VAR_SIZE
	hex
	default 0x01000
	depends on BOARD_GIGABYTE_GA_2761GXDK

config APIC_ID_OFFSET
	hex	
	default 0x10
	depends on BOARD_GIGABYTE_GA_2761GXDK

config MEM_TRAIN_SEQ
	int
	default 2
	depends on BOARD_GIGABYTE_GA_2761GXDK

config SB_HT_CHAIN_ON_BUS0
	int
	default 2
	depends on BOARD_GIGABYTE_GA_2761GXDK

config LB_CKS_RANGE_START
	int
	default 49
	depends on BOARD_GIGABYTE_GA_2761GXDK

config LB_CKS_RANGE_END
	int
	default 122
	depends on BOARD_GIGABYTE_GA_2761GXDK

config LB_CKS_LOC
	int
        default 123
	depends on BOARD_GIGABYTE_GA_2761GXDK

config MAINBOARD_PART_NUMBER
	string
	default "GA-2761GXDK"
	depends on BOARD_GIGABYTE_GA_2761GXDK

config PCI_64BIT_PREF_MEM
	bool
        default n
	depends on BOARD_GIGABYTE_GA_2761GXDK

config HW_MEM_HOLE_SIZEK
	hex
	default 0x100000
	depends on BOARD_GIGABYTE_GA_2761GXDK

config MAX_CPUS
	int
	default 2
	depends on BOARD_GIGABYTE_GA_2761GXDK

config MAX_PHYSICAL_CPUS
	int
	default 1
	depends on BOARD_GIGABYTE_GA_2761GXDK

config HW_MEM_HOLE_SIZE_AUTO_INC
	bool	
	default n
	depends on BOARD_GIGABYTE_GA_2761GXDK

config HT_CHAIN_UNITID_BASE
	hex
	default 0x0
	depends on BOARD_GIGABYTE_GA_2761GXDK

config HT_CHAIN_END_UNITID_BASE
	hex	
	default 0x20
	depends on BOARD_GIGABYTE_GA_2761GXDK

config USE_INIT
	bool
	default n
	depends on BOARD_GIGABYTE_GA_2761GXDK

config SERIAL_CPU_INIT
	bool	
	default n
	depends on BOARD_GIGABYTE_GA_2761GXDK

config MAINBOARD_PCI_SUBSYSTEM_VENDOR_ID
	hex
	default 0x1039
	depends on BOARD_GIGABYTE_GA_2761GXDK

config MAINBOARD_PCI_SUBSYSTEM_DEVICE_ID
	hex
	default 0x1234
	depends on BOARD_GIGABYTE_GA_2761GXDK

config IRQ_SLOT_COUNT
	int
	default 11
	depends on BOARD_GIGABYTE_GA_2761GXDK
```
