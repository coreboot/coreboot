## src/mainboard/gigabyte/m57sli/Kconfig
```kconfig
config BOARD_GIGABYTE_M57SLI
	bool "GA-M57SLI-S4"
	select ARCH_X86
	select CPU_AMD_SOCKET_AM2
	select NORTHBRIDGE_AMD_AMDK8
	select NORTHBRIDGE_AMD_AMDK8_ROOT_COMPLEX
	select SOUTHBRIDGE_NVIDIA_MCP55
	select SUPERIO_ITE_IT8716F
	select SUPERIO_ITE_IT8716F_OVERRIDE_FANCTL
	select HAVE_PIRQ_TABLE
	select HAVE_MP_TABLE
	select USE_PRINTK_IN_CAR
	select USE_DCACHE_RAM
	select HAVE_HARD_RESET
	select IOAPIC
	select LIFT_BSP_APIC_ID
	select SB_HT_CHAIN_UNITID_OFFSET_ONLY
	select HAVE_ACPI_TABLES
	select K8_REV_F_SUPPORT
	select BOARD_ROMSIZE_KB_512
 
config MAINBOARD_DIR
	string
	default gigabyte/m57sli 
	depends on BOARD_GIGABYTE_M57SLI

config DCACHE_RAM_BASE
	hex
	default 0xc8000
	depends on BOARD_GIGABYTE_M57SLI
	
config DCACHE_RAM_SIZE
	hex
	default 0x08000
	depends on BOARD_GIGABYTE_M57SLI

config DCACHE_RAM_GLOBAL_VAR_SIZE
	hex
	default 0x01000
	depends on BOARD_GIGABYTE_M57SLI

config APIC_ID_OFFSET
	hex	
	default 16
	depends on BOARD_GIGABYTE_M57SLI

config MEM_TRAIN_SEQ
	int
	default 1
	depends on BOARD_GIGABYTE_M57SLI

config SB_HT_CHAIN_ON_BUS0
	int
	default 2
	depends on BOARD_GIGABYTE_M57SLI

config LB_CKS_RANGE_START
	int
	default 49
	depends on BOARD_GIGABYTE_M57SLI

config LB_CKS_RANGE_END
	int
	default 122
	depends on BOARD_GIGABYTE_M57SLI

config LB_CKS_LOC
	int
        default 123
	depends on BOARD_GIGABYTE_M57SLI

config MAINBOARD_PART_NUMBER
	string
	default "GA-M57SLI-S4"
	depends on BOARD_GIGABYTE_M57SLI

config PCI_64BIT_PREF_MEM
	bool
        default n
	depends on BOARD_GIGABYTE_M57SLI

config HAVE_FALLBACK_BOOT
	bool
	default n
	depends on BOARD_GIGABYTE_M57SLI

config USE_FALLBACK_IMAGE
	bool
	default n
	depends on BOARD_GIGABYTE_M57SLI

config HW_MEM_HOLE_SIZEK
	hex
	default 0x100000
	depends on BOARD_GIGABYTE_M57SLI

config MAX_CPUS
	int
	default 2
	depends on BOARD_GIGABYTE_M57SLI

config MAX_PHYSICAL_CPUS
	int
	default 1
	depends on BOARD_GIGABYTE_M57SLI

config HW_MEM_HOLE_SIZE_AUTO_INC
	bool	
	default n
	depends on BOARD_GIGABYTE_M57SLI

config HT_CHAIN_UNITID_BASE
	hex
	default 0x0
	depends on BOARD_GIGABYTE_M57SLI

config HT_CHAIN_END_UNITID_BASE
	hex	
	default 0x0
	depends on BOARD_GIGABYTE_M57SLI

config USE_INIT
	bool
	default n
	depends on BOARD_GIGABYTE_M57SLI

config SERIAL_CPU_INIT
	bool	
	default n
	depends on BOARD_GIGABYTE_M57SLI

config WAIT_BEFORE_CPUS_INIT
	bool	
	default n
	depends on BOARD_GIGABYTE_M57SLI

config MAINBOARD_PCI_SUBSYSTEM_VENDOR_ID
	hex
	default 0x1022
	depends on BOARD_GIGABYTE_M57SLI

config MAINBOARD_PCI_SUBSYSTEM_DEVICE_ID
	hex
	default 0x2b80
	depends on BOARD_GIGABYTE_M57SLI

config IRQ_SLOT_COUNT
	int
	default 11
	depends on BOARD_GIGABYTE_M57SLI
```

## src/mainboard/gigabyte/ma785gm/Kconfig
```kconfig
if BOARD_GIGABYTE_MA785GM

config BOARD_SPECIFIC_OPTIONS # dummy
	def_bool y
	select ARCH_X86
	select CPU_AMD_SOCKET_AM3
	select DIMM_DDR2
	select DIMM_REGISTERED
	select NORTHBRIDGE_AMD_AMDFAM10
	select SOUTHBRIDGE_AMD_RS780
	select SOUTHBRIDGE_AMD_SB700
	select SUPERIO_ITE_IT8718F
	select HAVE_OPTION_TABLE
	select HAVE_PIRQ_TABLE
	select HAVE_MP_TABLE
	select SB_HT_CHAIN_UNITID_OFFSET_ONLY
	select LIFT_BSP_APIC_ID
	select SERIAL_CPU_INIT
	select AMDMCT
	select HAVE_ACPI_TABLES
	select BOARD_ROMSIZE_KB_1024
	select ENABLE_APIC_EXT_ID
	select GFXUMA
	select RAMINIT_SYSINFO
	select QRANK_DIMM_SUPPORT

config MAINBOARD_DIR
	string
	default gigabyte/ma785gm

config APIC_ID_OFFSET
	hex
	default 0x0

config MAINBOARD_PART_NUMBER
	string
	default "GA-MA785GM-US2H"

config MAX_CPUS
	int
	default 8

config MAX_PHYSICAL_CPUS
	int
	default 2

config MEM_TRAIN_SEQ
	int
	default 2

config SB_HT_CHAIN_ON_BUS0
	int
	default 1

config HT_CHAIN_END_UNITID_BASE
	hex
	default 0x1

config HT_CHAIN_UNITID_BASE
	hex
	default 0x0

config IRQ_SLOT_COUNT
	int
	default 11

config AMD_UCODE_PATCH_FILE
	string
	default "mc_patch_010000b6.h"

config RAMTOP
	hex
	default 0x2000000

config HEAP_SIZE
	hex
	default 0xc0000

config RAMBASE
	hex
	default 0x200000

endif # BOARD_GIGABYTE_MA785GM
```
