## src/mainboard/gigabyte/ma785gmt/Kconfig
```kconfig
config BOARD_GIGABYTE_GA785GMT
	bool "MA785GMT"
	select ARCH_X86
	select CPU_AMD_SOCKET_AM3
	select NORTHBRIDGE_AMD_AMDFAM10
	select SOUTHBRIDGE_AMD_RS780
	select SOUTHBRIDGE_AMD_SB700
	select SUPERIO_ITE_IT8718F
	select BOARD_HAS_FADT
	select HAVE_BUS_CONFIG
	select HAVE_OPTION_TABLE
	select GENERATE_PIRQ_TABLE
	select GENERATE_MP_TABLE
	select HAVE_MAINBOARD_RESOURCES
	select USE_DCACHE_RAM
	select HAVE_HARD_RESET
	select SB_HT_CHAIN_UNITID_OFFSET_ONLY
	select LIFT_BSP_APIC_ID
	select SERIAL_CPU_INIT
	select AMDMCT
	select GENERATE_ACPI_TABLES
	select BOARD_ROMSIZE_KB_1024
	select ENABLE_APIC_EXT_ID
	select TINY_BOOTBLOCK
	select GFXUMA

config MAINBOARD_DIR
	string
	default gigabyte/ma785gmt
	depends on BOARD_GIGABYTE_GA785GMT

config APIC_ID_OFFSET
	hex
	default 0x0
	depends on BOARD_GIGABYTE_GA785GMT

config MAINBOARD_PART_NUMBER
	string
	default "Gigabyte GA785GMT"
	depends on BOARD_GIGABYTE_GA785GMT

config HW_MEM_HOLE_SIZEK
	hex
	default 0x100000
	depends on BOARD_GIGABYTE_GA785GMT

config MAX_CPUS
	int
	default 8
	depends on BOARD_GIGABYTE_GA785GMT

config MAX_PHYSICAL_CPUS
	int
	default 2
	depends on BOARD_GIGABYTE_GA785GMT

config HW_MEM_HOLE_SIZE_AUTO_INC
	bool
	default n
	depends on BOARD_GIGABYTE_GA785GMT

config MEM_TRAIN_SEQ
	int
	default 2
	depends on BOARD_GIGABYTE_GA785GMT

config SB_HT_CHAIN_ON_BUS0
	int
	default 1
	depends on BOARD_GIGABYTE_GA785GMT

config HT_CHAIN_END_UNITID_BASE
	hex
	default 0x1
	depends on BOARD_GIGABYTE_GA785GMT

config HT_CHAIN_UNITID_BASE
	hex
	default 0x0
	depends on BOARD_GIGABYTE_GA785GMT

config IRQ_SLOT_COUNT
	int
	default 11
	depends on BOARD_GIGABYTE_GA785GMT

config AMD_UCODE_PATCH_FILE
	string
	default "mc_patch_010000b6.h"
	depends on BOARD_GIGABYTE_GA785GMT

config RAMTOP
	hex
	default 0x2000000
	depends on BOARD_GIGABYTE_GA785GMT

config HEAP_SIZE
	hex
	default 0xc0000
	depends on BOARD_GIGABYTE_GA785GMT

config ACPI_SSDTX_NUM
	int
	default 0
	depends on BOARD_GIGABYTE_GA785GMT

config MAINBOARD_PCI_SUBSYSTEM_DEVICE_ID
	hex
	default 0x3060
	depends on BOARD_GIGABYTE_GA785GMT

config MAINBOARD_PCI_SUBSYSTEM_VENDOR_ID
	hex
	default 0x1022
	depends on BOARD_GIGABYTE_GA785GMT

config RAMBASE
	hex
	default 0x200000
	depends on BOARD_GIGABYTE_GA785GMT

config COMPRESS
	hex
	default 0
	depends on BOARD_GIGABYTE_GA785GMT
```

## src/mainboard/gigabyte/ma78gm/Kconfig
```kconfig
if BOARD_GIGABYTE_MA78GM

config BOARD_SPECIFIC_OPTIONS # dummy
	def_bool y
	select CPU_AMD_SOCKET_AM2R2
	select DIMM_DDR2
	select DIMM_REGISTERED
	select NORTHBRIDGE_AMD_AMDFAM10
	select SOUTHBRIDGE_AMD_RS780
	select SOUTHBRIDGE_AMD_SB700
	select SUPERIO_ITE_IT8718F
	select HAVE_OPTION_TABLE
	select HAVE_PIRQ_TABLE
	select HAVE_MP_TABLE
	select SB_HT_CHAIN_UNITID_OFFSET_ONLY
	select LIFT_BSP_APIC_ID
	select HAVE_ACPI_TABLES
	select BOARD_ROMSIZE_KB_1024
	select ENABLE_APIC_EXT_ID
	select GFXUMA
	select QRANK_DIMM_SUPPORT

config MAINBOARD_DIR
	string
	default gigabyte/ma78gm

config APIC_ID_OFFSET
	hex
	default 0x0

config MAINBOARD_PART_NUMBER
	string
	default "GA-MA78GM-US2H"

config MAX_CPUS
	int
	default 8

config MAX_PHYSICAL_CPUS
	int
	default 2

config SB_HT_CHAIN_ON_BUS0
	int
	default 1

config HT_CHAIN_END_UNITID_BASE
	hex
	default 0x1

config HT_CHAIN_UNITID_BASE
	hex
	default 0x0

config IRQ_SLOT_COUNT
	int
	default 11

endif # BOARD_GIGABYTE_MA78GM
```

## src/mainboard/gigabyte/mz33-ar1/Kconfig
```kconfig
## SPDX-License-Identifier: GPL-2.0-only

if BOARD_GIGABYTE_MZ33_AR1

config BOARD_SPECIFIC_OPTIONS
	def_bool y
	select SOC_AMD_TURIN_POC
	select BOARD_ROMSIZE_KB_32768
	select MEMORY_MAPPED_TPM
	select DRIVERS_ASPEED_AST2050
	select SUPERIO_ASPEED_AST2400
	select IPMI_KCS
	select IPMI_KCS_ROMSTAGE
	select DISABLE_KEYBOARD_RESET_PIN
	select SPI_FLASH_FORCE_4_BYTE_ADDR_MODE
	select SYSTEM_TYPE_SERVER
	select HAVE_GIGABYTE_BMC_BIOS_UPDATE

config FMDFILE
	default "src/mainboard/gigabyte/mz33-ar1/board.fmd"

config MAINBOARD_DIR
	default "gigabyte/mz33-ar1"

config MAINBOARD_SMBIOS_MANUFACTURER
	default "Giga Computing"

config MAINBOARD_PART_NUMBER
	default "MZ33-AR1-000"

config MAINBOARD_SMBIOS_PRODUCT_NAME
	default "MZ33-AR1-000"

config MAINBOARD_SERIAL_NUMBER
	default "01234567890123456789AB"

config MAINBOARD_VERSION
	default "03000300"

config MAINBOARD_FAMILY
	string
	default "Server"

config PSP_EARLY_VGA_IMAGE
	default "src/mainboard/gigabyte/mz33-ar1/early_vga.bin"

config BUILD_WITH_DEBUG_APCB
	bool "Build with debug APCB blobs"
	default n
	help
	  Build coreboot image with debug APCB blobs. When selected, the
	  APCBs with debug output on serial port will be used during build.

	  Enabel it when debugging pre-reset vector issues.

config ECAM_MMCONF_BASE_ADDRESS
	default 0xb0000000

config EFS_SPI_READ_MODE
	default 0	# Normal read 33MHz

config EFS_SPI_SPEED
	default 0	# 66MHz

config EFS_SPI_MICRON_FLAG
	default 0

config NORMAL_READ_SPI_SPEED
	default 1	# 33MHz

config ALT_SPI_SPEED
	default 1	# 33MHz

config TPM_SPI_SPEED
	default 1	# 33MHz

config EFS_ESPI0_CONFIG0
	default 0x0e

config DIMM_MAX
	default 24

endif
```

## src/mainboard/gigabyte/mz33-ar1/Kconfig.name
```kconfig
## SPDX-License-Identifier: GPL-2.0-only

config BOARD_GIGABYTE_MZ33_AR1
	bool "MZ33-AR1"
```

## src/mainboard/gizmosphere/Kconfig
```kconfig
# SPDX-License-Identifier: GPL-2.0-only

if VENDOR_GIZMOSPHERE

choice
	prompt "Mainboard model"

source "src/mainboard/gizmosphere/*/Kconfig.name"

endchoice

source "src/mainboard/gizmosphere/*/Kconfig"

config MAINBOARD_VENDOR
	default "GizmoSphere"

endif # VENDOR_GIZMOSPHERE
```

## src/mainboard/gizmosphere/gizmo/Kconfig
```kconfig
# SPDX-License-Identifier: GPL-2.0-only

if BOARD_GIZMOSPHERE_GIZMO

config BOARD_SPECIFIC_OPTIONS
	def_bool y
	select CPU_AMD_AGESA_FAMILY14
	select NORTHBRIDGE_AMD_AGESA_FAMILY14
	select SOUTHBRIDGE_AMD_CIMX_SB800
	select HAVE_OPTION_TABLE
	select HAVE_PIRQ_TABLE
	select HAVE_MP_TABLE
	select HAVE_ACPI_RESUME
	select HAVE_ACPI_TABLES
	select BOARD_ROMSIZE_KB_2048
	select GFXUMA
	select HAVE_SPD_IN_CBFS

config MAINBOARD_DIR
	string
	default "gizmosphere/gizmo"

config MAINBOARD_PART_NUMBER
	string
	default "Gizmo"

config HW_MEM_HOLE_SIZEK
	hex
	default 0x200000

config MAX_CPUS
	int
	default 2

config IRQ_SLOT_COUNT
	int
	default 11

config ONBOARD_VGA_IS_PRIMARY
	bool
	default y

config VGA_BIOS_ID
	string
	default "1002,9804"

config SB800_AHCI_ROM
	bool
	default n

config DIMM_SPD_SIZE
	int
	default 128

endif # BOARD_GIZMOSPHERE_GIZMO
```

## src/mainboard/gizmosphere/gizmo2/Kconfig
```kconfig
# SPDX-License-Identifier: GPL-2.0-only

if BOARD_GIZMOSPHERE_GIZMO2

config BOARD_SPECIFIC_OPTIONS
	def_bool y
	select CPU_AMD_AGESA_FAMILY16_KB
	select NORTHBRIDGE_AMD_AGESA_FAMILY16_KB
	select SOUTHBRIDGE_AMD_AGESA_YANGTZE
	select DEFAULT_POST_ON_LPC
	select HAVE_OPTION_TABLE
	select HAVE_PIRQ_TABLE
	select HAVE_MP_TABLE
	select HAVE_ACPI_RESUME
	select HAVE_ACPI_TABLES
	select BOARD_ROMSIZE_KB_4096
	select GFXUMA
	select HUDSON_IMC_ENABLE
	select HAVE_SPD_IN_CBFS

config MAINBOARD_DIR
	string
	default "gizmosphere/gizmo2"

config MAINBOARD_PART_NUMBER
	string
	default "Gizmo2"

config HW_MEM_HOLE_SIZEK
	hex
	default 0x200000

config MAX_CPUS
	int
	default 4

config IRQ_SLOT_COUNT
	int
	default 11

config ONBOARD_VGA_IS_PRIMARY
	bool
	default y

config HUDSON_LEGACY_FREE
	bool
	default y

config DIMM_SPD_SIZE
	int
	default 128

endif # BOARD_GIZMOSPHERE_GIZMO2
```

## src/mainboard/google/Kconfig
```kconfig
## SPDX-License-Identifier: GPL-2.0-only

if VENDOR_GOOGLE

choice
	prompt "Mainboard model"

source "src/mainboard/google/*/Kconfig.name"

endchoice

source "src/mainboard/google/*/Kconfig"

config MAINBOARD_VENDOR
	default "Google"

endif # VENDOR_GOOGLE
```

## src/mainboard/google/asurada/Kconfig
```kconfig
## SPDX-License-Identifier: GPL-2.0-only

# Umbrella option to be selected by variant boards.
config BOARD_GOOGLE_ASURADA_COMMON
	def_bool n

if BOARD_GOOGLE_ASURADA_COMMON

config VBOOT
	select EC_GOOGLE_CHROMEEC_SWITCHES
	select VBOOT_VBNV_FLASH

config BOARD_SPECIFIC_OPTIONS
	def_bool y
	select RTC
	select SOC_MEDIATEK_MT8192
	select BOARD_ROMSIZE_KB_8192
	select MAINBOARD_HAS_CHROMEOS
	select CHROMEOS_USE_EC_WATCHDOG_FLAG if CHROMEOS
	select COMMON_CBFS_SPI_WRAPPER
	select SPI_FLASH
	select SPI_FLASH_INCLUDE_ALL_DRIVERS
	select EC_GOOGLE_CHROMEEC
	select EC_GOOGLE_CHROMEEC_BOARDID
	select EC_GOOGLE_CHROMEEC_SPI
	select SPI_TPM if VBOOT
	select TPM_GOOGLE_CR50 if VBOOT
	select MAINBOARD_HAS_TPM2 if VBOOT
	select MAINBOARD_HAS_NATIVE_VGA_INIT
	select MAINBOARD_FORCE_NATIVE_VGA_INIT
	select HAVE_LINEAR_FRAMEBUFFER
	select DRIVER_ANALOGIX_ANX7625
	select COMMONLIB_STORAGE
	select COMMONLIB_STORAGE_MMC

config MAINBOARD_DIR
	default "google/asurada"

config MAINBOARD_PART_NUMBER
	default "Asurada" if BOARD_GOOGLE_ASURADA
	default "Hayato" if BOARD_GOOGLE_HAYATO
	default "Spherion" if BOARD_GOOGLE_SPHERION

config DRIVER_TPM_SPI_BUS
	hex
	default 0x5

# On MT8192 the SPI flash is actually using a SPI-NOR controller with its own bus.
# The number here should be a virtual value as (SPI_BUS_NUMBER + 1).
config BOOT_DEVICE_SPI_FLASH_BUS
	int
	default 9

config EC_GOOGLE_CHROMEEC_SPI_BUS
	hex
	default 0x1

config CONSOLE_CBMEM_BUFFER_SIZE
	hex
	default 0x80000

endif
```

## src/mainboard/google/asurada/Kconfig.name
```kconfig
## SPDX-License-Identifier: GPL-2.0-only

comment "Asurada (MediaTek Kompanio 820 (MT8192))"

config BOARD_GOOGLE_ASURADA
	bool "->  Asurada"

config BOARD_GOOGLE_HAYATO
	bool "->  Hayato (ASUS Chromebook Flip CM3 (CM3200))"

config BOARD_GOOGLE_SPHERION
	bool "->  Spherion (Acer Chromebook 514 (CB514-2H, CB514-2HT))"
```

## src/mainboard/google/atria/Kconfig
```kconfig
## SPDX-License-Identifier: GPL-2.0-only

config BOARD_GOOGLE_ATRIA_COMMON
	def_bool n
	select BOARD_ROMSIZE_KB_32768
	select CPU_INTEL_SOCKET_OTHER
	select DRIVERS_GFX_GENERIC
	select DRIVERS_I2C_GENERIC
	select DRIVERS_I2C_HID
	select DRIVERS_INTEL_SOUNDWIRE
	select DRIVERS_INTEL_USB4_RETIMER
	select DRIVERS_SOUNDWIRE_ALC_BASE_7XX
	select DUMP_SMBIOS_TYPE17
	select EC_ACPI
	select EC_GOOGLE_CHROMEEC
	select EC_GOOGLE_CHROMEEC_BOARDID
	select EC_GOOGLE_CHROMEEC_ESPI
	select EC_GOOGLE_CHROMEEC_FW_CONFIG_FROM_UFSC
	select EC_GOOGLE_CHROMEEC_SKUID
	select EC_GOOGLE_CHROMEEC_SMBIOS
	select FSP_UGOP_EARLY_SIGN_OF_LIFE
	select FSP_VGA_MODE12_MONOCHROME
	select FW_CONFIG
	select FW_CONFIG_SOURCE_CHROMEEC_CBI
	select GENERATE_SMBIOS_TABLES
	select GOOGLE_SMBIOS_MAINBOARD_VERSION
	select HAVE_ACPI_TABLES
	select HAVE_SPD_IN_CBFS
	select I2C_TPM
	select INTEL_LPSS_UART_FOR_CONSOLE
	select MAINBOARD_DISABLE_STAGE_CACHE
	select MB_COMPRESS_RAMSTAGE_LZ4
	select MAINBOARD_HAS_TPM2
	select ROMSTAGE_VGA
	select SOC_INTEL_ENABLE_USB4_PCIE_RESOURCES
	select SOC_INTEL_NOVALAKE_H_P
	select TPM_GOOGLE_TI50

config BOARD_GOOGLE_BASEBOARD_ATRIA
	def_bool n
	select BOARD_GOOGLE_ATRIA_COMMON
	select MAINBOARD_HAS_CHROMEOS
	select SYSTEM_TYPE_LAPTOP

config BOARD_GOOGLE_ATRIA
	select BOARD_GOOGLE_BASEBOARD_ATRIA
	select EC_GOOGLE_CHROMEEC_RTK
	select EC_GOOGLE_CHROMEEC_LPC_GENERIC_MEMORY_RANGE

config BOARD_GOOGLE_PENGHU
	select BOARD_GOOGLE_BASEBOARD_ATRIA

if BOARD_GOOGLE_ATRIA_COMMON

config BASEBOARD_DIR
	string
	default "atria"

config CBFS_SIZE
	default 0x1000000

config CHROMEOS
	select CHROMEOS_DRAM_PART_NUMBER_IN_CBI
	select EC_GOOGLE_CHROMEEC_SWITCHES
	select GBB_FLAG_FORCE_DEV_BOOT_USB
	select GBB_FLAG_FORCE_MANUAL_RECOVERY
	select HAS_RECOVERY_MRC_CACHE

config DEVICETREE
	default "variants/baseboard/devicetree.cb"

config DIMM_SPD_SIZE
	default 512

config DRIVER_TPM_I2C_ADDR
	hex
	default 0x50

config DRIVER_TPM_I2C_BUS
	hex
	default 0x02

config MAINBOARD_DIR
	default "google/atria"

config MAINBOARD_FAMILY
	string
	default "Google_Atria"

config MAINBOARD_PART_NUMBER
	default "Atria" if BOARD_GOOGLE_ATRIA

config VARIANT_DIR
	string
	default "atria" if BOARD_GOOGLE_ATRIA
	default "penghu" if BOARD_GOOGLE_PENGHU

config OVERRIDE_DEVICETREE
	default "variants/\$(CONFIG_VARIANT_DIR)/overridetree.cb"

config TPM_TIS_ACPI_INTERRUPT
	int
	default 48 # GPE0_DW1_16 (GPP_F16)

config UART_FOR_CONSOLE
	int
	default 0

config VBOOT
	select VBOOT_LID_SWITCH

config EC_GOOGLE_CHROMEEC_LPC_GENERIC_MEMORY_BASE
	hex
	default 0xfe400000

endif # BOARD_GOOGLE_ATRIA_COMMON
```

## src/mainboard/google/atria/Kconfig.name
```kconfig
## SPDX-License-Identifier: GPL-2.0-only

comment "Atria (Intel NovaLake)"

config BOARD_GOOGLE_ATRIA
	bool "->  Atria"

config BOARD_GOOGLE_PENGHU
	bool "->  Penghu"
```

## src/mainboard/google/auron/Kconfig
```kconfig
config BOARD_GOOGLE_BASEBOARD_AURON
	def_bool n
	select BOARD_ROMSIZE_KB_8192
	select BROADWELL_LPDDR3 if BOARD_GOOGLE_SAMUS
	select EC_GOOGLE_CHROMEEC
	select EC_GOOGLE_CHROMEEC_LPC
	select HAVE_ACPI_RESUME
	select HAVE_ACPI_TABLES
	select HAVE_OPTION_TABLE
	select INTEL_GMA_HAVE_VBT
	select INTEL_INT15
	select MAINBOARD_HAS_CHROMEOS
	select MAINBOARD_HAS_LIBGFXINIT
	select MEMORY_MAPPED_TPM
	select MAINBOARD_HAS_TPM1
	select SOC_INTEL_BROADWELL

config BOARD_GOOGLE_AURON_PAINE
	select BOARD_GOOGLE_BASEBOARD_AURON
	select HAVE_SPD_IN_CBFS
	select SYSTEM_TYPE_LAPTOP

config BOARD_GOOGLE_AURON_YUNA
	select BOARD_GOOGLE_BASEBOARD_AURON
	select HAVE_SPD_IN_CBFS
	select SYSTEM_TYPE_LAPTOP

config BOARD_GOOGLE_BUDDY
	select BOARD_GOOGLE_BASEBOARD_AURON

config BOARD_GOOGLE_GANDOF
	select BOARD_GOOGLE_BASEBOARD_AURON
	select HAVE_SPD_IN_CBFS
	select SYSTEM_TYPE_LAPTOP

config BOARD_GOOGLE_LULU
	select BOARD_GOOGLE_BASEBOARD_AURON
	select HAVE_SPD_IN_CBFS
	select SYSTEM_TYPE_LAPTOP

config BOARD_GOOGLE_SAMUS
	select BOARD_GOOGLE_BASEBOARD_AURON
	select HAVE_SPD_IN_CBFS
	select SYSTEM_TYPE_LAPTOP

if BOARD_GOOGLE_BASEBOARD_AURON

config VBOOT
	select EC_GOOGLE_CHROMEEC_SWITCHES
	select VBOOT_LID_SWITCH
	select VBOOT_VBNV_CMOS

config MAINBOARD_DIR
	default "google/auron"

config VARIANT_DIR
	default "auron_paine" if BOARD_GOOGLE_AURON_PAINE
	default "auron_yuna" if BOARD_GOOGLE_AURON_YUNA
	default "buddy" if BOARD_GOOGLE_BUDDY
	default "gandof" if BOARD_GOOGLE_GANDOF
	default "lulu" if BOARD_GOOGLE_LULU
	default "samus" if BOARD_GOOGLE_SAMUS

config MAINBOARD_PART_NUMBER
	default "Auron_Paine" if BOARD_GOOGLE_AURON_PAINE
	default "Auron_Yuna" if BOARD_GOOGLE_AURON_YUNA
	default "Buddy" if BOARD_GOOGLE_BUDDY
	default "Gandof" if BOARD_GOOGLE_GANDOF
	default "Lulu" if BOARD_GOOGLE_LULU
	default "Samus" if BOARD_GOOGLE_SAMUS

config OVERRIDE_DEVICETREE
	default "variants/\$(CONFIG_VARIANT_DIR)/overridetree.cb"

config MAINBOARD_SMBIOS_MANUFACTURER
	string
	default "GOOGLE"

endif
```

## src/mainboard/google/auron/Kconfig.name
```kconfig
comment "Auron"

config BOARD_GOOGLE_AURON_PAINE
	bool "->  Auron_Paine (Acer C740 Chromebook)"

config BOARD_GOOGLE_AURON_YUNA
	bool "->  Auron_Yuna (Acer Chromebook 15 (C910/CB5-531))"

config BOARD_GOOGLE_BUDDY
	bool "->  Buddy (Acer Chromebase 24)"

config BOARD_GOOGLE_GANDOF
	bool "->  Gandof (Toshiba Chromebook 2 (2015))"

config BOARD_GOOGLE_LULU
	bool "->  Lulu (Dell Chromebook 13 7310)"

config BOARD_GOOGLE_SAMUS
	bool "->  Samus (Google Chromebook Pixel (2015))"
```
