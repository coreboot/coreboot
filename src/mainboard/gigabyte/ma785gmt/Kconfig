## src/mainboard/google/beltino/Kconfig
```kconfig
config BOARD_GOOGLE_BASEBOARD_BELTINO
	def_bool n
	select BOARD_ROMSIZE_KB_8192
	select HAVE_ACPI_RESUME
	select HAVE_ACPI_TABLES
	select HAVE_OPTION_TABLE
	select INTEL_GMA_HAVE_VBT
	select INTEL_LYNXPOINT_LP
	select MAINBOARD_HAS_CHROMEOS
	select MAINBOARD_HAS_LIBGFXINIT
	select MAINBOARD_HAS_LPC_TPM
	select MAINBOARD_HAS_TPM1
	select NORTHBRIDGE_INTEL_HASWELL
	select SOUTHBRIDGE_INTEL_LYNXPOINT
	select SUPERIO_ITE_IT8772F

config BOARD_GOOGLE_MCCLOUD
	select BOARD_GOOGLE_BASEBOARD_BELTINO

config BOARD_GOOGLE_MONROE
	select BOARD_GOOGLE_BASEBOARD_BELTINO

config BOARD_GOOGLE_PANTHER
	select BOARD_GOOGLE_BASEBOARD_BELTINO

config BOARD_GOOGLE_TRICKY
	select BOARD_GOOGLE_BASEBOARD_BELTINO

config BOARD_GOOGLE_ZAKO
	select BOARD_GOOGLE_BASEBOARD_BELTINO

if BOARD_GOOGLE_BASEBOARD_BELTINO

config VBOOT
	select VBOOT_VBNV_CMOS

config MAINBOARD_DIR
	default "google/beltino"

config VARIANT_DIR
	default "mccloud" if BOARD_GOOGLE_MCCLOUD
	default "monroe" if BOARD_GOOGLE_MONROE
	default "panther" if BOARD_GOOGLE_PANTHER
	default "tricky" if BOARD_GOOGLE_TRICKY
	default "zako" if BOARD_GOOGLE_ZAKO

config MAINBOARD_PART_NUMBER
	default "Mccloud" if BOARD_GOOGLE_MCCLOUD
	default "Monroe" if BOARD_GOOGLE_MONROE
	default "Panther" if BOARD_GOOGLE_PANTHER
	default "Tricky" if BOARD_GOOGLE_TRICKY
	default "Zako" if BOARD_GOOGLE_ZAKO

config MAINBOARD_FAMILY
	string
	default "Google_Beltino"

# Override the default variant behavior, since the data.vbt is the same
# for all variants except monroe
config INTEL_GMA_VBT_FILE
	default "src/mainboard/\$(MAINBOARDDIR)/data.vbt" if !BOARD_GOOGLE_MONROE

config MAINBOARD_SMBIOS_MANUFACTURER
	string
	default "GOOGLE"

config ENABLE_DDR_2X_REFRESH
	default y

config PCIEXP_AER
	def_bool n

config TIANOCORE_BOOT_TIMEOUT
	int
	default 5

endif # BOARD_GOOGLE_BASEBOARD_BELTINO
```

## src/mainboard/google/beltino/Kconfig.name
```kconfig
comment "Beltino"

config BOARD_GOOGLE_MCCLOUD
	bool "->  Mccloud (Acer Chromebox CXI)"

config BOARD_GOOGLE_MONROE
	bool "->  Monroe (LG Chromebase 22CV241 & 22CB25S)"

config BOARD_GOOGLE_PANTHER
	bool "->  Panther (ASUS Chromebox CN60)"

config BOARD_GOOGLE_TRICKY
	bool "->  Tricky (Dell Chromebox 3010)"

config BOARD_GOOGLE_ZAKO
	bool "->  Zako (HP Chromebox G1)"
```

## src/mainboard/google/bluey/Kconfig
```kconfig
## SPDX-License-Identifier: GPL-2.0-only

config BOARD_GOOGLE_BLUEY_COMMON
	def_bool n
	select COMMON_CBFS_SPI_WRAPPER
	# FIXME: keep ADB for development phase
	select GBB_FLAG_ENABLE_ADB if VBOOT
	select MAINBOARD_HAS_CHROMEOS
	select SOC_QUALCOMM_PCIE_ASYNCHRONOUS_INIT
	select SPI_FLASH
	select SPI_FLASH_FORCE_4_BYTE_ADDR_MODE
	select SPI_FLASH_INCLUDE_ALL_DRIVERS
	select QC_SKIP_SOC_DEBUG_FEATURES_IN_RECOVERY

config BOARD_GOOGLE_BASEBOARD_BLUEY
	def_bool n
	select BOARD_GOOGLE_BLUEY_COMMON

config BOARD_GOOGLE_MODEL_BLUEY
	def_bool n
	select BOARD_GOOGLE_BASEBOARD_BLUEY
	select BOARD_ROMSIZE_KB_65536
	select MAINBOARD_HAS_FINGERPRINT_VIA_USB
	select MISSING_BOARD_RESET
	select SOC_QUALCOMM_CDT

config BOARD_GOOGLE_BLUEY
	select BOARD_GOOGLE_MODEL_BLUEY
	select SOC_QUALCOMM_X1P42100

config BOARD_GOOGLE_BLUEYH
	select BOARD_GOOGLE_MODEL_BLUEY
	select SOC_QUALCOMM_HAMOA

config BOARD_GOOGLE_MODEL_QUENBI
	def_bool n
	select BOARD_GOOGLE_BASEBOARD_BLUEY
	select BOARD_ROMSIZE_KB_32768
	select DAP_USE_SMB2
	select EC_GOOGLE_CHROMEEC_BATTERY_SOC_DYNAMIC
	select HAVE_DEBUG_ACCESS_PORT_SOURCE_SINK
	select MAINBOARD_HAS_CAMERA_VIA_USB
	select MAINBOARD_HAS_CHROME_EC
	select MAINBOARD_HAS_FINGERPRINT_VIA_SPI
	select MAINBOARD_HAS_GOOGLE_TPM
	select SPI_FREQ_75MHZ

config BOARD_GOOGLE_MODEL_QUARTZ
	def_bool n
	select BOARD_GOOGLE_BASEBOARD_BLUEY
	select BOARD_ROMSIZE_KB_32768
	select EC_GOOGLE_CHROMEEC_BATTERY_SOC_DYNAMIC
	select EC_GOOGLE_CHROMEEC_LED_CONTROL
	select MAINBOARD_HAS_CAMERA_VIA_USB
	select MAINBOARD_HAS_CHROME_EC
	select MAINBOARD_HAS_FINGERPRINT_VIA_USB
	select MAINBOARD_HAS_GOOGLE_TPM
	select SPI_FREQ_75MHZ

config BOARD_GOOGLE_QUENBI
	select BOARD_GOOGLE_MODEL_QUENBI
	select SOC_QUALCOMM_X1P42100

config BOARD_GOOGLE_QUENBIH
	select BOARD_GOOGLE_MODEL_QUENBI
	select SOC_QUALCOMM_HAMOA

config BOARD_GOOGLE_QUARTZ
	select BOARD_GOOGLE_MODEL_QUARTZ
	select DAM_SINK_SENSOR_Z1_OPTIMIZATION
	select DAP_USE_SMB1
	select HAVE_DEBUG_ACCESS_PORT_SOURCE_SINK
	select SOC_QUALCOMM_HAMOA
	select MAINBOARD_HAS_PS8820_RETIMER
	select MAINBOARD_NO_USB_A_PORT
	select MAINBOARD_SUPPORTS_PARALLEL_CHARGING

config BOARD_GOOGLE_MODEL_MICA
	def_bool n
	select BOARD_GOOGLE_BASEBOARD_BLUEY
	select BOARD_ROMSIZE_KB_32768
	select EC_GOOGLE_CHROMEEC_LED_CONTROL
	select EC_GOOGLE_CHROMEEC_BATTERY_SOC_DYNAMIC
	select MAINBOARD_HAS_BACKLIGHT_PWM
	select MAINBOARD_HAS_CAMERA_VIA_USB
	select MAINBOARD_HAS_CHROME_EC
	select MAINBOARD_HAS_FINGERPRINT_VIA_USB
	select MAINBOARD_HAS_GOOGLE_TPM
	select SPI_FREQ_75MHZ

config BOARD_GOOGLE_MICA
	select BOARD_GOOGLE_MODEL_MICA
	select DAP_USE_SMB1
	select HAVE_DEBUG_ACCESS_PORT_SOURCE_SINK
	select MAINBOARD_HAS_PS8820_RETIMER
	select MAINBOARD_NO_USB_A_PORT
	select SOC_QUALCOMM_HAMOA

if BOARD_GOOGLE_BLUEY_COMMON

config MAINBOARD_DIR
	default "google/bluey"

config MAINBOARD_HAS_FINGERPRINT_VIA_SPI
	bool
	default n
	help
	  Enable this option if your mainboard's fingerprint reader
	  is connected via the SPI interface.

config MAINBOARD_HAS_FINGERPRINT_VIA_USB
	bool
	default n
	help
	  Enable this option if your mainboard's fingerprint reader
	  is connected via the USB interface.

config MAINBOARD_HAS_FINGERPRINT
	bool
	default y if MAINBOARD_HAS_FINGERPRINT_VIA_SPI || MAINBOARD_HAS_FINGERPRINT_VIA_USB
	help
	  Enable this option if your mainboard is equipped with an onboard
	  fingerprint reader. This could be connected via SPI or USB.

config MAINBOARD_HAS_SD_CONTROLLER
	bool
	default n
	help
	  Enable this option if your mainboard is equipped with SD card controller.

config MAINBOARD_HAS_PS8820_RETIMER
	bool
	default n
	help
	  Enable this option if your mainboard is equipped with a PS8820 retimer.

config MAINBOARD_NO_USB_A_PORT
	bool
	default n
	help
	  Enable this option if your mainboard is not equipped with USB-A port.

config MAINBOARD_SUPPORTS_PARALLEL_CHARGING
	bool
	default n
	help
	  Enable this option if your mainboard supports parallel charging.

config HAVE_DEBUG_ACCESS_PORT_SOURCE_SINK
	bool
	default n
	help
	  Enable this option to allow source and sink modes on the debug access port.

config DAP_SMB_SLAVE_ID
	depends on HAVE_DEBUG_ACCESS_PORT_SOURCE_SINK
	hex
	default 0x07 if DAP_USE_SMB1
	default 0x0a if DAP_USE_SMB2
	help
	  The Slave ID for the Debug Access Port communication.

config DAP_USE_SMB1
	depends on HAVE_DEBUG_ACCESS_PORT_SOURCE_SINK
	bool
	help
	  Select this to use SMB1 for DAP.

config DAP_USE_SMB2
	depends on HAVE_DEBUG_ACCESS_PORT_SOURCE_SINK
	bool
	help
	  Select this to use SMB2 for DAP.

config DAM_SINK_SENSOR_Z1_OPTIMIZATION
	bool
	default n
	help
	  Enable this option to write the PMIC PSI workaround flag (address 0x7297)
	  after QCLib loading. This is required for boards that have
	  the TPD6s3000 protection IC to prevent high power consumption in the
	  Z1 (off) state.

config MAINBOARD_HAS_GOOGLE_TPM
	bool
	default n
	select I2C_TPM
	select MAINBOARD_HAS_TPM2
	select TPM_GOOGLE_TI50
	help
	  Enable this option if your mainboard is equipped with Google TPM aka GSC.

config MAINBOARD_HAS_CHROME_EC
	bool
	default n
	select EC_GOOGLE_CHROMEEC
	select EC_GOOGLE_CHROMEEC_RTC
	select EC_GOOGLE_CHROMEEC_SPI
	select EC_GOOGLE_CHROMEEC_SWITCHES if VBOOT
	select RTC
	help
	  Enable this option if your mainboard is equipped with Chrome EC.

config MAINBOARD_HAS_BACKLIGHT_PWM
	bool
	default n
	help
	  Enable this option if your mainboard has PWM control for display
	  backlight.

config MAINBOARD_HAS_CAMERA_VIA_USB
	bool
	default n
	help
	  Enable this option if your mainboard's onboard camera
	  is connected via the USB interface.

config MAINBOARD_VENDOR
	string
	default "Google"

config VBOOT
	select VBOOT_ALWAYS_ENABLE_DISPLAY
	select VBOOT_LID_SWITCH if MAINBOARD_HAS_CHROME_EC
	select VBOOT_NO_BOARD_SUPPORT if BOARD_GOOGLE_MODEL_BLUEY
	select VBOOT_VBNV_FLASH

##########################################################
#### Update below when adding a new derivative board. ####
##########################################################

config MAINBOARD_PART_NUMBER
	default "Bluey" if BOARD_GOOGLE_MODEL_BLUEY
	default "Quenbi" if BOARD_GOOGLE_QUENBI
	default "QuenbiH" if BOARD_GOOGLE_QUENBIH
	default "Quartz" if BOARD_GOOGLE_MODEL_QUARTZ
	default "Mica" if BOARD_GOOGLE_MODEL_MICA

config DRIVER_TPM_I2C_BUS
	depends on I2C_TPM
	hex
	default 0xa if BOARD_GOOGLE_MODEL_QUENBI
	default 0xa if BOARD_GOOGLE_MODEL_QUARTZ
	default 0xa if BOARD_GOOGLE_MODEL_MICA
	default 0x10

config DRIVER_TPM_I2C_ADDR
	default 0x50

config EC_GOOGLE_CHROMEEC_SPI_BUS
	depends on EC_GOOGLE_CHROMEEC
	hex
	default 0xd if BOARD_GOOGLE_MODEL_QUENBI
	default 0xd if BOARD_GOOGLE_MODEL_QUARTZ
	default 0xd if BOARD_GOOGLE_MODEL_MICA
	default 0xb

config MAINBOARD_GPIO_PIN_FOR_TOUCHPAD_POWER
	int
	default 36 if BOARD_GOOGLE_MODEL_QUARTZ
	default 0
	help
	  This option specifies the GPIO pin number on the mainboard that is
	  used for enabling power to the touchpad. Set it to 0 if unused.

config MAINBOARD_GPIO_PIN_FOR_GSC_AP_INTERRUPT
	depends on TPM_GOOGLE_TI50
	int
	default 91 if BOARD_GOOGLE_MODEL_QUENBI
	default 91 if BOARD_GOOGLE_MODEL_QUARTZ
	default 91 if BOARD_GOOGLE_MODEL_MICA
	default 34
	help
	  This option specifies the GPIO pin number on the mainboard that is
	  used for the interrupt line from the Google Security Chip (GSC) to the
	  Application Processor (AP).

config MAINBOARD_GPIO_PIN_FOR_TOUCHSCREEN_POWER
	int
	default 88 if BOARD_GOOGLE_MODEL_MICA
	default 88 if BOARD_GOOGLE_MODEL_QUARTZ
	default 0
	help
	  The GPIO pin number used to enable/disable power to the
	  touchscreen controller. This varies by board revision.
	  Set to 0x0 if power is hardwired.

config FMDFILE
	default "src/mainboard/\$(CONFIG_MAINBOARD_DIR)/chromeos-nogsc.fmd" if BOARD_GOOGLE_MODEL_BLUEY
	default "src/mainboard/\$(CONFIG_MAINBOARD_DIR)/chromeos.fmd"

config RW_REGION_ONLY
	default "%/apdp %/apdp_meta %/ramdump %/ramdump_meta" if QC_SKIP_SOC_DEBUG_FEATURES_IN_RECOVERY

endif # BOARD_GOOGLE_BLUEY_COMMON
```

## src/mainboard/google/bluey/Kconfig.name
```kconfig
## SPDX-License-Identifier: GPL-2.0-only

comment "Bluey (Qualcomm Snapdragon X Plus (X1P-42-100))"

config BOARD_GOOGLE_BLUEY
	bool "->  Bluey"

config BOARD_GOOGLE_QUENBI
	bool "->  Quenbi"

config BOARD_GOOGLE_BLUEYH
	bool "->  BlueyH"

config BOARD_GOOGLE_QUENBIH
	bool "->  QuenbiH"

config BOARD_GOOGLE_QUARTZ
	bool "->  Quartz"
```
