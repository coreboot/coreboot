## src/mainboard/google/cyan/Kconfig
```kconfig
config BOARD_GOOGLE_BASEBOARD_CYAN
	def_bool n
	select BOARD_ROMSIZE_KB_8192
	select EC_GOOGLE_CHROMEEC
	select EC_GOOGLE_CHROMEEC_ACPI_MEMMAP
	select EC_GOOGLE_CHROMEEC_BOARDID
	select EC_GOOGLE_CHROMEEC_LPC
	select EC_GOOGLE_CHROMEEC_MEC
	select HAVE_ACPI_RESUME
	select HAVE_ACPI_TABLES
	select HAVE_OPTION_TABLE
	select HAVE_SPD_IN_CBFS
	select INTEL_GMA_HAVE_VBT
	select MAINBOARD_HAS_CHROMEOS
	select MAINBOARD_HAS_LPC_TPM
	select MAINBOARD_HAS_TPM1
	select PCIEXP_L1_SUB_STATE if !BOARD_GOOGLE_CYAN
	select SOC_INTEL_BRASWELL
	select SYSTEM_TYPE_LAPTOP
	select USE_GOOGLE_FSP

config BOARD_GOOGLE_BANON
	select BOARD_GOOGLE_BASEBOARD_CYAN

config BOARD_GOOGLE_CELES
	select BOARD_GOOGLE_BASEBOARD_CYAN

config BOARD_GOOGLE_CYAN
	select BOARD_GOOGLE_BASEBOARD_CYAN

config BOARD_GOOGLE_EDGAR
	select BOARD_GOOGLE_BASEBOARD_CYAN

config BOARD_GOOGLE_KEFKA
	select BOARD_GOOGLE_BASEBOARD_CYAN

config BOARD_GOOGLE_REKS
	select BOARD_GOOGLE_BASEBOARD_CYAN

config BOARD_GOOGLE_RELM
	select BOARD_GOOGLE_BASEBOARD_CYAN

config BOARD_GOOGLE_SETZER
	select BOARD_GOOGLE_BASEBOARD_CYAN

config BOARD_GOOGLE_TERRA
	select BOARD_GOOGLE_BASEBOARD_CYAN

config BOARD_GOOGLE_ULTIMA
	select BOARD_GOOGLE_BASEBOARD_CYAN

config BOARD_GOOGLE_WIZPIG
	select BOARD_GOOGLE_BASEBOARD_CYAN

if BOARD_GOOGLE_BASEBOARD_CYAN

config VBOOT
	select EC_GOOGLE_CHROMEEC_SWITCHES
	select VBOOT_LID_SWITCH
	select VBOOT_VBNV_CMOS

config DISPLAY_SPD_DATA
	bool "Display Memory Serial Presence Detect Data"
	default n
	help
	  When enabled displays the memory configuration data.

config MAINBOARD_DIR
	default "google/cyan"

config MAINBOARD_FAMILY
	string
	default "Intel_Strago" if !BOARD_GOOGLE_CYAN
	default ""

config VARIANT_DIR
	default "banon" if BOARD_GOOGLE_BANON
	default "celes" if BOARD_GOOGLE_CELES
	default "cyan" if BOARD_GOOGLE_CYAN
	default "edgar" if BOARD_GOOGLE_EDGAR
	default "kefka" if BOARD_GOOGLE_KEFKA
	default "reks" if BOARD_GOOGLE_REKS
	default "relm" if BOARD_GOOGLE_RELM
	default "setzer" if BOARD_GOOGLE_SETZER
	default "terra" if BOARD_GOOGLE_TERRA
	default "ultima" if BOARD_GOOGLE_ULTIMA
	default "wizpig" if BOARD_GOOGLE_WIZPIG

config MAINBOARD_PART_NUMBER
	default "Banon" if BOARD_GOOGLE_BANON
	default "Celes" if BOARD_GOOGLE_CELES
	default "Cyan" if BOARD_GOOGLE_CYAN
	default "Edgar" if BOARD_GOOGLE_EDGAR
	default "Kefka" if BOARD_GOOGLE_KEFKA
	default "Reks" if BOARD_GOOGLE_REKS
	default "Relm" if BOARD_GOOGLE_RELM
	default "Setzer" if BOARD_GOOGLE_SETZER
	default "Terra" if BOARD_GOOGLE_TERRA
	default "Ultima" if BOARD_GOOGLE_ULTIMA
	default "Wizpig" if BOARD_GOOGLE_WIZPIG

config OVERRIDE_DEVICETREE
	default "variants/\$(CONFIG_VARIANT_DIR)/overridetree.cb"

config CBFS_SIZE
	default 0x200000

config MAINBOARD_SMBIOS_MANUFACTURER
	string
	default "GOOGLE"

config CONSOLE_SERIAL
	default n

config ENABLE_BUILTIN_COM1
	default y if CONSOLE_SERIAL

endif # BOARD_GOOGLE_BASEBOARD_CYAN
```

## src/mainboard/google/cyan/Kconfig.name
```kconfig
## SPDX-License-Identifier: GPL-2.0-only

comment "Cyan"

config BOARD_GOOGLE_BANON
	bool "->  Banon (Acer Chromebook 15 (CB3-532))"

config BOARD_GOOGLE_CELES
	bool "->  Celes (Samsung Chromebook 3)"

config BOARD_GOOGLE_CYAN
	bool "->  Cyan (Acer Chromebook R11 (C738T))"

config BOARD_GOOGLE_EDGAR
	bool "->  Edgar (Acer Chromebook 14 (CB3-431))"

config BOARD_GOOGLE_KEFKA
	bool "->  Kefka (Dell Chromebook 11 3180/3189)"

config BOARD_GOOGLE_REKS
	bool "->  Reks (Lenovo N22/N42 Chromebook)"

config BOARD_GOOGLE_RELM
	bool "->  Relm (Multiple devices - See help text)"
	help
	  The Relm board supports the following devices:
	  - Acer Chromebook 11 N7 (C731, C731T)
	  - CTL NL61 Chromebook
	  - EduGear Chromebook R
	  - Edxis Education Chromebook (NL6D)
	  - HP Chromebook 11 G5 EE
	  - Mecer V2 Chromebook
	  - Positivo Chromebook C216B

config BOARD_GOOGLE_SETZER
	bool "->  Setzer (HP Chromebook 11 G5)"

config BOARD_GOOGLE_TERRA
	bool "->  Terra (ASUS Chromebook C202SA/C300SA/C301SA)"

config BOARD_GOOGLE_ULTIMA
	bool "->  Ultima (Lenovo Yoga 11e G3)"

config BOARD_GOOGLE_WIZPIG
	bool "->  Wizpig (Multiple devices - See help text)"
	help
	  The Wizpig board supports the following devices:
	  - CTL J5 Chromebook
	  - Edugear CMT Chromebook
	  - Haier Chromebook 11 C
	  - Multilaser Chromebook M11C
	  - PCMerge Chromebook PCM-116T-432B
	  - Prowise Chromebook Proline
	  - Viglen Chromebook 360
```

## src/mainboard/google/daisy/Kconfig
```kconfig
## SPDX-License-Identifier: GPL-2.0-only

if BOARD_GOOGLE_DAISY

config BOARD_SPECIFIC_OPTIONS
	def_bool y
	select BOOT_DEVICE_NOT_SPI_FLASH
	select CPU_SAMSUNG_EXYNOS5250
	select EC_GOOGLE_CHROMEEC
	select EC_GOOGLE_CHROMEEC_I2C
	select BOARD_ROMSIZE_KB_4096
	select DRIVER_MAXIM_MAX77686
	select DRIVER_TI_TPS65090
	select MAINBOARD_HAS_NATIVE_VGA_INIT
	select MAINBOARD_FORCE_NATIVE_VGA_INIT
	select HAVE_LINEAR_FRAMEBUFFER
	select I2C_TPM
	select MAINBOARD_HAS_TPM1

config MAINBOARD_DIR
	default "google/daisy"

config MAINBOARD_PART_NUMBER
	default "Daisy"

config MAX_CPUS
	int
	default 2

config DRAM_SIZE_MB
	int
	default 2048

config EC_GOOGLE_CHROMEEC_I2C_BUS
	hex
	default 0x4

config UART_FOR_CONSOLE
	int
	default 3

config PMIC_BUS
	int
	default 0

endif # BOARD_GOOGLE_DAISY
```

## src/mainboard/google/daisy/Kconfig.name
```kconfig
## SPDX-License-Identifier: GPL-2.0-only

comment "Daisy (Samsung Exynos 5250)"

config BOARD_GOOGLE_DAISY
	bool "->  Daisy (Samsung Chromebook (2012))"
```
