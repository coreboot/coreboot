## src/mainboard/google/dedede/Kconfig
```kconfig
## SPDX-License-Identifier: GPL-2.0-only

config BOARD_GOOGLE_BASEBOARD_DEDEDE
	def_bool n
	select BOARD_ROMSIZE_KB_16384 if !BOARD_ROMSIZE_KB_32768
	select DRIVERS_AUDIO_SOF
	select DRIVERS_GENERIC_ALC1015
	select DRIVERS_GENERIC_GPIO_KEYS
	select DRIVERS_GENERIC_MAX98357A
	select DRIVERS_I2C_CS42L42
	select DRIVERS_I2C_GENERIC
	select DRIVERS_I2C_GPIO_MUX
	select DRIVERS_I2C_HID
	select DRIVERS_I2C_RT5645
	select DRIVERS_INTEL_DPTF
	select DRIVERS_INTEL_MIPI_CAMERA
	select DRIVERS_SPI_ACPI
	select DRIVERS_USB_ACPI
	select EC_GOOGLE_CHROMEEC
	select EC_GOOGLE_CHROMEEC_BOARDID
	select EC_GOOGLE_CHROMEEC_ESPI
	select EC_GOOGLE_CHROMEEC_INCLUDE_SSFC_IN_FW_CONFIG
	select EC_GOOGLE_CHROMEEC_SKUID
	select FW_CONFIG
	select FW_CONFIG_SOURCE_CHROMEEC_CBI
	select GOOGLE_SMBIOS_MAINBOARD_VERSION
	select HAVE_ACPI_RESUME
	select HAVE_ACPI_TABLES
	select HAVE_SPD_IN_CBFS if !BOARD_GOOGLE_DEDEDE
	select INTEL_LPSS_UART_FOR_CONSOLE
	select MAINBOARD_HAS_CHROMEOS
	select MAINBOARD_HAS_TPM2
	select SOC_INTEL_COMMON_BLOCK_IPU
	select SOC_INTEL_CSE_LITE_SKU
	select SOC_INTEL_JASPERLAKE
	select SPI_FLASH_SMM

config BOARD_GOOGLE_AWASUKI
	select BOARD_GOOGLE_BASEBOARD_DEDEDE_CR50
	select BASEBOARD_DEDEDE_LAPTOP
	select SOC_INTEL_COMMON_BLOCK_IPU
	select INTEL_GMA_HAVE_VBT

config BOARD_GOOGLE_BASEBOARD_DEDEDE_CR50
	def_bool n
	select BOARD_GOOGLE_BASEBOARD_DEDEDE
	select CR50_USE_LONG_INTERRUPT_PULSES
	select SPI_TPM
	select TPM_GOOGLE_CR50

config BOARD_GOOGLE_BASEBOARD_DEDEDE_TPM2
	def_bool n
	select BOARD_GOOGLE_BASEBOARD_DEDEDE
	select MEMORY_MAPPED_TPM

config BOARD_GOOGLE_BEADRIX
	select BOARD_GOOGLE_BASEBOARD_DEDEDE_CR50
	select BASEBOARD_DEDEDE_LAPTOP
	select DRIVERS_GENERIC_MAX98357A
	select DRIVERS_I2C_SX9324
	select DRIVERS_I2C_SX9324_SUPPORT_LEGACY_LINUX_DRIVER
	select INTEL_GMA_HAVE_VBT

config BOARD_GOOGLE_BLIPPER
	select BOARD_GOOGLE_BASEBOARD_DEDEDE_CR50
	select BASEBOARD_DEDEDE_LAPTOP
	select GEO_SAR_ENABLE if CHROMEOS_WIFI_SAR
	select INTEL_GMA_HAVE_VBT

config BOARD_GOOGLE_BOTEN
	select BOARD_GOOGLE_BASEBOARD_DEDEDE_CR50
	select BASEBOARD_DEDEDE_LAPTOP
	select DRIVERS_I2C_SX9324
	select DRIVERS_I2C_SX9324_SUPPORT_LEGACY_LINUX_DRIVER
	select GEO_SAR_ENABLE if CHROMEOS_WIFI_SAR
	select INTEL_GMA_HAVE_VBT

config BOARD_GOOGLE_BOXY
	select BOARD_GOOGLE_BASEBOARD_DEDEDE_CR50
	select INTEL_GMA_HAVE_VBT
	select RT8168_GEN_ACPI_POWER_RESOURCE
	select RT8168_GET_MAC_FROM_VPD
	select RT8168_SET_LED_MODE

config BOARD_GOOGLE_BUGZZY
	select BOARD_GOOGLE_BASEBOARD_DEDEDE_CR50
	select BASEBOARD_DEDEDE_LAPTOP
	select DRIVERS_GENERIC_MAX98357A
	select DRIVERS_I2C_DA7219
	select DRIVERS_I2C_SX9360
	select GEO_SAR_ENABLE if CHROMEOS_WIFI_SAR
	select INTEL_GMA_HAVE_VBT

config BOARD_GOOGLE_CAPPY2
	select BOARD_GOOGLE_BASEBOARD_DEDEDE_TPM2
	select BASEBOARD_DEDEDE_LAPTOP

config BOARD_GOOGLE_CORORI
	select BOARD_GOOGLE_BASEBOARD_DEDEDE_TPM2
	select BASEBOARD_DEDEDE_LAPTOP
	select DRIVERS_GENERIC_MAX98357A

config BOARD_GOOGLE_CRET
	select BOARD_GOOGLE_BASEBOARD_DEDEDE_CR50
	select BASEBOARD_DEDEDE_LAPTOP
	select DRIVERS_GENERIC_MAX98357A
	select DRIVERS_I2C_DA7219
	select GEO_SAR_ENABLE if CHROMEOS_WIFI_SAR
	select INTEL_GMA_HAVE_VBT

config BOARD_GOOGLE_DEDEDE
	select BOARD_GOOGLE_BASEBOARD_DEDEDE_CR50
	select BASEBOARD_DEDEDE_LAPTOP
	select BOARD_ROMSIZE_KB_32768

config BOARD_GOOGLE_DEXI
	select BOARD_GOOGLE_BASEBOARD_DEDEDE_CR50
	select RT8168_GEN_ACPI_POWER_RESOURCE
	select RT8168_GET_MAC_FROM_VPD
	select RT8168_SET_LED_MODE
	select GEO_SAR_ENABLE if CHROMEOS_WIFI_SAR

config BOARD_GOOGLE_DIBBI
	select BOARD_GOOGLE_BASEBOARD_DEDEDE_CR50
	select INTEL_GMA_HAVE_VBT
	select RT8168_GEN_ACPI_POWER_RESOURCE
	select RT8168_GET_MAC_FROM_VPD
	select RT8168_SET_LED_MODE

config BOARD_GOOGLE_DITA
	select BOARD_GOOGLE_BASEBOARD_DEDEDE_CR50
	select RT8168_GEN_ACPI_POWER_RESOURCE
	select RT8168_GET_MAC_FROM_VPD
	select RT8168_SET_LED_MODE
	select GEO_SAR_ENABLE if CHROMEOS_WIFI_SAR

config BOARD_GOOGLE_DRAWCIA
	select BOARD_GOOGLE_BASEBOARD_DEDEDE_CR50
	select BASEBOARD_DEDEDE_LAPTOP
	select DRIVERS_GENERIC_MAX98357A
	select GEO_SAR_ENABLE if CHROMEOS_WIFI_SAR
	select DRIVERS_INTEL_MIPI_CAMERA
	select INTEL_GMA_HAVE_VBT
	select SOC_INTEL_COMMON_BLOCK_IPU

config BOARD_GOOGLE_DRIBLEE
	select BOARD_GOOGLE_BASEBOARD_DEDEDE_TPM2
	select BASEBOARD_DEDEDE_LAPTOP
	select DRIVERS_GENERIC_MAX98357A

config BOARD_GOOGLE_GALTIC
	select BOARD_GOOGLE_BASEBOARD_DEDEDE_CR50
	select BASEBOARD_DEDEDE_LAPTOP
	select GEO_SAR_ENABLE if CHROMEOS_WIFI_SAR
	select INTEL_GMA_HAVE_VBT

config BOARD_GOOGLE_GOOEY
	select BOARD_GOOGLE_BASEBOARD_DEDEDE_TPM2
	select BASEBOARD_DEDEDE_LAPTOP
	select DRIVERS_I2C_SX9324
	select DRIVERS_I2C_SX9324_SUPPORT_LEGACY_LINUX_DRIVER
	select GEO_SAR_ENABLE if CHROMEOS_WIFI_SAR

config BOARD_GOOGLE_HABOKI
	select BOARD_GOOGLE_BASEBOARD_DEDEDE_TPM2
	select BASEBOARD_DEDEDE_LAPTOP
	select DRIVERS_GENERIC_MAX98357A
	select GEO_SAR_ENABLE if CHROMEOS_WIFI_SAR
	select DRIVERS_INTEL_MIPI_CAMERA
	select SOC_INTEL_COMMON_BLOCK_IPU

config BOARD_GOOGLE_KRACKO
	select BOARD_GOOGLE_BASEBOARD_DEDEDE_CR50
	select BASEBOARD_DEDEDE_LAPTOP
	select DRIVERS_GENERIC_MAX98357A
	select DRIVERS_I2C_SX9324
	select DRIVERS_I2C_SX9324_SUPPORT_LEGACY_LINUX_DRIVER
	select GEO_SAR_ENABLE if CHROMEOS_WIFI_SAR
	select INTEL_GMA_HAVE_VBT

config BOARD_GOOGLE_LALALA
	select BOARD_GOOGLE_BASEBOARD_DEDEDE_TPM2
	select BASEBOARD_DEDEDE_LAPTOP
	select DRIVERS_INTEL_MIPI_CAMERA
	select GEO_SAR_ENABLE if CHROMEOS_WIFI_SAR
	select SOC_INTEL_COMMON_BLOCK_IPU

config BOARD_GOOGLE_LANTIS
	select BOARD_GOOGLE_BASEBOARD_DEDEDE_CR50
	select BASEBOARD_DEDEDE_LAPTOP
	select DRIVERS_GENERIC_MAX98357A
	select INTEL_GMA_HAVE_VBT

config BOARD_GOOGLE_MADOO
	select BOARD_GOOGLE_BASEBOARD_DEDEDE_CR50
	select BASEBOARD_DEDEDE_LAPTOP
	select DRIVERS_GENERIC_MAX98357A
	select GEO_SAR_ENABLE if CHROMEOS_WIFI_SAR
	select INTEL_GMA_HAVE_VBT

config BOARD_GOOGLE_MAGOLOR
	select BOARD_GOOGLE_BASEBOARD_DEDEDE_CR50
	select BASEBOARD_DEDEDE_LAPTOP
	select DRIVERS_I2C_DA7219
	select DRIVERS_INTEL_MIPI_CAMERA
	select GEO_SAR_ENABLE if CHROMEOS_WIFI_SAR
	select INTEL_GMA_HAVE_VBT
	select SOC_INTEL_COMMON_BLOCK_IPU

config BOARD_GOOGLE_METAKNIGHT
	select BOARD_GOOGLE_BASEBOARD_DEDEDE_CR50
	select BASEBOARD_DEDEDE_LAPTOP
	select INTEL_GMA_HAVE_VBT

config BOARD_GOOGLE_PIRIKA
	select BOARD_GOOGLE_BASEBOARD_DEDEDE_CR50
	select BASEBOARD_DEDEDE_LAPTOP
	select GEO_SAR_ENABLE if CHROMEOS_WIFI_SAR
	select INTEL_GMA_HAVE_VBT

config BOARD_GOOGLE_SASUKE
	select BOARD_GOOGLE_BASEBOARD_DEDEDE_CR50
	select BASEBOARD_DEDEDE_LAPTOP
	select DRIVERS_GENERIC_MAX98357A
	select DRIVERS_I2C_DA7219
	select GEO_SAR_ENABLE if CHROMEOS_WIFI_SAR
	select INTEL_GMA_HAVE_VBT

config BOARD_GOOGLE_SASUKETTE
	select BOARD_GOOGLE_BASEBOARD_DEDEDE_CR50
	select BASEBOARD_DEDEDE_LAPTOP
	select GEO_SAR_ENABLE if CHROMEOS_WIFI_SAR
	select INTEL_GMA_HAVE_VBT

config BOARD_GOOGLE_SHOTZO
	select BOARD_GOOGLE_BASEBOARD_DEDEDE_CR50

config BOARD_GOOGLE_STORO
	select BOARD_GOOGLE_BASEBOARD_DEDEDE_CR50
	select BASEBOARD_DEDEDE_LAPTOP
	select DRIVERS_I2C_SX9324
	select DRIVERS_I2C_SX9324_SUPPORT_LEGACY_LINUX_DRIVER
	select DRIVERS_INTEL_MIPI_CAMERA
	select SOC_INTEL_COMMON_BLOCK_IPU
	select GEO_SAR_ENABLE if CHROMEOS_WIFI_SAR
	select INTEL_GMA_HAVE_VBT

config BOARD_GOOGLE_TARANZA
	select BOARD_GOOGLE_BASEBOARD_DEDEDE_CR50
	select RT8168_GEN_ACPI_POWER_RESOURCE
	select RT8168_GET_MAC_FROM_VPD
	select RT8168_SET_LED_MODE
	select GEO_SAR_ENABLE if CHROMEOS_WIFI_SAR
	select INTEL_GMA_HAVE_VBT

config BOARD_GOOGLE_WADDLEDEE
	select BOARD_GOOGLE_BASEBOARD_DEDEDE_CR50
	select BASEBOARD_DEDEDE_LAPTOP
	select BOARD_ROMSIZE_KB_32768
	select INTEL_GMA_HAVE_VBT

config BOARD_GOOGLE_WADDLEDOO
	select BOARD_GOOGLE_BASEBOARD_DEDEDE_CR50
	select BASEBOARD_DEDEDE_LAPTOP
	select BOARD_ROMSIZE_KB_32768
	select DRIVERS_GENERIC_MAX98357A
	select DRIVERS_I2C_DA7219
	select DRIVERS_INTEL_MIPI_CAMERA
	select INTEL_GMA_HAVE_VBT
	select SOC_INTEL_COMMON_BLOCK_IPU

if BOARD_GOOGLE_BASEBOARD_DEDEDE

config BASEBOARD_DEDEDE_LAPTOP
	def_bool n
	select SYSTEM_TYPE_LAPTOP

config CHROMEOS
	select CHROMEOS_CSE_BOARD_RESET_OVERRIDE if BOARD_GOOGLE_BASEBOARD_DEDEDE_CR50
	select CHROMEOS_DRAM_PART_NUMBER_IN_CBI
	select EC_GOOGLE_CHROMEEC_SWITCHES
	select GBB_FLAG_FORCE_DEV_SWITCH_ON
	select GBB_FLAG_FORCE_DEV_BOOT_USB
	select GBB_FLAG_FORCE_DEV_BOOT_ALTFW
	select GBB_FLAG_FORCE_MANUAL_RECOVERY
	select HAS_RECOVERY_MRC_CACHE
	select VBOOT_EARLY_EC_SYNC
	select VBOOT_LID_SWITCH

config CHROMEOS_WIFI_SAR
	bool "Enable SAR options for ChromeOS build"
	depends on CHROMEOS
	select DSAR_ENABLE
	select SAR_ENABLE
	select USE_SAR

config DEVICETREE
	default "variants/baseboard/devicetree.cb"

config DIMM_SPD_SIZE
	default 512

config FMDFILE
	default "src/mainboard/\$(CONFIG_MAINBOARD_DIR)/chromeos-dedede-16MiB.fmd" if CHROMEOS && BOARD_ROMSIZE_KB_16384
	default "src/mainboard/\$(CONFIG_MAINBOARD_DIR)/chromeos-dedede-32MiB.fmd" if CHROMEOS && BOARD_ROMSIZE_KB_32768

config MAINBOARD_DIR
	default "google/dedede"

config MAINBOARD_FAMILY
	string
	default "Google_Dedede" if BOARD_GOOGLE_DEDEDE

config MAINBOARD_PART_NUMBER
	default "Beadrix" if BOARD_GOOGLE_BEADRIX
	default "Blipper" if BOARD_GOOGLE_BLIPPER
	default "Boten" if BOARD_GOOGLE_BOTEN
	default "Boxy" if BOARD_GOOGLE_BOXY
	default "Bugzzy" if BOARD_GOOGLE_BUGZZY
	default "Cappy2" if BOARD_GOOGLE_CAPPY2
	default "Corori" if BOARD_GOOGLE_CORORI
	default "Cret" if BOARD_GOOGLE_CRET
	default "Dedede" if BOARD_GOOGLE_DEDEDE
	default "Dexi" if BOARD_GOOGLE_DEXI
	default "Dibbi" if BOARD_GOOGLE_DIBBI
	default "Dita" if BOARD_GOOGLE_DITA
	default "Drawcia" if BOARD_GOOGLE_DRAWCIA
	default "Driblee" if BOARD_GOOGLE_DRIBLEE
	default "Galtic" if BOARD_GOOGLE_GALTIC
	default "Gooey" if BOARD_GOOGLE_GOOEY
	default "Haboki" if BOARD_GOOGLE_HABOKI
	default "Kracko" if BOARD_GOOGLE_KRACKO
	default "Lalala" if BOARD_GOOGLE_LALALA
	default "Lantis" if BOARD_GOOGLE_LANTIS
	default "Madoo" if BOARD_GOOGLE_MADOO
	default "Magolor" if BOARD_GOOGLE_MAGOLOR
	default "Metaknight" if BOARD_GOOGLE_METAKNIGHT
	default "Pirika" if BOARD_GOOGLE_PIRIKA
	default "Sasuke" if BOARD_GOOGLE_SASUKE
	default "Sasukette" if BOARD_GOOGLE_SASUKETTE
	default "Shotzo" if BOARD_GOOGLE_SHOTZO
	default "Storo" if BOARD_GOOGLE_STORO
	default "Taranza" if BOARD_GOOGLE_TARANZA
	default "Waddledee" if BOARD_GOOGLE_WADDLEDEE
	default "Waddledoo" if BOARD_GOOGLE_WADDLEDOO
	default "Awasuki" if BOARD_GOOGLE_AWASUKI

config MAX_CPUS
	int
	default 4

config OVERRIDE_DEVICETREE
	default "variants/\$(CONFIG_VARIANT_DIR)/overridetree.cb" if !BOARD_GOOGLE_DEDEDE

config UART_FOR_CONSOLE
	int
	default 2

config VARIANT_DIR
	default "beadrix" if BOARD_GOOGLE_BEADRIX
	default "blipper" if BOARD_GOOGLE_BLIPPER
	default "boten" if BOARD_GOOGLE_BOTEN
	default "boxy" if BOARD_GOOGLE_BOXY
	default "bugzzy" if BOARD_GOOGLE_BUGZZY
	default "cappy2" if BOARD_GOOGLE_CAPPY2
	default "corori" if BOARD_GOOGLE_CORORI
	default "cret" if BOARD_GOOGLE_CRET
	default "dedede" if BOARD_GOOGLE_DEDEDE
	default "dexi" if BOARD_GOOGLE_DEXI
	default "dibbi" if BOARD_GOOGLE_DIBBI
	default "dita" if BOARD_GOOGLE_DITA
	default "drawcia" if BOARD_GOOGLE_DRAWCIA
	default "driblee" if BOARD_GOOGLE_DRIBLEE
	default "galtic" if BOARD_GOOGLE_GALTIC
	default "gooey" if BOARD_GOOGLE_GOOEY
	default "haboki" if BOARD_GOOGLE_HABOKI
	default "kracko" if BOARD_GOOGLE_KRACKO
	default "lalala" if BOARD_GOOGLE_LALALA
	default "lantis" if BOARD_GOOGLE_LANTIS
	default "madoo" if BOARD_GOOGLE_MADOO
	default "magolor" if BOARD_GOOGLE_MAGOLOR
	default "metaknight" if BOARD_GOOGLE_METAKNIGHT
	default "pirika" if BOARD_GOOGLE_PIRIKA
	default "sasuke" if BOARD_GOOGLE_SASUKE
	default "sasukette" if BOARD_GOOGLE_SASUKETTE
	default "shotzo" if BOARD_GOOGLE_SHOTZO
	default "storo" if BOARD_GOOGLE_STORO
	default "taranza" if BOARD_GOOGLE_TARANZA
	default "waddledee" if BOARD_GOOGLE_WADDLEDEE
	default "waddledoo" if BOARD_GOOGLE_WADDLEDOO
	default "awasuki" if BOARD_GOOGLE_AWASUKI

endif #BOARD_GOOGLE_BASEBOARD_DEDEDE

if BOARD_GOOGLE_BASEBOARD_DEDEDE_CR50

config DRIVER_TPM_SPI_BUS
	default 0x1

config TPM_TIS_ACPI_INTERRUPT
	int
	default 4  # GPE0_DW0_4 (GPP_B4)

endif #BOARD_GOOGLE_BASEBOARD_DEDEDE_CR50

if BOARD_GOOGLE_BASEBOARD_DEDEDE_TPM2

config TPM_PIRQ
	hex
	default 0x24 # GPP_B4_IRQ

endif #BOARD_GOOGLE_BASEBOARD_DEDEDE_TPM2
```

## src/mainboard/google/dedede/Kconfig.name
```kconfig
## SPDX-License-Identifier: GPL-2.0-only

comment "Dedede"

config BOARD_GOOGLE_BEADRIX
	bool "->  Beadrix"

config BOARD_GOOGLE_BLIPPER
	bool "->  Blipper (Lenovo 3i-15 Chromebook)"

config BOARD_GOOGLE_BOTEN
	bool "->  Boten (Lenovo 500e Chromebook Gen 3)"

config BOARD_GOOGLE_BOXY
	bool "->  Boxy (Lenovo Chromebox Micro)"

config BOARD_GOOGLE_BUGZZY
	bool "->  Bugzzy (Samsung Galaxy Chromebook 2 360)"

config BOARD_GOOGLE_CAPPY2
	bool "->  Cappy2"

config BOARD_GOOGLE_CORORI
	bool "->  Corori"

config BOARD_GOOGLE_CRET
	bool "->  Cret (Dell Chromebook 3110)"

config BOARD_GOOGLE_DEDEDE
	bool "->  Dedede"

config BOARD_GOOGLE_DEXI
	bool "->  Dexi (AOPEN Chromebox Mini 2)"

config BOARD_GOOGLE_DIBBI
	bool "->  Dibbi"

config BOARD_GOOGLE_DITA
	bool "->  Dita (Acer Chromebox Mini CXM1)"

config BOARD_GOOGLE_DRAWCIA
	bool "->  Drawcia (Multiple devices - See help text)"
	help
	  The Drawcia board supports the following devices:
	  - HP Chromebook x360 11 G4 EE (Drawcia)
	  - HP Chromebook 11 G9 EE (Drawlat)
	  - HP Chromebook 14 G7 (Drawman)
	  - HP Fortis 14 G10 Chromebook (Drawper)

config BOARD_GOOGLE_DRIBLEE
	bool "->  Driblee"

config BOARD_GOOGLE_GALTIC
	bool "->  Galtic (ASUS Chromebook CX1400CKA)"

config BOARD_GOOGLE_GOOEY
	bool "->  Gooey"

config BOARD_GOOGLE_HABOKI
	bool "->  HABOKI"

config BOARD_GOOGLE_KRACKO
	bool "->  Kracko"

config BOARD_GOOGLE_LALALA
	bool "->  Lalala"

config BOARD_GOOGLE_LANTIS
	bool "->  Lantis (HP Chromebook 14a)"

config BOARD_GOOGLE_MADOO
	bool "->  Madoo (HP Chromebook x360 14b)"

config BOARD_GOOGLE_MAGOLOR
	bool "->  Magolor (Acer Chromebook Spin 511)"

config BOARD_GOOGLE_METAKNIGHT
	bool "->  Metaknight (NEC Chromebook Y3)"

config BOARD_GOOGLE_PIRIKA
	bool "->  Pirika"

config BOARD_GOOGLE_SASUKE
	bool "->  Sasuke (Samsung Galaxy Chromebook Go)"

config BOARD_GOOGLE_SASUKETTE
	bool "->  Sasukette (Samsung Galaxy Chromebook Go 11)"

config BOARD_GOOGLE_STORO
	bool "->  Storo (ASUS Chromebook CR1100CKA)"

config BOARD_GOOGLE_SHOTZO
	bool "->  Shotzo"

config BOARD_GOOGLE_TARANZA
	bool "->  Taranza"

config BOARD_GOOGLE_WADDLEDEE
	bool "->  Waddledee"

config BOARD_GOOGLE_WADDLEDOO
	bool "->  Waddledoo"

config BOARD_GOOGLE_AWASUKI
	bool "->  Awasuki (ASUS Chromebook CX1405CKA/CB1405CKA)"
```
