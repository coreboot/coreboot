## src/mainboard/google/calypso/Kconfig
```kconfig
## SPDX-License-Identifier: GPL-2.0-only

config BOARD_GOOGLE_CALYPSO_COMMON
	def_bool n
	select COMMON_CBFS_SPI_WRAPPER
	select ELOG
	# FIXME: keep ADB for development phase
	select GBB_FLAG_ENABLE_ADB if VBOOT
	select MAINBOARD_HAS_CHROMEOS
	select SOC_QUALCOMM_PCIE_ASYNCHRONOUS_INIT
	select SPI_FLASH
	select SPI_FLASH_FORCE_4_BYTE_ADDR_MODE
	select SPI_FLASH_INCLUDE_ALL_DRIVERS

config BOARD_GOOGLE_BASEBOARD_CALYPSO
	def_bool n
	select BOARD_GOOGLE_CALYPSO_COMMON

config BOARD_GOOGLE_MODEL_MENSA
	def_bool n
	select BOARD_GOOGLE_BASEBOARD_CALYPSO
	select BOARD_ROMSIZE_KB_32768
	select EC_GOOGLE_CHROMEEC_BATTERY_SOC_DYNAMIC
	select EC_GOOGLE_CHROMEEC_FW_CONFIG_FROM_UFSC
	select EC_GOOGLE_CHROMEEC_LED_CONTROL
	select FW_CONFIG
	select FW_CONFIG_SOURCE_CHROMEEC_CBI
	select MAINBOARD_HAS_CHROME_EC
	select MAINBOARD_HAS_GOOGLE_TPM

config BOARD_GOOGLE_MENSA
	select BOARD_GOOGLE_MODEL_MENSA
	select DAP_USE_SMB1
	select HAVE_DEBUG_ACCESS_PORT_SOURCE_SINK
	select MAINBOARD_HAS_FINGERPRINT_VIA_USB
	select SOC_QUALCOMM_CALYPSO
	select SPI_FREQ_100MHZ

config BOARD_GOOGLE_C1NV
	select BOARD_GOOGLE_MODEL_MENSA
	select MAINBOARD_HAS_FINGERPRINT_VIA_USB
	select SOC_QUALCOMM_CALYPSO
	select SPI_FREQ_100MHZ

config BOARD_GOOGLE_MODEL_CALYPSO
	def_bool n
	select BOARD_GOOGLE_BASEBOARD_CALYPSO
	select BOARD_ROMSIZE_KB_65536
	select MISSING_BOARD_RESET
	select SOC_QUALCOMM_CDT

config BOARD_GOOGLE_CALYPSO
	select BOARD_GOOGLE_MODEL_CALYPSO
	select MAINBOARD_HAS_FINGERPRINT_VIA_USB
	select SOC_QUALCOMM_CALYPSO

if BOARD_GOOGLE_CALYPSO_COMMON

config MAINBOARD_DIR
	default "google/calypso"

config MAINBOARD_HAS_FINGERPRINT_VIA_SPI
	bool
	default n
	help
	  Enable this option if your mainboard's fingerprint reader
	  is connected via the SPI interface.

config MAINBOARD_HAS_FINGERPRINT_VIA_USB
	bool
	default n
	help
	  Enable this option if your mainboard's fingerprint reader
	  is connected via the USB interface.

config MAINBOARD_HAS_FINGERPRINT
	bool
	default y if MAINBOARD_HAS_FINGERPRINT_VIA_SPI || MAINBOARD_HAS_FINGERPRINT_VIA_USB
	help
	  Enable this option if your mainboard is equipped with an onboard
	  fingerprint reader. This could be connected via SPI or USB.

config HAVE_DEBUG_ACCESS_PORT_SOURCE_SINK
	bool
	default n
	help
	  Enable this option to allow source and sink modes on the debug access port.

config DAP_SMB_SLAVE_ID
	depends on HAVE_DEBUG_ACCESS_PORT_SOURCE_SINK
	hex
	default 0x09 if DAP_USE_SMB1
	default 0x0a if DAP_USE_SMB2
	default 0x0b if DAP_USE_SMB3
	help
	  The Slave ID for the Debug Access Port communication.

config DAP_USE_SMB1
	depends on HAVE_DEBUG_ACCESS_PORT_SOURCE_SINK
	bool
	help
	  Select this to use SMB1 for DAP.

config DAP_USE_SMB2
	depends on HAVE_DEBUG_ACCESS_PORT_SOURCE_SINK
	bool
	help
	  Select this to use SMB2 for DAP.

config DAP_USE_SMB3
	depends on HAVE_DEBUG_ACCESS_PORT_SOURCE_SINK
	bool
	help
	  Select this to use SMB3 for DAP.

config MAINBOARD_HAS_GOOGLE_TPM
	bool
	default n
	select I2C_TPM
	select MAINBOARD_HAS_TPM2
	select TPM_GOOGLE_TI50
	help
	  Enable this option if your mainboard is equipped with Google TPM aka GSC.

config MAINBOARD_HAS_CHROME_EC
	bool
	default n
	select EC_GOOGLE_CHROMEEC
	select EC_GOOGLE_CHROMEEC_RTC
	select EC_GOOGLE_CHROMEEC_SPI
	select EC_GOOGLE_CHROMEEC_SWITCHES if VBOOT
	select RTC
	help
	  Enable this option if your mainboard is equipped with Chrome EC.

config MAINBOARD_VENDOR
	string
	default "Google"

config VBOOT
	select VBOOT_ALWAYS_ENABLE_DISPLAY
	select VBOOT_LID_SWITCH if MAINBOARD_HAS_CHROME_EC
	select VBOOT_MOCK_SECDATA if BOARD_GOOGLE_MODEL_CALYPSO
	select VBOOT_NO_BOARD_SUPPORT if !MAINBOARD_HAS_CHROME_EC
	select VBOOT_VBNV_FLASH

##########################################################
#### Update below when adding a new derivative board. ####
##########################################################

config MAINBOARD_PART_NUMBER
	default "Calypso" if BOARD_GOOGLE_CALYPSO
	default "Mensa" if BOARD_GOOGLE_MENSA
	default "C1nv" if BOARD_GOOGLE_C1NV

config DRIVER_TPM_I2C_BUS
	depends on I2C_TPM
	hex
	default 0x01 # QUP0_SE1

config DRIVER_TPM_I2C_ADDR
	depends on I2C_TPM
	default 0x50

config EC_GOOGLE_CHROMEEC_SPI_BUS
	depends on EC_GOOGLE_CHROMEEC
	hex
	default 0x16 # QUP2_SE6

config MAINBOARD_GPIO_PIN_FOR_GSC_AP_INTERRUPT
	depends on TPM_GOOGLE_TI50
	int
	default 23
	help
	  This option specifies the GPIO pin number on the mainboard that is
	  used for the interrupt line from the Google Security Chip (GSC) to the
	  Application Processor (AP).

config FMDFILE
	default "src/mainboard/\$(CONFIG_MAINBOARD_DIR)/chromeos.fmd" if MAINBOARD_HAS_GOOGLE_TPM
	default "src/mainboard/\$(CONFIG_MAINBOARD_DIR)/chromeos-nogsc.fmd"

endif # BOARD_GOOGLE_CALYPSO_COMMON
```

## src/mainboard/google/calypso/Kconfig.name
```kconfig
## SPDX-License-Identifier: GPL-2.0-only

comment "Calypso (Qualcomm Calypso)"

config BOARD_GOOGLE_CALYPSO
	bool "->  Calypso"

config BOARD_GOOGLE_MENSA
	bool "->  Mensa"

config BOARD_GOOGLE_C1NV
	bool "->  C1nv"
```

## src/mainboard/google/chell/Kconfig
```kconfig
if BOARD_GOOGLE_CHELL

config BOARD_SPECIFIC_OPTIONS # dummy
	def_bool y
	select BOARD_ROMSIZE_KB_16384
	select DRIVERS_I2C_GENERIC
	select DRIVERS_I2C_NAU8825
	select EC_GOOGLE_CHROMEEC
	select EC_GOOGLE_CHROMEEC_ACPI_MEMMAP
	select EC_GOOGLE_CHROMEEC_BOARDID
	select EC_GOOGLE_CHROMEEC_LPC
	select EC_GOOGLE_CHROMEEC_MEC
	select EC_GOOGLE_CHROMEEC_PD
	select HAVE_ACPI_RESUME
	select HAVE_ACPI_TABLES
	select HAVE_OPTION_TABLE
	select HAVE_SMI_HANDLER
	select MAINBOARD_HAS_CHROMEOS
	select MAINBOARD_HAS_LPC_TPM
	select MAINBOARD_HAS_TPM1
	select SOC_INTEL_SKYLAKE
	select SYSTEM_TYPE_LAPTOP

config VBOOT
	select EC_GOOGLE_CHROMEEC_SWITCHES
	select VBOOT_LID_SWITCH

config IRQ_SLOT_COUNT
	int
	default 18

config MAINBOARD_DIR
	string
	default "google/chell"

config MAINBOARD_PART_NUMBER
	string
	default "Chell"

config MAINBOARD_FAMILY
	string
	default "Google_Glados"

config MAX_CPUS
	int
	default 8

config TPM_PIRQ
	hex
	default 0x18  # GPP_E0_IRQ

config INCLUDE_NHLT_BLOBS
	bool "Include blobs for audio."
	select NHLT_DMIC_2CH
	select NHLT_NAU88L25
	select NHLT_SSM4567

config EC_GOOGLE_CHROMEEC_BOARDNAME
	string
	default "chell"

config EC_GOOGLE_CHROMEEC_PD_BOARDNAME
	string
	default "chell_pd"

config GBB_HWID
	string
	depends on CHROMEOS
	default "CHELL TEST 6297"
endif
```

## src/mainboard/google/cherry/Kconfig
```kconfig
## SPDX-License-Identifier: GPL-2.0-only

# Umbrella option to be selected by variant boards.
config BOARD_GOOGLE_CHERRY_COMMON
	def_bool n

if BOARD_GOOGLE_CHERRY_COMMON

config VBOOT
	select EC_GOOGLE_CHROMEEC_SWITCHES
	select VBOOT_VBNV_FLASH

config BOARD_SPECIFIC_OPTIONS
	def_bool y
	select RTC
	select SOC_MEDIATEK_MT8195
	select BOARD_ROMSIZE_KB_8192
	select MAINBOARD_HAS_CHROMEOS
	select CHROMEOS_USE_EC_WATCHDOG_FLAG if CHROMEOS
	select COMMON_CBFS_SPI_WRAPPER
	select SPI_FLASH
	select SPI_FLASH_INCLUDE_ALL_DRIVERS
	select EC_GOOGLE_CHROMEEC
	select EC_GOOGLE_CHROMEEC_BOARDID
	select EC_GOOGLE_CHROMEEC_SKUID
	select EC_GOOGLE_CHROMEEC_SPI
	select MAINBOARD_HAS_I2C_TPM_CR50 if VBOOT
	select MAINBOARD_HAS_TPM2 if VBOOT
	select MAINBOARD_HAS_NATIVE_VGA_INIT
	select HAVE_LINEAR_FRAMEBUFFER
	select COMMONLIB_STORAGE
	select COMMONLIB_STORAGE_MMC

config MAINBOARD_DIR
	default "google/cherry"

config MAINBOARD_PART_NUMBER
	default "Cherry" if BOARD_GOOGLE_CHERRY
	default "Dojo" if BOARD_GOOGLE_DOJO
	default "Tomato" if BOARD_GOOGLE_TOMATO

config DRIVER_TPM_I2C_BUS
	hex
	default 0x3

config DRIVER_TPM_I2C_ADDR
	hex
	default 0x50

# On MT8195 the SPI flash is actually using a SPI-NOR controller with its own bus.
# The number here should be a virtual value as (SPI_BUS_NUMBER + 1).
config BOOT_DEVICE_SPI_FLASH_BUS
	int
	default 7

config EC_GOOGLE_CHROMEEC_SPI_BUS
	hex
	default 0x0

choice
	prompt "Speaker AMP for Cherry"
	default CHERRY_USE_RT1019 if BOARD_GOOGLE_CHERRY || BOARD_GOOGLE_TOMATO
	default CHERRY_USE_MAX98390 if BOARD_GOOGLE_DOJO

config CHERRY_USE_RT1011
	bool "RT1011"
config CHERRY_USE_RT1019
	bool "RT1019"
config CHERRY_USE_MAX98390
	bool "MAX98390"

endchoice

endif
```

## src/mainboard/google/cherry/Kconfig.name
```kconfig
## SPDX-License-Identifier: GPL-2.0-only

comment "Cherry (MediaTek Kompanio 1200 (MT8195))"

config BOARD_GOOGLE_CHERRY
	bool "->  Cherry"

config BOARD_GOOGLE_DOJO
	bool "->  Dojo (HP Chromebook x360 (13b-ca0002sa))"

config BOARD_GOOGLE_TOMATO
	bool "->  Tomato (Acer Chromebook Spin 513 (CP513-2H))"
```

## src/mainboard/google/cheza/Kconfig
```kconfig
config BOARD_GOOGLE_CHEZA_COMMON  # Umbrella option to be selected by variants
	def_bool n

if BOARD_GOOGLE_CHEZA_COMMON

config BOARD_SPECIFIC_OPTIONS
	def_bool y
	select BOARD_ROMSIZE_KB_16384
	select COMMON_CBFS_SPI_WRAPPER
	select EC_GOOGLE_CHROMEEC
	select EC_GOOGLE_CHROMEEC_RTC
	select EC_GOOGLE_CHROMEEC_SPI
	select RTC
	select SOC_QUALCOMM_SDM845
	select SPI_FLASH
	select SPI_FLASH_WINBOND
	select MAINBOARD_HAS_CHROMEOS
	select MAINBOARD_HAS_TPM2
	select MAINBOARD_HAS_SPI_TPM_CR50

config VBOOT
	select EC_GOOGLE_CHROMEEC_SWITCHES
	select VBOOT_VBNV_FLASH

config MAINBOARD_DIR
	string
	default "google/cheza"

config DRIVER_TPM_SPI_BUS
	hex
	default 0x5

config EC_GOOGLE_CHROMEEC_SPI_BUS
	hex
	default 0xa

##########################################################
#### Update below when adding a new derivative board. ####
##########################################################

config MAINBOARD_PART_NUMBER
	string
	default "Cheza" if BOARD_GOOGLE_CHEZA

endif # BOARD_GOOGLE_CHEZA_COMMON
```

## src/mainboard/google/corsola/Kconfig
```kconfig
## SPDX-License-Identifier: GPL-2.0-only

config BOARD_GOOGLE_CORSOLA_COMMON
	def_bool BOARD_GOOGLE_KINGLER_COMMON || \
		 BOARD_GOOGLE_KRABBY_COMMON || \
		 BOARD_GOOGLE_STARYU_COMMON

config BOARD_GOOGLE_KINGLER_COMMON
	def_bool BOARD_GOOGLE_KINGLER || \
		 BOARD_GOOGLE_KYOGRE || \
		 BOARD_GOOGLE_PONYTA || \
		 BOARD_GOOGLE_SQUIRTLE || \
		 BOARD_GOOGLE_STEELIX || \
		 BOARD_GOOGLE_VOLTORB

config BOARD_GOOGLE_KRABBY_COMMON
	def_bool BOARD_GOOGLE_CHINCHOU || \
		 BOARD_GOOGLE_KRABBY || \
		 BOARD_GOOGLE_MAGIKARP || \
		 BOARD_GOOGLE_SKITTY || \
		 BOARD_GOOGLE_TENTACRUEL || \
		 BOARD_GOOGLE_VELUZA

config BOARD_GOOGLE_STARYU_COMMON
	def_bool BOARD_GOOGLE_STARMIE || \
		 BOARD_GOOGLE_WUGTRIO

if BOARD_GOOGLE_CORSOLA_COMMON

config CORSOLA_SDCARD_INIT
	def_bool BOARD_GOOGLE_KINGLER_COMMON || \
		 BOARD_GOOGLE_MAGIKARP || \
		 BOARD_GOOGLE_TENTACRUEL || \
		 BOARD_GOOGLE_WUGTRIO

config BOARD_SPECIFIC_OPTIONS
	def_bool y
	select SOC_MEDIATEK_MT8186
	select BOARD_ROMSIZE_KB_8192
	select MAINBOARD_HAS_CHROMEOS
	select CHROMEOS_USE_EC_WATCHDOG_FLAG if CHROMEOS
	select COMMON_CBFS_SPI_WRAPPER
	select SPI_FLASH
	select SPI_FLASH_INCLUDE_ALL_DRIVERS
	select COMMONLIB_STORAGE
	select COMMONLIB_STORAGE_MMC
	select EC_GOOGLE_CHROMEEC
	select EC_GOOGLE_CHROMEEC_BOARDID
	select EC_GOOGLE_CHROMEEC_SKUID
	select EC_GOOGLE_CHROMEEC_SPI
	select SPI_TPM if VBOOT
	select TPM_GOOGLE_TI50 if VBOOT
	select MAINBOARD_HAS_TPM2 if VBOOT
	select MAINBOARD_HAS_NATIVE_VGA_INIT
	select HAVE_LINEAR_FRAMEBUFFER
	select DRIVER_ANALOGIX_ANX7625 if BOARD_GOOGLE_CHINCHOU || \
					  BOARD_GOOGLE_KINGLER || \
					  BOARD_GOOGLE_KYOGRE || \
					  BOARD_GOOGLE_PONYTA || \
					  BOARD_GOOGLE_SQUIRTLE || \
					  BOARD_GOOGLE_STEELIX || \
					  BOARD_GOOGLE_VOLTORB
	select DRIVER_PARADE_PS8640 if BOARD_GOOGLE_KRABBY || \
				       BOARD_GOOGLE_MAGIKARP || \
				       BOARD_GOOGLE_SKITTY || \
				       BOARD_GOOGLE_STEELIX || \
				       BOARD_GOOGLE_TENTACRUEL || \
				       BOARD_GOOGLE_VELUZA
	select RTC
	select FW_CONFIG
	select FW_CONFIG_SOURCE_CHROMEEC_CBI
	select MIPI_PANEL_KD_KD101NE3_40TI if BOARD_GOOGLE_WUGTRIO
	select MIPI_PANEL_LCE_LMFBX101117480 if BOARD_GOOGLE_WUGTRIO
	select MIPI_PANEL_STA_ER88577 if BOARD_GOOGLE_WUGTRIO
	select MIPI_PANEL_STA_HIMAX83102_J02 if BOARD_GOOGLE_STARMIE
	select MIPI_PANEL_STA_ILI9882T if BOARD_GOOGLE_STARMIE

config VBOOT
	select EC_GOOGLE_CHROMEEC_SWITCHES
	select VBOOT_VBNV_FLASH

config MAINBOARD_DIR
	string
	default "google/corsola"

config MAINBOARD_PART_NUMBER
	string
	default "Chinchou" if BOARD_GOOGLE_CHINCHOU
	default "Kingler" if BOARD_GOOGLE_KINGLER
	default "Krabby" if BOARD_GOOGLE_KRABBY
	default "Kyogre" if BOARD_GOOGLE_KYOGRE
	default "Magikarp" if BOARD_GOOGLE_MAGIKARP
	default "Ponyta" if BOARD_GOOGLE_PONYTA
	default "Skitty" if BOARD_GOOGLE_SKITTY
	default "Squirtle" if BOARD_GOOGLE_SQUIRTLE
	default "Starmie" if BOARD_GOOGLE_STARMIE
	default "Steelix" if BOARD_GOOGLE_STEELIX
	default "Tentacruel" if BOARD_GOOGLE_TENTACRUEL
	default "Veluza" if BOARD_GOOGLE_VELUZA
	default "Voltorb" if BOARD_GOOGLE_VOLTORB
	default "Wugtrio" if BOARD_GOOGLE_WUGTRIO

config BOOT_DEVICE_SPI_FLASH_BUS
	int
	default 7

config DRIVER_TPM_SPI_BUS
	hex
	default 0x2

config EC_GOOGLE_CHROMEEC_SPI_BUS
	hex
	default 0x1
endif
```

## src/mainboard/google/corsola/Kconfig.name
```kconfig
## SPDX-License-Identifier: GPL-2.0-only

comment "Kingler (MediaTek Kompanio 520 (MT8186))"

config BOARD_GOOGLE_KINGLER
	bool "->  Kingler"

config BOARD_GOOGLE_KYOGRE
	bool "->  Kyogre"

config BOARD_GOOGLE_PONYTA
	bool "->  Ponyta"

config BOARD_GOOGLE_SQUIRTLE
	bool "->  Squirtle (Acer Chromebook Spin 311 (R724T))"

config BOARD_GOOGLE_STEELIX
	bool "->  Steelix/Magneton (see help text for details)"
	help
		The "Steelix" board supports the following devices:
		- Lenovo 300e Yoga Chromebook Gen 4 (Steelix, convertible)
		- Lenovo IdeaPad Slim 3 Chromebook (14M868) (Magneton, clamshell)

config BOARD_GOOGLE_VOLTORB
	bool "->  Voltorb (Acer Chromebook 311 (C723/C732T))"

comment "Krabby (MediaTek Kompanio 520 (MT8186))"

config BOARD_GOOGLE_CHINCHOU
	bool "->  Chinchou/Chinochou360 (see help text for details)"
	help
		The "Chinochou" board supports the following devices:
		- Asus Chromebook CZ1104CM2A/CZ1204CM2A
		- Asus Chromebook CZ1104FM2A/CZ1204FM2A/CZ1104CM2A/CZ1204CM2A
		- Asus Chromebook CZ1104FM2A/CZ1204FM2A Flip

config BOARD_GOOGLE_KRABBY
	bool "->  Krabby"

config BOARD_GOOGLE_MAGIKARP
	bool "->  Magikarp"

config BOARD_GOOGLE_SKITTY
	bool "->  Skitty"

config BOARD_GOOGLE_TENTACRUEL
	bool "->  Tentacruel/Tentacool (see help text for details)"
	help
		The "Tentacruel" board supports the following devices:
		- ASUS Chromebook CM14 Flip (CM1402F) (Tentacruel, convertible)
		- ASUS Chromebook CM14 (CM1402C) (Tentacool, clamshell)

config BOARD_GOOGLE_VELUZA
	bool "->  Veluza"

comment "Staryu (MediaTek Kompanio 528 (MT8186T))"

config BOARD_GOOGLE_STARMIE
	bool "->  Starmie (ASUS Chromebook Enterprise CM30 (CM3001))"

config BOARD_GOOGLE_WUGTRIO
	bool "->  Wugtrio"

config BOARD_GOOGLE_WYRDEER
	bool "->  Wyrdeer"
```

## src/mainboard/google/cosmos/Kconfig
```kconfig
##
## This file is part of the coreboot project.
##
## Copyright 2014 Google Inc.
##
## This program is free software; you can redistribute it and/or modify
## it under the terms of the GNU General Public License as published by
## the Free Software Foundation; version 2 of the License.
##
## This program is distributed in the hope that it will be useful,
## but WITHOUT ANY WARRANTY; without even the implied warranty of
## MERCHANTABILITY or FITNESS FOR A PARTICULAR PURPOSE.  See the
## GNU General Public License for more details.
##

if BOARD_GOOGLE_COSMOS

config BOARD_SPECIFIC_OPTIONS # dummy
	def_bool y
	select BOARD_ID_AUTO
	select BOARD_ROMSIZE_KB_2048
	select COMMON_CBFS_SPI_WRAPPER
	select HAVE_HARD_RESET
	select MAINBOARD_HAS_CHROMEOS
	select SOC_MARVELL_BG4CD
	select SPI_FLASH
	select SPI_FLASH_SPANSION

config CHROMEOS
	select CHROMEOS_VBNV_FLASH

config MAINBOARD_DIR
	string
	default google/cosmos

config MAINBOARD_PART_NUMBER
	string
	default "Cosmos"

config MAINBOARD_VENDOR
	string
	default "Google"

config BOOT_MEDIA_SPI_BUS
	int
	default 2

config DRAM_SIZE_MB
	int
	default 1024

endif #  BOARD_GOOGLE_COSMOS
```
