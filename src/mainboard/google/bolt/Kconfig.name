## src/mainboard/google/brox/Kconfig
```kconfig
## SPDX-License-Identifier: GPL-2.0-only

config BOARD_GOOGLE_BROX_COMMON
	def_bool n
	select DRIVERS_GENERIC_GPIO_KEYS
	select DRIVERS_I2C_GENERIC
	select DRIVERS_I2C_HID
	select DRIVERS_INTEL_DPTF
	select DRIVERS_INTEL_DPTF_SUPPORTS_TPCH
	select DRIVERS_INTEL_PMC
	select DRIVERS_INTEL_SOUNDWIRE
	select DRIVERS_INTEL_USB4_RETIMER
	select DRIVERS_SPI_ACPI
	select DRIVERS_WIFI_GENERIC
	select EC_GOOGLE_CHROMEEC
	select EC_GOOGLE_CHROMEEC_BOARDID
	select EC_GOOGLE_CHROMEEC_ESPI
	select EC_GOOGLE_CHROMEEC_SKUID
	select ENABLE_TCSS_USB_DETECTION if !(SOC_INTEL_TCSS_USE_PDC_PMC_USBC_MUX_CONFIGURATION || CHROMEOS)
	select FW_CONFIG
	select FW_CONFIG_SOURCE_CHROMEEC_CBI
	select GOOGLE_SMBIOS_MAINBOARD_VERSION
	select HAVE_ACPI_TABLES
	select HAVE_FSP_LOGO_SUPPORT if RUN_FSP_GOP
	select I2C_TPM
	select INTEL_LPSS_UART_FOR_CONSOLE
	select MAINBOARD_HAS_CHROMEOS
	select MAINBOARD_HAS_TPM2
	select PMC_IPC_ACPI_INTERFACE
	select SOC_INTEL_CSE_LITE_SKU
	select SOC_INTEL_CSE_SEND_EOP_ASYNC
	select SOC_INTEL_COMMON_BLOCK_USB4
	select SOC_INTEL_COMMON_BLOCK_TCSS
	select SOC_INTEL_ENABLE_USB4_PCIE_RESOURCES
	select SOC_INTEL_COMMON_BASECODE_DEBUG_FEATURE
	select SOC_INTEL_CSE_PRE_CPU_RESET_TELEMETRY_V1

config BOARD_GOOGLE_BASEBOARD_BROX
	def_bool n
	select BOARD_GOOGLE_BROX_COMMON
	select BOARD_ROMSIZE_KB_32768
	select DRIVERS_AUDIO_SOF
	select DRIVERS_GFX_GENERIC
	select HAVE_SLP_S0_GATE
	select MEMORY_SOLDERDOWN if !BOARD_GOOGLE_GREENBAYUPOC
	select SOC_INTEL_COMMON_BLOCK_IPU
	select SOC_INTEL_RAPTORLAKE
	select SOC_INTEL_ALDERLAKE_PCH_P
	select SOC_INTEL_COMMON_BLOCK_HDA_VERB
	select SOC_INTEL_TCSS_USE_PDC_PMC_USBC_MUX_CONFIGURATION
	select DRIVERS_INTEL_ISH
	select MAINBOARD_HAS_EARLY_LIBGFXINIT
	select SYSTEM_TYPE_LAPTOP
	select TPM_GOOGLE_TI50

config BOARD_GOOGLE_BROX
	select BOARD_GOOGLE_BASEBOARD_BROX
	select CHROMEOS_WIFI_SAR if CHROMEOS
	select USE_UNIFIED_AP_FIRMWARE_FOR_UFS_AND_NON_UFS

config BOARD_GOOGLE_BROX_TI_PDC
	select BOARD_GOOGLE_BASEBOARD_BROX
	select CHROMEOS_WIFI_SAR if CHROMEOS
	select USE_UNIFIED_AP_FIRMWARE_FOR_UFS_AND_NON_UFS

config BOARD_GOOGLE_BROX_EC_ISH
	select BOARD_GOOGLE_BASEBOARD_BROX
	select CHROMEOS_WIFI_SAR if CHROMEOS
	select SOC_INTEL_STORE_ISH_FW_VERSION

config BOARD_GOOGLE_LOTSO
	select BOARD_GOOGLE_BASEBOARD_BROX
	select CHROMEOS_WIFI_SAR if CHROMEOS
	select MAINBOARD_HAS_GOOGLE_STRAUSS_KEYBOARD
	select USE_UNIFIED_AP_FIRMWARE_FOR_UFS_AND_NON_UFS

config BOARD_GOOGLE_GREENBAYUPOC
	select BOARD_GOOGLE_BASEBOARD_BROX
	select CHROMEOS_WIFI_SAR if CHROMEOS
	select MEMORY_SODIMM

config BOARD_GOOGLE_JUBILANT
	select BOARD_GOOGLE_BASEBOARD_BROX
	select CHROMEOS_WIFI_SAR if CHROMEOS
	select DRIVERS_GENERIC_ALC1015
	select DRIVERS_I2C_SX9324
	select MAINBOARD_HAS_GOOGLE_STRAUSS_KEYBOARD
	select USE_UNIFIED_AP_FIRMWARE_FOR_UFS_AND_NON_UFS

if BOARD_GOOGLE_BROX_COMMON

config BASEBOARD_DIR
	string
	default "brox" if BOARD_GOOGLE_BASEBOARD_BROX

config CHROMEOS
	select EC_GOOGLE_CHROMEEC_SWITCHES
	select GBB_FLAG_DISABLE_PD_SOFTWARE_SYNC
	select HAS_RECOVERY_MRC_CACHE

config CHROMEOS_WIFI_SAR
	bool "Enable SAR options for ChromeOS build"
	depends on CHROMEOS
	select DSAR_ENABLE
	select GEO_SAR_ENABLE
	select SAR_ENABLE
	select USE_SAR

config DEVICETREE
	default "variants/baseboard/\$(CONFIG_BASEBOARD_DIR)/devicetree.cb"

config DRIVER_TPM_I2C_BUS
	hex
	default 0x4 if BOARD_GOOGLE_BASEBOARD_BROX

config PL4_LIMIT_FOR_CRITICAL_BAT_BOOT
	int
	default 9 if BOARD_GOOGLE_BROX
	default 14 if BOARD_GOOGLE_JUBILANT
	default 40 if BOARD_GOOGLE_LOTSO
	help
	  Select this if the variant has to boot even with low battery, critical battery
	  threshold, or when the battery is physically disconnected. PL4, which stands for
	  Processor Instantaneous Power or Absolute Peak Power, controls the highest power draw
	  from the processor at any given moment within the Pl1Tau duration. Therefore, PL4
	  acts as a failsafe mechanism to set an upper threshold limit for the processor's
	  instantaneous power draw. For a 30W adapter, the maximum peak power is set at 9
	  watts, which is 30W multiplied by 32% efficiency. This default pl4 value is set for
	  30W or any higher adapter rating, such as 45W or 65W.

config DRIVER_TPM_I2C_ADDR
	hex
	default 0x50

config FMDFILE
	default "src/mainboard/\$(CONFIG_MAINBOARD_DIR)/chromeos.fmd" if CHROMEOS

config TPM_TIS_ACPI_INTERRUPT
	int
	default 66 # GPE0_DW2_02 (GPP_E2)

config OVERRIDE_DEVICETREE
	default "variants/\$(CONFIG_VARIANT_DIR)/overridetree.cb"

config MAINBOARD_DIR
	default "google/brox"

config MAINBOARD_FAMILY
	string
	default "Google_Brox" if BOARD_GOOGLE_BASEBOARD_BROX

config MAINBOARD_PART_NUMBER
	default "Brox" if BOARD_GOOGLE_BROX
	default "Brox_Ec_Ish" if BOARD_GOOGLE_BROX_EC_ISH
	default "Brox_Ti_Pdc" if BOARD_GOOGLE_BROX_TI_PDC
	default "Greenbayupoc" if BOARD_GOOGLE_GREENBAYUPOC
	default "Jubilant" if BOARD_GOOGLE_JUBILANT
	default "Lotso" if BOARD_GOOGLE_LOTSO

config VARIANT_DIR
	default "brox" if BOARD_GOOGLE_BROX || BOARD_GOOGLE_BROX_EC_ISH || BOARD_GOOGLE_BROX_TI_PDC
	default "lotso" if BOARD_GOOGLE_LOTSO
	default "greenbayupoc" if BOARD_GOOGLE_GREENBAYUPOC
	default "jubilant" if BOARD_GOOGLE_JUBILANT

config VBOOT
	select VBOOT_LID_SWITCH

config UART_FOR_CONSOLE
	int
	default 0

config HAVE_WWAN_POWER_SEQUENCE
	def_bool n
	help
	  Select this if the variant has a WWAN module and requires the poweroff sequence
	  to be performed on shutdown. Must define WWAN_FCPO, WWAN_RST and WWAN_PERST GPIOs
	  in variant.h, as well as T1_OFF_MS (time between PERST & RST) and T2_OFF_MS (time
	  between RST and FCPO). WWAN_PERST and T1_OFF_MS are only necessary for PCIe WWAN
	  (when HAVE_PCIE_WWAN is also selected).

config HAVE_PCIE_WWAN
	def_bool n

config USE_PM_ACPI_TIMER
	default n

config MEMORY_SODIMM
	def_bool n
	select SPD_CACHE_ENABLE
	select SPD_CACHE_IN_FMAP

config MEMORY_SOLDERDOWN
	def_bool n
	select CHROMEOS_DRAM_PART_NUMBER_IN_CBI if CHROMEOS
	select HAVE_SPD_IN_CBFS

config HAVE_SLP_S0_GATE
	def_bool n

config PCIEXP_DEFAULT_MAX_RESIZABLE_BAR_BITS
	int
	default 33

endif # BOARD_GOOGLE_BROX_COMMON
```

## src/mainboard/google/brox/Kconfig.name
```kconfig
## SPDX-License-Identifier: GPL-2.0-only

comment "Brox"

config BOARD_GOOGLE_BROX
	bool "->  Brox"

config BOARD_GOOGLE_BROX_RTK_EC
	bool "->  Brox RTK EC"

config BOARD_GOOGLE_BROX_EC_ISH
	bool "->  Brox EC ISH"

config BOARD_GOOGLE_BROX_TI_PDC
	bool "->  Brox TI PDC"

config BOARD_GOOGLE_CABOC
	bool "->  Caboc"

config BOARD_GOOGLE_GREENBAYUPOC
	bool "->  Greenbayupoc"

config BOARD_GOOGLE_JUBILANT
	bool "->  Jubilant (Multiple devices - See help text)"
	help
	  The Jubilant board supports the following devices:
	  - Acer Chromebook Plus 514
	  - Acer Chromebook Plus 516 (CB516-1H,CB516-1HT)

config BOARD_GOOGLE_LOTSO
	bool "->  Lotso (Lenovo Chromebook Plus 2-in-1)"
```

## src/mainboard/google/brya/Kconfig.name
```kconfig
## SPDX-License-Identifier: GPL-2.0-only

comment "Brya"

config BOARD_GOOGLE_AGAH
	bool "->  Agah"

config BOARD_GOOGLE_ANAHERA
	bool "->  Anahera (HP Elite c640 14 inch G3 Chromebook)"

config BOARD_GOOGLE_ANAHERA4ES
	bool "->  Anahera4ES"

config BOARD_GOOGLE_ANRAGGAR
	bool "->  Anraggar (ASUS Chromebook CR12 CR1204C)"

config BOARD_GOOGLE_AURASH
	bool "->  Aurash (AOpen Chromebox Commercial 3)"

config BOARD_GOOGLE_BANSHEE
	bool "->  Banshee (Framework Laptop Chromebook Edition)"

config BOARD_GOOGLE_BRASK
	bool "->  Brask"

config BOARD_GOOGLE_BRYA0
	bool "->  Brya 0"

config BOARD_GOOGLE_CRAASK
	bool "->  Craask (Acer Chromebook Spin 512)"

config BOARD_GOOGLE_CRAASKOV
	bool "->  Craaskov (Acer Chromebook Spin 312)"

config BOARD_GOOGLE_CONSTITUTION
	bool "->  Constitution (Google Meet Series Two)"

config BOARD_GOOGLE_CROTA
	bool "->  Crota (Multiple devices - See help text)"
	help
	  The Crota board supports the following devices:
	  - Dell Latitude 5430 Chromebook
	  - Dell Latitude 5430 2-in-1 Chromebook

config BOARD_GOOGLE_DIRKS
	bool "->  Dirks (Acer Chromebox Mini CXM2 (TWL))"

config BOARD_GOOGLE_DOCHI
	bool "->  Dochi (Acer Chromebook Plus Spin 514)"

config BOARD_GOOGLE_DOMIKA
	bool "->  Domika (Multiple devices - See help text)"
	help
	  The Domika board supports the following devices:
	  - HP Fortis G1i 11 Chromebook
	  - HP Fortis Flip G1i 11 Chromebook
	  - HP Fortis G1i 14 Chromebook

config BOARD_GOOGLE_FELWINTER
	bool "->  Felwinter (ASUS Chromebook Flip CX5(CX5601))"

config BOARD_GOOGLE_GAELIN
	bool "->  Gaelin"

config BOARD_GOOGLE_GIMBLE
	bool "->  Gimble (HP Chromebook x360 14c-cd0)"

config BOARD_GOOGLE_GIMBLE4ES
	bool "->  Gimble4ES"

config BOARD_GOOGLE_GLADIOS
	bool "->  Gladios (HP Chromebox Enterprise G4)"

config BOARD_GOOGLE_GLASSWAY
	bool "->  Glassway (CTL Chromebook Plus PX141GX)"

config BOARD_GOOGLE_GOTHRAX
	bool "->  Gothrax (Multiple OEM Chromebooks)"

config BOARD_GOOGLE_GUREN
	bool "->  Guren (CTL Chromebook PX121E)"

config BOARD_GOOGLE_HADES
	bool "->  Hades"

config BOARD_GOOGLE_KANO
	bool "->  Kano (Acer Chromebook Spin 714)"

config BOARD_GOOGLE_KALADIN
	bool "->  Kaladin"

config BOARD_GOOGLE_KINOX
	bool "->  Kinox (Lenovo ThinkCentre M60q Chromebox)"

config BOARD_GOOGLE_KULDAX
	bool "->  Kuldax (ASUS Chromebox 5/5a (CN67))"

config BOARD_GOOGLE_JOXER
	bool "->  Joxer (HP Chromebook x360 14b)"

config BOARD_GOOGLE_LISBON
	bool "->  Lisbon (Multiple devices - See help text)"
	help
	  The Lisbon board supports the following devices:
	  - CTL Chromebox CBx3 / CTL Chromebox Enterprise CBx3
	  - Centerm Chromebox D661 / Centerm Chromebox Enterprise D661
	  - Promethean Chromebox 3

config BOARD_GOOGLE_MARASOV
	bool "->  Marasov (ASUS Chromebook Plus CX34 CX3402)"

config BOARD_GOOGLE_MITHRAX
	bool "->  Mithrax (ASUS Chromebook CX34 Flip (CX3401))"

config BOARD_GOOGLE_MOLI
	bool "->  Moli (Acer Chromebox CXI5)"

config BOARD_GOOGLE_MOXIE
	bool "->  Moxie (Acer Chromebox CXI6)"

config BOARD_GOOGLE_NIVVIKS
	bool "->  Nivviks"

config BOARD_GOOGLE_NEREID
	bool "->  Nereid"

config BOARD_GOOGLE_NOKRIS
	bool "->  Nokris"

config BOARD_GOOGLE_OMNIGUL
	bool "->  Omnigul (Multiple devices - See help text)"
	help
	  The Omnigul board supports the following devices:
	  - Acer Chromebook Plus 515 (CB515-2H/2HT)
	  - Acer Chromebook Plus Enterprise 515 (CBE595-2/2T)

config BOARD_GOOGLE_OSIRIS
	bool "->  Osiris (Acer Chromebook 516 GE)"

config BOARD_GOOGLE_PIRRHA
	bool "->  Pirrha"

config BOARD_GOOGLE_PRIMUS
	bool "->  Primus (Lenovo ThinkPad C14 Gen 1 Chromebook)"

config BOARD_GOOGLE_PUJJO
	bool "->  Pujjo (Lenovo 500e Yoga/Flex 3i Chromebook)"

config BOARD_GOOGLE_PUJJONIRU
	bool "->  Pujjoniru (Lenovo Chromebook Plus 2-in-1 14ITN10)"

config BOARD_GOOGLE_QUANDISO
	bool "->  Quandiso (CTL Chromebook NL73)"

config BOARD_GOOGLE_QUANDISO2
	bool "->  Quandiso2 (CTL Chromebook NL73 Gen 2)"

config BOARD_GOOGLE_REDRIX
	bool "->  Redrix (HP Elite Dragonfly Chromebook)"

config BOARD_GOOGLE_REDRIX4ES
	bool "->  Redrix4ES"

config BOARD_GOOGLE_RIVEN
	bool "->  Riven (Acer Chromebook Spin 511)"

config BOARD_GOOGLE_RULL
	bool "->  Rull (Acer Chromebook 514 C937)"

config BOARD_GOOGLE_SKOLAS
	bool "->  Skolas"

config BOARD_GOOGLE_SKOLAS4ES
	bool "->  Skolas4ES"

config BOARD_GOOGLE_TAEKO
	bool "->  Taeko (Lenovo IdeaPad/Flex 5i Chromebook 14)"

config BOARD_GOOGLE_TAEKO4ES
	bool "->  Taeko4ES"

config BOARD_GOOGLE_TANIKS
	bool "->  Taniks (Lenovo IdeaPad Gaming Chromebook 16)"

config BOARD_GOOGLE_TELIKS
	bool "->  Teliks (ASUS Chromebook CR11 (CR1104CTA))"

config BOARD_GOOGLE_TEREID
	bool "->  Tereid"

config BOARD_GOOGLE_TIVVIKS
	bool "-> Tivviks"

config BOARD_GOOGLE_TRULO
	bool "->  Trulo"

config BOARD_GOOGLE_ULDREN
	bool "->  Uldren (Dell Chromebook 3120)"

config BOARD_GOOGLE_ULDRENITE
	bool "->  Uldrenite"

config BOARD_GOOGLE_VELL
	bool "->  Vell (HP Dragonfly Pro Chromebook)"

config BOARD_GOOGLE_VOLMAR
	bool "->  Volmar (Acer Chromebook Vero 514)"

config BOARD_GOOGLE_XIVU
	bool "->  Xivu (Asus Chromebook CR11 [CR1102C])"

config BOARD_GOOGLE_YAVIKS
	bool "->  Yaviks (HP Chromebook 15.6)"

config BOARD_GOOGLE_YAVILLA
	bool "->  Yavilla (HP Fortis 11 G10 Chromebook)"

config BOARD_GOOGLE_ZYDRON
	bool "->  Zydron"

config BOARD_GOOGLE_XOL
	bool "->  Xol (Galaxy Chromebook Plus)"

config BOARD_GOOGLE_NOVA
	bool "->  Nova"

config BOARD_GOOGLE_BUJIA
	bool "->  Bujia (Multiple devices - See help text)"
	help
	  The Bujia board supports the following devices:
	  - AOPEN Chromebox OPS / AOPEN Chromebox Enterprise OPS
	  - IMAGO Chromebox OPS
	  - Satsuki Chromebox OPS / Satsuki Chromebox Enterprise OPS
	  - ViewSonic Bujia

config BOARD_GOOGLE_YAVISTA
	bool "->  Yavista"

config BOARD_GOOGLE_SUNDANCE
	bool "->  Sundance (NEC Chromebook Y4)"

config BOARD_GOOGLE_PUJJOGA
	bool "->  Pujjoga (Lenovo 500e Chromebook Gen 4s)"

config BOARD_GOOGLE_PUJJOGATWIN
	bool "->  Pujjogatwin (Lenovo 500e Chromebook Gen 4s)"

config BOARD_GOOGLE_PUJJOLO
	bool "->  Pujjolo"

config BOARD_GOOGLE_ORISA
	bool "->  Orisa"

config BOARD_GOOGLE_TELITH
	bool "->  Telith (ASUS Chromebook CX15 (CX1505CTA))"

config BOARD_GOOGLE_MELIKS
	bool "->  Meliks"

config BOARD_GOOGLE_EPIC
	bool "->  Epic"

config BOARD_GOOGLE_PUJJOCENTO
	bool "->  Pujjocento"
```

## src/mainboard/google/butterfly/Kconfig
```kconfig
if BOARD_GOOGLE_BUTTERFLY

config BOARD_SPECIFIC_OPTIONS
	def_bool y
	select BOARD_ROMSIZE_KB_8192
	select EC_QUANTA_ENE_KB3940Q
	select GFX_GMA_PANEL_1_ON_LVDS
	select HAVE_ACPI_RESUME
	select HAVE_ACPI_TABLES
	select HAVE_CMOS_DEFAULT
	select HAVE_IFD_BIN
	select HAVE_ME_BIN
	select HAVE_OPTION_TABLE
	select INTEL_INT15
	select MAINBOARD_HAS_CHROMEOS
	select MAINBOARD_HAS_LIBGFXINIT
	select MAINBOARD_HAS_LPC_TPM
	select MAINBOARD_HAS_TPM1
	select NORTHBRIDGE_INTEL_SANDYBRIDGE
	select SANDYBRIDGE_VBOOT_IN_ROMSTAGE
	select SERIRQ_CONTINUOUS_MODE	# Workaround for EC/KBC IRQ1.
	select SOUTHBRIDGE_INTEL_C216
	select SYSTEM_TYPE_LAPTOP

config VBOOT
	select VBOOT_VBNV_CMOS

config MAINBOARD_DIR
	default "google/butterfly"

config MAINBOARD_PART_NUMBER
	default "Butterfly"

config MAINBOARD_VENDOR
	string
	default "Hewlett-Packard"

config MAINBOARD_SMBIOS_MANUFACTURER
	string
	default "GOOGLE"

endif # BOARD_GOOGLE_BUTTERFLY
```

## src/mainboard/google/butterfly/Kconfig.name
```kconfig
## SPDX-License-Identifier: GPL-2.0-only

comment "Butterfly (Intel SandyBridge (2nd Gen))"

config BOARD_GOOGLE_BUTTERFLY
	bool "->  Butterfly (HP Pavilion Chromebook 14)"
```
