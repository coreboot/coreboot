## src/mainboard/google/deltaur/Kconfig
```kconfig
config BOARD_GOOGLE_BASEBOARD_DELTAUR
	def_bool n
	select BOARD_ROMSIZE_KB_32768
	select DRIVERS_I2C_GENERIC
	select DRIVERS_I2C_HID
	select DRIVERS_INTEL_ISH
	select DRIVERS_SPI_ACPI
	select DRIVERS_USB_ACPI
	select EC_GOOGLE_WILCO
	select HAVE_ACPI_RESUME
	select HAVE_ACPI_TABLES
	select INTEL_LPSS_UART_FOR_CONSOLE
	select MAINBOARD_HAS_CHROMEOS
	select MAINBOARD_HAS_I2C_TPM_CR50
	select MAINBOARD_HAS_TPM2
	select MAINBOARD_USES_IFD_EC_REGION
	select SOC_INTEL_COMMON_BLOCK_HDA_VERB
	select SOC_INTEL_TIGERLAKE
	select SYSTEM_TYPE_LAPTOP

config BOARD_GOOGLE_DELTAN
	select BOARD_GOOGLE_BASEBOARD_DELTAUR
	select MAINBOARD_USES_IFD_GBE_REGION

config BOARD_GOOGLE_DELTAUR
	select BOARD_GOOGLE_BASEBOARD_DELTAUR

if BOARD_GOOGLE_BASEBOARD_DELTAUR

config IGNORE_IASL_MISSING_DEPENDENCY
	def_bool y

config CHROMEOS
	select GBB_FLAG_DISABLE_EC_SOFTWARE_SYNC
	select GBB_FLAG_FORCE_DEV_BOOT_ALTFW
	select GBB_FLAG_FORCE_DEV_BOOT_USB
	select GBB_FLAG_FORCE_DEV_SWITCH_ON

config DEVICETREE
	default "variants/baseboard/devicetree.cb"

config DRIVER_TPM_I2C_BUS
	hex
	default 0x3

config DRIVER_TPM_I2C_ADDR
	hex
	default 0x50

config FMDFILE
	default "src/mainboard/\$(CONFIG_MAINBOARD_DIR)/chromeos-gbe.fmd" if BOARD_GOOGLE_DELTAN
	default "src/mainboard/\$(CONFIG_MAINBOARD_DIR)/chromeos.fmd" if BOARD_GOOGLE_DELTAUR

config OVERRIDE_DEVICETREE
	default "variants/\$(CONFIG_VARIANT_DIR)/overridetree.cb"

config POWER_OFF_ON_CR50_UPDATE
	bool
	default n

config MAINBOARD_DIR
	default "google/deltaur"

config MAINBOARD_FAMILY
	string
	default "Google_Deltaur"

config MAINBOARD_PART_NUMBER
	default "Deltan" if BOARD_GOOGLE_DELTAN
	default "Deltaur" if BOARD_GOOGLE_DELTAUR

config TPM_TIS_ACPI_INTERRUPT
	int
	default 23  # GPE0_DW0_23 (GPP_C23)

config UART_FOR_CONSOLE
	int
	default 2

config VARIANT_DIR
	default "deltan" if BOARD_GOOGLE_DELTAN
	default "deltaur" if BOARD_GOOGLE_DELTAUR

config VBOOT
	select HAS_RECOVERY_MRC_CACHE
	select VBOOT_LID_SWITCH

endif # BOARD_GOOGLE_BASEBOARD_DELTAUR
```

## src/mainboard/google/deltaur/Kconfig.name
```kconfig
comment "Deltaur"

config BOARD_GOOGLE_DELTAN
	bool "->  Deltan"

config BOARD_GOOGLE_DELTAUR
	bool "->  Deltaur"
```

## src/mainboard/google/dragonegg/Kconfig
```kconfig
config BOARD_GOOGLE_BASEBOARD_DRAGONEGG
	def_bool n
	select BOARD_ROMSIZE_KB_32768
	select DRIVERS_I2C_GENERIC
	select DRIVERS_I2C_HID
	select DRIVERS_SPI_ACPI
	select EC_GOOGLE_CHROMEEC
	select EC_GOOGLE_CHROMEEC_ESPI
	select HAVE_ACPI_RESUME
	select HAVE_ACPI_TABLES
	select INTEL_LPSS_UART_FOR_CONSOLE
	select MAINBOARD_HAS_CHROMEOS
	select SOC_INTEL_ICELAKE

if BOARD_GOOGLE_BASEBOARD_DRAGONEGG

config CHROMEOS
	bool
	default y
	select GBB_FLAG_FORCE_MANUAL_RECOVERY

config DEVICETREE
	string
	default "variants/baseboard/devicetree.cb"

config DIMM_SPD_SIZE
	int
	default 512

# Select this option to enable use of cr50 SPI TPM on dragon egg.
config DRAGONEGG_USE_SPI_TPM
	bool
	default y
	select MAINBOARD_HAS_SPI_TPM_CR50
	select MAINBOARD_HAS_TPM2

config DRIVER_TPM_SPI_BUS
	depends on DRAGONEGG_USE_SPI_TPM
	default 0x1

config MAINBOARD_DIR
	string
	default "google/dragonegg"

config MAINBOARD_PART_NUMBER
	string
	default "Dragonegg"

config MAINBOARD_FAMILY
	string
	default "Google_Dragonegg"

config MAX_CPUS
	int
	default 8

config TPM_TIS_ACPI_INTERRUPT
	int
	default 48 # GPE0_DW1_16 (GPP_D16)

config VARIANT_DIR
	string
	default "dragonegg" if BOARD_GOOGLE_DRAGONEGG

config UART_FOR_CONSOLE
	int
	default 0

config VBOOT
	select VBOOT_LID_SWITCH
	select EC_GOOGLE_CHROMEEC_SWITCHES
	select HAS_RECOVERY_MRC_CACHE
	select MRC_CLEAR_NORMAL_CACHE_ON_RECOVERY_RETRAIN

endif # BOARD_GOOGLE_BASEBOARD_DRAGONEGG
```

## src/mainboard/google/dragonegg/Kconfig.name
```kconfig
comment "DragonEgg"

config BOARD_GOOGLE_DRAGONEGG
	bool "->  DragonEgg"
	select BOARD_GOOGLE_BASEBOARD_DRAGONEGG
```

## src/mainboard/google/drallion/Kconfig
```kconfig
config BOARD_GOOGLE_BASEBOARD_DRALLION
	def_bool n
	select BOARD_ROMSIZE_KB_32768
	select DRIVERS_GFX_GENERIC
	select DRIVERS_I2C_GENERIC
	select DRIVERS_I2C_HID
	select DRIVERS_INTEL_ISH
	select DRIVERS_SPI_ACPI
	select DRIVERS_USB_ACPI
	select EC_GOOGLE_WILCO
	select GOOGLE_SMBIOS_MAINBOARD_VERSION
	select HAVE_ACPI_RESUME
	select HAVE_ACPI_TABLES
	select HAVE_SPD_IN_CBFS
	select I2C_TPM
	select INTEL_LPSS_UART_FOR_CONSOLE
	select MAINBOARD_HAS_CHROMEOS
	select MAINBOARD_HAS_TPM2
	select MAINBOARD_USES_IFD_EC_REGION
	select SMBIOS_SERIAL_FROM_VPD if VPD
	select SOC_INTEL_COMETLAKE_1
	select SOC_INTEL_COMMON_BLOCK_HDA_VERB
	select SOC_INTEL_COMMON_BLOCK_SMM_ESPI_DISABLE
	select SYSTEM_TYPE_LAPTOP
	select TPM_GOOGLE_CR50

config BOARD_GOOGLE_DRALLION
	select BOARD_GOOGLE_BASEBOARD_DRALLION

if BOARD_GOOGLE_BASEBOARD_DRALLION

config DISABLE_HECI1_AT_PRE_BOOT
	default y

config CHROMEOS
	select GBB_FLAG_FORCE_DEV_SWITCH_ON
	select GBB_FLAG_FORCE_DEV_BOOT_USB
	select GBB_FLAG_FORCE_DEV_BOOT_ALTFW
	select GBB_FLAG_DISABLE_EC_SOFTWARE_SYNC

config CHROMEOS_WIFI_SAR
	bool "Enable SAR options for ChromeOS build"
	depends on CHROMEOS
	select DSAR_ENABLE
	select GEO_SAR_ENABLE
	select SAR_ENABLE
	select USE_SAR

config DIMM_MAX
	default 2

config DRIVER_TPM_I2C_BUS
	hex
	default 0x4

config DRIVER_TPM_I2C_ADDR
	hex
	default 0x50

config TPM_TIS_ACPI_INTERRUPT
	int
	default 82  # GPE0_DW2_18 (GPP_D18)

config POWER_OFF_ON_CR50_UPDATE
	bool
	default n

config MAINBOARD_DIR
	default "google/drallion"

config MAINBOARD_FAMILY
	string
	default "Google_Drallion" if BOARD_GOOGLE_DRALLION

config MAINBOARD_PART_NUMBER
	default "Drallion" if BOARD_GOOGLE_DRALLION

config UART_FOR_CONSOLE
	int
	default 0 if BOARD_GOOGLE_DRALLION

config VARIANT_DIR
	default "drallion" if BOARD_GOOGLE_DRALLION

config DEVICETREE
	default "variants/\$(CONFIG_VARIANT_DIR)/devicetree.cb"

config VBOOT
	select HAS_RECOVERY_MRC_CACHE
	select VBOOT_LID_SWITCH

endif # BOARD_GOOGLE_BASEBOARD_DRALLION
```

## src/mainboard/google/drallion/Kconfig.name
```kconfig
## SPDX-License-Identifier: GPL-2.0-only

comment "Drallion (Intel CometLake (10th Gen) with ISH)"

config BOARD_GOOGLE_DRALLION
	bool "->  Drallion/Drallion360 (Dell Latitude 7410 Chromebook Enterprise)"
```

## src/mainboard/google/enguarde/Kconfig
```kconfig
if BOARD_GOOGLE_ENGUARDE

config BOARD_SPECIFIC_OPTIONS
	def_bool y
	select SOC_INTEL_BAYTRAIL
	select EC_GOOGLE_CHROMEEC
	select ENABLE_BUILTIN_COM1
	select BOARD_ROMSIZE_KB_8192
	select HAVE_ACPI_TABLES
	select HAVE_OPTION_TABLE
	select HAVE_ACPI_RESUME
	select MAINBOARD_HAS_CHROMEOS
	select MAINBOARD_HAS_LPC_TPM

config CHROMEOS
	select VBOOT_VBNV_CMOS
	select LID_SWITCH
	select EC_GOOGLE_CHROMEEC_SWITCHES
	select EC_SOFTWARE_SYNC
	select VIRTUAL_DEV_SWITCH

config MAINBOARD_DIR
	string
	default google/enguarde

config MAINBOARD_PART_NUMBER
	string
	default "Enguarde"

config VGA_BIOS_FILE
	string
	default "pci8086,0f31.rom"

config HAVE_IFD_BIN
	bool
	default n

config HAVE_ME_BIN
	bool
	default n

config EC_GOOGLE_CHROMEEC_BOARDNAME
	string
	default ""

config GBB_HWID
	string
	depends on CHROMEOS
	default "ENGUARDE TEST A-A 0128"

endif # BOARD_GOOGLE_ENGUARDE
```

## src/mainboard/google/eve/Kconfig
```kconfig
if BOARD_GOOGLE_EVE

config BOARD_SPECIFIC_OPTIONS
	def_bool y
	select BOARD_ROMSIZE_KB_16384
	select DRIVERS_I2C_GENERIC
	select DRIVERS_I2C_HID
	select DRIVERS_I2C_MAX98927
	select DRIVERS_I2C_RT5663
	select DRIVERS_SPI_ACPI
	select DRIVERS_USB_ACPI
	select EC_GOOGLE_CHROMEEC
	select EC_GOOGLE_CHROMEEC_BOARDID
	select EC_GOOGLE_CHROMEEC_ESPI
	select HAVE_ACPI_RESUME
	select HAVE_ACPI_TABLES
	select INTEL_GMA_HAVE_VBT
	select INTEL_LPSS_UART_FOR_CONSOLE
	select MAINBOARD_HAS_CHROMEOS
	select MAINBOARD_HAS_I2C_TPM_CR50
	select MAINBOARD_HAS_LIBGFXINIT
	select MAINBOARD_HAS_TPM2
	select SOC_INTEL_KABYLAKE
	select SYSTEM_TYPE_CONVERTIBLE
	select HAVE_SPD_IN_CBFS

config DISABLE_HECI1_AT_PRE_BOOT
	default y

config VBOOT
	select EC_GOOGLE_CHROMEEC_SWITCHES
	select HAS_RECOVERY_MRC_CACHE
	select VBOOT_LID_SWITCH

config CHROMEOS
	select DSAR_ENABLE
	select SAR_ENABLE
	select USE_SAR

config DRIVER_TPM_I2C_BUS
	hex
	default 0x1

config DRIVER_TPM_I2C_ADDR
	hex
	default 0x50

config TPM_TIS_ACPI_INTERRUPT
	int
	default 64  # GPE0_DW2_00 (GPP_E0)

config MAINBOARD_DIR
	default "google/eve"

config MAINBOARD_PART_NUMBER
	default "Eve"

config MAINBOARD_FAMILY
	string
	default "Google_Eve"

config INCLUDE_NHLT_BLOBS
	bool "Include blobs for audio."
	select NHLT_RT5514
	select NHLT_RT5663
	select NHLT_MAX98927

config UART_FOR_CONSOLE
	int
	default 2

config USE_PM_ACPI_TIMER
	default n
endif
```

## src/mainboard/google/eve/Kconfig.name
```kconfig
## SPDX-License-Identifier: GPL-2.0-only

comment "Eve (Intel KabyLake (7th Gen))"

config BOARD_GOOGLE_EVE
	bool "->  Eve (Google Pixelbook)"
```

## src/mainboard/google/falco/Kconfig
```kconfig
if BOARD_GOOGLE_FALCO

config BOARD_SPECIFIC_OPTIONS # dummy
	def_bool y
	select ARCH_X86
	select CPU_INTEL_SOCKET_RPGA989
	select NORTHBRIDGE_INTEL_HASWELL
	select SOUTHBRIDGE_INTEL_LYNXPOINT
	select INTEL_LYNXPOINT_LP
	select BOARD_ROMSIZE_KB_8192
	select EC_GOOGLE_CHROMEEC
	select EC_SOFTWARE_SYNC
	select VIRTUAL_DEV_SWITCH
	select HAVE_ACPI_TABLES
	select HAVE_OPTION_TABLE
	select HAVE_ACPI_RESUME
	select MMCONF_SUPPORT
	select HAVE_SMI_HANDLER
	select CHROMEOS
	select EXTERNAL_MRC_BLOB
	select CACHE_ROM
	select MARK_GRAPHICS_MEM_WRCOMB
	select MONOTONIC_TIMER_MSR

config VBOOT_RAMSTAGE_INDEX
	hex
	default 0x2

config MAINBOARD_DIR
	string
	default google/falco

config MAINBOARD_PART_NUMBER
	string
	default "Falco"

config MMCONF_BASE_ADDRESS
	hex
	default 0xf0000000

config IRQ_SLOT_COUNT
	int
	default 18

config MAX_CPUS
	int
	default 8

config VGA_BIOS_FILE
	string
	default "pci8086,0166.rom"

endif
```

## src/mainboard/google/fatcat/Kconfig
```kconfig
## SPDX-License-Identifier: GPL-2.0-only

config BOARD_GOOGLE_FATCAT_COMMON
	def_bool n
	select BOARD_ROMSIZE_KB_32768
	select CPU_INTEL_SOCKET_OTHER
	select DRIVERS_GFX_GENERIC
	select DRIVERS_I2C_GENERIC
	select DRIVERS_I2C_HID
	select DRIVERS_INTEL_DPTF
	select DRIVERS_INTEL_MIPI_CAMERA
	select DRIVERS_INTEL_PMC
	select DRIVERS_INTEL_SOUNDWIRE
	select DRIVERS_WWAN_FM350GL
	select DRIVERS_AUDIO_SOF
	select DRIVERS_SOUNDWIRE_ALC_BASE_7XX
	select DRIVERS_SPI_ACPI
	select DUMP_SMBIOS_TYPE17
	select EC_ACPI
	select EC_GOOGLE_CHROMEEC
	select EC_GOOGLE_CHROMEEC_BOARDID
	select EC_GOOGLE_CHROMEEC_ESPI
	select EC_GOOGLE_CHROMEEC_SKUID
	select EC_GOOGLE_CHROMEEC_SMBIOS
	select FW_CONFIG
	select FW_CONFIG_SOURCE_CHROMEEC_CBI
	select GENERATE_SMBIOS_TABLES
	select GOOGLE_SMBIOS_MAINBOARD_VERSION
	select HAVE_ACPI_RESUME
	select HAVE_ACPI_TABLES
	select HAVE_SPD_IN_CBFS
	select I2C_TPM
	select INTEL_LPSS_UART_FOR_CONSOLE
	select MAINBOARD_DISABLE_STAGE_CACHE
	select MAINBOARD_HAS_TPM2
	select MB_COMPRESS_RAMSTAGE_LZ4
	select PMC_IPC_ACPI_INTERFACE
	select SOC_INTEL_COMMON_BLOCK_VARIANT_POWER_LIMIT
	select SOC_INTEL_CSE_LITE_SYNC_BY_PAYLOAD
	select SOC_INTEL_CSE_SEND_EOP_BY_PAYLOAD
	select SOC_INTEL_PANTHERLAKE_U_H
	select SOC_INTEL_TCSS_USE_PDC_PMC_USBC_MUX_CONFIGURATION

config BOARD_GOOGLE_BASEBOARD_FATCAT
	def_bool n
	select BOARD_GOOGLE_FATCAT_COMMON
	select CHROMEOS_WIFI_SAR if CHROMEOS
	select DRIVERS_INTEL_ISH
	select DRIVER_INTEL_ISH_HAS_MAIN_FW
	select DRIVERS_INTEL_USB4_RETIMER
	select MAINBOARD_HAS_CHROMEOS
	select MEMORY_SOLDERDOWN
	select SOC_INTEL_COMMON_BLOCK_HDA_VERB
	select SOC_INTEL_IOE_DIE_SUPPORT
	select SOC_INTEL_ENABLE_USB4_PCIE_RESOURCES
	select SYSTEM_TYPE_LAPTOP
	select TPM_GOOGLE_TI50

config BOARD_GOOGLE_MODEL_FATCAT
	def_bool n
	select BOARD_GOOGLE_BASEBOARD_FATCAT
	select DRIVERS_GENERIC_BAYHUB_LV2
	select DRIVERS_GENERIC_MAX98357A
	select DRIVERS_INTEL_TOUCH
	select FSP_UGOP_EARLY_SIGN_OF_LIFE

config BOARD_GOOGLE_MODEL_FELINO
	def_bool n
	select BOARD_GOOGLE_BASEBOARD_FATCAT
	select FSP_UGOP_EARLY_SIGN_OF_LIFE
	select HAVE_SLP_S0_GATE
	select DRIVERS_SOUNDWIRE_ALC1320
	select MAINBOARD_HAS_GOOGLE_STRAUSS_KEYBOARD

config BOARD_GOOGLE_FATCAT
	select BOARD_GOOGLE_MODEL_FATCAT
	select EC_GOOGLE_CHROMEEC_MEC
	select MAINBOARD_USES_IFD_EC_REGION

config BOARD_GOOGLE_FATCAT4ES
	select BOARD_GOOGLE_MODEL_FATCAT
	select EC_GOOGLE_CHROMEEC_MEC
	select MAINBOARD_USES_IFD_EC_REGION
	select SOC_INTEL_PANTHERLAKE_PRE_PRODUCTION_SILICON

config BOARD_GOOGLE_FATCATISH
	select BOARD_GOOGLE_MODEL_FATCAT
	select EC_GOOGLE_CHROMEEC_MEC
	select MAINBOARD_USES_IFD_EC_REGION

config BOARD_GOOGLE_FATCATNUVO
	select BOARD_GOOGLE_MODEL_FATCAT

config BOARD_GOOGLE_FATCATNUVO4ES
	select BOARD_GOOGLE_MODEL_FATCAT
	select SOC_INTEL_PANTHERLAKE_PRE_PRODUCTION_SILICON

config BOARD_GOOGLE_FATCATITE
	select BOARD_GOOGLE_MODEL_FATCAT

config BOARD_GOOGLE_FATCATITE4ES
	select BOARD_GOOGLE_MODEL_FATCAT
	select SOC_INTEL_PANTHERLAKE_PRE_PRODUCTION_SILICON

config BOARD_GOOGLE_FELINO
	select BOARD_GOOGLE_MODEL_FELINO
	select SOC_INTEL_PANTHERLAKE_PRE_PRODUCTION_SILICON

config BOARD_GOOGLE_FELINO4ES
	select BOARD_GOOGLE_MODEL_FELINO
	select SOC_INTEL_PANTHERLAKE_PRE_PRODUCTION_SILICON

config BOARD_GOOGLE_FRANCKA
	select BOARD_GOOGLE_BASEBOARD_FATCAT
	select DRIVERS_SOUNDWIRE_ALC1320
	select HAVE_SLP_S0_GATE
	select SOC_INTEL_PANTHERLAKE_PRE_PRODUCTION_SILICON

config BOARD_GOOGLE_KINMEN
	select BOARD_GOOGLE_BASEBOARD_FATCAT
	select HAVE_SLP_S0_GATE
	select MAINBOARD_HAS_GOOGLE_STRAUSS_KEYBOARD

if BOARD_GOOGLE_FATCAT_COMMON

config BASEBOARD_DIR
	string
	default "fatcat"

config CHROMEOS
	select EC_GOOGLE_CHROMEEC_SWITCHES
	select GBB_FLAG_DISABLE_EC_SOFTWARE_SYNC if EC_GOOGLE_CHROMEEC_MEC
	select GBB_FLAG_FORCE_DEV_BOOT_USB
	select GBB_FLAG_FORCE_MANUAL_RECOVERY
	select HAS_RECOVERY_MRC_CACHE

config CHROMEOS_WIFI_SAR
	bool "Enable SAR options for ChromeOS build"
	depends on CHROMEOS
	select DSAR_ENABLE
	select GEO_SAR_ENABLE
	select SAR_ENABLE
	select USE_SAR

config DEVICETREE
	default "variants/baseboard/\$(CONFIG_BASEBOARD_DIR)/devicetree.cb"

config DIMM_SPD_SIZE
	default 512

config DRIVER_TPM_I2C_ADDR
	hex
	default 0x50

config DRIVER_TPM_I2C_BUS
	hex
	default 0x03 if BOARD_GOOGLE_MODEL_FATCAT
	default 0x01 if BOARD_GOOGLE_FRANCKA
	default 0x01 if BOARD_GOOGLE_MODEL_FELINO
	default 0x03 if BOARD_GOOGLE_KINMEN

config HAVE_SLP_S0_GATE
	def_bool n

config MAINBOARD_DIR
	default "google/fatcat"

config MAINBOARD_FAMILY
	string
	default "Google_Fatcat"

config MAINBOARD_PART_NUMBER
	default "Fatcat" if BOARD_GOOGLE_FATCAT
	default "Fatcat4ES" if BOARD_GOOGLE_FATCAT4ES
	default "Fatcat_ish" if BOARD_GOOGLE_FATCATISH
	default "Fatcatite" if BOARD_GOOGLE_FATCATITE
	default "Fatcatite4ES" if BOARD_GOOGLE_FATCATITE4ES
	default "Fatcatnuvo" if BOARD_GOOGLE_FATCATNUVO
	default "Fatcatnuvo4ES" if BOARD_GOOGLE_FATCATNUVO4ES
	default "Francka" if BOARD_GOOGLE_FRANCKA
	default "Felino" if BOARD_GOOGLE_FELINO
	default "Felino4ES" if BOARD_GOOGLE_FELINO4ES
	default "Kinmen" if BOARD_GOOGLE_KINMEN

config MEMORY_SOLDERDOWN
	def_bool n
	select CHROMEOS_DRAM_PART_NUMBER_IN_CBI if CHROMEOS
	select HAVE_SPD_IN_CBFS

config TPM_TIS_ACPI_INTERRUPT
	int
	default 47 if BOARD_GOOGLE_MODEL_FATCAT # GPE0_DW1_15 (GPP_D15)
	default 79 if BOARD_GOOGLE_MODEL_FELINO # GPE0_DW2_15 (GPP_F15)
	default 11 if BOARD_GOOGLE_FRANCKA # GPE0_DW0_11 (GPP_H11)
	default 66 if BOARD_GOOGLE_KINMEN # GPE0_DW2_02 (GPP_E02)

# FIXME: update as per board schematics
config UART_FOR_CONSOLE
	int
	default 0

config USE_PM_ACPI_TIMER
	default n

config VARIANT_DIR
	string
	default "fatcat" if BOARD_GOOGLE_MODEL_FATCAT
	default "francka" if BOARD_GOOGLE_FRANCKA
	default "felino" if BOARD_GOOGLE_MODEL_FELINO
	default "kinmen" if BOARD_GOOGLE_KINMEN

config OVERRIDE_DEVICETREE
	default "variants/\$(CONFIG_VARIANT_DIR)/overridetree.cb"

config VBOOT
	select VBOOT_LID_SWITCH

endif # BOARD_GOOGLE_FATCAT_COMMON
```
