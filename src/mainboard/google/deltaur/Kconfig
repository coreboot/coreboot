## src/mainboard/google/fatcat/Kconfig.name
```kconfig
## SPDX-License-Identifier: GPL-2.0-only

comment "Fatcat"

config BOARD_GOOGLE_FATCAT
	bool "-> Fatcat"

config BOARD_GOOGLE_FATCAT4ES
	bool "-> Fatcat4ES"

config BOARD_GOOGLE_FATCATISH
	bool "-> Fatcat_ish"

config BOARD_GOOGLE_FATCATITE
	bool "-> Fatcatite"

config BOARD_GOOGLE_FATCATITE4ES
	bool "-> Fatcatite4ES"

config BOARD_GOOGLE_FATCATNUVO
	bool "-> Fatcatnuvo"

config BOARD_GOOGLE_FATCATNUVO4ES
	bool "-> Fatcatnuvo4ES"

config BOARD_GOOGLE_FELINO
	bool "-> Felino"

config BOARD_GOOGLE_FELINO4ES
	bool "-> Felino4ES"

config BOARD_GOOGLE_FRANCKA
	bool "-> Francka"

config BOARD_GOOGLE_KINMEN4ES
	bool "-> Kinmen4ES"

config BOARD_GOOGLE_KINMEN
	bool "-> Kinmen"

config BOARD_GOOGLE_LAPIS
	bool "-> Lapis"

config BOARD_GOOGLE_MOONSTONE
	bool "-> Moonstone"
```

## src/mainboard/google/fizz/Kconfig
```kconfig
config BOARD_GOOGLE_BASEBOARD_FIZZ
	def_bool n
	select BOARD_ROMSIZE_KB_16384
	select DRIVERS_I2C_GENERIC
	select DRIVERS_SPI_ACPI
	select DRIVERS_USB_ACPI
	select EC_GOOGLE_CHROMEEC
	select EC_GOOGLE_CHROMEEC_ACPI_USB_PORT_POWER
	select EC_GOOGLE_CHROMEEC_BOARDID
	select EC_GOOGLE_CHROMEEC_LPC
	select HAVE_ACPI_RESUME
	select HAVE_ACPI_TABLES
	select INTEL_GMA_HAVE_VBT
	select INTEL_LPSS_UART_FOR_CONSOLE
	select MAINBOARD_HAS_CHROMEOS
	select MAINBOARD_HAS_LIBGFXINIT
	select MAINBOARD_HAS_SPI_TPM_CR50
	select MAINBOARD_HAS_TPM2
	select NO_FADT_8042
	select SOC_INTEL_KABYLAKE
	select SPD_READ_BY_WORD
	select RT8168_GET_MAC_FROM_VPD
	select RT8168_SUPPORT_LEGACY_VPD_MAC
	select RT8168_SET_LED_MODE

config BOARD_GOOGLE_FIZZ
	select BOARD_GOOGLE_BASEBOARD_FIZZ

config BOARD_GOOGLE_KARMA
	select BOARD_GOOGLE_BASEBOARD_FIZZ
	select DRIVERS_GENERIC_MAX98357A
	select DRIVERS_I2C_DA7219
	select EXCLUDE_NATIVE_SD_INTERFACE

config BOARD_GOOGLE_ENDEAVOUR
	select BOARD_GOOGLE_BASEBOARD_FIZZ

if BOARD_GOOGLE_BASEBOARD_FIZZ

config DISABLE_HECI1_AT_PRE_BOOT
	default y

config DEVICETREE
	default "variants/baseboard/devicetree.cb"

config OVERRIDE_DEVICETREE
	default "variants/\$(CONFIG_VARIANT_DIR)/overridetree.cb"

config VBOOT
	select EC_GOOGLE_CHROMEEC_SWITCHES
	select HAS_RECOVERY_MRC_CACHE

config DRIVER_TPM_SPI_BUS
	default 0x1

config MAINBOARD_DIR
	default "google/fizz"

config MAINBOARD_PART_NUMBER
	default "Fizz" if BOARD_GOOGLE_FIZZ
	default "Karma" if BOARD_GOOGLE_KARMA
	default "Endeavour" if BOARD_GOOGLE_ENDEAVOUR

config MAINBOARD_FAMILY
	string
	default "Google_Fizz" if BOARD_GOOGLE_FIZZ
	default "Google_Kalista" if BOARD_GOOGLE_KARMA
	default "Google_Endeavour" if BOARD_GOOGLE_ENDEAVOUR

config DIMM_MAX
	default 2

config DIMM_SPD_SIZE
	default 512

config TPM_TIS_ACPI_INTERRUPT
	int
	default 64  # GPE0_DW2_00 (GPP_E0)

config VARIANT_DIR
	default "fizz" if BOARD_GOOGLE_FIZZ
	default "karma" if BOARD_GOOGLE_KARMA
	default "endeavour" if BOARD_GOOGLE_ENDEAVOUR

config INCLUDE_NHLT_BLOBS
	bool "Include blobs for audio."
	select NHLT_RT5663

config INCLUDE_NHLT_BLOBS_KARMA
	bool "Include blobs for karma audio."
	select NHLT_DA7219
	select NHLT_DMIC_4CH
	select NHLT_MAX98357

config UART_FOR_CONSOLE
	int
	default 2

config USE_PM_ACPI_TIMER
	default n

config TIANOCORE_BOOT_TIMEOUT
	int
	default 5

endif # BOARD_GOOGLE_BASEBOARD_FIZZ
```

## src/mainboard/google/fizz/Kconfig.name
```kconfig
## SPDX-License-Identifier: GPL-2.0-only

comment "Fizz"

config BOARD_GOOGLE_FIZZ
	bool "->  Fizz (Multiple devices - See help text)"
	help
	  The Fizz board supports the following devices:
	  - AOpen Chromebox Commercial 2 (Jax)
	  - HP Chromebox G2 (Kench)
	  - Acer Chromebox CXI3 (SION)
	  - ASUS Chromebox 3 (CN65) (TEEMO)
	  - CTL Chromebox CBx1 (WUKONG)

config BOARD_GOOGLE_KARMA
	bool "->  Karma (Acer Chromebase 24I2)"

config BOARD_GOOGLE_ENDEAVOUR
	bool "->  Endeavour (Google Meet Series One (Lenovo))"
```

## src/mainboard/google/foster/Kconfig
```kconfig
## SPDX-License-Identifier: GPL-2.0-only

if BOARD_GOOGLE_FOSTER

config BOARD_SPECIFIC_OPTIONS
	def_bool y
	select BOARD_ROMSIZE_KB_4096
	select SPI_FLASH
	select SOC_NVIDIA_TEGRA210
	select MAINBOARD_HAS_CHROMEOS
	select BOOTROM_SDRAM_INIT # use BootRom to config sdram
	select COMMON_CBFS_SPI_WRAPPER
	select SPI_FLASH_WINBOND
	select I2C_TPM
	select MAINBOARD_HAS_TPM1

config VBOOT
	select VBOOT_VBNV_FLASH

config MAINBOARD_DIR
	default "google/foster"

config MAINBOARD_PART_NUMBER
	default "Foster"

config DRAM_SIZE_MB
	int
	default 2048

choice
	prompt "BCT boot media"
	default FOSTER_BCT_CFG_SPI
	help
	  Which boot media to configure the BCT for.

config FOSTER_BCT_CFG_SPI
	bool "SPI"
	help
	  Configure the BCT for booting from SPI.

config FOSTER_BCT_CFG_EMMC
	bool "eMMC"
	help
	  Configure the BCT for booting from eMMC.

endchoice

config BOOT_DEVICE_SPI_FLASH_BUS
	int "SPI bus with boot media ROM"
	range 1 7
	depends on FOSTER_BCT_CFG_SPI
	default 7
	help
	  Which SPI bus the boot media is connected to.

config DRIVER_TPM_I2C_BUS
	hex
	default 0x2

config DRIVER_TPM_I2C_ADDR
	hex
	default 0x20

#config EC_GOOGLE_CHROMEEC_BOARDNAME
#	string
#	default "nyan"

config VBOOT_FWID_MODEL
	string
	default "Nvidia_Foster"

endif # BOARD_GOOGLE_FOSTER
```

## src/mainboard/google/foster/Kconfig.name
```kconfig
## SPDX-License-Identifier: GPL-2.0-only

comment "Foster (Nvidia Tegra X1 (T210))"

config BOARD_GOOGLE_FOSTER
	bool "->  Foster"
```

## src/mainboard/google/gale/Kconfig
```kconfig
## SPDX-License-Identifier: GPL-2.0-only

if BOARD_GOOGLE_GALE

config BOARD_SPECIFIC_OPTIONS
	def_bool y
	select SOC_QC_IPQ40XX
	select BOARD_ROMSIZE_KB_8192
	select COMMON_CBFS_SPI_WRAPPER
	select DRIVERS_I2C_WW_RING
	select MAINBOARD_HAS_CHROMEOS
	select SPI_FLASH
	select SPI_FLASH_GIGADEVICE
	select SPI_FLASH_SPANSION
	select SPI_FLASH_STMICRO
	select SPI_FLASH_WINBOND
	select DRIVERS_UART
	select I2C_TPM
	select MAINBOARD_HAS_TPM1

config VBOOT
	select VBOOT_DISABLE_DEV_ON_RECOVERY
	select VBOOT_WIPEOUT_SUPPORTED

config BOARD_VARIANT_DK01
	bool "Build an image for DK01"
	default n

config MAINBOARD_DIR
	default "google/gale"

config MAINBOARD_PART_NUMBER
	default "DK01" if BOARD_VARIANT_DK01
	default "Gale"

config DRAM_SIZE_MB
	int
	default 512 if BOARD_VARIANT_DK01
	default 512

config DRIVER_TPM_I2C_BUS
	hex
	default 0x2

config DRIVER_TPM_I2C_ADDR
	hex
	default 0x20

endif # BOARD_GOOGLE_GALE
```

## src/mainboard/google/gale/Kconfig.name
```kconfig
## SPDX-License-Identifier: GPL-2.0-only

comment "Gale (Qualcomm IPQ4019)"

config BOARD_GOOGLE_GALE
	bool "->  Gale (Google WiFi)"
```

## src/mainboard/google/geralt/Kconfig
```kconfig
## SPDX-License-Identifier: GPL-2.0-only

# Umbrella option to be selected by variant boards.
config BOARD_GOOGLE_GERALT_COMMON
	def_bool n

if BOARD_GOOGLE_GERALT_COMMON

config VBOOT
	select VBOOT_VBNV_FLASH
	select EC_GOOGLE_CHROMEEC_SWITCHES

config BOARD_SPECIFIC_OPTIONS
	def_bool y
	select SOC_MEDIATEK_MT8188
	select BOARD_ROMSIZE_KB_8192
	select MAINBOARD_HAS_CHROMEOS
	select CHROMEOS_USE_EC_WATCHDOG_FLAG if CHROMEOS
	select COMMON_CBFS_SPI_WRAPPER
	select SPI_FLASH
	select SPI_FLASH_INCLUDE_ALL_DRIVERS
	select COMMONLIB_STORAGE
	select COMMONLIB_STORAGE_MMC
	select EC_GOOGLE_CHROMEEC
	select EC_GOOGLE_CHROMEEC_BOARDID
	select EC_GOOGLE_CHROMEEC_SKUID
	select EC_GOOGLE_CHROMEEC_SPI
	select I2C_TPM if VBOOT
	select MAINBOARD_HAS_TPM2 if VBOOT
	select TPM_GOOGLE_TI50 if VBOOT

config MAINBOARD_DIR
	string
	default "google/geralt"

config MAINBOARD_PART_NUMBER
	string
	default "Geralt" if BOARD_GOOGLE_GERALT

config BOOT_DEVICE_SPI_FLASH_BUS
	int
	default 7

config EC_GOOGLE_CHROMEEC_SPI_BUS
	hex
	default 0x0

config DRIVER_TPM_I2C_BUS
	hex
	default 0x1

config DRIVER_TPM_I2C_ADDR
	hex
	default 0x50
endif
```

## src/mainboard/google/geralt/Kconfig.name
```kconfig
## SPDX-License-Identifier: GPL-2.0-only

comment "Geralt (MediaTek Kompanio 838 (MT8188))"

config BOARD_GOOGLE_GERALT
	bool "->  Geralt"

config BOARD_GOOGLE_CIRI
	bool "->  Ciri (Lenovo Chromebook Duet Gen9 (11M889))"
```

## src/mainboard/google/glados/Kconfig
```kconfig
config BOARD_GOOGLE_BASEBOARD_GLADOS
	def_bool n
	select BOARD_ROMSIZE_KB_16384
	select DRIVERS_I2C_GENERIC
	select DRIVERS_I2C_NAU8825
	select EC_GOOGLE_CHROMEEC
	select EC_GOOGLE_CHROMEEC_ACPI_MEMMAP
	select EC_GOOGLE_CHROMEEC_BOARDID
	select EC_GOOGLE_CHROMEEC_LPC
	select EC_GOOGLE_CHROMEEC_MEC
	select EC_GOOGLE_CHROMEEC_PD
	select HAVE_ACPI_RESUME
	select HAVE_ACPI_TABLES
	select HAVE_OPTION_TABLE
	select HAVE_SPD_IN_CBFS
	select INTEL_LPSS_UART_FOR_CONSOLE
	select MAINBOARD_HAS_CHROMEOS
	select MAINBOARD_HAS_LIBGFXINIT
	select MEMORY_MAPPED_TPM
	select MAINBOARD_HAS_TPM1
	select SOC_INTEL_SKYLAKE
	select SYSTEM_TYPE_LAPTOP

config BOARD_GOOGLE_ASUKA
	select BOARD_GOOGLE_BASEBOARD_GLADOS
	select DRIVERS_GENERIC_MAX98357A
	select EXCLUDE_NATIVE_SD_INTERFACE
	select INTEL_GMA_HAVE_VBT
	select MAINBOARD_NO_FSP_GOP
	select NHLT_MAX98357 if INCLUDE_NHLT_BLOBS

config BOARD_GOOGLE_CAROLINE
	select BOARD_GOOGLE_BASEBOARD_GLADOS
	select CHROMEOS_WIFI_SAR if CHROMEOS
	select INTEL_GMA_HAVE_VBT
	select MAINBOARD_NO_FSP_GOP
	select NHLT_SSM4567 if INCLUDE_NHLT_BLOBS

config BOARD_GOOGLE_CAVE
	select BOARD_GOOGLE_BASEBOARD_GLADOS
	select DRIVERS_GENERIC_MAX98357A
	select INTEL_GMA_HAVE_VBT
	select MAINBOARD_NO_FSP_GOP
	select NHLT_MAX98357 if INCLUDE_NHLT_BLOBS

config BOARD_GOOGLE_CHELL
	select BOARD_GOOGLE_BASEBOARD_GLADOS
	select INTEL_GMA_HAVE_VBT
	select MAINBOARD_NO_FSP_GOP
	select NHLT_SSM4567 if INCLUDE_NHLT_BLOBS

config BOARD_GOOGLE_GLADOS
	select BOARD_GOOGLE_BASEBOARD_GLADOS
	select NHLT_DMIC_4CH if INCLUDE_NHLT_BLOBS
	select NHLT_SSM4567 if INCLUDE_NHLT_BLOBS

config BOARD_GOOGLE_LARS
	select BOARD_GOOGLE_BASEBOARD_GLADOS
	select DRIVERS_GENERIC_MAX98357A
	select EXCLUDE_NATIVE_SD_INTERFACE
	select INTEL_GMA_HAVE_VBT
	select MAINBOARD_NO_FSP_GOP
	select NHLT_MAX98357 if INCLUDE_NHLT_BLOBS

config BOARD_GOOGLE_SENTRY
	select BOARD_GOOGLE_BASEBOARD_GLADOS
	select DRIVERS_GENERIC_MAX98357A
	select INTEL_GMA_HAVE_VBT
	select MAINBOARD_NO_FSP_GOP
	select NHLT_DMIC_4CH if INCLUDE_NHLT_BLOBS
	select NHLT_MAX98357 if INCLUDE_NHLT_BLOBS
	select NHLT_SSM4567 if INCLUDE_NHLT_BLOBS

if BOARD_GOOGLE_BASEBOARD_GLADOS

config CHROMEOS_WIFI_SAR
	bool "Enable SAR options for ChromeOS build"
	depends on CHROMEOS
	select DSAR_ENABLE
	select SAR_ENABLE
	select USE_SAR

config DISABLE_HECI1_AT_PRE_BOOT
	default y

config VBOOT
	select EC_GOOGLE_CHROMEEC_SWITCHES
	select VBOOT_LID_SWITCH

config MAINBOARD_DIR
	default "google/glados"

config MAINBOARD_PART_NUMBER
	default "Asuka" if BOARD_GOOGLE_ASUKA
	default "Caroline" if BOARD_GOOGLE_CAROLINE
	default "Cave" if BOARD_GOOGLE_CAVE
	default "Chell" if BOARD_GOOGLE_CHELL
	default "Glados" if BOARD_GOOGLE_GLADOS
	default "Lars" if BOARD_GOOGLE_LARS
	default "Sentry" if BOARD_GOOGLE_SENTRY

config MAINBOARD_FAMILY
	string
	default "Google_Glados"

config VARIANT_DIR
	default "asuka" if BOARD_GOOGLE_ASUKA
	default "caroline" if BOARD_GOOGLE_CAROLINE
	default "cave" if BOARD_GOOGLE_CAVE
	default "chell" if BOARD_GOOGLE_CHELL
	default "glados" if BOARD_GOOGLE_GLADOS
	default "lars" if BOARD_GOOGLE_LARS
	default "sentry" if BOARD_GOOGLE_SENTRY

config OVERRIDE_DEVICETREE
	default "variants/\$(CONFIG_VARIANT_DIR)/overridetree.cb"

config INCLUDE_NHLT_BLOBS
	bool "Include blobs for audio."
	select NHLT_DMIC_2CH
	select NHLT_NAU88L25

config UART_FOR_CONSOLE
	int
	default 2

config CONSOLE_SERIAL
	bool
	default n

config USE_PM_ACPI_TIMER
	default n

endif
```

## src/mainboard/google/glados/Kconfig.name
```kconfig
comment "Glados"

config BOARD_GOOGLE_ASUKA
	bool "->  Asuka (Dell Chromebook 13 3380)"

config BOARD_GOOGLE_CAROLINE
	bool "->  Caroline (Samsung Chromebook Pro)"

config BOARD_GOOGLE_CAVE
	bool "->  Cave (Asus Chromebook Flip C302SA)"

config BOARD_GOOGLE_CHELL
	bool "->  Chell (HP Chromebook 13 G1)"

config BOARD_GOOGLE_GLADOS
	bool "->  Glados Skylake Reference Board"

config BOARD_GOOGLE_LARS
	bool "->  Lars (Acer Chromebook 14 for Work (CP5-471))"

config BOARD_GOOGLE_SENTRY
	bool "->  Sentry (Lenovo Thinkpad 13 Chromebook)"
```

## src/mainboard/google/gru/Kconfig
```kconfig
## SPDX-License-Identifier: GPL-2.0-only

config BOARD_GOOGLE_GRU_COMMON
	def_bool BOARD_GOOGLE_BOB || \
		 BOARD_GOOGLE_GRU || \
		 BOARD_GOOGLE_KEVIN || \
		 BOARD_GOOGLE_NEFARIO || \
		 BOARD_GOOGLE_RAINIER || \
		 BOARD_GOOGLE_SCARLET

if BOARD_GOOGLE_GRU_COMMON

# Most Grus have TPM2 but later Kevins don't... decide this in one place for
# convenience. Explicitly override it when building for earlier Kevins.
config GRU_HAS_TPM2
	bool "Build for a board revision with a SPI TPM 2.0"
	default !BOARD_GOOGLE_KEVIN

config GRU_HAS_CENTERLOG_PWM
	def_bool BOARD_GOOGLE_GRU || \
		 BOARD_GOOGLE_KEVIN || \
		 BOARD_GOOGLE_BOB

config GRU_HAS_WLAN_RESET
	def_bool BOARD_GOOGLE_GRU || \
		 BOARD_GOOGLE_KEVIN || \
		 BOARD_GOOGLE_BOB

config GRU_BASEBOARD_SCARLET
	def_bool BOARD_GOOGLE_SCARLET || \
		 BOARD_GOOGLE_RAINIER

config BOARD_SPECIFIC_OPTIONS
	def_bool y
	select BOARD_ROMSIZE_KB_8192
	select COMMON_CBFS_SPI_WRAPPER
	select EC_GOOGLE_CHROMEEC
	select EC_GOOGLE_CHROMEEC_RTC
	select EC_GOOGLE_CHROMEEC_SPI
	select MAINBOARD_FORCE_NATIVE_VGA_INIT
	select MAINBOARD_HAS_CHROMEOS
	select MAINBOARD_HAS_NATIVE_VGA_INIT
	select RK3399_SPREAD_SPECTRUM_DDR if BOARD_GOOGLE_BOB
	select RTC
	select SOC_ROCKCHIP_RK3399
	select SPI_FLASH
	select SPI_FLASH_GIGADEVICE
	select SPI_FLASH_WINBOND
	select I2C_TPM if !GRU_HAS_TPM2
	select TPM_GOOGLE_CR50 if GRU_HAS_TPM2
	select SPI_TPM if GRU_HAS_TPM2
	select MAINBOARD_HAS_TPM1 if !GRU_HAS_TPM2
	select MAINBOARD_HAS_TPM2 if GRU_HAS_TPM2

config VBOOT
	select EC_GOOGLE_CHROMEEC_SWITCHES
	select VBOOT_VBNV_FLASH

config MAINBOARD_DIR
	default "google/gru"

config EC_GOOGLE_CHROMEEC_SPI_BUS
	hex
	default 0x5

config BOOT_DEVICE_SPI_FLASH_BUS
	int
	default 1

config DRIVER_TPM_I2C_BUS
	hex
	default 0x0

config DRIVER_TPM_I2C_ADDR
	hex
	default 0x20

config DRIVER_TPM_SPI_BUS
	hex
	default 0x2 if GRU_BASEBOARD_SCARLET
	default 0x0

config CONSOLE_SERIAL_UART_ADDRESS
	hex
	depends on DRIVERS_UART
	default 0xFF1A0000

##########################################################
#### Update below when adding a new derivative board. ####
##########################################################
config DEVICETREE
	default "devicetree.scarlet.cb" if BOARD_GOOGLE_SCARLET

config MAINBOARD_PART_NUMBER
	default "Scarlet" if BOARD_GOOGLE_SCARLET
	default "Bob" if BOARD_GOOGLE_BOB
	default "Gru" if BOARD_GOOGLE_GRU
	default "Kevin" if BOARD_GOOGLE_KEVIN
	default "Nefario" if BOARD_GOOGLE_NEFARIO
	default "Rainier" if BOARD_GOOGLE_RAINIER

endif # BOARD_GOOGLE_GRU_COMMON
```
