## src/soc/amd/common/block/cpu/Kconfig
```kconfig
## SPDX-License-Identifier: GPL-2.0-only

config SOC_AMD_COMMON_BLOCK_CAR
	bool
	help
	  This option allows the SOC to use a standard AMD cache-as-ram (CAR)
	  implementation.  CAR setup is built into bootblock and teardown is
	  in postcar.  The teardown procedure does not preserve the stack so
	  it may not be appropriate for a romstage implementation without
	  additional consideration.  If this option is not used, the SOC must
	  implement these functions separately.
	  This is only used for AMD CPU before family 17h. From family 17h on
	  the RAM is already initialized by the PSP before the x86 cores are
	  released from reset.

config SOC_AMD_COMMON_BLOCK_NONCAR
	bool
	select RESERVED_PHYSICAL_ADDRESS_BITS_SUPPORT
	select RESET_VECTOR_IN_RAM
	help
	  From family 17h on AMD CPUs/APUs don't use cache as RAM (CAR) any
	  more, since the RAM initialization is already done by the PSP when
	  the x86 cores are released from reset.

if SOC_AMD_COMMON_BLOCK_NONCAR

config BOOTBLOCK_IN_CBFS
	bool
	default n

config MEMLAYOUT_LD_FILE
	string
	default "src/soc/amd/common/block/cpu/noncar/memlayout.ld"

config CBFS_CACHE_SIZE
	hex
	help
	  The size of the cbfs_cache region.

config ACPI_CPU_STRING
	string
	default "C%03X"

config SOC_AMD_COMMON_ROMSTAGE_LEGACY_DMA_FIXUP
	bool
	help
	  Disable the legacy DMA decodes again after the call into the
	  reference code in romstage to fix up things.

endif # SOC_AMD_COMMON_BLOCK_NONCAR

config SOC_AMD_COMMON_BLOCK_CPUFREQ_FAM15H_16H
	bool
	help
	  Select this option to include code to calculate the CPU frequency
	  from the P state MSR values on AMD CPU families 15h and 16h.

config SOC_AMD_COMMON_BLOCK_CPUFREQ_FAM17H_19H
	bool
	help
	  Select this option to include code to calculate the CPU frequency
	  from the P state MSR values on AMD CPU families 17h and 19h.

config SOC_AMD_COMMON_BLOCK_CPUFREQ_FAM1AH
	bool
	help
	  Select this option to include code to calculate the CPU frequency
	  from the P state MSR values on AMD CPU family 1Ah.

config SOC_AMD_COMMON_BLOCK_MCA_COMMON
	bool
	help
	  Add common machine check architecture support. Do not select this
	  in the SoC's Kconfig; select either SOC_AMD_COMMON_BLOCK_MCA or
	  SOC_AMD_COMMON_BLOCK_MCAX which will select this one.

config SOC_AMD_COMMON_BLOCK_MCA
	bool
	select SOC_AMD_COMMON_BLOCK_MCA_COMMON
	help
	  Add IA32 machine check architecture (MCA) support for pre-Zen CPUs.

config SOC_AMD_COMMON_BLOCK_MCAX
	bool
	select SOC_AMD_COMMON_BLOCK_MCA_COMMON
	help
	  Add extended machine check architecture (MCAX) support for AMD family
	  17h, 19h and possibly newer CPUs.

config SOC_AMD_COMMON_BLOCK_SMM
	bool
	select X86_SMM_SKIP_RELOCATION_HANDLER if HAVE_SMI_HANDLER
	help
	  Add common SMM relocation, finalization and handler functionality to
	  the build.

config SOC_AMD_COMMON_BLOCK_SMIHANDLER
	bool
	depends on SOC_AMD_COMMON_BLOCK_SMM
	help
	  Common fch_slp_typ_handler, get_smi_source_handler, and SMM
	  early-init/exit. Stoneyridge keeps a custom SMI handler and does not
	  select this.

config SOC_AMD_COMMON_BLOCK_SMI_PSP_SX_NOTIFY
	bool
	depends on SOC_AMD_COMMON_BLOCK_SMIHANDLER
	help
	  Notify the PSP of S3 entry from the common SMI sleep handler before
	  sending the SMU the sleep entry message.

config SOC_AMD_COMMON_BLOCK_SMI_STPCLK_RETRY
	bool
	depends on SOC_AMD_COMMON_BLOCK_SMIHANDLER
	help
	  Set FORCE_STPCLK_RETRY in PM_PCI_CTRL in the common SMI sleep
	  handler before enabling SlpTyp.

config SOC_AMD_COMMON_BLOCK_SMI_USB_S3_ENTRY
	bool
	depends on SOC_AMD_COMMON_BLOCK_SMIHANDLER
	help
	  SoC provides soc_smi_usb_s3_entry() which the common SMI sleep
	  handler calls on S3 entry, e.g. to send the SMU a message to prepare
	  the USB controllers for S3.

config SOC_AMD_COMMON_BLOCK_SMM_CBMEMC_REPLAY
	bool
	depends on SOC_AMD_COMMON_BLOCK_SMIHANDLER
	help
	  Replay the verstage console from the PSP transfer buffer into the
	  SMM cbmem console during SMM early init, so that SMM console output
	  is not misattributed to verstage.

config SOC_AMD_COMMON_LATE_SMM_LOCKING
	bool
	depends on SOC_AMD_COMMON_BLOCK_SMM
	help
	  Select this option to perform SMM locking late in soc_finalize(), rather than earlier
	  in smm_relocation_handler(). This is required for pre-Zen SoCs like Stoneyridge which
	  call into an AGESA binary as part of S3 resume, and require SMM to still be unlocked
	  at that time.

config SOC_AMD_COMMON_BLOCK_SVI2
	bool
	help
	  Select this option is the SoC uses the serial VID 2 standard for
	  encoding the voltage it requests from the VRM.

config SOC_AMD_COMMON_BLOCK_SVI3
	bool
	help
	  Select this option is the SoC uses the serial VID 3 standard for
	  encoding the voltage it requests from the VRM.

config SOC_AMD_COMMON_BLOCK_TSC
	bool
	select TSC_SYNC_LFENCE
	select UDELAY_TSC
	select TSC_MONOTONIC_TIMER
	help
	  Select this option to add the common functions for getting the TSC
	  frequency of AMD family 17h, 19h and 1Ah CPUs/APUs and to provide
	  TSC-based monotonic timer functionality to the build.

config SOC_AMD_COMMON_BLOCK_CPU_SYNC_PSP_ADDR_MSR
	bool
	help
	  Select this option to have coreboot sync the PSP_ADDR_MSR from
	  the BSP to all APs.

config SOC_AMD_COMMON_BLOCK_UCODE
	bool
	help
	  Builds in support for loading uCode.

config SOC_AMD_COMMON_BLOCK_CLEAR_HLE_RTM
	bool
	help
	  Clear unsupported HLE and RTM bits from the CPUID feature override
	  after loading microcode.

config SOC_AMD_COMMON_BLOCK_ENABLE_CACHE_ON_RESUME
	bool
	help
	  Enable the Cache on a S3 resume.
```

## src/soc/amd/common/block/gpp_clk/Kconfig
```kconfig
## SPDX-License-Identifier: GPL-2.0-only

config SOC_AMD_COMMON_BLOCK_GPP_CLK
	bool
	help
	  Select this option to use AMD common PCIe clk generator configuration.

config SOC_AMD_COMMON_BLOCK_PCIE_CLK_REQ
	bool
	depends on SOC_AMD_COMMON_BLOCK_PCIE_GPP_DRIVER
	help
	  This option includes code to disable PCIe clock request if the corresponding
	  PCIe device is disabled.
```

## src/soc/ampere/altra/Kconfig
```kconfig
## SPDX-License-Identifier: GPL-2.0-only

config SOC_AMPERE_ALTRA
	bool
	default n
	select ARCH_BOOTBLOCK_ARMV8_64
	select ARCH_VERSTAGE_ARMV8_64
	select ARCH_ROMSTAGE_ARMV8_64
	select ARCH_RAMSTAGE_ARMV8_64
	select ARM64_USE_ARCH_TIMER
	select BOOTBLOCK_CUSTOM
	select FLATTENED_DEVICE_TREE
	select DRIVERS_UART_PL011
	help
	  Ampere Altra (AC01) and Altra Max (AC02) server processors with Arm
	  Neoverse N1 cores.

# TF-A has already initialized the DRAM, so there is no romstage
config SEPARATE_ROMSTAGE
	default n if SOC_AMPERE_ALTRA

if SOC_AMPERE_ALTRA

config ARM64_CURRENT_EL
	int
	default 2

config MEMLAYOUT_LD_FILE
	string
	default "src/soc/ampere/altra/memlayout.ld"

# Ampere Altra Max has up to 128 cores
config MAX_CPUS
	int
	default 128

# Size of the DRAM at _dram (0x80000000), which is always fully populated.
# CBMEM is placed at its top; the actual DRAM layout comes from the TF-A HOB.
config DRAM_SIZE_MB
	int
	default 2048

config AMPERE_ALTRA_TFA_FILE
	string "Path to the TF-A image"
	default ""
	help
	  The TF-A image of Ampere, which is written to the TFA_BIN region of
	  the flash.

config AMPERE_ALTRA_BL33_KEY
	string "Path to the BL33 signing key"
	default ""
	help
	  The RSA private key the content certificate of the non-trusted
	  firmware (BL33, the coreboot bootblock) is signed with. TF-A only
	  runs BL33 if the certificate is signed with a key it trusts.

config AMPERE_ALTRA_BOARD_SETTINGS_FILE
	string "Path to the board settings"
	default ""
	help
	  The board settings (NVPARAM) that TF-A and the SMpro read from the
	  BOARD_SETTINGS region of the flash. Either a text file in the format
	  of the Ampere reference board settings, which is converted with
	  util/ampere/nvparam.py, or an already converted .bin file.

endif # SOC_AMPERE_ALTRA
```

## src/soc/intel/common/block/systemagent/Kconfig
```kconfig
## SPDX-License-Identifier: GPL-2.0-only

config SOC_INTEL_COMMON_BLOCK_SA
	bool
	select SOC_INTEL_COMMON_BASECODE
	help
	  Intel Processor common System Agent support

if SOC_INTEL_COMMON_BLOCK_SA

config DOMAIN_RESOURCE_32BIT_LIMIT
	default 0xe0000000

config ECAM_MMCONF_BASE_ADDRESS
	default 0xe0000000

config ECAM_MMCONF_BUS_NUMBER
	default 256

config SA_ENABLE_IMR
	bool
	default n
	help
	  This option allows you to add the isolated memory ranges (IMRs).

config SA_ENABLE_DPR
	bool
	default n
	help
	  This option allows you to add the DMA Protected Range (DPR).

config SA_RESERVE_LOW_IOVA_FOR_EXTERNAL_DMA
	bool
	default n
	help
	  Reserve address space between TOUUD and
	  SA_RESERVE_LOW_IOVA_FOR_EXTERNAL_DMA_LIMIT as unusable for PCI MMIO
	  BAR placement, so the coreboot resource allocator places 64-bit
	  MMIO BARs starting at that limit instead of directly above TOUUD.
	  This frees up the address range below the limit for use as
	  contiguous IOVA space by devices with large IOMMU-mapped DMA
	  address requirements (e.g. an NPU), matching the placement behavior
	  of the EDK2 UEFI BIOS on the same platform.

config SA_RESERVE_LOW_IOVA_FOR_EXTERNAL_DMA_LIMIT
	hex
	default 0x10000000000
	depends on SA_RESERVE_LOW_IOVA_FOR_EXTERNAL_DMA
	help
	  Upper bound (exclusive) of the [TOUUD, limit) range reserved by
	  SA_RESERVE_LOW_IOVA_FOR_EXTERNAL_DMA. Defaults to 1TiB
	  (0x10000000000).

config ACPI_BERT_SIZE
	hex
	default 0x10000 if ACPI_BERT
	default 0x0
	help
	  Specify the amount of DRAM reserved for gathering the data used to
	  generate the ACPI table.

config HAVE_PAM0_REGISTER
	bool
	default y
	help
	  Specify if the SOC has a PAM0 register

config HAVE_CAPID_A_REGISTER
	bool
	default y
	help
	  Specify if the SOC has the CAPID0_A register that holds DRAM infomations.

config HAVE_BDSM_BGSM_REGISTER
	bool
	default y
	help
	  Specify if the SOC has BDSM and BGSM registers.

endif
```

## src/soc/qualcomm/dougie/Kconfig
```kconfig
## SPDX-License-Identifier: GPL-2.0-only

config SOC_QUALCOMM_DOUGIE
	bool
	default n
	select ARCH_BOOTBLOCK_ARMV8_64
	select ARCH_RAMSTAGE_ARMV8_64
	select ARCH_ROMSTAGE_ARMV8_64
	select ARCH_VERSTAGE_ARMV8_64
	select GENERIC_GPIO_LIB
	select GENERIC_UDELAY
	select HAVE_MONOTONIC_TIMER
	select ARM64_USE_ARCH_TIMER
	select SOC_QUALCOMM_COMMON
	select CACHE_MRC_SETTINGS
	select HAS_RECOVERY_MRC_CACHE
	select COMPRESS_BOOTBLOCK
	select HAVE_UART_SPECIAL

if SOC_QUALCOMM_DOUGIE

config QC_BLOBS_UPSTREAM
	bool "QC blobs are available in upstream repository"
	select USE_QC_BLOBS
	default n
	help
	  Select based on availability of QC blobs in upstream coreboot `3rdparty/qc_blobs`.

config MEMLAYOUT_LD_FILE
	string
	default "src/soc/qualcomm/dougie/memlayout.ld"

config VBOOT
	select VBOOT_SEPARATE_VERSTAGE
	select VBOOT_RETURN_FROM_VERSTAGE
	select VBOOT_MUST_REQUEST_DISPLAY
	select VBOOT_STARTS_IN_BOOTBLOCK

config BOOT_DEVICE_SPI_FLASH_BUS
	int
	default 16

config UART_FOR_CONSOLE
	int
	default 5
	help
	 Select the QUP instance to be used for UART console output.

endif
```
