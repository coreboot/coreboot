## src/mainboard/google/dougie/Kconfig
```kconfig
## SPDX-License-Identifier: GPL-2.0-only

config BOARD_GOOGLE_DOUGIE_COMMON
	def_bool n
	select BOARD_ROMSIZE_KB_32768
	select COMMON_CBFS_SPI_WRAPPER
	select MAINBOARD_HAS_CHROMEOS
	select SOC_QUALCOMM_DOUGIE
	select SPI_FLASH
	select SPI_FLASH_FORCE_4_BYTE_ADDR_MODE
	select SPI_FLASH_INCLUDE_ALL_DRIVERS

config BOARD_GOOGLE_DOUGIE
	select BOARD_GOOGLE_DOUGIE_COMMON
	select MAINBOARD_HAS_AMP_VIA_I2C
	select MAINBOARD_HAS_KEYBOARD_VIA_I2C

config BOARD_GOOGLE_BANDIT
	select BOARD_GOOGLE_DOUGIE_COMMON
	select MAINBOARD_HAS_CHROME_EC
	select MAINBOARD_HAS_GOOGLE_TPM

if BOARD_GOOGLE_DOUGIE_COMMON

config MAINBOARD_HAS_AMP_VIA_I2C
	bool
	default n
	help
	  Enable this option if your mainboard has an audio amplifier on I2C.

config MAINBOARD_HAS_CHROME_EC
	bool
	default n
	select EC_GOOGLE_CHROMEEC
	select EC_GOOGLE_CHROMEEC_RTC
	select EC_GOOGLE_CHROMEEC_SPI
	select RTC
	help
	  Enable this option if your mainboard is equipped with Chrome EC.

config MAINBOARD_HAS_GOOGLE_TPM
	bool
	default n
	select I2C_TPM
	select MAINBOARD_HAS_TPM2
	select TPM_GOOGLE_TI50
	help
	  Enable this option if your mainboard is equipped with Google TPM.

config MAINBOARD_HAS_KEYBOARD_VIA_I2C
	bool
	default n
	help
	  Enable this option if your mainboard has a keyboard controller on I2C.

config VBOOT
	select EC_GOOGLE_CHROMEEC_SWITCHES if MAINBOARD_HAS_CHROME_EC
	select VBOOT_LID_SWITCH if MAINBOARD_HAS_CHROME_EC
	select VBOOT_MOCK_SECDATA if !MAINBOARD_HAS_GOOGLE_TPM
	select VBOOT_NO_BOARD_SUPPORT if !MAINBOARD_HAS_CHROME_EC
	select VBOOT_VBNV_FLASH

config MAINBOARD_DIR
	default "google/dougie"

##########################################################
#### Update below when adding a new derivative board. ####
##########################################################

config MAINBOARD_PART_NUMBER
	default "Dougie" if BOARD_GOOGLE_DOUGIE
	default "Bandit" if BOARD_GOOGLE_BANDIT

config FMDFILE
	default "src/mainboard/\$(CONFIG_MAINBOARD_DIR)/chromeos.fmd" if MAINBOARD_HAS_GOOGLE_TPM
	default "src/mainboard/\$(CONFIG_MAINBOARD_DIR)/chromeos-nogsc.fmd"

config DRIVER_TPM_I2C_BUS
	depends on I2C_TPM
	hex
	default 0xE

config DRIVER_TPM_I2C_ADDR
	depends on I2C_TPM
	hex
	default 0x50

config EC_GOOGLE_CHROMEEC_SPI_BUS
	depends on EC_GOOGLE_CHROMEEC
	hex
	default 0xA

config MAINBOARD_HAS_UFS
	bool "Enable UFS storage"
	default y
	help
	  Enable this option if your mainboard is equipped with UFS
	  storage.

config MAINBOARD_HAS_EMMC
	bool "Enable eMMC (SDC1) storage"
	default n
	help
	  Enable this option if your mainboard is equipped with eMMC
	  storage on SDC1 and you want coreboot to initialize SDCC1
	  clocks, TLMM pads, and early CMD1 during ramstage.

config MAINBOARD_HAS_NVME
	bool "Enable NVMe (PCIe1) storage"
	default y if BOARD_GOOGLE_DOUGIE
	default n
	help
	  Enable this option if your mainboard is equipped with NVMe
	  storage on PCIe1 and you want coreboot to initialize the PCIe
	  root complex during ramstage.

endif # BOARD_GOOGLE_DOUGIE_COMMON
```

## src/mainboard/google/dougie/Kconfig.name
```kconfig
## SPDX-License-Identifier: GPL-2.0-only

comment "Dougie"

config BOARD_GOOGLE_DOUGIE
	bool "->  Dougie"
```

## src/mainboard/hardkernel/odroid-h5/Kconfig
```kconfig
## SPDX-License-Identifier: GPL-2.0-only

if BOARD_HARDKERNEL_ODROID_H5

config BOARD_SPECIFIC_OPTIONS
	def_bool y
	select BOARD_ROMSIZE_KB_16384
	select CRB_TPM
	select DRIVERS_UART_8250IO
	select FSP_TYPE_IOT
	select HAVE_ACPI_RESUME
	select HAVE_ACPI_TABLES
	select HAVE_INTEL_PTT
	select INTEL_GMA_HAVE_VBT
	select SUPERIO_ITE_IT8613E
	select SOC_INTEL_ALDERLAKE_PCH_N

config MAINBOARD_DIR
	default "hardkernel/odroid-h5"

config MAINBOARD_PART_NUMBER
	default "ODROID-H5"

config ODROID_H5_ENABLE_SAGV
	bool "Enable SAGV"
	default y
	help
	  SAGV (System Agent GeyserVille) is Intel's implementation of
	  DVFS (Dynamic Voltage Frequency Scaling) that reduces energy
	  consumption of the SA and DRAM during low-load conditions by
	  automatically switching to lower voltages / frequencies when
	  the system load is low enough. When enabled, memory training
	  has to run multiple times (once per SAGV point), which slows
	  down booting (but only when the MRC cache is unusable).

	  If unsure, keep enabled. If reflashing often, disabling this
	  option can be useful to reduce memory training time.

endif #BOARD_HARDKERNEL_ODROID_H5
```

## src/mainboard/hardkernel/odroid-h5/Kconfig.name
```kconfig
## SPDX-License-Identifier: GPL-2.0-only

config BOARD_HARDKERNEL_ODROID_H5
	bool "ODROID-H5"
```

## src/mainboard/hp/haswell_desktops/Kconfig
```kconfig
## SPDX-License-Identifier: GPL-2.0-only

config BOARD_HP_HASWELL_DESKTOPS_COMMON
	def_bool n
	select AZALIA_USE_LEGACY_VERB_TABLE
	select BOARD_ROMSIZE_KB_16384
	select CPU_INTEL_HASWELL
	select HAVE_ACPI_RESUME
	select HAVE_ACPI_TABLES
	select HAVE_CMOS_DEFAULT
	select HAVE_OPTION_TABLE
	select INTEL_GMA_HAVE_VBT
	select MAINBOARD_HAS_LIBGFXINIT
	select MAINBOARD_HAS_TPM1
	select MAINBOARD_USES_IFD_GBE_REGION
	select MEMORY_MAPPED_TPM
	select NORTHBRIDGE_INTEL_HASWELL
	select SERIRQ_CONTINUOUS_MODE
	select SOUTHBRIDGE_INTEL_LYNXPOINT
	select SUPERIO_NUVOTON_NPCD378

config BOARD_HP_PRODESK_600_G1_SFF
	select BOARD_HP_HASWELL_DESKTOPS_COMMON

if BOARD_HP_HASWELL_DESKTOPS_COMMON

config MAINBOARD_DIR
	default "hp/haswell_desktops"

config VARIANT_DIR
	default "prodesk_600_g1_sff" if BOARD_HP_PRODESK_600_G1_SFF

config OVERRIDE_DEVICETREE
	default "variants/\$(CONFIG_VARIANT_DIR)/overridetree.cb"

config MAINBOARD_PART_NUMBER
	default "ProDesk 600 G1 SFF" if BOARD_HP_PRODESK_600_G1_SFF

config USBDEBUG_HCD_INDEX # FIXME: check this
	default 2
endif
```

## src/mainboard/hp/haswell_desktops/Kconfig.name
```kconfig
## SPDX-License-Identifier: GPL-2.0-only

config BOARD_HP_PRODESK_600_G1_SFF
	bool "ProDesk 600 G1 SFF"

config BOARD_HP_ELITEDESK_800_G1_SFF
	bool "EliteDesk 800 G1 SFF"
```

## src/mainboard/lenovo/p320/Kconfig.name
```kconfig
## SPDX-License-Identifier: GPL-2.0-only

config BOARD_LENOVO_P320
	bool "ThinkStation P320"
```

## src/mainboard/msi/z87-g43/Kconfig
```kconfig
## SPDX-License-Identifier: GPL-2.0-only

if BOARD_MSI_Z87_G43

config BOARD_SPECIFIC_OPTIONS
	def_bool y
	select BOARD_ROMSIZE_KB_8192
	select HAVE_ACPI_RESUME
	select HAVE_ACPI_TABLES
	select INTEL_GMA_HAVE_VBT
	select MAINBOARD_HAS_LIBGFXINIT
	select MEMORY_MAPPED_TPM
	select NORTHBRIDGE_INTEL_HASWELL
	select SERIRQ_CONTINUOUS_MODE
	select SOUTHBRIDGE_INTEL_LYNXPOINT
	select SUPERIO_NUVOTON_NCT6779D

config CBFS_SIZE
	default 0x600000

config MAINBOARD_DIR
	default "msi/z87-g43"

config MAINBOARD_PART_NUMBER
	default "Z87-G43"

config USBDEBUG_HCD_INDEX
	default 2	# Rear1:	USB1: Bottom
			# Rear2:	USB2: Top
endif
```

## src/mainboard/msi/z87-g43/Kconfig.name
```kconfig
## SPDX-License-Identifier: GPL-2.0-only

config BOARD_MSI_Z87_G43
	bool "Z87-G43"
```

## src/mainboard/nvidia/porg/Kconfig
```kconfig
## SPDX-License-Identifier: GPL-2.0-only

if BOARD_NVIDIA_PORG

config BOARD_SPECIFIC_OPTIONS
	def_bool y
	select BOARD_ROMSIZE_KB_4096
	select COMMON_CBFS_SPI_WRAPPER
	select SPI_FLASH
	select SPI_FLASH_MACRONIX
	select SOC_NVIDIA_TEGRA210
	select BOOTROM_SDRAM_INIT

config MAINBOARD_DIR
	default "nvidia/porg"

config MAINBOARD_PART_NUMBER
	default "Porg"

config DRAM_SIZE_MB
	int
	default 4096

config BOOT_DEVICE_SPI_FLASH_BUS
	int "SPI bus with boot media ROM"
	range 1 7
	default 7
	help
		Which SPI bus the boot media is connected to.

endif # BOARD_NVIDIA_PORG
```

## src/mainboard/nvidia/porg/Kconfig.name
```kconfig
## SPDX-License-Identifier: GPL-2.0-only

comment "Porg (NVIDIA Tegra X1 (T210))"

config BOARD_NVIDIA_PORG
	bool "->  Porg (Jetson Nano)"
```

## src/mainboard/samsung/stumpy/Kconfig
```kconfig
## SPDX-License-Identifier: GPL-2.0-only

if BOARD_SAMSUNG_STUMPY

config BOARD_SPECIFIC_OPTIONS
	def_bool y
	select BOARD_ROMSIZE_KB_8192
	select DRIVERS_OPTION_CFR_ENABLED if PAYLOAD_EDK2 && SMMSTORE
	select MAINBOARD_HAS_CHROMEOS
	select MEMORY_MAPPED_TPM
	select MAINBOARD_HAS_TPM1
	select HAVE_ACPI_RESUME
	select HAVE_ACPI_TABLES
	select HAVE_OPTION_TABLE
	select INTEL_GMA_HAVE_VBT
	select MAINBOARD_HAS_LIBGFXINIT
	select NORTHBRIDGE_INTEL_SANDYBRIDGE
	select SOUTHBRIDGE_INTEL_BD82X6X
	select SUPERIO_ITE_IT8772F
	select HAVE_IFD_BIN
	select HAVE_ME_BIN
	select INTEL_INT15
	select SANDYBRIDGE_VBOOT_IN_ROMSTAGE
	select SYSTEM_TYPE_MINIPC

config VBOOT
	select VBOOT_VBNV_FLASH

config MAINBOARD_DIR
	default "samsung/stumpy"

config MAINBOARD_PART_NUMBER
	default "Stumpy"

config HAVE_EXTERNAL_LPC_CARD
	bool "Enable external LPC47N207 board"
	select SUPERIO_SMSC_LPC47N207

config CBFS_SIZE
	default 0x680000

endif # BOARD_SAMSUNG_STUMPY
```

## src/mainboard/sapphire/rave2/Kconfig
```kconfig
# SPDX-License-Identifier: GPL-2.0-only

config BOARD_SAPPHIRE_RAVE2
	select BOARD_ROMSIZE_KB_32768
	select DRIVERS_PCIE_RTD3_DEVICE
	select SOC_AMD_FAEGAN
	select SOC_AMD_COMMON_BLOCK_USE_ESPI
	select SOC_AMD_COMMON_BLOCK_ESPI_RETAIN_PORT80_EN
	select SPI_FLASH_EXIT_4_BYTE_ADDR_MODE

if BOARD_SAPPHIRE_RAVE2

config FMDFILE
	default "src/mainboard/sapphire/rave2/rave2.fmd"

config MAINBOARD_DIR
	default "sapphire/rave2"

config MAINBOARD_PART_NUMBER
	default "Rave2"

config DEVICETREE
	default "devicetree.cb"

config AMD_SOC_CONSOLE_UART
	default y

if !EM100
config EFS_SPI_READ_MODE
	default 5	# Quad IO (1-4-4)

config EFS_SPI_SPEED
	default 0	# 66MHz

config EFS_SPI_MICRON_FLAG
	default 0

config NORMAL_READ_SPI_SPEED
	default 1	# 33MHz

config ALT_SPI_SPEED
	default 1	# 33MHz

endif # !EM100

endif # BOARD_SAPPHIRE_RAVE2
```

## src/mainboard/siemens/fa_asl/Kconfig
```kconfig
## SPDX-License-Identifier: GPL-2.0-only

if BOARD_SIEMENS_FA_ASL

config BOARD_SPECIFIC_OPTIONS
	def_bool y
	select BOARD_ROMSIZE_KB_32768
	select CPU_INTEL_SOCKET_LGA1700
	select DRIVERS_INTEL_DPTF
	select FSP_TYPE_IOT
	select HAVE_ACPI_TABLES
	select HAVE_SPD_IN_CBFS
	select INTEL_LPSS_UART_FOR_CONSOLE
	select SOC_INTEL_ALDERLAKE_PCH_N

config MAINBOARD_DIR
	default "siemens/fa_asl"

config MAINBOARD_PART_NUMBER
	default "FA ASL"

config MAINBOARD_VENDOR
	default "Siemens"

config MAINBOARD_FAMILY
	string
	default "FA ASL"

config DEVICETREE
	default "devicetree.cb"

config UART_FOR_CONSOLE
	int
	default 1

endif # BOARD_SIEMENS_FA_ASL
```

## src/mainboard/siemens/fa_asl/Kconfig.name
```kconfig
## SPDX-License-Identifier: GPL-2.0-only

comment "FA ASL"

config BOARD_SIEMENS_FA_ASL
	bool "FA ASL"
```

## src/mainboard/starlabs/common/hda/Kconfig
```kconfig
## SPDX-License-Identifier: GPL-2.0-only

config HAVE_HDA_DMIC
	bool
	help
	  Select if the board has a DMIC and to allow disabling it via
	  the option API.

config STARLABS_HDA_LEGACY_SUBSYSTEM_ID
	hex
	default 0x1e507038 if BOARD_STARLABS_ADL_HORIZON || BOARD_STARLABS_LITE_ADL || \
		BOARD_STARLABS_STARBOOK_ADL_N
	default 0x10ec111e if BOARD_STARLABS_LITE_GLK || BOARD_STARLABS_LITE_GLKR
	default 0x1e507007 if BOARD_STARLABS_STARBOOK_ADL || BOARD_STARLABS_STARBOOK_RPL
	default 0x10ec1200 if BOARD_STARLABS_LABTOP_CML || BOARD_STARLABS_STARBOOK_TGL || \
		BOARD_STARLABS_STARFIGHTER_RPL
	default 0x10ec10d0 if BOARD_STARLABS_LABTOP_KBL
	default 0x1025174e if BOARD_STARLABS_STARBOOK_MTL
	default 0x20147017 if BOARD_STARLABS_STARFIGHTER_MTL
	default 0x0
```

## src/soc/amd/common/block/config/Kconfig
```kconfig
## SPDX-License-Identifier: GPL-2.0-only

config SOC_AMD_COMMON_BLOCK_CONFIG
	bool
	help
	  Common soc_get_common_config() helper. SoCs that select this must
	  provide <soc/soc_chip.h> with a soc_amd_config_t typedef for their chip
	  config, which embeds struct soc_amd_common_config common_config.
```
