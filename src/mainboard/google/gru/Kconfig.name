## src/mainboard/google/kahlee/Kconfig
```kconfig
# SPDX-License-Identifier: GPL-2.0-only

config BOARD_GOOGLE_BASEBOARD_KAHLEE
	bool
	select ALWAYS_LOAD_OPROM
	select ALWAYS_RUN_OPROM
	select AMD_APU_STONEYRIDGE
	select AMD_APU_PKG_FT4
	select AMD_FWM_POSITION_F20000_DEFAULT
	select AMD_SOC_CONSOLE_UART
	select BOARD_ROMSIZE_KB_16384
	select DRIVERS_GENERIC_ADAU7002
	select DRIVERS_GENERIC_BH720
	select DRIVERS_GENERIC_MAX98357A
	select DRIVERS_I2C_DA7219
	select DRIVERS_I2C_GENERIC
	select DRIVERS_I2C_HID
	select EC_GOOGLE_CHROMEEC
	select EC_GOOGLE_CHROMEEC_BOARDID
	select EC_GOOGLE_CHROMEEC_LPC
	select GFXUMA
	select GOOGLE_SMBIOS_MAINBOARD_VERSION
	select HAVE_ACPI_RESUME
	select HAVE_ACPI_TABLES
	select HAVE_EM100_SUPPORT
	select HAVE_SPD_IN_CBFS
	select I2C_TPM
	select MAINBOARD_HAS_CHROMEOS
	select MAINBOARD_HAS_TPM2
	select PCIEXP_ASPM
	select PCIEXP_CLK_PM
	select PCIEXP_COMMON_CLOCK
	select PCIEXP_L1_SUB_STATE
	select SERIRQ_CONTINUOUS_MODE
	select SOC_AMD_COMMON_BLOCK_GRAPHICS_ACP
	select SOC_AMD_COMMON_BLOCK_GRAPHICS_ATIF
	select SOC_AMD_SMU_FANLESS
	select SOC_AMD_STONEYRIDGE
	select SYSTEM_TYPE_LAPTOP
	select TPM_GOOGLE_CR50

config BOARD_GOOGLE_ALEENA
	select BOARD_GOOGLE_BASEBOARD_KAHLEE

config BOARD_GOOGLE_CAREENA
	select BOARD_GOOGLE_BASEBOARD_KAHLEE

config BOARD_GOOGLE_GRUNT
	select BOARD_GOOGLE_BASEBOARD_KAHLEE

config BOARD_GOOGLE_LIARA
	select BOARD_GOOGLE_BASEBOARD_KAHLEE

config BOARD_GOOGLE_NUWANI
	select BOARD_GOOGLE_BASEBOARD_KAHLEE

config BOARD_GOOGLE_TREEYA
	select BOARD_GOOGLE_BASEBOARD_KAHLEE

if BOARD_GOOGLE_BASEBOARD_KAHLEE

config MAINBOARD_DIR
	default "google/kahlee"

config VGA_BIOS_FILE
	string
	default "3rdparty/blobs/mainboard/google/kahlee/aleena/VBIOS_015_049_000_018.bin" if BOARD_GOOGLE_ALEENA
	default "3rdparty/blobs/mainboard/google/kahlee/liara/VBIOS_BRT39865.001.bin" if BOARD_GOOGLE_LIARA
	default "3rdparty/blobs/mainboard/google/kahlee/VBIOS_015_049_000_017.bin"

config VARIANT_DIR
	default "aleena" if BOARD_GOOGLE_ALEENA
	default "careena" if BOARD_GOOGLE_CAREENA
	default "grunt" if BOARD_GOOGLE_GRUNT
	default "liara" if BOARD_GOOGLE_LIARA
	default "nuwani" if BOARD_GOOGLE_NUWANI
	default "treeya" if BOARD_GOOGLE_TREEYA

config MAINBOARD_PART_NUMBER
	default "Aleena" if BOARD_GOOGLE_ALEENA
	default "Careena" if BOARD_GOOGLE_CAREENA
	default "Grunt" if BOARD_GOOGLE_GRUNT
	default "Liara" if BOARD_GOOGLE_LIARA
	default "Nuwani" if BOARD_GOOGLE_NUWANI
	default "Treeya" if BOARD_GOOGLE_TREEYA

config DEVICETREE
	default "variants/baseboard/devicetree.cb"

config OVERRIDE_DEVICETREE
	default "variants/\$(CONFIG_VARIANT_DIR)/overridetree.cb"

config MAINBOARD_FAMILY
	string
	default "Google_Kahlee"

config FMDFILE
	default "src/mainboard/\$(CONFIG_MAINBOARD_DIR)/variants/baseboard/chromeos.fmd" if CHROMEOS
	default ""
	help
	  The build system creates a default FMAP from ROM_SIZE and CBFS_SIZE,
	  but in some cases more complex setups are required.
	  When an fmd is specified, it overrides the default format.

config MAX_CPUS
	int
	default 4

config IRQ_SLOT_COUNT
	int
	default 11

config ONBOARD_VGA_IS_PRIMARY
	bool
	default y

config VBOOT
	select EC_GOOGLE_CHROMEEC_SWITCHES
	select VBOOT_LID_SWITCH

config VBOOT_VBNV_OFFSET
	hex
	default 0x2A

config CHROMEOS
	select LP_DEFCONFIG_OVERRIDE if PAYLOAD_DEPTHCHARGE

config DRIVER_TPM_I2C_BUS
	hex
	default 0x01

config DRIVER_TPM_I2C_ADDR
	hex
	default 0x50

config GSC_IRQ_GPIO
	int
	default 9

config USE_OEM_BIN
	bool "Add an oem.bin file"
	help
	  Add an oem.bin file to identify the manufacturer in SMBIOS, overriding the
	  CONFIG_MAINBOARD_SMBIOS_MANUFACTURER value.

config OEM_BIN_FILE
	string "OEM ID table"
	depends on USE_OEM_BIN
	default ""

if !EM100	# EM100 defaults in soc/amd/common/blocks/spi/Kconfig
config EFS_SPI_READ_MODE
	default 4          # Dual IO (1-2-2)

config EFS_SPI_SPEED
	default 0	# 66MHz

config NORMAL_READ_SPI_SPEED
	default 1	# 33MHz

config ALT_SPI_SPEED
	default 0	# 66MHz

config TPM_SPI_SPEED
	default 0	# 66MHz

endif

# Don't use AMD's Secure OS if ChromeOS build.
config USE_PSPSECUREOS
	bool
	default n if CHROMEOS
	default y

choice
	prompt "UMA Memory Allocation"
	default KAHLEE_UMA_SIZE_32MB
	help
	  The amount of system memory allocated for the integrated GPU

config KAHLEE_UMA_SIZE_32MB
	bool "32MB"

config KAHLEE_UMA_SIZE_64MB
	bool "64MB"

config KAHLEE_UMA_SIZE_128MB
	bool "128MB"

config KAHLEE_UMA_SIZE_256MB
	bool "256MB"

endchoice

config UMA_SIZE_IN_MB
	int
	default 32  if KAHLEE_UMA_SIZE_32MB
	default 64  if KAHLEE_UMA_SIZE_64MB
	default 128 if KAHLEE_UMA_SIZE_128MB
	default 256 if KAHLEE_UMA_SIZE_256MB

endif # BOARD_GOOGLE_BASEBOARD_KAHLEE
```

## src/mainboard/google/kahlee/Kconfig.name
```kconfig
## SPDX-License-Identifier: GPL-2.0-only

comment "Kahlee"

config BOARD_GOOGLE_ALEENA
	bool "->  Aleena/Kasumi (Acer Chromebook  315 (CB315-2H), 311 (C721) / Spin 311 (R721T))"

config BOARD_GOOGLE_CAREENA
	bool "->  Barla/Careena (HP Chromebook 11A G6/G8 EE, 14A G5/G6)"

config BOARD_GOOGLE_GRUNT
	bool "->  Grunt"

config BOARD_GOOGLE_LIARA
	bool "->  Liara (Lenovo 14e Chromebook, Chromebook S345-14)"

config BOARD_GOOGLE_NUWANI
	bool "->  Nuwani"

config BOARD_GOOGLE_TREEYA
	bool "->  Treeya (Lenovo 100e/300e Gen2 AMD)"
```

## src/mainboard/google/kukui/Kconfig
```kconfig
## SPDX-License-Identifier: GPL-2.0-only

# Umbrella option to be selected by variant boards.
config BOARD_GOOGLE_KUKUI_COMMON
	def_bool n

config BOARD_GOOGLE_JACUZZI_COMMON
	def_bool n
	select BOARD_GOOGLE_KUKUI_COMMON
	select DRIVER_PARADE_PS8640 if BOARD_GOOGLE_JACUZZI
	# All Jacuzzi followers are using ANX7625 except the reference board.
	select DRIVER_ANALOGIX_ANX7625 if !BOARD_GOOGLE_JACUZZI

if BOARD_GOOGLE_KUKUI_COMMON

config VBOOT
	select EC_GOOGLE_CHROMEEC_SWITCHES
	select VBOOT_VBNV_FLASH

config BOARD_SPECIFIC_OPTIONS
	def_bool y
	select RTC
	select SOC_MEDIATEK_MT8183
	select BOARD_ROMSIZE_KB_8192
	select MAINBOARD_HAS_CHROMEOS
	select CHROMEOS_CAMERA
	select CHROMEOS_USE_EC_WATCHDOG_FLAG if CHROMEOS
	select COMMON_CBFS_SPI_WRAPPER
	select SPI_FLASH
	select SPI_FLASH_INCLUDE_ALL_DRIVERS
	select EC_GOOGLE_CHROMEEC
	select EC_GOOGLE_CHROMEEC_BOARDID
	select EC_GOOGLE_CHROMEEC_SPI
	select SPI_TPM if VBOOT
	select TPM_GOOGLE_CR50 if VBOOT
	select MAINBOARD_HAS_TPM2 if VBOOT
	select MAINBOARD_HAS_NATIVE_VGA_INIT
	select MAINBOARD_FORCE_NATIVE_VGA_INIT
	select HAVE_LINEAR_FRAMEBUFFER
	select MT8183_DRAM_EMCP if BOARD_GOOGLE_KRANE || BOARD_GOOGLE_KAKADU || BOARD_GOOGLE_KATSU
	select MIPI_PANEL_AUO_KD101N80_45NA if BOARD_GOOGLE_KRANE
	select MIPI_PANEL_BOE_TV101WUM_NL6 if BOARD_GOOGLE_KRANE
	select MIPI_PANEL_AUO_B101UAN08_3 if BOARD_GOOGLE_KODAMA
	select MIPI_PANEL_BOE_TV101WUM_N53 if BOARD_GOOGLE_KODAMA
	select MIPI_PANEL_BOE_TV105WUM_NW0 if BOARD_GOOGLE_KAKADU
	select MIPI_PANEL_CMN_P097PFG_SSD2858 if BOARD_GOOGLE_KUKUI
	select MIPI_PANEL_AUO_NT51021D8P if BOARD_GOOGLE_FLAPJACK
	select MIPI_PANEL_BOE_TV080WUM_NG0 if BOARD_GOOGLE_FLAPJACK
	select MIPI_PANEL_BOE_TV101WUM_NG0 if BOARD_GOOGLE_FLAPJACK
	select MIPI_PANEL_INX_OTA7290D10P if BOARD_GOOGLE_FLAPJACK
	select MIPI_PANEL_STA_2081101QFH032011_53G if BOARD_GOOGLE_KATSU
	select MIPI_PANEL_BOE_TV105WUM_NW0 if BOARD_GOOGLE_KATSU

config MAINBOARD_DIR
	default "google/kukui"

config MAINBOARD_PART_NUMBER
	default "Kukui" if BOARD_GOOGLE_KUKUI
	default "Krane" if BOARD_GOOGLE_KRANE
	default "Kodama" if BOARD_GOOGLE_KODAMA
	default "Kakadu" if BOARD_GOOGLE_KAKADU
	default "Flapjack" if BOARD_GOOGLE_FLAPJACK
	default "Jacuzzi" if BOARD_GOOGLE_JACUZZI
	default "Juniper" if BOARD_GOOGLE_JUNIPER
	default "Kappa" if BOARD_GOOGLE_KAPPA
	default "Damu" if BOARD_GOOGLE_DAMU
	default "Cerise" if BOARD_GOOGLE_CERISE
	default "Stern" if BOARD_GOOGLE_STERN
	default "Willow" if BOARD_GOOGLE_WILLOW
	default "Esche" if BOARD_GOOGLE_ESCHE
	default "Burnet" if BOARD_GOOGLE_BURNET
	default "Fennel" if BOARD_GOOGLE_FENNEL
	default "Katsu" if BOARD_GOOGLE_KATSU
	default "Cozmo" if BOARD_GOOGLE_COZMO
	default "Makomo" if BOARD_GOOGLE_MAKOMO
	default "Munna" if BOARD_GOOGLE_MUNNA
	default "Pico" if BOARD_GOOGLE_PICO

config DRIVER_TPM_SPI_BUS
	hex
	default 0x0

config BOOT_DEVICE_SPI_FLASH_BUS
	int
	default 1

config EC_GOOGLE_CHROMEEC_SPI_BUS
	hex
	default 0x2

config BOARD_SDRAM_TABLE_OFFSET
	hex
	default 0x10 if BOARD_GOOGLE_FENNEL || BOARD_GOOGLE_CERISE || BOARD_GOOGLE_STERN || BOARD_GOOGLE_MAKOMO || BOARD_GOOGLE_MUNNA
	default 0x20 if BOARD_GOOGLE_KAKADU || BOARD_GOOGLE_KATSU
	default 0x30 if BOARD_GOOGLE_COZMO || BOARD_GOOGLE_PICO
	default 0x40 if BOARD_GOOGLE_KAPPA
	default 0x50 if BOARD_GOOGLE_BURNET || BOARD_GOOGLE_ESCHE
	default 0x0

config BOARD_OVERRIDE_LCM_ID
	hex
	default 0x1 if BOARD_GOOGLE_JUNIPER || BOARD_GOOGLE_KAPPA || BOARD_GOOGLE_DAMU
	default 0x1 if BOARD_GOOGLE_BURNET || BOARD_GOOGLE_ESCHE
	default 0x0

config SPEAKER_GPIO_NAME
	string
	# MAX98357A, should include KENZO in future.
	default "speaker enable" if BOARD_GOOGLE_JACUZZI || BOARD_GOOGLE_JUNIPER
	default "speaker enable" if BOARD_GOOGLE_WILLOW || BOARD_GOOGLE_DAMU
	# MAX98360
	default "speaker enable" if BOARD_GOOGLE_BURNET || BOARD_GOOGLE_ESCHE
	default "speaker enable" if BOARD_GOOGLE_KAPPA
	# ALC1015Q (default for Jacuzzi followers)
	default "rt1015p sdb" if BOARD_GOOGLE_KAKADU || BOARD_GOOGLE_KATSU
	default "rt1015p sdb" if BOARD_GOOGLE_JACUZZI_COMMON
	# MAX98357A (default for Kukui followers)
	default "speaker enable"

endif
```

## src/mainboard/google/kukui/Kconfig.name
```kconfig
## SPDX-License-Identifier: GPL-2.0-only

comment "Kukui"

config BOARD_GOOGLE_KUKUI
	bool "->  Kukui"

config BOARD_GOOGLE_KRANE
	bool "->  Krane (Lenovo Chromebook Duet/Lenovo IdeaPad Duet Chromebook)"

config BOARD_GOOGLE_KODAMA
	bool "->  Kodama (Lenovo 10e Chromebook Tablet)"

config BOARD_GOOGLE_KAKADU
	bool "->  Kakadu"

config BOARD_GOOGLE_FLAPJACK
	bool "->  Flapjack"

config BOARD_GOOGLE_KATSU
	bool "->  Katsu (ASUS Chromebook Detachable CZ1)"

comment "Jacuzzi"

config BOARD_GOOGLE_JACUZZI
	bool "->  Jacuzzi"

config BOARD_GOOGLE_JUNIPER
	bool "->  Juniper (Acer Chromebook Spin 311 (CP311-3H))"

config BOARD_GOOGLE_KAPPA
	bool "->  Kappa"

config BOARD_GOOGLE_DAMU
	bool "->  Damu (ASUS Chromebook Flip CM3 (CM3200))"

config BOARD_GOOGLE_CERISE
	bool "->  Cerise"

config BOARD_GOOGLE_STERN
	bool "->  Stern"

config BOARD_GOOGLE_WILLOW
	bool "->  Willow"

config BOARD_GOOGLE_ESCHE
	bool "->  Esche (HP Chromebook 11MK G9 EE)"

config BOARD_GOOGLE_BURNET
	bool "->  Burnet (HP Chromebook x360 11MK G3 EE)"

config BOARD_GOOGLE_FENNEL
	bool "->  Fennel"

config BOARD_GOOGLE_COZMO
	bool "->  Cozmo (Acer Chromebook 314 (CB314-2H/CB314-2HT))"

config BOARD_GOOGLE_MAKOMO
	bool "->  Makomo"

config BOARD_GOOGLE_MUNNA
	bool "->  Munna"

config BOARD_GOOGLE_PICO
	bool "->  Pico"
```

## src/mainboard/google/lars/Kconfig
```kconfig
if BOARD_GOOGLE_LARS

config BOARD_SPECIFIC_OPTIONS # dummy
	def_bool y
	select BOARD_ROMSIZE_KB_16384
	select DRIVERS_GENERIC_MAX98357A
	select DRIVERS_I2C_GENERIC
	select DRIVERS_I2C_NAU8825
	select EC_GOOGLE_CHROMEEC
	select EC_GOOGLE_CHROMEEC_ACPI_MEMMAP
	select EC_GOOGLE_CHROMEEC_BOARDID
	select EC_GOOGLE_CHROMEEC_LPC
	select EC_GOOGLE_CHROMEEC_MEC
	select EC_GOOGLE_CHROMEEC_PD
	select EXCLUDE_NATIVE_SD_INTERFACE
	select HAVE_ACPI_RESUME
	select HAVE_ACPI_TABLES
	select HAVE_OPTION_TABLE
	select HAVE_SMI_HANDLER
	select INTEL_GMA_HAVE_VBT
	select MAINBOARD_HAS_CHROMEOS
	select MAINBOARD_HAS_LPC_TPM
	select MAINBOARD_HAS_TPM1
	select SOC_INTEL_SKYLAKE
	select SYSTEM_TYPE_LAPTOP

config VBOOT
	select EC_GOOGLE_CHROMEEC_SWITCHES
	select VBOOT_LID_SWITCH

config IRQ_SLOT_COUNT
	int
	default 18

config MAINBOARD_DIR
	string
	default "google/lars"

config MAINBOARD_PART_NUMBER
	string
	default "Lars"

config MAINBOARD_FAMILY
	string
	default "Google_Lars"

config MAX_CPUS
	int
	default 8

config TPM_PIRQ
	hex
	default 0x18  # GPP_E0_IRQ

config INCLUDE_NHLT_BLOBS
	bool "Include blobs for audio."
	select NHLT_DMIC_2CH
	select NHLT_MAX98357
	select NHLT_NAU88L25

config GBB_HWID
	string
	depends on CHROMEOS
	default "LARS TEST 5001"
endif
```

## src/mainboard/google/link/Kconfig
```kconfig
if BOARD_GOOGLE_LINK

config BOARD_SPECIFIC_OPTIONS
	def_bool y
	select BOARD_ROMSIZE_KB_8192
	select EC_GOOGLE_CHROMEEC
	select EC_GOOGLE_CHROMEEC_LPC
	select HAVE_ACPI_RESUME
	select HAVE_ACPI_TABLES
	select HAVE_IFD_BIN
	select HAVE_ME_BIN
	select HAVE_OPTION_TABLE
	select HAVE_SPD_IN_CBFS
	select MAINBOARD_HAS_CHROMEOS
	select MAINBOARD_HAS_LIBGFXINIT
	select MAINBOARD_HAS_LPC_TPM
	select MAINBOARD_HAS_TPM1
	select NORTHBRIDGE_INTEL_SANDYBRIDGE
	select SERIRQ_CONTINUOUS_MODE
	select SOUTHBRIDGE_INTEL_C216
	select SYSTEM_TYPE_LAPTOP

config VBOOT
	select EC_GOOGLE_CHROMEEC_SWITCHES
	select VBOOT_LID_SWITCH
	select VBOOT_VBNV_CMOS

config MAINBOARD_DIR
	default "google/link"

config MAINBOARD_PART_NUMBER
	default "Link"

config MAINBOARD_SMBIOS_MANUFACTURER
	string
	default "GOOGLE"

endif # BOARD_GOOGLE_LINK
```

## src/mainboard/google/link/Kconfig.name
```kconfig
## SPDX-License-Identifier: GPL-2.0-only

comment "Link (Intel IvyBridge (3rd Gen))"

config BOARD_GOOGLE_LINK
	bool "->  Link (Google Chromebook Pixel (2013))"
```

## src/mainboard/google/mancomb/Kconfig
```kconfig
# SPDX-License-Identifier: GPL-2.0-or-later

config BOARD_GOOGLE_BASEBOARD_MANCOMB
	def_bool n

if BOARD_GOOGLE_BASEBOARD_MANCOMB

config BOARD_SPECIFIC_OPTIONS
	def_bool y
	select AMD_SOC_CONSOLE_UART
	select BOARD_ROMSIZE_KB_16384
	select DISABLE_SPI_FLASH_ROM_SHARING
	select DRIVERS_I2C_GENERIC
	select DRIVERS_I2C_HID
	select EC_GOOGLE_CHROMEEC
	select EC_GOOGLE_CHROMEEC_BOARDID
	select EC_GOOGLE_CHROMEEC_ESPI
	select EC_GOOGLE_CHROMEEC_SKUID
	select ELOG
	select ELOG_GSMI
	select HAVE_ACPI_RESUME
	select MAINBOARD_HAS_CHROMEOS
	select SOC_AMD_CEZANNE
	select SOC_AMD_COMMON_BLOCK_USE_ESPI

config CHROMEOS
	select EC_GOOGLE_CHROMEEC_SWITCHES

config VBOOT
	select VBOOT_SEPARATE_VERSTAGE
	select VBOOT_STARTS_IN_BOOTBLOCK
	select VBOOT_EARLY_EC_SYNC

config FMDFILE
	string
	default "src/mainboard/\$(CONFIG_MAINBOARD_DIR)/chromeos.fmd"

config MAINBOARD_DIR
	string
	default "google/mancomb"

config MAINBOARD_PART_NUMBER
	string
	default "Mancomb" if BOARD_GOOGLE_MANCOMB

config AMD_FWM_POSITION_INDEX
	int
	default 3
	help
	  TODO: might need to be adapted for better placement of files in cbfs

config VARIANT_DIR
	string
	default "mancomb" if BOARD_GOOGLE_MANCOMB

config DEVICETREE
	string
	default "variants/baseboard/devicetree.cb"

config OVERRIDE_DEVICETREE
	string
	default "variants/\$(CONFIG_VARIANT_DIR)/overridetree.cb"

config MAINBOARD_FAMILY
	string
	default "Google_Mancomb"

endif # BOARD_GOOGLE_BASEBOARD_MANCOMB
```

## src/mainboard/google/mancomb/Kconfig.name
```kconfig
comment "Mancomb"

config BOARD_GOOGLE_MANCOMB
	bool "->  Mancomb"
	select BOARD_GOOGLE_BASEBOARD_MANCOMB
```

## src/mainboard/google/mistral/Kconfig
```kconfig
config BOARD_GOOGLE_MISTRAL_COMMON  # Umbrella option to be selected by variants
	def_bool n

if BOARD_GOOGLE_MISTRAL_COMMON

config BOARD_SPECIFIC_OPTIONS
	def_bool y
	select BOARD_ROMSIZE_KB_8192
	select COMMON_CBFS_SPI_WRAPPER
	select SOC_QUALCOMM_QCS405
	select SPI_FLASH
	select SPI_FLASH_GIGADEVICE
	select SPI_FLASH_WINBOND
	select MAINBOARD_HAS_CHROMEOS

config VBOOT
	select VBOOT_VBNV_FLASH
	select VBOOT_MOCK_SECDATA
	select VBOOT_NO_BOARD_SUPPORT
	select GBB_FLAG_FORCE_DEV_SWITCH_ON

config MAINBOARD_DIR
	string
	default "google/mistral"

##########################################################
#### Update below when adding a new derivative board. ####
##########################################################

config MAINBOARD_PART_NUMBER
	string
	default "Mistral" if BOARD_GOOGLE_MISTRAL

endif # BOARD_GOOGLE_MISTRAL_COMMON
```

## src/mainboard/google/mistral/Kconfig.name
```kconfig
## SPDX-License-Identifier: GPL-2.0-only

comment "Mistral (Qualcomm Dragonwing QCS405)"

config BOARD_GOOGLE_MISTRAL
	bool "->  Mistral"
```
