## src/mainboard/google/gru/Kconfig.name
```kconfig
## SPDX-License-Identifier: GPL-2.0-only

comment "Gru"

config BOARD_GOOGLE_KEVIN
	bool "->  Kevin (Samsung Chromebook Plus)"

config BOARD_GOOGLE_GRU
	bool "->  Gru"

config BOARD_GOOGLE_BOB
	bool "->  Bob (Asus Chromebook Flip C101PA)"

config BOARD_GOOGLE_SCARLET
	bool "->  Scarlet (Acer Chromebook Tab 10)"

config BOARD_GOOGLE_NEFARIO
	bool "->  Nefario"

config BOARD_GOOGLE_RAINIER
	bool "->  Rainier"
```

## src/mainboard/google/guybrush/Kconfig
```kconfig
# SPDX-License-Identifier: GPL-2.0-or-later

config BOARD_GOOGLE_BASEBOARD_GUYBRUSH
	def_bool n

if BOARD_GOOGLE_BASEBOARD_GUYBRUSH

config BOARD_SPECIFIC_OPTIONS
	def_bool y
	select AMD_SOC_CONSOLE_UART
	select BOARD_ROMSIZE_KB_16384
	select CONSOLE_CBMEM_DUMP_TO_UART if !CONSOLE_SERIAL
	select DEBUG_SMI if !CONSOLE_SERIAL # TODO(b/217968734): Always enable
	select DISABLE_KEYBOARD_RESET_PIN
	select DISABLE_SPI_FLASH_ROM_SHARING
	select DRIVERS_ACPI_THERMAL_ZONE
	select DRIVERS_AMD_I2S_MACHINE_DEV
	select DRIVERS_GENERIC_GPIO_KEYS
	select DRIVERS_GENERIC_MAX98357A
	select DRIVERS_I2C_GENERIC
	select DRIVERS_I2C_HID
	select DRIVERS_PCIE_RTD3_DEVICE
	select DRIVERS_UART_ACPI
	select DRIVERS_PCIE_GENERIC
	select EC_GOOGLE_CHROMEEC
	select EC_GOOGLE_CHROMEEC_BOARDID
	select EC_GOOGLE_CHROMEEC_ESPI
	select EC_GOOGLE_CHROMEEC_SKUID
	select ELOG
	select ELOG_GSMI
	select FW_CONFIG
	select FW_CONFIG_SOURCE_CHROMEEC_CBI
	select GOOGLE_SMBIOS_MAINBOARD_VERSION
	select HAVE_EM100_SUPPORT
	select HAVE_SPD_IN_CBFS
	select I2C_TPM
	select MAINBOARD_HAS_CHROMEOS
	select MAINBOARD_HAS_TPM2
	select PCIEXP_ASPM
	select PCIEXP_CLK_PM
	select PCIEXP_COMMON_CLOCK
	select PCIEXP_L1_SUB_STATE
	select PSP_DISABLE_POSTCODES if !VBOOT_STARTS_BEFORE_BOOTBLOCK
	select PSP_S0I3_RESUME_VERSTAGE if VBOOT_STARTS_BEFORE_BOOTBLOCK
	select SOC_AMD_CEZANNE
	select SOC_AMD_COMMON_BLOCK_GRAPHICS_ATIF
	select SOC_AMD_COMMON_BLOCK_I2C3_TPM_SHARED_WITH_PSP
	select SOC_AMD_COMMON_BLOCK_USE_ESPI
	select SOC_AMD_COMMON_BLOCK_PSP_FUSE_SPL
	select TPM_GOOGLE_CR50

config CHROMEOS
	select EC_GOOGLE_CHROMEEC_SWITCHES

config VBOOT
	select VBOOT_LID_SWITCH
	select VBOOT_SEPARATE_VERSTAGE

config VBOOT_STARTS_BEFORE_BOOTBLOCK
	bool "Enable PSP_verstage"
	default y if VBOOT

config VBOOT_STARTS_IN_BOOTBLOCK
	bool
	default y if VBOOT && !VBOOT_STARTS_BEFORE_BOOTBLOCK

config VBOOT_STARTS_IN_BOOTBLOCK
	select NO_EARLY_BOOTBLOCK_POSTCODES

config VBOOT_VBNV_OFFSET
	hex
	default 0x2A

config FMDFILE
	default "src/mainboard/\$(CONFIG_MAINBOARD_DIR)/chromeos.fmd"

config MAINBOARD_DIR
	default "google/guybrush"

config MAINBOARD_PART_NUMBER
	default "Guybrush" if BOARD_GOOGLE_GUYBRUSH
	default "Nipperkin" if BOARD_GOOGLE_NIPPERKIN
	default "Dewatt" if BOARD_GOOGLE_DEWATT

config AMD_FWM_POSITION_INDEX
	int
	default 3
	help
	  TODO: might need to be adapted for better placement of files in cbfs

config DRIVER_TPM_I2C_BUS
	hex
	default 0x03

config DRIVER_TPM_I2C_ADDR
	hex
	default 0x50

config AMDFW_CONFIG_FILE
	string
	default "src/mainboard/google/guybrush/variants/baseboard/amdfw.cfg"

config HAVE_SPL_FILE
	bool
	default y

config SPL_TABLE_FILE
	string
	depends on HAVE_SPL_FILE
	default "3rdparty/blobs/mainboard/google/guybrush/TypeId0x55_SplTable_Prod_CZN_Chrome.sbin"

if !EM100	# EM100 defaults in soc/amd/common/blocks/spi/Kconfig
config EFS_SPI_READ_MODE
	default 4          # Dual IO (1-2-2)

config EFS_SPI_SPEED
	default 0	# 66MHz

config EFS_SPI_MICRON_FLAG
	default 0

config NORMAL_READ_SPI_SPEED
	default 1	# 33MHz

config ALT_SPI_SPEED
	default 0	# 66MHz

endif # !EM100

config OVERRIDE_EFS_SPI_SPEED
	int
	default 3 if EM100
	default 4	# 100MHz
	help
	  Override EFS SPI Speed Configuration to be applied based on certain
	  board version.

config OVERRIDE_EFS_SPI_SPEED_MIN_BOARD
	hex
	default 0x4 if BOARD_GOOGLE_GUYBRUSH
	default 0x2 if BOARD_GOOGLE_NIPPERKIN
	default 0x3 if BOARD_GOOGLE_DEWATT
	default 0xffffffff
	help
	  Minimum board version starting which the Override EFS SPI Speed
	  configuration has to be applied.

config VARIANT_DIR
	default "guybrush" if BOARD_GOOGLE_GUYBRUSH
	default "nipperkin" if BOARD_GOOGLE_NIPPERKIN
	default "dewatt" if BOARD_GOOGLE_DEWATT

config DEVICETREE
	default "variants/baseboard/devicetree.cb"

config OVERRIDE_DEVICETREE
	default "variants/\$(CONFIG_VARIANT_DIR)/overridetree.cb"

config MAINBOARD_FAMILY
	string
	default "Google_Guybrush"

endif # BOARD_GOOGLE_BASEBOARD_GUYBRUSH
```

## src/mainboard/google/guybrush/Kconfig.name
```kconfig
## SPDX-License-Identifier: GPL-2.0-only

comment "Guybrush (AMD Ryzen Mobile 5000 (Cezanne))"

config BOARD_GOOGLE_DEWATT
	bool "->  Dewatt (Acer Chromebook Spin 514)"

config BOARD_GOOGLE_GUYBRUSH
	bool "->  Guybrush"

config BOARD_GOOGLE_NIPPERKIN
	bool "->  Nipperkin (HP Elite c645 G2 Chromebook)"
```

## src/mainboard/google/hatch/Kconfig
```kconfig
config BOARD_GOOGLE_BASEBOARD_HATCH
	def_bool n
	select BOARD_ROMSIZE_KB_16384 if !BOARD_ROMSIZE_KB_32768
	select DRIVERS_GENERIC_GPIO_KEYS
	select DRIVERS_GENERIC_MAX98357A
	select DRIVERS_I2C_DA7219
	select DRIVERS_I2C_GENERIC
	select DRIVERS_I2C_HID
	select DRIVERS_I2C_SX9310
	select DRIVERS_SPI_ACPI
	select DRIVERS_USB_ACPI
	select EC_GOOGLE_CHROMEEC
	select EC_GOOGLE_CHROMEEC_BOARDID
	select EC_GOOGLE_CHROMEEC_ESPI
	select EC_GOOGLE_CHROMEEC_I2C_TUNNEL
	select EC_GOOGLE_CHROMEEC_SKUID
	select GOOGLE_SMBIOS_MAINBOARD_VERSION
	select HAVE_ACPI_RESUME
	select HAVE_ACPI_TABLES
	select HAVE_SPD_IN_CBFS
	select INTEL_LPSS_UART_FOR_CONSOLE
	select MAINBOARD_HAS_CHROMEOS
	select MAINBOARD_HAS_TPM2
	select MB_HAS_ACTIVE_HIGH_SD_PWR_ENABLE
	select SOC_INTEL_COMETLAKE_1
	select SOC_INTEL_COMMON_BLOCK_DTT
	select SPI_TPM
	select SYSTEM_TYPE_LAPTOP
	select TPM_GOOGLE_CR50

config BOARD_GOOGLE_AKEMI
	select BOARD_GOOGLE_BASEBOARD_HATCH
	select INTEL_GMA_HAVE_VBT

config BOARD_GOOGLE_DRATINI
	select BOARD_GOOGLE_BASEBOARD_HATCH
	select INTEL_GMA_HAVE_VBT

config BOARD_GOOGLE_HATCH
	select BOARD_GOOGLE_BASEBOARD_HATCH
	select BOARD_ROMSIZE_KB_32768
	select INTEL_GMA_HAVE_VBT

config BOARD_GOOGLE_HELIOS
	select BOARD_GOOGLE_BASEBOARD_HATCH
	select CHROMEOS_DSM_CALIB if CHROMEOS
	select DRIVERS_I2C_RT1011
	select INTEL_GMA_HAVE_VBT

config BOARD_GOOGLE_HELIOS_DISKSWAP
	select BOARD_GOOGLE_BASEBOARD_HATCH
	select CHROMEOS_DSM_CALIB if CHROMEOS
	select DRIVERS_I2C_RT1011
	select INTEL_GMA_HAVE_VBT

config BOARD_GOOGLE_JINLON
	select BOARD_GOOGLE_BASEBOARD_HATCH
	select DRIVERS_GFX_GENERIC
	select INTEL_GMA_HAVE_VBT

config BOARD_GOOGLE_KINDRED
	select BOARD_GOOGLE_BASEBOARD_HATCH
	select INTEL_GMA_HAVE_VBT
	select SOC_INTEL_COMMON_MMC_OVERRIDE

config BOARD_GOOGLE_KOHAKU
	select BOARD_GOOGLE_BASEBOARD_HATCH
	select INTEL_GMA_HAVE_VBT

config BOARD_GOOGLE_MUSHU
	select BOARD_GOOGLE_BASEBOARD_HATCH
	select INTEL_GMA_HAVE_VBT

config BOARD_GOOGLE_NIGHTFURY
	select BOARD_GOOGLE_BASEBOARD_HATCH
	select CHROMEOS_DSM_CALIB if CHROMEOS
	select DRIVERS_I2C_MAX98390
	select INTEL_GMA_HAVE_VBT

config BOARD_GOOGLE_PALKIA
	select BOARD_GOOGLE_BASEBOARD_HATCH
	select CHROMEOS_DSM_CALIB if CHROMEOS
	select DRIVERS_I2C_RT1011

if BOARD_GOOGLE_BASEBOARD_HATCH

config DISABLE_HECI1_AT_PRE_BOOT
	default y

config CHROMEOS
	select CHROMEOS_DRAM_PART_NUMBER_IN_CBI
	select EC_GOOGLE_CHROMEEC_SWITCHES
	select GBB_FLAG_FORCE_DEV_BOOT_ALTFW
	select GBB_FLAG_FORCE_DEV_BOOT_USB
	select GBB_FLAG_FORCE_DEV_SWITCH_ON
	select GBB_FLAG_FORCE_MANUAL_RECOVERY
	select HAS_RECOVERY_MRC_CACHE
	select VBOOT_LID_SWITCH

config CHROMEOS_WIFI_SAR
	bool "Enable SAR options for ChromeOS build"
	depends on CHROMEOS
	select DSAR_ENABLE
	select GEO_SAR_ENABLE
	select SAR_ENABLE
	select USE_SAR

config DEVICETREE
	default "variants/baseboard/devicetree.cb"

config DIMM_MAX
	default 2

config DRIVER_TPM_SPI_BUS
	default 0x1

config UART_FOR_CONSOLE
	default 0

config FMDFILE
	default "src/mainboard/\$(CONFIG_MAINBOARD_DIR)/chromeos-16MiB.fmd" if BOARD_ROMSIZE_KB_16384 && CHROMEOS
	default "src/mainboard/\$(CONFIG_MAINBOARD_DIR)/chromeos-32MiB.fmd" if BOARD_ROMSIZE_KB_32768 && CHROMEOS

config MAINBOARD_DIR
	default "google/hatch"

config MAINBOARD_FAMILY
	string
	default "Google_Hatch"

config MAINBOARD_PART_NUMBER
	default "Akemi" if BOARD_GOOGLE_AKEMI
	default "Dratini" if BOARD_GOOGLE_DRATINI
	default "Hatch" if BOARD_GOOGLE_HATCH
	default "Helios" if BOARD_GOOGLE_HELIOS
	default "Helios_Diskswap" if BOARD_GOOGLE_HELIOS_DISKSWAP
	default "Jinlon" if BOARD_GOOGLE_JINLON
	default "Kindred" if BOARD_GOOGLE_KINDRED
	default "Kohaku" if BOARD_GOOGLE_KOHAKU
	default "Mushu" if BOARD_GOOGLE_MUSHU
	default "Nightfury" if BOARD_GOOGLE_NIGHTFURY
	default "Palkia" if BOARD_GOOGLE_PALKIA

config OVERRIDE_DEVICETREE
	default "variants/helios_diskswap/overridetree.cb" if BOARD_GOOGLE_HELIOS_DISKSWAP
	default "variants/\$(CONFIG_VARIANT_DIR)/overridetree.cb"

config TPM_TIS_ACPI_INTERRUPT
	int
	default 53 # GPE0_DW1_21 (GPP_C21)

config VARIANT_DIR
	default "akemi" if BOARD_GOOGLE_AKEMI
	default "dratini" if BOARD_GOOGLE_DRATINI
	default "hatch" if BOARD_GOOGLE_HATCH
	default "helios" if BOARD_GOOGLE_HELIOS
	default "helios" if BOARD_GOOGLE_HELIOS_DISKSWAP
	default "jinlon" if BOARD_GOOGLE_JINLON
	default "kindred" if BOARD_GOOGLE_KINDRED
	default "kohaku" if BOARD_GOOGLE_KOHAKU
	default "mushu" if BOARD_GOOGLE_MUSHU
	default "nightfury" if BOARD_GOOGLE_NIGHTFURY
	default "palkia" if BOARD_GOOGLE_PALKIA

config VBOOT
	select HAS_RECOVERY_MRC_CACHE
	select VBOOT_EARLY_EC_SYNC

config USE_PM_ACPI_TIMER
	default n

endif # BOARD_GOOGLE_BASEBOARD_HATCH
```

## src/mainboard/google/hatch/Kconfig.name
```kconfig
comment "Hatch"

config BOARD_GOOGLE_AKEMI
	bool "->  Akemi (IdeaPad Flex 5/5i Chromebook)"

config BOARD_GOOGLE_DRATINI
	bool "->  Dratini (HP Pro c640 Chromebook)"

config BOARD_GOOGLE_HATCH
	bool "->  Hatch"

config BOARD_GOOGLE_HELIOS
	bool "->  Helios (ASUS Chromebook Flip C436FA)"

config BOARD_GOOGLE_HELIOS_DISKSWAP
	bool "->  Helios_Diskswap"

config BOARD_GOOGLE_JINLON
	bool "->  Jinlon (HP Elite c1030 Chromebook)"

config BOARD_GOOGLE_KINDRED
	bool "->  Kindred (Acer Chromebook 712)"

config BOARD_GOOGLE_KOHAKU
	bool "->  Kohaku (Samsung Galaxy Chromebook)"

config BOARD_GOOGLE_MUSHU
	bool "->  Mushu"

config BOARD_GOOGLE_NIGHTFURY
	bool "->  Nightfury (Samsung Galaxy Chromebook 2)"

config BOARD_GOOGLE_PALKIA
	bool "->  Palkia"
```

## src/mainboard/google/herobrine/Kconfig
```kconfig
config BOARD_GOOGLE_HEROBRINE_COMMON  # Umbrella option to be selected by variants
	def_bool n

if BOARD_GOOGLE_HEROBRINE_COMMON

config HEROBRINE_HAS_FINGERPRINT
	bool
	default y if BOARD_GOOGLE_HEROBRINE || BOARD_GOOGLE_HEROBRINE_REV0
	default n

config BOARD_SPECIFIC_OPTIONS
	def_bool y
	select BOARD_ROMSIZE_KB_65536 if BOARD_GOOGLE_PIGLIN || BOARD_GOOGLE_HOGLIN
	select BOARD_ROMSIZE_KB_8192 if !BOARD_GOOGLE_PIGLIN && !BOARD_GOOGLE_HOGLIN
	select COMMON_CBFS_SPI_WRAPPER
	select EC_GOOGLE_CHROMEEC if !BOARD_GOOGLE_SENOR
	select EC_GOOGLE_CHROMEEC_RTC if !BOARD_GOOGLE_SENOR
	select EC_GOOGLE_CHROMEEC_SKUID if !BOARD_GOOGLE_SENOR
	select EC_GOOGLE_CHROMEEC_SPI if !BOARD_GOOGLE_SENOR
	select RTC if !BOARD_GOOGLE_SENOR
	select MISSING_BOARD_RESET if BOARD_GOOGLE_SENOR
	select SOC_QUALCOMM_SC7280
	select SPI_FLASH
	select SPI_FLASH_EXIT_4_BYTE_ADDR_MODE
	select SPI_FLASH_GIGADEVICE
	select SPI_FLASH_MACRONIX
	select SPI_FLASH_WINBOND
	select TPM_GOOGLE_CR50 if !BOARD_GOOGLE_SENOR
	select SPI_TPM if BOARD_GOOGLE_PIGLIN
	select I2C_TPM if !BOARD_GOOGLE_PIGLIN && !BOARD_GOOGLE_SENOR
	select MAINBOARD_HAS_CHROMEOS
	select MAINBOARD_HAS_TPM2 if !BOARD_GOOGLE_SENOR

config VBOOT
	select EC_GOOGLE_CHROMEEC_SWITCHES if !BOARD_GOOGLE_SENOR
	select VBOOT_VBNV_FLASH
	select VBOOT_NO_BOARD_SUPPORT if BOARD_GOOGLE_SENOR
	select VBOOT_MOCK_SECDATA if BOARD_GOOGLE_SENOR

config MAINBOARD_DIR
	default "google/herobrine"

config MAINBOARD_VENDOR
	string
	default "Google"


##########################################################
#### Update below when adding a new derivative board. ####
##########################################################

config MAINBOARD_PART_NUMBER
	default "Herobrine" if BOARD_GOOGLE_HEROBRINE
	default "Herobrine.rev0" if BOARD_GOOGLE_HEROBRINE_REV0
	default "Senor" if BOARD_GOOGLE_SENOR
	default "Piglin" if BOARD_GOOGLE_PIGLIN
	default "Hoglin" if BOARD_GOOGLE_HOGLIN
	default "Villager" if BOARD_GOOGLE_VILLAGER
	default "Evoker" if BOARD_GOOGLE_EVOKER

config DRIVER_TPM_I2C_BUS
	depends on I2C_TPM
	hex
	default 0xC if BOARD_GOOGLE_HEROBRINE_REV0
	default 0xE

config DRIVER_TPM_I2C_ADDR
	default 0x50

config DRIVER_TPM_SPI_BUS
	depends on SPI_TPM
	hex
	default 0xE

config EC_GOOGLE_CHROMEEC_SPI_BUS
	hex
	default 0x8 if BOARD_GOOGLE_HEROBRINE_REV0
	default 0xA

endif # BOARD_GOOGLE_HEROBRINE_COMMON
```

## src/mainboard/google/herobrine/Kconfig.name
```kconfig
## SPDX-License-Identifier: GPL-2.0-only

comment "Herobrine"

config BOARD_GOOGLE_HEROBRINE
	bool "->  Herobrine"

config BOARD_GOOGLE_HEROBRINE_REV0
	bool "->  Herobrine_Rev0"

config BOARD_GOOGLE_SENOR
	bool "->  Senor"

config BOARD_GOOGLE_PIGLIN
	bool "->  Piglin"

config BOARD_GOOGLE_HOGLIN
	bool "-> Hoglin"

config BOARD_GOOGLE_VILLAGER
	bool "-> Villager"

config BOARD_GOOGLE_EVOKER
	bool "-> Evoker"

config BOARD_GOOGLE_ZOGLIN
	bool "-> Zoglin"

config BOARD_GOOGLE_ZOMBIE
	bool "->  Zombie"
```

## src/mainboard/google/jecht/Kconfig
```kconfig
config BOARD_GOOGLE_BASEBOARD_JECHT
	def_bool n
	select BOARD_ROMSIZE_KB_8192
	select HAVE_ACPI_RESUME
	select HAVE_ACPI_TABLES
	select HAVE_OPTION_TABLE
	select INTEL_GMA_HAVE_VBT
	select MAINBOARD_HAS_CHROMEOS
	select MAINBOARD_HAS_LIBGFXINIT
	select MAINBOARD_HAS_LPC_TPM
	select MAINBOARD_HAS_TPM1
	select SOC_INTEL_BROADWELL
	select SUPERIO_ITE_IT8772F

config BOARD_GOOGLE_GUADO
	select BOARD_GOOGLE_BASEBOARD_JECHT

config BOARD_GOOGLE_JECHT
	select BOARD_GOOGLE_BASEBOARD_JECHT

config BOARD_GOOGLE_RIKKU
	select BOARD_GOOGLE_BASEBOARD_JECHT

config BOARD_GOOGLE_TIDUS
	select BOARD_GOOGLE_BASEBOARD_JECHT

if BOARD_GOOGLE_BASEBOARD_JECHT

config VBOOT
	select VBOOT_VBNV_CMOS

config MAINBOARD_DIR
	default "google/jecht"


config VARIANT_DIR
	default "guado" if BOARD_GOOGLE_GUADO
	default "jecht" if BOARD_GOOGLE_JECHT
	default "rikku" if BOARD_GOOGLE_RIKKU
	default "tidus" if BOARD_GOOGLE_TIDUS

config MAINBOARD_PART_NUMBER
	default "Guado" if BOARD_GOOGLE_GUADO
	default "Jecht" if BOARD_GOOGLE_JECHT
	default "Rikku" if BOARD_GOOGLE_RIKKU
	default "Tidus" if BOARD_GOOGLE_TIDUS

# Override the default variant behavior, since the data.vbt is the same
# for all variants except tidus
config INTEL_GMA_VBT_FILE
	default "src/mainboard/\$(MAINBOARDDIR)/data.vbt" if !BOARD_GOOGLE_TIDUS

config MAINBOARD_SMBIOS_MANUFACTURER
	string
	default "GOOGLE"

config PCIEXP_AER
	def_bool n

config TIANOCORE_BOOT_TIMEOUT
	int
	default 5

endif
```

## src/mainboard/google/jecht/Kconfig.name
```kconfig
## SPDX-License-Identifier: GPL-2.0-only

comment "Jecht (Intel Broadwell (5th Gen))"

config BOARD_GOOGLE_GUADO
	bool "->  Guado (ASUS Chromebox CN62)"

config BOARD_GOOGLE_JECHT
	bool "->  Jecht"

config BOARD_GOOGLE_RIKKU
	bool "->  Rikku (Acer Chromebox CXI2)"

config BOARD_GOOGLE_TIDUS
	bool "->  Tidus (Lenovo ThinkCentre Chromebox)"
```
