## src/mainboard/google/nyan/Kconfig
```kconfig
##
## This file is part of the coreboot project.
##
## Copyright 2013 Google Inc.
##
## This program is free software; you can redistribute it and/or modify
## it under the terms of the GNU General Public License as published by
## the Free Software Foundation; version 2 of the License.
##
## This program is distributed in the hope that it will be useful,
## but WITHOUT ANY WARRANTY; without even the implied warranty of
## MERCHANTABILITY or FITNESS FOR A PARTICULAR PURPOSE.  See the
## GNU General Public License for more details.
##
## You should have received a copy of the GNU General Public License
## along with this program; if not, write to the Free Software
## Foundation, Inc., 51 Franklin St, Fifth Floor, Boston, MA 02110-1301 USA
##

if BOARD_GOOGLE_NYAN

config BOARD_SPECIFIC_OPTIONS # dummy
	def_bool y
	select SOC_NVIDIA_TEGRA124
	select BOARD_ROMSIZE_KB_1024

config MAINBOARD_DIR
	string
	default google/nyan

config MAINBOARD_PART_NUMBER
	string
	default "Nyan"

config DRAM_SIZE_MB
	int
	default 2048

choice
	prompt "BCT boot media"
	default BCT_CFG_SPI
	help
	  Which boot media to configure the BCT for.

config BCT_CFG_SPI
	bool "SPI"
	help
	  Configure the BCT for booting from SPI.

config BCT_CFG_EMMC
	bool "eMMC"
	help
	  Configure the BCT for booting from eMMC.

endchoice

endif # BOARD_GOOGLE_NYAN
```

## src/mainboard/google/nyan/Kconfig.name
```kconfig
## SPDX-License-Identifier: GPL-2.0-only

comment "Nyan (NVIDIA Tegra K1 (CD570M))"

config BOARD_GOOGLE_NYAN
	bool "->  Nyan"
```

## src/mainboard/google/nyan_big/Kconfig
```kconfig
## SPDX-License-Identifier: GPL-2.0-only

if BOARD_GOOGLE_NYAN_BIG

config BOARD_SPECIFIC_OPTIONS
	def_bool y
	select SOC_NVIDIA_TEGRA124
	select MAINBOARD_HAS_CHROMEOS
	select COMMON_CBFS_SPI_WRAPPER
	select EC_GOOGLE_CHROMEEC
	select EC_GOOGLE_CHROMEEC_SPI
	select TEGRA124_MODEL_CD570M
	select BOARD_ROMSIZE_KB_4096
	select SPI_FLASH
	select SPI_FLASH_GIGADEVICE
	select SPI_FLASH_WINBOND
	select I2C_TPM
	select MAINBOARD_HAS_TPM1
	select DRIVERS_AS3722_RTC

config VBOOT
	select EC_GOOGLE_CHROMEEC_SWITCHES
	select VBOOT_VBNV_EC

config MAINBOARD_DIR
	default "google/nyan_big"

config MAINBOARD_PART_NUMBER
	default "Nyan Big"

choice
	prompt "BCT boot media"
	default NYAN_BIG_BCT_CFG_SPI
	help
	  Which boot media to configure the BCT for.

config NYAN_BIG_BCT_CFG_SPI
	bool "SPI"
	help
	  Configure the BCT for booting from SPI.

config NYAN_BIG_BCT_CFG_EMMC
	bool "eMMC"
	help
	  Configure the BCT for booting from eMMC.

endchoice

config BOOT_DEVICE_SPI_FLASH_BUS
	int "SPI bus with boot media ROM"
	range 1 6
	depends on NYAN_BIG_BCT_CFG_SPI
	default 4
	help
	  Which SPI bus the boot media is connected to.

config EC_GOOGLE_CHROMEEC_SPI_BUS
	hex
	default 0x1

config DRIVER_TPM_I2C_BUS
	hex
	default 0x2

config DRIVER_TPM_I2C_ADDR
	hex
	default 0x20

config DRIVERS_AS3722_RTC_BUS
	int
	default 4

config DRIVERS_AS3722_RTC_ADDR
	hex
	default 0x40

endif # BOARD_GOOGLE_NYAN_BIG
```

## src/mainboard/google/nyan_big/Kconfig.name
```kconfig
## SPDX-License-Identifier: GPL-2.0-only

comment "Nyan Big (Nvidia Tegra K1 (T124))"

config BOARD_GOOGLE_NYAN_BIG
	bool "->  Nyan Big (Acer Chromebook 13 (CB5-311))"
```

## src/mainboard/google/nyan_blaze/Kconfig.name
```kconfig
## SPDX-License-Identifier: GPL-2.0-only

comment "Nyan Blaze (NVIDIA Tegra K1 (CD570M))"

config BOARD_GOOGLE_NYAN_BLAZE
	bool "->  Nyan Blaze (HP Chromebook 14 G3)"
```

## src/mainboard/google/oak/Kconfig
```kconfig
## SPDX-License-Identifier: GPL-2.0-only

config BOARD_GOOGLE_OAK_COMMON
	def_bool n

if BOARD_GOOGLE_OAK_COMMON

config BOARD_SPECIFIC_OPTIONS
	def_bool y
	select SOC_MEDIATEK_MT8173
	select BOARD_ROMSIZE_KB_4096
	select COMMON_CBFS_SPI_WRAPPER
	select DRIVER_PARADE_PS8640
	select EC_GOOGLE_CHROMEEC
	select EC_GOOGLE_CHROMEEC_SPI
	select I2C_TPM
	select MAINBOARD_HAS_TPM1
	select MAINBOARD_HAS_NATIVE_VGA_INIT
	select MAINBOARD_FORCE_NATIVE_VGA_INIT
	select HAVE_LINEAR_FRAMEBUFFER
	select MAINBOARD_HAS_CHROMEOS
	select SPI_FLASH

config VBOOT
	select EC_GOOGLE_CHROMEEC_SWITCHES
	select VBOOT_VBNV_FLASH

config MAINBOARD_DIR
	default "google/oak"

config EC_GOOGLE_CHROMEEC_SPI_BUS
	hex
	default 0x0

config DRIVER_TPM_I2C_BUS
	hex
	default 0x2

config DRIVER_TPM_I2C_ADDR
	hex
	default 0x20

config BOOT_DEVICE_SPI_FLASH_BUS
	int
	default 9

config EC_GOOGLE_CHROMEEC_BOARDNAME
	string
	default "oak"

config EC_GOOGLE_CHROMEEC_PD_BOARDNAME
	string
	default "oak_pd"

##########################################################
#### Update below when adding a new derivative board. ####
##########################################################
config MAINBOARD_PART_NUMBER
	default "Oak" if BOARD_GOOGLE_OAK
	default "Elm" if BOARD_GOOGLE_ELM
	default "Hana" if BOARD_GOOGLE_HANA

# All Oak-derivatives count their board IDs as 0 being equivalent to Oak rev6.
config BOARD_ID_ADJUSTMENT
	int
	default 0 if BOARD_GOOGLE_OAK
	default 7 if BOARD_GOOGLE_ELM
	default 11 if BOARD_GOOGLE_HANA

endif # BOARD_GOOGLE_OAK
```

## src/mainboard/google/oak/Kconfig.name
```kconfig
## SPDX-License-Identifier: GPL-2.0-only

comment "Oak"

config BOARD_GOOGLE_OAK
	bool "->  Oak"

config BOARD_GOOGLE_ELM
	bool "->  Elm (Acer Chromebook R13)"

config BOARD_GOOGLE_HANA
	bool "->  Hana (Lenovo N23 Yoga Chromebook)"
```

## src/mainboard/google/ocelot/Kconfig
```kconfig
## SPDX-License-Identifier: GPL-2.0-only

config BOARD_GOOGLE_OCELOT_COMMON
	def_bool n
	select BOARD_ROMSIZE_KB_32768
	select CPU_INTEL_SOCKET_OTHER
	select DRIVERS_GFX_GENERIC
	select DRIVERS_I2C_GENERIC
	select DRIVERS_I2C_HID
	select DRIVERS_INTEL_DPTF
	select DRIVERS_INTEL_MIPI_CAMERA
	select DRIVERS_INTEL_PMC
	select DRIVERS_INTEL_SOUNDWIRE
	select DRIVERS_WWAN_FM350GL
	select DRIVERS_AUDIO_SOF
	select DRIVERS_SOUNDWIRE_ALC_BASE_7XX
	select DRIVERS_SPI_ACPI
	select DUMP_SMBIOS_TYPE17
	select EC_ACPI
	select EC_GOOGLE_CHROMEEC
	select EC_GOOGLE_CHROMEEC_BOARDID
	select EC_GOOGLE_CHROMEEC_ESPI
	select EC_GOOGLE_CHROMEEC_SMBIOS
	select FW_CONFIG
	select FW_CONFIG_SOURCE_CHROMEEC_CBI
	select GENERATE_SMBIOS_TABLES
	select GOOGLE_SMBIOS_MAINBOARD_VERSION
	select HAVE_ACPI_RESUME
	select HAVE_ACPI_TABLES
	select HAVE_SPD_IN_CBFS
	select I2C_TPM
	select INTEL_LPSS_UART_FOR_CONSOLE
	select MAINBOARD_DISABLE_STAGE_CACHE
	select MAINBOARD_HAS_TPM2
	select MB_COMPRESS_RAMSTAGE_LZ4
	select PMC_IPC_ACPI_INTERFACE
	select SOC_INTEL_COMMON_BLOCK_VARIANT_POWER_LIMIT
	select SOC_INTEL_CSE_LITE_SYNC_BY_PAYLOAD
	select SOC_INTEL_CSE_SEND_EOP_BY_PAYLOAD
	select SOC_INTEL_TCSS_USE_PDC_PMC_USBC_MUX_CONFIGURATION
	select SOC_INTEL_WILDCATLAKE

config BOARD_GOOGLE_BASEBOARD_OCELOT
	def_bool n
	select BOARD_GOOGLE_OCELOT_COMMON
	select CHROMEOS_WIFI_SAR if CHROMEOS
	select DRIVERS_INTEL_ISH
	select DRIVER_INTEL_ISH_HAS_MAIN_FW
	select DRIVERS_INTEL_USB4_RETIMER
	select HAVE_SLP_S0_GATE
	select MAINBOARD_HAS_CHROMEOS
	select MEMORY_SOLDERDOWN
	select SOC_INTEL_COMMON_BLOCK_HDA_VERB
	select SOC_INTEL_IOE_DIE_SUPPORT
	select SOC_INTEL_ENABLE_USB4_PCIE_RESOURCES
	select SYSTEM_TYPE_LAPTOP
	select TPM_GOOGLE_TI50

config BOARD_GOOGLE_MODEL_MATSU
	def_bool n
	select BOARD_GOOGLE_BASEBOARD_OCELOT
	select FSP_UGOP_EARLY_SIGN_OF_LIFE
	select MAINBOARD_HAS_GOOGLE_STRAUSS_KEYBOARD

config BOARD_GOOGLE_MODEL_OCELOT
	def_bool n
	select BOARD_GOOGLE_BASEBOARD_OCELOT
	select DRIVERS_GENERIC_BAYHUB_LV2
	select DRIVERS_GENERIC_MAX98357A
	select DRIVERS_INTEL_TOUCH
	select FSP_UGOP_EARLY_SIGN_OF_LIFE

config BOARD_GOOGLE_MODEL_OJAL
	def_bool n
	select BOARD_GOOGLE_BASEBOARD_OCELOT
	select DRIVERS_GENERIC_BAYHUB_LV2
	select DRIVERS_GENERIC_MAX98357A
	select DRIVERS_INTEL_TOUCH
	select FSP_UGOP_EARLY_SIGN_OF_LIFE
	select EC_GOOGLE_CHROMEEC_RTK
	select EC_GOOGLE_CHROMEEC_LPC_GENERIC_MEMORY_RANGE

config BOARD_GOOGLE_MATSU
	select BOARD_GOOGLE_MODEL_MATSU

config BOARD_GOOGLE_OCELOT
	select BOARD_GOOGLE_MODEL_OCELOT

config BOARD_GOOGLE_OCELOTITE
	select BOARD_GOOGLE_MODEL_OCELOT

config BOARD_GOOGLE_OCELOTMCHP
	select BOARD_GOOGLE_MODEL_OCELOT
	select EC_GOOGLE_CHROMEEC_MEC

config BOARD_GOOGLE_OCELOT4ES
	select BOARD_GOOGLE_MODEL_OCELOT

config BOARD_GOOGLE_OCELOTITE4ES
	select BOARD_GOOGLE_MODEL_OCELOT

config BOARD_GOOGLE_OCELOTMCHP4ES
	select BOARD_GOOGLE_MODEL_OCELOT
	select EC_GOOGLE_CHROMEEC_MEC

config BOARD_GOOGLE_OJAL
	select BOARD_GOOGLE_MODEL_OJAL

if BOARD_GOOGLE_OCELOT_COMMON

config BASEBOARD_DIR
	string
	default "ocelot"

config CHROMEOS
	select EC_GOOGLE_CHROMEEC_SWITCHES
	select GBB_FLAG_DISABLE_EC_SOFTWARE_SYNC
	select GBB_FLAG_FORCE_DEV_BOOT_USB
	select GBB_FLAG_FORCE_MANUAL_RECOVERY
	select HAS_RECOVERY_MRC_CACHE

config CHROMEOS_WIFI_SAR
	bool "Enable SAR options for ChromeOS build"
	depends on CHROMEOS
	select DSAR_ENABLE
	select GEO_SAR_ENABLE
	select SAR_ENABLE
	select USE_SAR

config DEVICETREE
	default "variants/baseboard/\$(CONFIG_BASEBOARD_DIR)/devicetree.cb"

config DIMM_SPD_SIZE
	default 512

config DRIVER_TPM_I2C_ADDR
	hex
	default 0x50

config DRIVER_TPM_I2C_BUS
	hex
	default 0x01 if BOARD_GOOGLE_MODEL_MATSU
	default 0x01 if BOARD_GOOGLE_MODEL_OCELOT
	default 0x01 if BOARD_GOOGLE_MODEL_OJAL

config HAVE_SLP_S0_GATE
	def_bool n

config MAINBOARD_DIR
	default "google/ocelot"

config MAINBOARD_FAMILY
	string
	default "Google_Ocelot"

config MAINBOARD_PART_NUMBER
	default "Matsu" if BOARD_GOOGLE_MODEL_MATSU
	default "Ocelot" if BOARD_GOOGLE_MODEL_OCELOT
	default "Ojal" if BOARD_GOOGLE_OJAL

config MEMORY_SOLDERDOWN
	def_bool n
	select CHROMEOS_DRAM_PART_NUMBER_IN_CBI if CHROMEOS
	select HAVE_SPD_IN_CBFS

config TPM_TIS_ACPI_INTERRUPT
	int
	default 78 if BOARD_GOOGLE_MODEL_MATSU # GPE0_DW2_14 (GPP_E14)
	default 49 if BOARD_GOOGLE_MODEL_OCELOT # GPE0_DW1_17 (GPP_B17)
	default 49 if BOARD_GOOGLE_MODEL_OJAL # GPE0_DW1_17 (GPP_B17)

config UART_FOR_CONSOLE
	int
	default 0

config USE_PM_ACPI_TIMER
	default n

config VARIANT_DIR
	string
	default "matsu" if BOARD_GOOGLE_MODEL_MATSU
	default "ocelot" if BOARD_GOOGLE_MODEL_OCELOT
	default "ojal" if BOARD_GOOGLE_MODEL_OJAL

config OVERRIDE_DEVICETREE
	default "variants/\$(CONFIG_VARIANT_DIR)/overridetree.cb"

config VBOOT
	select VBOOT_LID_SWITCH

endif # BOARD_GOOGLE_OCELOT_COMMON
```

## src/mainboard/google/ocelot/Kconfig.name
```kconfig
## SPDX-License-Identifier: GPL-2.0-only

comment "Ocelot"

config BOARD_GOOGLE_OCELOT
	bool "-> Ocelot"

config BOARD_GOOGLE_OCELOTITE
	bool "-> Ocelotite"

config BOARD_GOOGLE_OCELOTMCHP
	bool "-> Ocelotmchp"

config BOARD_GOOGLE_OCELOT4ES
	bool "-> Ocelot4ES"

config BOARD_GOOGLE_OCELOTITE4ES
	bool "-> Ocelotite4ES"

config BOARD_GOOGLE_OCELOTMCHP4ES
	bool "-> Ocelotmchp4ES"
```

## src/mainboard/google/octopus/Kconfig
```kconfig
config BOARD_GOOGLE_BASEBOARD_OCTOPUS
	def_bool n
	select BOARD_ROMSIZE_KB_16384
	select DRIVERS_GENERIC_GPIO_KEYS
	select DRIVERS_GENERIC_MAX98357A
	select DRIVERS_I2C_CS42L42
	select DRIVERS_I2C_DA7219
	select DRIVERS_I2C_GENERIC
	select DRIVERS_I2C_HID
	select DRIVERS_I2C_SX9310
	select DRIVERS_SPI_ACPI
	select DRIVERS_USB_ACPI
	select EC_GOOGLE_CHROMEEC
	select EC_GOOGLE_CHROMEEC_BOARDID
	select EC_GOOGLE_CHROMEEC_ESPI
	select EC_GOOGLE_CHROMEEC_SKUID
	select GOOGLE_SMBIOS_MAINBOARD_VERSION
	select HAVE_ACPI_RESUME
	select HAVE_ACPI_TABLES
	select INTEL_LPSS_UART_FOR_CONSOLE
	select MAINBOARD_HAS_CHROMEOS
	select MAINBOARD_HAS_TPM2
	select NO_BOOTBLOCK_CONSOLE
	select SOC_ESPI
	select SOC_INTEL_GEMINILAKE
	select SPI_TPM
	select SYSTEM_TYPE_LAPTOP
	select TPM_GOOGLE_CR50

config BOARD_GOOGLE_AMPTON
	select BOARD_GOOGLE_BASEBOARD_OCTOPUS
	select INTEL_GMA_HAVE_VBT
	select NHLT_RT5682 if INCLUDE_NHLT_BLOBS

config BOARD_GOOGLE_BLOOG
	select BOARD_GOOGLE_BASEBOARD_OCTOPUS
	select INTEL_GMA_HAVE_VBT
	select NHLT_DA7219 if INCLUDE_NHLT_BLOBS
	select NHLT_RT5682 if INCLUDE_NHLT_BLOBS

config BOARD_GOOGLE_BOBBA
	select BOARD_GOOGLE_BASEBOARD_OCTOPUS
	select INTEL_GMA_HAVE_VBT
	select NHLT_DA7219 if INCLUDE_NHLT_BLOBS
	select NHLT_RT5682 if INCLUDE_NHLT_BLOBS

config BOARD_GOOGLE_CASTA
	select BOARD_GOOGLE_BASEBOARD_OCTOPUS
	select INTEL_GMA_HAVE_VBT
	select NHLT_DA7219 if INCLUDE_NHLT_BLOBS

config BOARD_GOOGLE_DOOD
	select BOARD_GOOGLE_BASEBOARD_OCTOPUS
	select NHLT_DA7219 if INCLUDE_NHLT_BLOBS

config BOARD_GOOGLE_FLEEX
	select BOARD_GOOGLE_BASEBOARD_OCTOPUS
	select INTEL_GMA_HAVE_VBT
	select NHLT_DA7219 if INCLUDE_NHLT_BLOBS
	select NHLT_RT5682 if INCLUDE_NHLT_BLOBS

config BOARD_GOOGLE_FOOB
	select BOARD_GOOGLE_BASEBOARD_OCTOPUS
	select NHLT_DA7219 if INCLUDE_NHLT_BLOBS

config BOARD_GOOGLE_GARG
	select BOARD_GOOGLE_BASEBOARD_OCTOPUS
	select INTEL_GMA_HAVE_VBT
	select NHLT_DA7219 if INCLUDE_NHLT_BLOBS
	select NHLT_RT5682 if INCLUDE_NHLT_BLOBS

config BOARD_GOOGLE_LICK
	select BOARD_GOOGLE_BASEBOARD_OCTOPUS
	select INTEL_GMA_HAVE_VBT
	select NHLT_DA7219 if INCLUDE_NHLT_BLOBS

config BOARD_GOOGLE_MEEP
	select BOARD_GOOGLE_BASEBOARD_OCTOPUS
	select INTEL_GMA_HAVE_VBT
	select NHLT_DA7219 if INCLUDE_NHLT_BLOBS
	select NHLT_RT5682 if INCLUDE_NHLT_BLOBS

config BOARD_GOOGLE_OCTOPUS
	select BOARD_GOOGLE_BASEBOARD_OCTOPUS

config BOARD_GOOGLE_PHASER
	select BOARD_GOOGLE_BASEBOARD_OCTOPUS
	select INTEL_GMA_HAVE_VBT
	select NHLT_DA7219 if INCLUDE_NHLT_BLOBS
	select NHLT_RT5682 if INCLUDE_NHLT_BLOBS

config BOARD_GOOGLE_YORP
	select BOARD_GOOGLE_BASEBOARD_OCTOPUS
	select INTEL_GMA_HAVE_VBT
	select NHLT_DA7219 if INCLUDE_NHLT_BLOBS

if BOARD_GOOGLE_BASEBOARD_OCTOPUS

config CHROMEOS_WIFI_SAR
	bool
	default y if CHROMEOS
	select DSAR_ENABLE
	select GEO_SAR_ENABLE
	select SAR_ENABLE
	select USE_SAR

config CHROMEOS
	select EC_GOOGLE_CHROMEEC_SWITCHES
	select HAS_RECOVERY_MRC_CACHE
	select VBOOT_LID_SWITCH

config MAINBOARD_DIR
	default "google/octopus"

config VARIANT_DIR
	default "yorp" if BOARD_GOOGLE_YORP
	default "phaser" if BOARD_GOOGLE_PHASER
	default "fleex" if BOARD_GOOGLE_FLEEX
	default "bobba" if BOARD_GOOGLE_BOBBA
	default "meep" if BOARD_GOOGLE_MEEP
	default "ampton" if BOARD_GOOGLE_AMPTON
	default "casta" if BOARD_GOOGLE_CASTA
	default "bloog" if BOARD_GOOGLE_BLOOG
	default "octopus" if BOARD_GOOGLE_OCTOPUS
	default "garg" if BOARD_GOOGLE_GARG
	default "dood" if BOARD_GOOGLE_DOOD
	default "lick" if BOARD_GOOGLE_LICK
	default "foob" if BOARD_GOOGLE_FOOB

config DEVICETREE
	default "variants/baseboard/devicetree.cb"

config OVERRIDE_DEVICETREE
	default "variants/\$(CONFIG_VARIANT_DIR)/overridetree.cb" if !BOARD_GOOGLE_OCTOPUS

config MAINBOARD_PART_NUMBER
	default "Yorp" if BOARD_GOOGLE_YORP
	default "Phaser" if BOARD_GOOGLE_PHASER
	default "Fleex" if BOARD_GOOGLE_FLEEX
	default "Bobba" if BOARD_GOOGLE_BOBBA
	default "Meep" if BOARD_GOOGLE_MEEP
	default "Ampton" if BOARD_GOOGLE_AMPTON
	default "Casta" if BOARD_GOOGLE_CASTA
	default "Bloog" if BOARD_GOOGLE_BLOOG
	default "Octopus" if BOARD_GOOGLE_OCTOPUS
	default "Garg" if BOARD_GOOGLE_GARG
	default "Dood" if BOARD_GOOGLE_DOOD
	default "Lick" if BOARD_GOOGLE_LICK
	default "Foob" if BOARD_GOOGLE_FOOB

config MAINBOARD_FAMILY
	string
	default "Google_Octopus"

config UART_FOR_CONSOLE
	int
	default 2

config INCLUDE_NHLT_BLOBS
	bool "Include blobs for audio"
	select NHLT_DMIC_2CH_16B
	select NHLT_DMIC_4CH_16B
	select NHLT_MAX98357

config DRIVER_TPM_SPI_BUS
	default 0x1

config TPM_TIS_ACPI_INTERRUPT
	int
	default 63 # GPE0_DW1_31 (GPIO_63)

config DRAM_PART_NUM_NOT_ALWAYS_IN_CBI
	bool
	default y if BOARD_GOOGLE_BOBBA
	default y if BOARD_GOOGLE_FLEEX
	default y if BOARD_GOOGLE_MEEP
	default y if BOARD_GOOGLE_OCTOPUS
	default y if BOARD_GOOGLE_PHASER
	default y if BOARD_GOOGLE_YORP

config DRAM_PART_IN_CBI_BOARD_ID_MIN
	int
	depends on DRAM_PART_NUM_NOT_ALWAYS_IN_CBI
	default 255 if BOARD_GOOGLE_YORP
	default 2 if BOARD_GOOGLE_PHASER
	default 2 if BOARD_GOOGLE_FLEEX
	default 3 if BOARD_GOOGLE_BOBBA
	default 1 if BOARD_GOOGLE_MEEP
	default 255 if BOARD_GOOGLE_OCTOPUS

config FMDFILE
	default "src/mainboard/\$(CONFIG_MAINBOARD_DIR)/default.fmd" if !CHROMEOS

endif # BOARD_GOOGLE_OCTOPUS
```
