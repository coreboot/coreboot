## src/mainboard/google/octopus/Kconfig.name
```kconfig
## SPDX-License-Identifier: GPL-2.0-only

comment "Octopus"

config BOARD_GOOGLE_AMPTON
	bool "->  Ampton (ASUS Chromebook Flip C214)"

config BOARD_GOOGLE_BLOOG
	bool "->  Bloog (HP Chromebook x360 12b, 14a, x360 14b)"

config BOARD_GOOGLE_BOBBA
	bool "->  Bobba (Acer Chromebook 311 / Spin 511)"

config BOARD_GOOGLE_CASTA
	bool "->  Bluebird/Casta (Samsung Chromebook 4, 4+)"

config BOARD_GOOGLE_DOOD
	bool "->  Dood (NEC Chromebook Y2)"

config BOARD_GOOGLE_FLEEX
	bool "->  Fleex (Dell Chromebook 3100)"

config BOARD_GOOGLE_FOOB
	bool "->  Foob (CTL Chromebook VX11/VT11T)"

config BOARD_GOOGLE_GARG
	bool "->  Garg (CTL Chromebook NL71/CT/LTE)"

config BOARD_GOOGLE_LICK
	bool "->  Lick (Ideapad 3 Chromebook)"

config BOARD_GOOGLE_MEEP
	bool "->  Meep (HP Chromebook x360 11 G2 EE)"

config BOARD_GOOGLE_OCTOPUS
	bool "->  Octopus"

config BOARD_GOOGLE_PHASER
	bool "->  Phaser (Lenovo 100e/300e/500e Chromebook 2nd Gen (Intel))"

config BOARD_GOOGLE_YORP
	bool "->  Yorp"
```

## src/mainboard/google/panther/Kconfig
```kconfig
if BOARD_GOOGLE_PANTHER

config BOARD_SPECIFIC_OPTIONS # dummy
	def_bool y
	select CPU_INTEL_HASWELL
	select NORTHBRIDGE_INTEL_HASWELL
	select SOUTHBRIDGE_INTEL_LYNXPOINT
	select INTEL_LYNXPOINT_LP
	select BOARD_ROMSIZE_KB_8192
	select SUPERIO_ITE_IT8772F
	select HAVE_ACPI_TABLES
	select HAVE_OPTION_TABLE
	select HAVE_ACPI_RESUME
	select MMCONF_SUPPORT
	select HAVE_SMI_HANDLER
	select MAINBOARD_HAS_CHROMEOS
	select MAINBOARD_HAS_LPC_TPM
	select INTEL_INT15

config CHROMEOS
	select PHYSICAL_REC_SWITCH
	select CHROMEOS_VBNV_CMOS
	select VIRTUAL_DEV_SWITCH

config MAINBOARD_DIR
	string
	default google/panther

config MAINBOARD_PART_NUMBER
	string
	default "Panther"

config MMCONF_BASE_ADDRESS
	hex
	default 0xf0000000

config MAX_CPUS
	int
	default 8

config VGA_BIOS_FILE
	string
	default "pci8086,0166.rom"

config HAVE_IFD_BIN
	bool
	default n

config HAVE_ME_BIN
	bool
	default n

endif
```

## src/mainboard/google/parrot/Kconfig
```kconfig
if BOARD_GOOGLE_PARROT

config BOARD_SPECIFIC_OPTIONS
	def_bool y
	select BOARD_ROMSIZE_KB_8192
	select EC_COMPAL_ENE932
	# This board also feature sandy-bridge CPU's so must have LVDS
	select GFX_GMA_PANEL_1_ON_LVDS
	select HAVE_ACPI_RESUME
	select HAVE_ACPI_TABLES
	select HAVE_IFD_BIN
	select HAVE_ME_BIN
	select HAVE_OPTION_TABLE
	select INTEL_INT15
	select MAINBOARD_HAS_CHROMEOS
	select MAINBOARD_HAS_LIBGFXINIT
	select MEMORY_MAPPED_TPM
	select MAINBOARD_HAS_TPM1
	select NORTHBRIDGE_INTEL_SANDYBRIDGE
	select SANDYBRIDGE_VBOOT_IN_ROMSTAGE
	# Workaround for EC/KBC IRQ1.
	select SERIRQ_CONTINUOUS_MODE
	select SOUTHBRIDGE_INTEL_C216
	select SYSTEM_TYPE_LAPTOP

config VBOOT
	select VBOOT_VBNV_CMOS

config MAINBOARD_DIR
	default "google/parrot"

config MAINBOARD_PART_NUMBER
	default "Parrot"

config MAINBOARD_SMBIOS_MANUFACTURER
	string
	default "GOOGLE"

endif # BOARD_GOOGLE_PARROT
```

## src/mainboard/google/parrot/Kconfig.name
```kconfig
## SPDX-License-Identifier: GPL-2.0-only

comment "Parrot (Intel SandyBridge (2nd Gen))"

config BOARD_GOOGLE_PARROT
	bool "->  Parrot (Acer C7/C710 Chromebook)"
```

## src/mainboard/google/peach_pit/Kconfig
```kconfig
## SPDX-License-Identifier: GPL-2.0-only

if BOARD_GOOGLE_PEACH_PIT

config BOARD_SPECIFIC_OPTIONS
	def_bool y
	select BOOT_DEVICE_NOT_SPI_FLASH
	select CPU_SAMSUNG_EXYNOS5420
	select EC_GOOGLE_CHROMEEC
	select EC_GOOGLE_CHROMEEC_SPI
	select BOARD_ROMSIZE_KB_4096
	select MAINBOARD_HAS_NATIVE_VGA_INIT
	select MAINBOARD_FORCE_NATIVE_VGA_INIT
	select HAVE_LINEAR_FRAMEBUFFER
	select DRIVER_PARADE_PS8625
	select I2C_TPM
	select MAINBOARD_HAS_TPM1
	select MISSING_BOARD_RESET

config MAINBOARD_DIR
	default "google/peach_pit"

config MAINBOARD_PART_NUMBER
	default "Peach Pit"

config DRAM_SIZE_MB
	int
	default 2048

config EC_GOOGLE_CHROMEEC_SPI_BUS
	hex
	default 0x2

config UART_FOR_CONSOLE
	int
	default 3

endif # BOARD_GOOGLE_PEACH_PIT
```

## src/mainboard/google/peach_pit/Kconfig.name
```kconfig
## SPDX-License-Identifier: GPL-2.0-only

comment "Peach Pit (Samsung Exynos 5420)"

config BOARD_GOOGLE_PEACH_PIT
	bool "->  Peach Pit (Samsung Chromebook 2 11\")"
```

## src/mainboard/google/peppy/Kconfig
```kconfig
if BOARD_GOOGLE_PEPPY

config BOARD_SPECIFIC_OPTIONS # dummy
	def_bool y
	select SYSTEM_TYPE_LAPTOP
	select CPU_INTEL_HASWELL
	select NORTHBRIDGE_INTEL_HASWELL
	select SOUTHBRIDGE_INTEL_LYNXPOINT
	select INTEL_LYNXPOINT_LP
	select BOARD_ROMSIZE_KB_8192
	select EC_GOOGLE_CHROMEEC
	select HAVE_ACPI_TABLES
	select HAVE_OPTION_TABLE
	select HAVE_ACPI_RESUME
	select HAVE_SMI_HANDLER
	select MAINBOARD_HAS_CHROMEOS
	select MAINBOARD_HAS_LPC_TPM
	select MAINBOARD_HAS_NATIVE_VGA_INIT
	select INTEL_DP
	select INTEL_DDI
	select INTEL_INT15

config CHROMEOS
	select EC_GOOGLE_CHROMEEC_SWITCHES
	select EC_SOFTWARE_SYNC
	select LID_SWITCH
	select MAINBOARD_DO_NATIVE_VGA_INIT
	select VBOOT_VBNV_CMOS
	select VIRTUAL_DEV_SWITCH

config MAINBOARD_DIR
	string
	default google/peppy

config MAINBOARD_PART_NUMBER
	string
	default "Peppy"

config MMCONF_BASE_ADDRESS
	hex
	default 0xf0000000

config MAX_CPUS
	int
	default 8

config VGA_BIOS_FILE
	string
	default "pci8086,0166.rom"

config HAVE_IFD_BIN
	bool
	default n

config HAVE_ME_BIN
	bool
	default n

config GBB_HWID
	string
	depends on CHROMEOS
	default "X86 PEPPY TEST 4211"
endif
```

## src/mainboard/google/poppy/Kconfig
```kconfig
config BOARD_GOOGLE_BASEBOARD_POPPY
	def_bool n
	select BOARD_ROMSIZE_KB_16384
	select DRIVERS_GENERIC_GPIO_KEYS
	select DRIVERS_I2C_GENERIC
	select DRIVERS_I2C_HID
	select EC_GOOGLE_CHROMEEC
	select EC_GOOGLE_CHROMEEC_BOARDID
	select EC_GOOGLE_CHROMEEC_ESPI
	select HAVE_ACPI_RESUME
	select HAVE_ACPI_TABLES
	select HAVE_SPD_IN_CBFS
	select INTEL_LPSS_UART_FOR_CONSOLE
	select MAINBOARD_HAS_CHROMEOS
	select MAINBOARD_HAS_TPM2
	select SOC_INTEL_KABYLAKE
	select TPM_GOOGLE_CR50

config BOARD_GOOGLE_ATLAS
	select BOARD_GOOGLE_BASEBOARD_POPPY
	select CHROMEOS_WIFI_SAR if CHROMEOS
	select DRIVERS_I2C_DA7219
	select DRIVERS_I2C_MAX98373
	select DRIVERS_SPI_ACPI
	select DRIVERS_USB_ACPI
	select EXCLUDE_NATIVE_SD_INTERFACE
	select GEO_SAR_ENABLE if CHROMEOS_WIFI_SAR
	select INTEL_GMA_HAVE_VBT
	select MAINBOARD_HAS_LIBGFXINIT
	select SPI_TPM
	select SYSTEM_TYPE_LAPTOP
	select VARIANT_HAS_CAMERA_ACPI

config BOARD_GOOGLE_POPPY
	select BOARD_GOOGLE_BASEBOARD_POPPY
	select DRIVERS_I2C_MAX98927
	select I2C_TPM
	select NO_FADT_8042
	select SYSTEM_TYPE_LAPTOP
	select VARIANT_HAS_CAMERA_ACPI

config BOARD_GOOGLE_NAMI
	select BOARD_GOOGLE_BASEBOARD_POPPY
	select CHROMEOS_WIFI_SAR if CHROMEOS
	select DRIVERS_GENERIC_MAX98357A
	select DRIVERS_I2C_DA7219
	select DRIVERS_SPI_ACPI
	select EXCLUDE_NATIVE_SD_INTERFACE
	select INTEL_GMA_HAVE_VBT
	select SPI_TPM
	select SYSTEM_TYPE_LAPTOP

config BOARD_GOOGLE_NAUTILUS
	select BOARD_GOOGLE_BASEBOARD_POPPY
	select CHROMEOS_WIFI_SAR if CHROMEOS
	select DRIVERS_GENERIC_MAX98357A
	select DRIVERS_I2C_DA7219
	select I2C_TPM
	select INTEL_GMA_HAVE_VBT
	select SYSTEM_TYPE_CONVERTIBLE
	select VARIANT_HAS_CAMERA_ACPI

config BOARD_GOOGLE_NOCTURNE
	select BOARD_GOOGLE_BASEBOARD_POPPY
	select CHROMEOS_WIFI_SAR if CHROMEOS
	select DRIVERS_I2C_DA7219
	select DRIVERS_I2C_MAX98373
	select DRIVERS_I2C_SX9310
	select DRIVERS_SPI_ACPI
	select DRIVERS_USB_ACPI
	select EXCLUDE_NATIVE_SD_INTERFACE
	select GEO_SAR_ENABLE if CHROMEOS_WIFI_SAR
	select INTEL_GMA_HAVE_VBT
	select NO_FADT_8042
	select SPI_TPM
	select SYSTEM_TYPE_DETACHABLE
	select VARIANT_HAS_CAMERA_ACPI

config BOARD_GOOGLE_RAMMUS
	select BOARD_GOOGLE_BASEBOARD_POPPY
	select CHROMEOS_WIFI_SAR if CHROMEOS
	select DRIVERS_I2C_DA7219
	select DRIVERS_I2C_MAX98927
	select DRIVERS_SPI_ACPI
	select DRIVERS_USB_ACPI
	select INTEL_GMA_HAVE_VBT
	select MAINBOARD_HAS_LIBGFXINIT
	select SPI_TPM
	select SYSTEM_TYPE_LAPTOP

config BOARD_GOOGLE_SORAKA
	select BOARD_GOOGLE_BASEBOARD_POPPY
	select DRIVERS_I2C_MAX98927
	select I2C_TPM
	select INTEL_GMA_HAVE_VBT
	select NO_FADT_8042
	select SYSTEM_TYPE_DETACHABLE
	select VARIANT_HAS_CAMERA_ACPI

if BOARD_GOOGLE_BASEBOARD_POPPY

config DISABLE_HECI1_AT_PRE_BOOT
	default y

config CHROMEOS_WIFI_SAR
	bool
	depends on CHROMEOS
	select DSAR_ENABLE
	select SAR_ENABLE
	select USE_SAR

config DEVICETREE
	default "variants/atlas/devicetree.cb" if BOARD_GOOGLE_ATLAS
	default "variants/nami/devicetree.cb" if BOARD_GOOGLE_NAMI
	default "variants/nautilus/devicetree.cb" if BOARD_GOOGLE_NAUTILUS
	default "variants/nocturne/devicetree.cb" if BOARD_GOOGLE_NOCTURNE
	default "variants/rammus/devicetree.cb" if BOARD_GOOGLE_RAMMUS
	default "variants/soraka/devicetree.cb" if BOARD_GOOGLE_SORAKA
	default "variants/baseboard/devicetree.cb"

config DRIVER_TPM_I2C_BUS
	depends on I2C_TPM
	default 0x1

config DRIVER_TPM_I2C_ADDR
	depends on I2C_TPM
	default 0x50

config DRIVER_TPM_SPI_BUS
	depends on SPI_TPM
	default 0x1

config INCLUDE_NHLT_BLOBS
	bool "Include blobs for audio."
	select NHLT_DMIC_2CH
	select NHLT_DMIC_4CH
	select NHLT_MAX98927
	select NHLT_RT5663

config INCLUDE_NHLT_BLOBS_ATLAS
	bool "Include blobs for atlas audio."
	select NHLT_DA7219
	select NHLT_DMIC_4CH
	select NHLT_MAX98373

config INCLUDE_NHLT_BLOBS_NAUTILUS
	bool "Include blobs for nautilus audio."
	select NHLT_DA7219
	select NHLT_DMIC_4CH
	select NHLT_MAX98357

config INCLUDE_NHLT_BLOBS_NAMI
	bool "Include blobs for nami audio."
	select NHLT_DA7219
	select NHLT_DMIC_4CH
	select NHLT_MAX98357

config INCLUDE_NHLT_BLOBS_NOCTURNE
	bool "Include blobs for nocturne audio."
	select NHLT_DMIC_4CH
	select NHLT_MAX98373

config INCLUDE_NHLT_BLOBS_RAMMUS
	bool "Include blobs for rammus audio."
	select NHLT_DA7219
	select NHLT_DMIC_4CH
	select NHLT_MAX98927

config MAINBOARD_DIR
	default "google/poppy"

config MAINBOARD_FAMILY
	string
	default "Google_Atlas" if BOARD_GOOGLE_ATLAS
	default "Google_Poppy" if BOARD_GOOGLE_POPPY
	default "Google_Nami" if BOARD_GOOGLE_NAMI
	default "Google_Nautilus" if BOARD_GOOGLE_NAUTILUS
	default "Google_Nocturne" if BOARD_GOOGLE_NOCTURNE
	default "Google_Rammus" if BOARD_GOOGLE_RAMMUS
	default "Google_Soraka" if BOARD_GOOGLE_SORAKA

config MAINBOARD_PART_NUMBER
	default "Atlas" if BOARD_GOOGLE_ATLAS
	default "Poppy" if BOARD_GOOGLE_POPPY
	default "Nami" if BOARD_GOOGLE_NAMI
	default "Nautilus" if BOARD_GOOGLE_NAUTILUS
	default "Nocturne" if BOARD_GOOGLE_NOCTURNE
	default "Rammus" if BOARD_GOOGLE_RAMMUS
	default "Soraka" if BOARD_GOOGLE_SORAKA

config OEM_BIN_FILE
	string "OEM ID table"
	default ""

config TPM_TIS_ACPI_INTERRUPT
	int
	default 64  # GPE0_DW2_00 (GPP_E0)

config VARIANT_DIR
	default "atlas" if BOARD_GOOGLE_ATLAS
	default "poppy" if BOARD_GOOGLE_POPPY
	default "nami" if BOARD_GOOGLE_NAMI
	default "nautilus" if BOARD_GOOGLE_NAUTILUS
	default "nocturne" if BOARD_GOOGLE_NOCTURNE
	default "rammus" if BOARD_GOOGLE_RAMMUS
	default "soraka" if BOARD_GOOGLE_SORAKA

# Select this option to enable camera ACPI support on the variant.
config VARIANT_HAS_CAMERA_ACPI
	bool
	default n

config VBOOT
	select EC_GOOGLE_CHROMEEC_SWITCHES
	select HAS_RECOVERY_MRC_CACHE
	select VBOOT_LID_SWITCH

config UART_FOR_CONSOLE
	int
	default 2

config USE_PM_ACPI_TIMER
	default n

endif # BOARD_GOOGLE_BASEBOARD_POPPY
```

## src/mainboard/google/poppy/Kconfig.name
```kconfig
comment "Poppy"

config BOARD_GOOGLE_ATLAS
	bool "->  Atlas (Google Pixelbook Go)"

config BOARD_GOOGLE_POPPY
	bool "->  Poppy"

config BOARD_GOOGLE_NAMI
	bool "->  Nami"
	help
	  The Nami board supports the following devices:
	  - Acer Chromebook 13 / Spin 13 (Akali)
	  - Lenovo Yoga Chromebook C630 (Pantheon)
	  - HP Chromebook x360 14 (Sona)
	  - HP Chromebook 15 G1 (Syndra)
	  - Dell Inspiron Chromebook 14 (7460) (Vayne)

config BOARD_GOOGLE_NAUTILUS
	bool "->  Nautilus (Samsung Chromebook Plus V2, V2 LTE)"

config BOARD_GOOGLE_NOCTURNE
	bool "->  Nocturne (Google Pixel Slate)"

config BOARD_GOOGLE_RAMMUS
	bool "->  Rammus"
	help
	  The Rammus board supports the following devices:
	  - Asus Chromebook C425 (Leona)
	  - Asus Chromebook Flip C433/C434 (Shyvana)

config BOARD_GOOGLE_SORAKA
	bool "->  Soraka (HP Chromebook x2)"
```
