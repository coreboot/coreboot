## src/mainboard/google/sarien/Kconfig
```kconfig
config BOARD_GOOGLE_BASEBOARD_SARIEN
	def_bool n
	select BOARD_ROMSIZE_KB_32768
	select DRIVERS_GENERIC_BH720
	select DRIVERS_I2C_GENERIC
	select DRIVERS_I2C_HID
	select DRIVERS_SPI_ACPI
	select DRIVERS_USB_ACPI
	select EC_GOOGLE_WILCO
	select GOOGLE_SMBIOS_MAINBOARD_VERSION
	select HAVE_ACPI_RESUME
	select HAVE_ACPI_TABLES
	select INTEL_GMA_HAVE_VBT
	select INTEL_LPSS_UART_FOR_CONSOLE
	select MAINBOARD_HAS_CHROMEOS
	select MAINBOARD_HAS_I2C_TPM_CR50
	select MAINBOARD_HAS_TPM2
	select MAINBOARD_USES_IFD_EC_REGION
	select SAR_ENABLE
	select SMBIOS_SERIAL_FROM_VPD if VPD
	select SOC_INTEL_COMMON_BLOCK_HDA_VERB
	select SOC_INTEL_COMMON_BLOCK_SMM_ESPI_DISABLE
	select SOC_INTEL_WHISKEYLAKE
	select SPD_READ_BY_WORD
	select USE_SAR

config BOARD_GOOGLE_ARCADA
	select BOARD_GOOGLE_BASEBOARD_SARIEN
	select DRIVERS_INTEL_ISH
	select SYSTEM_TYPE_CONVERTIBLE

config BOARD_GOOGLE_SARIEN
	select BOARD_GOOGLE_BASEBOARD_SARIEN
	select MAINBOARD_USES_IFD_GBE_REGION
	select SYSTEM_TYPE_LAPTOP

if BOARD_GOOGLE_BASEBOARD_SARIEN

config DISABLE_HECI1_AT_PRE_BOOT
	default y

config CHROMEOS
	select GBB_FLAG_FORCE_DEV_SWITCH_ON
	select GBB_FLAG_FORCE_DEV_BOOT_USB
	select GBB_FLAG_FORCE_DEV_BOOT_ALTFW
	select GBB_FLAG_DISABLE_EC_SOFTWARE_SYNC

config DIMM_MAX
	default 2

config DRIVER_TPM_I2C_BUS
	hex
	default 0x4

config DRIVER_TPM_I2C_ADDR
	hex
	default 0x50

config TPM_TIS_ACPI_INTERRUPT
	int
	default 82  # GPE0_DW2_18 (GPP_D18)

config POWER_OFF_ON_CR50_UPDATE
	bool
	default n

config MAINBOARD_DIR
	default "google/sarien"

config MAINBOARD_FAMILY
	string
	default "Google_Arcada" if BOARD_GOOGLE_ARCADA
	default "Google_Sarien" if BOARD_GOOGLE_SARIEN

config MAINBOARD_PART_NUMBER
	default "Arcada" if BOARD_GOOGLE_ARCADA
	default "Sarien" if BOARD_GOOGLE_SARIEN

config MAX_CPUS
	int
	default 8

config UART_FOR_CONSOLE
	int
	default 2

config VARIANT_DIR
	default "arcada" if BOARD_GOOGLE_ARCADA
	default "sarien" if BOARD_GOOGLE_SARIEN

config DEVICETREE
	default "variants/\$(CONFIG_VARIANT_DIR)/devicetree.cb"

config VBOOT
	select HAS_RECOVERY_MRC_CACHE
	select VBOOT_LID_SWITCH

# Override the default variant behavior, since the data.vbt is the same
# for all variants.
config INTEL_GMA_VBT_FILE
	default "src/mainboard/\$(MAINBOARDDIR)/data.vbt"

endif # BOARD_GOOGLE_BASEBOARD_SARIEN
```

## src/mainboard/google/sarien/Kconfig.name
```kconfig
## SPDX-License-Identifier: GPL-2.0-only

comment "Sarien (Intel WhiskeyLake (8th Gen))"

config BOARD_GOOGLE_ARCADA
	bool "->  Arcada (Latitude 5300 2-in-1 Chromebook Enterprise)"

config BOARD_GOOGLE_SARIEN
	bool "->  Sarien (Dell Latitude 5400 Chromebook Enterprise)"
```

## src/mainboard/google/skyrim/Kconfig
```kconfig
# SPDX-License-Identifier: GPL-2.0-or-later

config BOARD_GOOGLE_BASEBOARD_SKYRIM
	def_bool n

config BOARD_GOOGLE_CRYSTALDRIFT
	select BOARD_GOOGLE_BASEBOARD_SKYRIM

config BOARD_GOOGLE_FROSTFLOW
	select BOARD_GOOGLE_BASEBOARD_SKYRIM
	select DRIVERS_GENESYSLOGIC_GL9755
	select FEATURE_TABLET_MODE_DPTC
	select SOC_AMD_COMMON_BLOCK_ACPI_DPTC
	select SYSTEM_TYPE_CONVERTIBLE

config BOARD_GOOGLE_MARKARTH
	select BOARD_GOOGLE_BASEBOARD_SKYRIM
	select SOC_AMD_COMMON_BLOCK_ACPI_DPTC

config BOARD_GOOGLE_SKYRIM
	select BOARD_GOOGLE_BASEBOARD_SKYRIM
	select SOC_AMD_COMMON_BLOCK_ACPI_DPTC

config BOARD_GOOGLE_WINTERHOLD
	select BOARD_GOOGLE_BASEBOARD_SKYRIM
	select SOC_AMD_COMMON_BLOCK_ACPI_DPTC
	select FEATURE_DYNAMIC_DPTC

if BOARD_GOOGLE_BASEBOARD_SKYRIM

config BOARD_SPECIFIC_OPTIONS
	def_bool y
	select ACPI_S1_NOT_SUPPORTED
	select AMD_FWM_POSITION_C20000_DEFAULT
	select AMD_SOC_CONSOLE_UART
	select BOARD_ROMSIZE_KB_16384
	select DISABLE_KEYBOARD_RESET_PIN
	select DISABLE_SPI_FLASH_ROM_SHARING
	select DRIVERS_GENERIC_GPIO_KEYS
	select DRIVERS_GENERIC_MAX98357A
	select DRIVERS_ACPI_THERMAL_ZONE
	select DRIVERS_I2C_GENERIC
	select DRIVERS_I2C_HID
	select DRIVERS_I2C_NAU8825
	select DRIVERS_USB_HUB
	select DRIVERS_UART_ACPI
	select DRIVERS_PCIE_GENERIC
	select DRIVERS_PCIE_RTD3_DEVICE
	select EC_GOOGLE_CHROMEEC
	select EC_GOOGLE_CHROMEEC_BOARDID
	select EC_GOOGLE_CHROMEEC_ESPI
	select EC_GOOGLE_CHROMEEC_SMBIOS
	select ELOG
	select ELOG_GSMI
	select FW_CONFIG
	select FW_CONFIG_SOURCE_CHROMEEC_CBI
	select GOOGLE_SMBIOS_MAINBOARD_VERSION
	select HAS_RECOVERY_MRC_CACHE
	select I2C_TPM
	select MAINBOARD_HAS_CHROMEOS
	select MAINBOARD_HAS_TPM2
	select MB_COMPRESS_RAMSTAGE_LZ4
	select PCIEXP_ASPM
	select PCIEXP_CLK_PM
	select PCIEXP_COMMON_CLOCK
	select PCIEXP_L1_SUB_STATE
	select SOC_AMD_MENDOCINO
	select SOC_AMD_COMMON_BLOCK_I2C3_TPM_SHARED_WITH_PSP
	select SOC_AMD_COMMON_BLOCK_USE_ESPI
	select SOC_AMD_GFX_CACHE_VBIOS_IN_FMAP if CHROMEOS && RUN_FSP_GOP
	select SYSTEM_TYPE_LAPTOP if !SYSTEM_TYPE_CONVERTIBLE
	select TPM_GOOGLE_TI50

config DEVICETREE
	default "variants/baseboard/devicetree.cb"

config DRIVER_TPM_I2C_BUS
	hex
	default 0x03

config DRIVER_TPM_I2C_ADDR
	hex
	default 0x50

config GSC_IRQ_GPIO
	int
	default 18

config AMDFW_CONFIG_FILE
	string
	default "src/mainboard/\$(CONFIG_MAINBOARD_DIR)/amdfw.cfg"
	help
	  Custom firmware list excluding the fwTPM binary.

config PSP_LOAD_MP2_FW
	prompt "Load MP2 Firmware"
	depends on CHROMEOS
	default y

config SPL_TABLE_FILE
	string
	default "3rdparty/blobs/mainboard/google/skyrim/TypeId0x55_SplTableBl_MDN_CHROME_RO.sbin"

config HAVE_SPL_RW_AB_FILE
	bool
	default y

config SPL_RW_AB_TABLE_FILE
	string
	default "3rdparty/blobs/mainboard/google/skyrim/TypeId0x55_SplTableBl_MDN_CHROME.sbin"

config PERFORM_SPL_FUSING
	default n if BOARD_GOOGLE_SKYRIM
	default y

config FMDFILE
	default "src/mainboard/\$(CONFIG_MAINBOARD_DIR)/chromeos.fmd"

config MAINBOARD_DIR
	default "google/skyrim"

config MAINBOARD_FAMILY
	string
	default "Google_Skyrim"

config MAINBOARD_PART_NUMBER
	default "Crystaldrift" if BOARD_GOOGLE_CRYSTALDRIFT
	default "Frostflow" if BOARD_GOOGLE_FROSTFLOW
	default "Markarth" if BOARD_GOOGLE_MARKARTH
	default "Skyrim" if BOARD_GOOGLE_SKYRIM
	default "Winterhold" if BOARD_GOOGLE_WINTERHOLD

config OVERRIDE_DEVICETREE
	string
	default "variants/\$(CONFIG_VARIANT_DIR)/overridetree.cb"

config VARIANT_DIR
	string
	default "crystaldrift" if BOARD_GOOGLE_CRYSTALDRIFT
	default "frostflow" if BOARD_GOOGLE_FROSTFLOW
	default "markarth" if BOARD_GOOGLE_MARKARTH
	default "skyrim" if BOARD_GOOGLE_SKYRIM
	default "winterhold" if BOARD_GOOGLE_WINTERHOLD

config USE_SELECTIVE_GOP_INIT
	default y if CHROMEOS && RUN_FSP_GOP && BOARD_GOOGLE_SKYRIM

config VBOOT
	select EC_GOOGLE_CHROMEEC_SWITCHES
	select VBOOT_LID_SWITCH
	select VBOOT_SEPARATE_VERSTAGE

config VBOOT_STARTS_BEFORE_BOOTBLOCK
	bool "Enable PSP_verstage"
	default y if VBOOT
	select SEPARATE_SIGNED_PSPFW

config VBOOT_STARTS_IN_BOOTBLOCK
	bool
	default y if VBOOT && !VBOOT_STARTS_BEFORE_BOOTBLOCK

if !EM100	# EM100 defaults in soc/amd/common/blocks/spi/Kconfig
config EFS_SPI_READ_MODE
	default 2 if BOARD_GOOGLE_SKYRIM          # Dual IO (1-1-2)
	default 4                                 # Dual IO (1-2-2)

config EFS_SPI_SPEED
	default 4 if BOARD_GOOGLE_WINTERHOLD
	default 0	# 66MHz

config EFS_SPI_MICRON_FLAG
	default 0

config NORMAL_READ_SPI_SPEED
	default 1	# 33MHz

config ALT_SPI_SPEED
	default 4 if BOARD_GOOGLE_WINTERHOLD
	default 0	# 66MHz

endif # !EM100

config OVERRIDE_EFS_SPI_SPEED
	int
	default 3 if EM100
	default 4	# 100MHz
	help
	  Override EFS SPI Speed Configuration to be applied based on certain
	  board version.

config OVERRIDE_EFS_SPI_SPEED_MIN_BOARD
	hex
	default 0x1 if BOARD_GOOGLE_CRYSTALDRIFT
	default 0x1 if BOARD_GOOGLE_FROSTFLOW
	default 0x1 if BOARD_GOOGLE_MARKARTH
	default 0x5 if BOARD_GOOGLE_SKYRIM
	default 0xffffffff
	help
	  Minimum board version starting which the Override EFS SPI Speed
	  configuration has to be applied.

config CONSOLE_CBMEM_BUFFER_SIZE
	hex
	default 0x80000

config ENABLE_STB_SPILL_TO_DRAM
	default y
	help
	  Spill-to-DRAM is an STB feature that extends the buffer from using
	  just the small SRAM buffer to a much larger area reserved in main
	  memory.

config CARDBUS_PLUGIN_SUPPORT
	default n

# Exclude support for SPI ROM types that won't be used on Skyrim platforms
config SPI_FLASH_DONT_INCLUDE_ALL_DRIVERS
	default y

# Gigadevice is used on Whiterun as an alternative to Winbond
config SPI_FLASH_GIGADEVICE
	default y

# XMC chips used on Markarth as an alternative to Winbond
# These chips identify as ST Micro (Manufacturer ID: 0x20)
config SPI_FLASH_STMICRO
	default y

# Winbond chips are used by all Skyrim devices as the primary flash chip
config SPI_FLASH_WINBOND
	default y

endif # BOARD_GOOGLE_BASEBOARD_SKYRIM
```

## src/mainboard/google/skyrim/Kconfig.name
```kconfig
## SPDX-License-Identifier: GPL-2.0-only

comment "Skyrim"

config BOARD_GOOGLE_CRYSTALDRIFT
	bool "->  Crystaldrift (SPC Chromebook V1)"

config BOARD_GOOGLE_FROSTFLOW
	bool "->  Frostflow (ASUS Chromebook CM34 Flip)"

config BOARD_GOOGLE_MARKARTH
	bool "->  Markarth (Acer Chromebook Plus 514)"

config BOARD_GOOGLE_SKYRIM
	bool "->  Skyrim"

config BOARD_GOOGLE_WINTERHOLD
	bool "->  Winterhold (Dell Latitude 3445 Chromebook)"
```

## src/mainboard/google/skywalker/Kconfig
```kconfig
## SPDX-License-Identifier: GPL-2.0-only OR MIT

# Umbrella option to be selected by variant boards.
config BOARD_GOOGLE_SKYWALKER_COMMON
	def_bool BOARD_GOOGLE_ANAKIN || \
		 BOARD_GOOGLE_BAZE || \
		 BOARD_GOOGLE_OBIWAN || \
		 BOARD_GOOGLE_SKYWALKER || \
		 BOARD_GOOGLE_TARKIN || \
		 BOARD_GOOGLE_YODA

if BOARD_GOOGLE_SKYWALKER_COMMON

config SKYWALKER_SDCARD_INIT
	def_bool BOARD_GOOGLE_SKYWALKER

config VBOOT
	select EC_GOOGLE_CHROMEEC_SWITCHES
	select VBOOT_VBNV_FLASH

config BOARD_SPECIFIC_OPTIONS
	def_bool y
	select SOC_MEDIATEK_MT8189
	select BOARD_ROMSIZE_KB_8192
	select MAINBOARD_HAS_CHROMEOS
	select CHROMEOS_USE_EC_WATCHDOG_FLAG if CHROMEOS
	select COMMON_CBFS_SPI_WRAPPER
	select SPI_FLASH
	select SPI_FLASH_INCLUDE_ALL_DRIVERS
	select MAINBOARD_HAS_NATIVE_VGA_INIT
	select HAVE_LINEAR_FRAMEBUFFER
	select EC_GOOGLE_CHROMEEC
	select EC_GOOGLE_CHROMEEC_BOARDID
	select EC_GOOGLE_CHROMEEC_SPI
	select I2C_TPM if VBOOT
	select MAINBOARD_HAS_TPM2 if VBOOT
	select TPM_GOOGLE_TI50 if VBOOT
	select FW_CONFIG
	select FW_CONFIG_SOURCE_CHROMEEC_CBI
	select RTC
	select COMMONLIB_STORAGE
	select COMMONLIB_STORAGE_MMC

config MAINBOARD_DIR
	string
	default "google/skywalker"

config MAINBOARD_PART_NUMBER
	string
	default "Anakin" if BOARD_GOOGLE_ANAKIN
	default "Baze" if BOARD_GOOGLE_BAZE
	default "Obiwan" if BOARD_GOOGLE_OBIWAN
	default "Skywalker" if BOARD_GOOGLE_SKYWALKER
	default "Tarkin" if BOARD_GOOGLE_TARKIN
	default "Yoda" if BOARD_GOOGLE_YODA

config BOOT_DEVICE_SPI_FLASH_BUS
	int
	default 7

config EC_GOOGLE_CHROMEEC_SPI_BUS
	hex
	default 0x0

config DRIVER_TPM_I2C_BUS
	hex
	default 0x3

config DRIVER_TPM_I2C_ADDR
	hex
	default 0x50

endif
```

## src/mainboard/google/skywalker/Kconfig.name
```kconfig
## SPDX-License-Identifier: GPL-2.0-only OR MIT

comment "Skywalker (MediaTek Kompanio 540 (MT8189))"

config BOARD_GOOGLE_ANAKIN
	bool "->  Anakin"

config BOARD_GOOGLE_BAZE
	bool "->  Baze"

config BOARD_GOOGLE_DOOKU
	bool "->  Dooku"

config BOARD_GOOGLE_GROGU
	bool "->  Grogu"

config BOARD_GOOGLE_JAINA
	bool "->  Jaina"

config BOARD_GOOGLE_MACE
	bool "->  Mace"

config BOARD_GOOGLE_OBIWAN
	bool "->  Obiwan"

config BOARD_GOOGLE_PADME
	bool "->  Padme"

config BOARD_GOOGLE_SKYWALKER
	bool "->  Skywalker"

config BOARD_GOOGLE_TARKIN
	bool "->  Tarkin"

config BOARD_GOOGLE_VADER
	bool "->  Vader"

config BOARD_GOOGLE_YODA
	bool "->  Yoda"
```

## src/mainboard/google/slippy/Kconfig
```kconfig
config BOARD_GOOGLE_BASEBOARD_SLIPPY
	def_bool n
	select BOARD_ROMSIZE_KB_8192
	select EC_GOOGLE_CHROMEEC
	select EC_GOOGLE_CHROMEEC_LPC
	select HAVE_ACPI_RESUME
	select HAVE_ACPI_TABLES
	select HAVE_OPTION_TABLE
	select HAVE_SPD_IN_CBFS
	select INTEL_GMA_HAVE_VBT
	select INTEL_INT15
	select INTEL_LYNXPOINT_LP
	select MAINBOARD_HAS_CHROMEOS
	select MAINBOARD_HAS_LIBGFXINIT
	select MAINBOARD_HAS_LPC_TPM
	select MAINBOARD_HAS_TPM1
	select NORTHBRIDGE_INTEL_HASWELL
	select SOUTHBRIDGE_INTEL_LYNXPOINT
	select SYSTEM_TYPE_LAPTOP

config BOARD_GOOGLE_FALCO
	select BOARD_GOOGLE_BASEBOARD_SLIPPY

config BOARD_GOOGLE_LEON
	select BOARD_GOOGLE_BASEBOARD_SLIPPY
	select DRIVERS_I2C_RTD2132

config BOARD_GOOGLE_PEPPY
	select BOARD_GOOGLE_BASEBOARD_SLIPPY

config BOARD_GOOGLE_WOLF
	select BOARD_GOOGLE_BASEBOARD_SLIPPY

if BOARD_GOOGLE_BASEBOARD_SLIPPY

config VBOOT
	select EC_GOOGLE_CHROMEEC_SWITCHES
	select VBOOT_LID_SWITCH
	select VBOOT_VBNV_CMOS

config MAINBOARD_DIR
	default "google/slippy"

config VARIANT_DIR
	default "falco" if BOARD_GOOGLE_FALCO
	default "leon" if BOARD_GOOGLE_LEON
	default "peppy" if BOARD_GOOGLE_PEPPY
	default "wolf" if BOARD_GOOGLE_WOLF

config MAINBOARD_PART_NUMBER
	default "Falco" if BOARD_GOOGLE_FALCO
	default "Leon" if BOARD_GOOGLE_LEON
	default "Peppy" if BOARD_GOOGLE_PEPPY
	default "Wolf" if BOARD_GOOGLE_WOLF

config MAINBOARD_FAMILY
	string
	default "Google_Slippy"

config OVERRIDE_DEVICETREE
	default "variants/\$(CONFIG_VARIANT_DIR)/overridetree.cb"

# Override the default variant behavior, since the data.vbt is the same
# for all variants.
config INTEL_GMA_VBT_FILE
	default "src/mainboard/\$(MAINBOARDDIR)/data.vbt"

config MAINBOARD_SMBIOS_MANUFACTURER
	string
	default "GOOGLE"

config ENABLE_DDR_2X_REFRESH
	default y if BOARD_GOOGLE_FALCO

endif # BOARD_GOOGLE_BASEBOARD_SLIPPY
```
