## src/mainboard/google/rambi/Kconfig
```kconfig
config BOARD_GOOGLE_BASEBOARD_RAMBI
	def_bool n
	select BOARD_ROMSIZE_KB_8192
	select EC_GOOGLE_CHROMEEC
	select EC_GOOGLE_CHROMEEC_LPC
	select ENABLE_BUILTIN_COM1 if CONSOLE_SERIAL
	select HAVE_ACPI_RESUME
	select HAVE_ACPI_TABLES
	select HAVE_OPTION_TABLE
	select HAVE_SPD_IN_CBFS
	select MAINBOARD_HAS_CHROMEOS
	select MEMORY_MAPPED_TPM
	select MAINBOARD_HAS_TPM1
	select SOC_INTEL_BAYTRAIL

config BOARD_GOOGLE_BANJO
	select BOARD_GOOGLE_BASEBOARD_RAMBI
	select INTEL_GMA_HAVE_VBT
	select SYSTEM_TYPE_LAPTOP

config BOARD_GOOGLE_CANDY
	select BOARD_GOOGLE_BASEBOARD_RAMBI
	select INTEL_GMA_HAVE_VBT
	select SYSTEM_TYPE_LAPTOP

config BOARD_GOOGLE_CLAPPER
	select BOARD_GOOGLE_BASEBOARD_RAMBI
	select INTEL_GMA_HAVE_VBT
	select SYSTEM_TYPE_LAPTOP

config BOARD_GOOGLE_ENGUARDE
	select BOARD_GOOGLE_BASEBOARD_RAMBI
	select INTEL_GMA_HAVE_VBT
	select SYSTEM_TYPE_LAPTOP

config BOARD_GOOGLE_GLIMMER
	select BOARD_GOOGLE_BASEBOARD_RAMBI
	select INTEL_GMA_HAVE_VBT
	select SYSTEM_TYPE_LAPTOP

config BOARD_GOOGLE_GNAWTY
	select BOARD_GOOGLE_BASEBOARD_RAMBI
	select INTEL_GMA_HAVE_VBT
	select SYSTEM_TYPE_LAPTOP

config BOARD_GOOGLE_HELI
	select BOARD_GOOGLE_BASEBOARD_RAMBI
	select INTEL_GMA_HAVE_VBT
	select SYSTEM_TYPE_LAPTOP

config BOARD_GOOGLE_KIP
	select BOARD_GOOGLE_BASEBOARD_RAMBI
	select INTEL_GMA_HAVE_VBT
	select SYSTEM_TYPE_LAPTOP

config BOARD_GOOGLE_NINJA
	select BOARD_GOOGLE_BASEBOARD_RAMBI
	select INTEL_GMA_HAVE_VBT

config BOARD_GOOGLE_ORCO
	select BOARD_GOOGLE_BASEBOARD_RAMBI
	select INTEL_GMA_HAVE_VBT
	select SYSTEM_TYPE_LAPTOP

config BOARD_GOOGLE_QUAWKS
	select BOARD_GOOGLE_BASEBOARD_RAMBI
	select INTEL_GMA_HAVE_VBT
	select SYSTEM_TYPE_LAPTOP

config BOARD_GOOGLE_SQUAWKS
	select BOARD_GOOGLE_BASEBOARD_RAMBI
	select INTEL_GMA_HAVE_VBT
	select SYSTEM_TYPE_LAPTOP

config BOARD_GOOGLE_RAMBI
	select BOARD_GOOGLE_BASEBOARD_RAMBI
	select SYSTEM_TYPE_LAPTOP

config BOARD_GOOGLE_SUMO
	select BOARD_GOOGLE_BASEBOARD_RAMBI
	select INTEL_GMA_HAVE_VBT

config BOARD_GOOGLE_SWANKY
	select BOARD_GOOGLE_BASEBOARD_RAMBI
	select INTEL_GMA_HAVE_VBT
	select SYSTEM_TYPE_LAPTOP

config BOARD_GOOGLE_WINKY
	select BOARD_GOOGLE_BASEBOARD_RAMBI
	select INTEL_GMA_HAVE_VBT
	select SYSTEM_TYPE_LAPTOP

if BOARD_GOOGLE_BASEBOARD_RAMBI

config VBOOT
	select EC_GOOGLE_CHROMEEC_SWITCHES
	select VBOOT_LID_SWITCH
	select VBOOT_VBNV_CMOS

config MAINBOARD_DIR
	default "google/rambi"

config VARIANT_DIR
	default "banjo" if BOARD_GOOGLE_BANJO
	default "candy" if BOARD_GOOGLE_CANDY
	default "clapper" if BOARD_GOOGLE_CLAPPER
	default "enguarde" if BOARD_GOOGLE_ENGUARDE
	default "glimmer" if BOARD_GOOGLE_GLIMMER
	default "gnawty" if BOARD_GOOGLE_GNAWTY
	default "heli" if BOARD_GOOGLE_HELI
	default "kip" if BOARD_GOOGLE_KIP
	default "ninja" if BOARD_GOOGLE_NINJA
	default "orco" if BOARD_GOOGLE_ORCO
	default "quawks" if BOARD_GOOGLE_QUAWKS
	default "rambi" if BOARD_GOOGLE_RAMBI
	default "squawks" if BOARD_GOOGLE_SQUAWKS
	default "sumo" if BOARD_GOOGLE_SUMO
	default "swanky" if BOARD_GOOGLE_SWANKY
	default "winky" if BOARD_GOOGLE_WINKY

config MAINBOARD_PART_NUMBER
	default "Banjo" if BOARD_GOOGLE_BANJO
	default "Candy" if BOARD_GOOGLE_CANDY
	default "Clapper" if BOARD_GOOGLE_CLAPPER
	default "Enguarde" if BOARD_GOOGLE_ENGUARDE
	default "Glimmer" if BOARD_GOOGLE_GLIMMER
	default "Gnawty" if BOARD_GOOGLE_GNAWTY
	default "Heli" if BOARD_GOOGLE_HELI
	default "Kip" if BOARD_GOOGLE_KIP
	default "Ninja" if BOARD_GOOGLE_NINJA
	default "Orco" if BOARD_GOOGLE_ORCO
	default "Quawks" if BOARD_GOOGLE_QUAWKS
	default "Rambi" if BOARD_GOOGLE_RAMBI
	default "Squawks" if BOARD_GOOGLE_SQUAWKS
	default "Sumo" if BOARD_GOOGLE_SUMO
	default "Swanky" if BOARD_GOOGLE_SWANKY
	default "Winky" if BOARD_GOOGLE_WINKY

config OVERRIDE_DEVICETREE
	default "variants/\$(CONFIG_VARIANT_DIR)/overridetree.cb"

config EC_GOOGLE_CHROMEEC_BOARDNAME
	string
	default ""

config MAINBOARD_SMBIOS_MANUFACTURER
	string
	default "GOOGLE"

config CONSOLE_SERIAL
	bool
	default n

config SEABIOS_HARDWARE_IRQ
	bool
	default n

endif # BOARD_GOOGLE_BASEBOARD_RAMBI
```

## src/mainboard/google/rambi/Kconfig.name
```kconfig
## SPDX-License-Identifier: GPL-2.0-only

comment "Rambi"

config BOARD_GOOGLE_BANJO
	bool "->  Banjo (Acer Chromebook 15 (CB3-531))"

config BOARD_GOOGLE_CANDY
	bool "->  Candy (Dell Chromebook 11 3120)"

config BOARD_GOOGLE_CLAPPER
	bool "->  Clapper (Lenovo N20 Chromebook)"

config BOARD_GOOGLE_ENGUARDE
	bool "->  Enguarde (Multiple devices - See help text)"
	help
	  The Enguarde board supports the following devices:
	  - ASI Chromebook
	  - CTL N6 Education Chromebook
	  - Crambo Chromebook
	  - Education Chromebook
	  - Edxis Education Chromebook (NL6)
	  - JP Sa Couto Chromebook
	  - Lenovo N21 Chromebook
	  - M&A Chromebook
	  - RGS Education Chromebook
	  - Senkatel C1101 Chromebook
	  - True IDC Chromebook
	  - Videonet Chromebook
	  - eduGear Chromebook R

config BOARD_GOOGLE_EXPRESSO
	bool "->  Expresso (Multiple devices - See help text)"
	help
	  The Expresso board supports the following devices:
	  - Bobicus Chromebook 11
	  - Consumer Chromebook
	  - Edxis Chromebook
	  - HEXA Chromebook Pi

config BOARD_GOOGLE_GLIMMER
	bool "->  Glimmer (Lenovo ThinkPad 11e Chromebook)"

config BOARD_GOOGLE_GNAWTY
	bool "->  Gnawty (Acer Chromebook 11 (CB3-111/131,C730/C730E/C735))"

config BOARD_GOOGLE_HELI
	bool "->  Heli (Haier Chromebook G2)"

config BOARD_GOOGLE_KIP
	bool "->  Kip (HP Chromebook 11 G3 / G4 / G4 EE)"

config BOARD_GOOGLE_NINJA
	bool "->  Ninja (AOpen Chromebox Commercial)"

config BOARD_GOOGLE_ORCO
	bool "->  Orco (Lenovo 100S Chromebook)"

config BOARD_GOOGLE_QUAWKS
	bool "->  Quawks (ASUS Chromebook C300)"

config BOARD_GOOGLE_SQUAWKS
	bool "->  Squawks (ASUS Chromebook C200)"

config BOARD_GOOGLE_RAMBI
	bool "->  Rambi"

config BOARD_GOOGLE_SUMO
	bool "->  Sumo (AOpen Chromebase Commercial)"

config BOARD_GOOGLE_SWANKY
	bool "->  Swanky (Toshiba Chromebook 2)"

config BOARD_GOOGLE_WINKY
	bool "->  Winky (Samsung Chromebook 2 (XE500C12))"
```

## src/mainboard/google/rauru/Kconfig
```kconfig
## SPDX-License-Identifier: GPL-2.0-only

# Umbrella option to be selected by variant boards.
config BOARD_GOOGLE_RAURU_COMMON
	def_bool BOARD_GOOGLE_HYLIA || \
		 BOARD_GOOGLE_NAVI || \
		 BOARD_GOOGLE_RAURU

if BOARD_GOOGLE_RAURU_COMMON

config RAURU_SDCARD_INIT
	def_bool BOARD_GOOGLE_RAURU

config VBOOT
	select VBOOT_VBNV_FLASH
	select EC_GOOGLE_CHROMEEC_SWITCHES

config BOARD_SPECIFIC_OPTIONS
	def_bool y
	select SOC_MEDIATEK_MT8196
	select BOARD_ROMSIZE_KB_8192
	select MAINBOARD_HAS_CHROMEOS
	select COMMON_CBFS_SPI_WRAPPER
	select SPI_FLASH
	select SPI_FLASH_INCLUDE_ALL_DRIVERS
	select MAINBOARD_HAS_NATIVE_VGA_INIT
	select HAVE_LINEAR_FRAMEBUFFER
	select CHROMEOS_USE_EC_WATCHDOG_FLAG if CHROMEOS
	select EC_GOOGLE_CHROMEEC
	select EC_GOOGLE_CHROMEEC_BOARDID
	select EC_GOOGLE_CHROMEEC_SKUID
	select EC_GOOGLE_CHROMEEC_SPI
	select I2C_TPM if VBOOT
	select MAINBOARD_HAS_TPM2 if VBOOT
	select TPM_GOOGLE_TI50 if VBOOT
	select COMMONLIB_STORAGE
	select COMMONLIB_STORAGE_MMC
	select FW_CONFIG
	select FW_CONFIG_SOURCE_CHROMEEC_CBI

config MAINBOARD_DIR
	string
	default "google/rauru"

config MAINBOARD_PART_NUMBER
	string
	default "Hylia" if BOARD_GOOGLE_HYLIA
	default "Navi" if BOARD_GOOGLE_NAVI
	default "Rauru" if BOARD_GOOGLE_RAURU

config BOOT_DEVICE_SPI_FLASH_BUS
	int
	default 8

config EC_GOOGLE_CHROMEEC_SPI_BUS
	hex
	default 0x1

config DRIVER_TPM_I2C_BUS
	hex
	default 0x1

config DRIVER_TPM_I2C_ADDR
	hex
	default 0x50

endif
```

## src/mainboard/google/rauru/Kconfig.name
```kconfig
## SPDX-License-Identifier: GPL-2.0-only

comment "Rauru (MediaTek Kompanio Ultra 910 (MT8196))"

config BOARD_GOOGLE_HYLIA
	bool "->  Hylia (Acer Chromebook Plus Spin 514 (CP514-5HN/CPE594-2N))"

config BOARD_GOOGLE_NAVI
	bool "->  Navi (Lenovo Chromebook Plus (14M9610))"

config BOARD_GOOGLE_RAURU
	bool "->  Rauru"

config BOARD_GOOGLE_SAPPHIRE
	bool "->  Sapphire"
```

## src/mainboard/google/reef/Kconfig
```kconfig
config BOARD_GOOGLE_BASEBOARD_REEF
	def_bool n
	select BOARD_ROMSIZE_KB_16384
	select DRIVERS_GENERIC_MAX98357A
	select DRIVERS_I2C_DA7219
	select DRIVERS_I2C_GENERIC
	select DRIVERS_I2C_HID
	select DSAR_ENABLE
	select EC_GOOGLE_CHROMEEC
	select EC_GOOGLE_CHROMEEC_BOARDID
	select EC_GOOGLE_CHROMEEC_LPC
	select GOOGLE_SMBIOS_MAINBOARD_VERSION
	select HAVE_ACPI_RESUME
	select HAVE_ACPI_TABLES
	select I2C_TPM
	select INTEL_GMA_HAVE_VBT
	select INTEL_LPSS_UART_FOR_CONSOLE
	select MAINBOARD_HAS_CHROMEOS
	select MAINBOARD_HAS_TPM2
	select SAR_ENABLE
	select SOC_INTEL_APOLLOLAKE
	select SYSTEM_TYPE_LAPTOP
	select TPM_GOOGLE_CR50
	select USE_SAR

config BOARD_GOOGLE_REEF
	select BOARD_GOOGLE_BASEBOARD_REEF

config BOARD_GOOGLE_PYRO
	select BOARD_GOOGLE_BASEBOARD_REEF

config BOARD_GOOGLE_SAND
	select BOARD_GOOGLE_BASEBOARD_REEF

config BOARD_GOOGLE_SNAPPY
	select BOARD_GOOGLE_BASEBOARD_REEF

config BOARD_GOOGLE_CORAL
	select BOARD_GOOGLE_BASEBOARD_REEF

if BOARD_GOOGLE_BASEBOARD_REEF

config DRIVER_TPM_I2C_BUS
	hex
	default 0x2

config DRIVER_TPM_I2C_ADDR
	hex
	default 0x50

config TPM_TIS_ACPI_INTERRUPT
	int
	default 60 # GPE0_DW1_28

config VBOOT
	select EC_GOOGLE_CHROMEEC_SWITCHES
	select HAS_RECOVERY_MRC_CACHE
	select VBOOT_LID_SWITCH

config MAINBOARD_DIR
	default "google/reef"

config VARIANT_DIR
	default "reef" if BOARD_GOOGLE_REEF
	default "pyro" if BOARD_GOOGLE_PYRO
	default "sand" if BOARD_GOOGLE_SAND
	default "snappy" if BOARD_GOOGLE_SNAPPY
	default "coral" if BOARD_GOOGLE_CORAL

config DEVICETREE
	default "variants/coral/devicetree.cb" if BOARD_GOOGLE_CORAL
	default "variants/pyro/devicetree.cb" if BOARD_GOOGLE_PYRO
	default "variants/sand/devicetree.cb" if BOARD_GOOGLE_SAND
	default "variants/snappy/devicetree.cb" if BOARD_GOOGLE_SNAPPY
	default "variants/baseboard/devicetree.cb"

config MAINBOARD_PART_NUMBER
	default "Reef" if BOARD_GOOGLE_REEF
	default "Pyro" if BOARD_GOOGLE_PYRO
	default "Sand" if BOARD_GOOGLE_SAND
	default "Snappy" if BOARD_GOOGLE_SNAPPY
	default "Coral" if BOARD_GOOGLE_CORAL

config MAINBOARD_FAMILY
	string
	default "Google_Coral" if BOARD_GOOGLE_CORAL
	default "Google_Reef"

config UART_FOR_CONSOLE
	int
	default 2

config INCLUDE_NHLT_BLOBS
	bool "Include blobs for audio."
	select NHLT_DMIC_4CH_16B
	select NHLT_DA7219
	select NHLT_MAX98357

config PRERAM_CBMEM_CONSOLE_SIZE
	hex
	default 0xe00 if CHROMEOS
	default 0xc00

config FMDFILE
	default "src/mainboard/\$(CONFIG_MAINBOARD_DIR)/default.fmd" if !CHROMEOS

endif # BOARD_GOOGLE_REEF
```

## src/mainboard/google/reef/Kconfig.name
```kconfig
comment "Reef"

config BOARD_GOOGLE_REEF
	bool "->  Reef/Electro (Acer Chromebook Spin 11 R751T)"

config BOARD_GOOGLE_PYRO
	bool "->  Pyro (Lenovo Thinkpad (Yoga) 11e Chromebook)"

config BOARD_GOOGLE_SAND
	bool "->  Sand (Acer Chromebook 15 CB515-1HT/1H)"

config BOARD_GOOGLE_SNAPPY
	bool "->  Snappy (HP Chromebook x360 11 G1 EE)"

config BOARD_GOOGLE_NASHER
	bool "->  Nasher"

config BOARD_GOOGLE_CORAL
	bool "->  Coral"
```
