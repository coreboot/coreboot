## src/mainboard/google/slippy/Kconfig.name
```kconfig
comment "Slippy"

config BOARD_GOOGLE_FALCO
	bool "->  Falco (HP Chromebook 14)"

config BOARD_GOOGLE_LEON
	bool "->  Leon (Toshiba Chromebook)"

config BOARD_GOOGLE_PEPPY
	bool "->  Peppy (Acer C720/C720P Chromebook)"

config BOARD_GOOGLE_WOLF
	bool "->  Wolf (Dell Chromebook 11)"
```

## src/mainboard/google/smaug/Kconfig
```kconfig
## SPDX-License-Identifier: GPL-2.0-only

if BOARD_GOOGLE_SMAUG

config BOARD_SPECIFIC_OPTIONS
	def_bool y
	select BOARD_ROMSIZE_KB_16384
	select COMMON_CBFS_SPI_WRAPPER
	select EC_GOOGLE_CHROMEEC
	select EC_GOOGLE_CHROMEEC_I2C
	select EC_GOOGLE_CHROMEEC_I2C_PROTO3
	select I2C_TPM
	select MAINBOARD_HAS_NATIVE_VGA_INIT
	select MAINBOARD_FORCE_NATIVE_VGA_INIT
	select SPI_FLASH
	select SPI_FLASH_WINBOND
	select SOC_NVIDIA_TEGRA210
	select MAINBOARD_DO_DSI_INIT
	select MAINBOARD_HAS_CHROMEOS
	select MAINBOARD_HAS_TPM1
	select DRIVERS_TI_TPS65913_RTC

config VBOOT
	select EC_GOOGLE_CHROMEEC_SWITCHES
	select VBOOT_VBNV_FLASH

config MAINBOARD_DIR
	default "google/smaug"

config MAINBOARD_PART_NUMBER
	default "Smaug"

config DRAM_SIZE_MB
	int
	default 2048

choice
	prompt "BCT boot media"
	default SMAUG_BCT_CFG_SPI
	help
	  Which boot media to configure the BCT for.

config SMAUG_BCT_CFG_SPI
	bool "SPI"
	help
	  Configure the BCT for booting from SPI.

config SMAUG_BCT_CFG_EMMC
	bool "eMMC"
	help
	  Configure the BCT for booting from eMMC.

endchoice

config BOOT_DEVICE_SPI_FLASH_BUS
	int "SPI bus with boot media ROM"
	range 1 7
	depends on SMAUG_BCT_CFG_SPI
	default 7
	help
	  Which SPI bus the boot media is connected to.

config DRIVER_TPM_I2C_BUS
	hex
	default 0x2

config DRIVER_TPM_I2C_ADDR
	hex
	default 0x20

config EC_GOOGLE_CHROMEEC_I2C_BUS
	hex
	default 0x1

config DRIVERS_TI_TPS65913_RTC_BUS
	int
	default 4

config DRIVERS_TI_TPS65913_RTC_ADDR
	hex
	default 0x58

endif # BOARD_GOOGLE_SMAUG
```

## src/mainboard/google/smaug/Kconfig.name
```kconfig
## SPDX-License-Identifier: GPL-2.0-only

comment "Smaug (Nvidia Tegra X1 (T210))"

config BOARD_GOOGLE_SMAUG
	bool "->  Smaug (Google Pixel C)"
```

## src/mainboard/google/snow/Kconfig
```kconfig
##
## This file is part of the coreboot project.
##
## Copyright 2013 Google Inc.
##
## This program is free software; you can redistribute it and/or modify
## it under the terms of the GNU General Public License as published by
## the Free Software Foundation; version 2 of the License.
##
## This program is distributed in the hope that it will be useful,
## but WITHOUT ANY WARRANTY; without even the implied warranty of
## MERCHANTABILITY or FITNESS FOR A PARTICULAR PURPOSE.  See the
## GNU General Public License for more details.
##
## You should have received a copy of the GNU General Public License
## along with this program; if not, write to the Free Software
## Foundation, Inc., 51 Franklin St, Fifth Floor, Boston, MA 02110-1301 USA
##

if BOARD_GOOGLE_SNOW

config BOARD_SPECIFIC_OPTIONS # dummy
	def_bool y
	select ARCH_ARMV7
	select CPU_SAMSUNG_EXYNOS5250
	select HAVE_UART_MEMORY_MAPPED
	select EC_GOOGLE_CHROMEEC
	select EC_GOOGLE_CHROMEEC_I2C
	select BOARD_ROMSIZE_KB_4096
	select DRIVER_MAXIM_MAX77686
	select CHROMEOS
	select DRIVER_TI_TPS65090
	select MAINBOARD_HAS_NATIVE_VGA_INIT
	select MAINBOARD_DO_NATIVE_VGA_INIT

config MAINBOARD_DIR
	string
	default google/snow

config MAINBOARD_PART_NUMBER
	string
	default "Snow"

config MAX_CPUS
	int
	default 2

config DRAM_SIZE_MB
	int
	default 2048

config EC_GOOGLE_CHROMEEC_I2C_BUS
	hex
	default 4

endif # BOARD_GOOGLE_SNOW
```

## src/mainboard/google/storm/Kconfig
```kconfig
## SPDX-License-Identifier: GPL-2.0-only

if BOARD_GOOGLE_STORM

config BOARD_SPECIFIC_OPTIONS
	def_bool y
	select SOC_QC_IPQ806X
	select BOARD_ROMSIZE_KB_8192
	select COMMON_CBFS_SPI_WRAPPER
	select DRIVERS_I2C_WW_RING
	select MAINBOARD_HAS_CHROMEOS
	select SPI_FLASH
	select SPI_FLASH_SPANSION
	select SPI_FLASH_STMICRO
	select DRIVERS_UART
	select I2C_TPM
	select MAINBOARD_HAS_TPM1

config VBOOT
	select VBOOT_DISABLE_DEV_ON_RECOVERY
	select VBOOT_WIPEOUT_SUPPORTED

config BOARD_VARIANT_AP148
	bool "pick this to build an image for ap148"
	default n

config MAINBOARD_DIR
	default "google/storm"

config MAINBOARD_PART_NUMBER
	default "AP148" if BOARD_VARIANT_AP148
	default "Storm"

config DRAM_SIZE_MB
	int
	default 512 if BOARD_VARIANT_AP148
	default 1024

config DRIVER_TPM_I2C_BUS
	hex
	default 0x1

config DRIVER_TPM_I2C_ADDR
	hex
	default 0x20

endif # BOARD_GOOGLE_STORM
```

## src/mainboard/google/storm/Kconfig.name
```kconfig
## SPDX-License-Identifier: GPL-2.0-only

comment "Storm (Qualcomm IPQ8064)"

config BOARD_GOOGLE_STORM
	bool "->  Storm (OnHub Router TGR1900)"
```

## src/mainboard/google/stout/Kconfig
```kconfig
if BOARD_GOOGLE_STOUT

config BOARD_SPECIFIC_OPTIONS
	def_bool y
	select BOARD_ROMSIZE_KB_8192
	select EC_QUANTA_IT8518
	select GFX_GMA_PANEL_1_ON_LVDS
	select HAVE_ACPI_RESUME
	select HAVE_ACPI_TABLES
	select HAVE_CMOS_DEFAULT
	select HAVE_IFD_BIN
	select HAVE_ME_BIN
	select HAVE_OPTION_TABLE
	select INTEL_INT15
	select MAINBOARD_HAS_CHROMEOS
	select MAINBOARD_HAS_LIBGFXINIT
	select MEMORY_MAPPED_TPM
	select MAINBOARD_HAS_TPM1
	select NORTHBRIDGE_INTEL_SANDYBRIDGE
	select SANDYBRIDGE_VBOOT_IN_ROMSTAGE
	select SOUTHBRIDGE_INTEL_C216
	select SYSTEM_TYPE_LAPTOP

config VBOOT
	select VBOOT_VBNV_CMOS

config MAINBOARD_DIR
	default "google/stout"

config MAINBOARD_PART_NUMBER
	default "Stout"

config VGA_BIOS_ID
	string
	default "8086,0156"

config MAINBOARD_SMBIOS_MANUFACTURER
	string
	default "GOOGLE"

endif # BOARD_GOOGLE_STOUT
```

## src/mainboard/google/stout/Kconfig.name
```kconfig
## SPDX-License-Identifier: GPL-2.0-only

comment "Stout (Intel SandyBridge (2nd Gen))"

config BOARD_GOOGLE_STOUT
	bool "->  Stout (Lenovo Thinkpad X131e Chromebook)"
```

## src/mainboard/google/trogdor/Kconfig
```kconfig
## SPDX-License-Identifier: GPL-2.0-only

config BOARD_GOOGLE_TROGDOR_COMMON
	def_bool BOARD_GOOGLE_BUBS || \
		 BOARD_GOOGLE_COACHZ || \
		 BOARD_GOOGLE_GELARSHIE || \
		 BOARD_GOOGLE_HOMESTAR || \
		 BOARD_GOOGLE_KINGOFTOWN || \
		 BOARD_GOOGLE_LAZOR || \
		 BOARD_GOOGLE_MARZIPAN || \
		 BOARD_GOOGLE_MRBLAND || \
		 BOARD_GOOGLE_PAZQUEL || \
		 BOARD_GOOGLE_POMPOM || \
		 BOARD_GOOGLE_QUACKINGSTICK || \
		 BOARD_GOOGLE_TROGDOR || \
		 BOARD_GOOGLE_WORMDINGLER

if BOARD_GOOGLE_TROGDOR_COMMON

config TROGDOR_REV0
	def_bool n

config TROGDOR_HAS_BRIDGE_BACKLIGHT
	def_bool BOARD_GOOGLE_HOMESTAR

config TROGDOR_HAS_MIPI_PANEL
	def_bool BOARD_GOOGLE_MRBLAND || \
		 BOARD_GOOGLE_QUACKINGSTICK || \
		 BOARD_GOOGLE_WORMDINGLER
	select MIPI_PANEL_AUO_B101UAN08_3 if BOARD_GOOGLE_MRBLAND || BOARD_GOOGLE_QUACKINGSTICK
	select MIPI_PANEL_BOE_TV101WUM_N53 if BOARD_GOOGLE_MRBLAND
	select MIPI_PANEL_INX_HJ110IZ_01A_B2 if BOARD_GOOGLE_WORMDINGLER
	select MIPI_PANEL_BOE_TV110C9M_LL0 if BOARD_GOOGLE_WORMDINGLER

config TROGDOR_HAS_FINGERPRINT
	def_bool BOARD_GOOGLE_COACHZ || \
		 BOARD_GOOGLE_MARZIPAN

config BOARD_SPECIFIC_OPTIONS
	def_bool y
	select BOARD_ROMSIZE_KB_8192
	select COMMON_CBFS_SPI_WRAPPER
	select EC_GOOGLE_CHROMEEC if !BOARD_GOOGLE_BUBS
	select EC_GOOGLE_CHROMEEC_RTC if !BOARD_GOOGLE_BUBS
	select EC_GOOGLE_CHROMEEC_SPI if !BOARD_GOOGLE_BUBS
	select RTC if !BOARD_GOOGLE_BUBS
	select MISSING_BOARD_RESET if BOARD_GOOGLE_BUBS
	select DRIVERS_TI_SN65DSI86BRIDGE
	select DRIVER_PARADE_PS8640
	select SOC_QUALCOMM_SC7180
	select SPI_FLASH
	select SPI_FLASH_MACRONIX
	select SPI_FLASH_GIGADEVICE
	select SPI_FLASH_WINBOND
	select MAINBOARD_HAS_CHROMEOS
	select MAINBOARD_HAS_TPM2 if !BOARD_GOOGLE_BUBS
	select SPI_TPM if !BOARD_GOOGLE_BUBS
	select TPM_GOOGLE_CR50 if !BOARD_GOOGLE_BUBS

config VBOOT
	select EC_GOOGLE_CHROMEEC_SWITCHES if !BOARD_GOOGLE_BUBS
	select VBOOT_VBNV_FLASH
	select VBOOT_NO_BOARD_SUPPORT if BOARD_GOOGLE_BUBS
	select VBOOT_MOCK_SECDATA if BOARD_GOOGLE_BUBS

config MAINBOARD_DIR
	default "google/trogdor"

config DRIVER_TPM_SPI_BUS
	hex
	default 0x6 if TROGDOR_REV0
	default 0x0

config EC_GOOGLE_CHROMEEC_SPI_BUS
	hex
	default 0x0 if TROGDOR_REV0
	default 0x6

##########################################################
#### Update below when adding a new derivative board. ####
##########################################################

config MAINBOARD_PART_NUMBER
	default "Bubs" if BOARD_GOOGLE_BUBS
	default "Coachz" if BOARD_GOOGLE_COACHZ
	default "Gelarshie" if BOARD_GOOGLE_GELARSHIE
	default "Homestar" if BOARD_GOOGLE_HOMESTAR
	default "Kingoftown" if BOARD_GOOGLE_KINGOFTOWN
	default "Lazor" if BOARD_GOOGLE_LAZOR
	default "Marzipan" if BOARD_GOOGLE_MARZIPAN
	default "Mrbland" if BOARD_GOOGLE_MRBLAND
	default "Pazquel" if BOARD_GOOGLE_PAZQUEL
	default "Pompom" if BOARD_GOOGLE_POMPOM
	default "Quackingstick" if BOARD_GOOGLE_QUACKINGSTICK
	default "Trogdor" if BOARD_GOOGLE_TROGDOR
	default "Wormdingler" if BOARD_GOOGLE_WORMDINGLER

endif # BOARD_GOOGLE_TROGDOR_COMMON
```

## src/mainboard/google/trogdor/Kconfig.name
```kconfig
## SPDX-License-Identifier: GPL-2.0-only

comment "Trogdor (Qualcomm Snapdragon 7c (SC7180))"

config BOARD_GOOGLE_BUBS
	bool "->  Bubs"

config BOARD_GOOGLE_COACHZ
	bool "->  Coachz (HP Chromebook x2 11-da0)"

config BOARD_GOOGLE_GELARSHIE
	bool "->  Gelarshie"

config BOARD_GOOGLE_HOMESTAR
	bool "->  Homestar (Lenovo IdeaPad Duet 5 Chromebook)"

config BOARD_GOOGLE_KINGOFTOWN
	bool "->  Kingoftown (HP Fortis 11 G9 Q Chromebook)"

config BOARD_GOOGLE_LAZOR
	bool "->  Lazor (Acer Chromebook Spin 513, CP513-1H/1HL, R841T/LT)"

config BOARD_GOOGLE_MARZIPAN
	bool "->  Marzipan"

config BOARD_GOOGLE_MRBLAND
	bool "->  Mrbland"

config BOARD_GOOGLE_PAZQUEL
	bool "->  Pazquel (see help text for details)"
	help
		The "Pazquel" board supports the following devices:
		- Orbic Chromebook 4G
		- Libera-Merdeka Chromebook C100/C110/C120/C150

config BOARD_GOOGLE_POMPOM
	bool "->  Pompom (Dynabook Chromebook C1)"

config BOARD_GOOGLE_QUACKINGSTICK
	bool "->  Quackingstick (Acer Chromebook Tab 510 / Enterprise Tab 510)"

config BOARD_GOOGLE_WORMDINGLER
	bool "->  Wormdingler (Lenovo IdeaPad Duet 3 Chromebook)"

config BOARD_GOOGLE_TROGDOR
	bool "->  Trogdor"
```

## src/mainboard/google/urara/Kconfig
```kconfig
#
# This file is part of the coreboot project.
#
# Copyright (C) 2014 Imagination Technologies
#
# This program is free software; you can redistribute it and/or
# modify it under the terms of the GNU General Public License as
# published by the Free Software Foundation; version 2 of
# the License.
#
# This program is distributed in the hope that it will be useful,
# but WITHOUT ANY WARRANTY; without even the implied warranty of
# MERCHANTABILITY or FITNESS FOR A PARTICULAR PURPOSE.  See the
# GNU General Public License for more details.
#

if BOARD_GOOGLE_URARA

config BOARD_SPECIFIC_OPTIONS
	def_bool y
	select BOARD_ROMSIZE_KB_512
	select BOOTBLOCK_CONSOLE
	select SPI_FLASH_WINBOND
	select CPU_IMGTEC_PISTACHIO
	select COMMON_CBFS_SPI_WRAPPER
	select SPI_FLASH

config MAINBOARD_DIR
	string
	default "google/urara"

config MAINBOARD_PART_NUMBER
	string
	default "ImgTec Pistachio Virtual Platform"

config BOOTBLOCK_MAINBOARD_INIT
	string
	default "mainboard/google/urara/bootblock.c"

config DRAM_SIZE_MB
	int
	default 256

config TTYS0_LCS
	int
	default 3

config CONSOLE_SERIAL_UART_ADDRESS
	hex
	depends on DRIVERS_UART
	default 0xB8101500

config BOOT_DEVICE_SPI_FLASH_BUS
	int
	default 1

config GBB_HWID
	string
	depends on CHROMEOS
	default "Urara TEST 1"
endif
```

## src/mainboard/google/veyron/Kconfig
```kconfig
## SPDX-License-Identifier: GPL-2.0-only

config BOARD_GOOGLE_VEYRON
	def_bool n

if BOARD_GOOGLE_VEYRON

# Some Veyron boards incorrectly had their RAM code strapped with 100Kohm
# resistors. These get overpowered by the SoC's internal pull-downs, so we
# cannot read those pins as tri-state. They're restricted to binary RAM codes.
config VEYRON_FORCE_BINARY_RAM_CODE
	bool
	default y if BOARD_GOOGLE_VEYRON_JAQ
	default y if BOARD_GOOGLE_VEYRON_JERRY
	default y if BOARD_GOOGLE_VEYRON_MIGHTY
	default n

config BOARD_SPECIFIC_OPTIONS
	def_bool y
	select COMMON_CBFS_SPI_WRAPPER
	select EC_GOOGLE_CHROMEEC
	select EC_GOOGLE_CHROMEEC_SPI
	select SOC_ROCKCHIP_RK3288
	select MAINBOARD_HAS_CHROMEOS
	select BOARD_ROMSIZE_KB_4096
	select SPI_FLASH
	select SPI_FLASH_GIGADEVICE
	select SPI_FLASH_WINBOND
	select I2C_TPM
	select MAINBOARD_HAS_TPM1

config VBOOT
	select VBOOT_VBNV_FLASH

config MAINBOARD_DIR
	default "google/veyron"

config MAINBOARD_PART_NUMBER
	default "Veyron_Jaq" if BOARD_GOOGLE_VEYRON_JAQ
	default "Veyron_Jerry" if BOARD_GOOGLE_VEYRON_JERRY
	default "Veyron_Mighty" if BOARD_GOOGLE_VEYRON_MIGHTY
	default "Veyron_Minnie" if BOARD_GOOGLE_VEYRON_MINNIE
	default "Veyron_Speedy" if BOARD_GOOGLE_VEYRON_SPEEDY
	default "Veyron"

config EC_GOOGLE_CHROMEEC_SPI_BUS
	hex
	default 0x0

config EC_GOOGLE_CHROMEEC_SPI_WAKEUP_DELAY_US
	int
	default 100

config BOOT_DEVICE_SPI_FLASH_BUS
	int
	default 2

config DRIVER_TPM_I2C_BUS
	hex
	default 0x1

config DRIVER_TPM_I2C_ADDR
	hex
	default 0x20

config CONSOLE_SERIAL_UART_ADDRESS
	hex
	depends on DRIVERS_UART
	default 0xFF690000

config PMIC_BUS
	int
	default 0

config CBFS_SIZE
	default 0x100000 if CHROMEOS
	default ROM_SIZE

endif #  BOARD_GOOGLE_VEYRON
```

## src/mainboard/google/veyron/Kconfig.name
```kconfig
comment "Veyron"

config BOARD_GOOGLE_VEYRON_JAQ
	bool "->  Veyron_Jaq (Haier Chromebook 11)"
	select BOARD_GOOGLE_VEYRON
	select SYSTEM_TYPE_LAPTOP

config BOARD_GOOGLE_VEYRON_JERRY
	bool "->  Veyron_Jerry (Hisense Chromebook 11)"
	select BOARD_GOOGLE_VEYRON
	select SYSTEM_TYPE_LAPTOP

config BOARD_GOOGLE_VEYRON_MIGHTY
	bool "->  Veyron_Mighty (Haier Chromebook 11(edu))"
	select BOARD_GOOGLE_VEYRON
	select SYSTEM_TYPE_LAPTOP

config BOARD_GOOGLE_VEYRON_MINNIE
	bool "->  Veyron_Minnie (ASUS Chromebook Flip C100)"
	select BOARD_GOOGLE_VEYRON
	select SYSTEM_TYPE_LAPTOP

config BOARD_GOOGLE_VEYRON_SPEEDY
	bool "->  Veyron_Speedy (ASUS C201 Chromebook)"
	select BOARD_GOOGLE_VEYRON
	select SYSTEM_TYPE_LAPTOP
```

## src/mainboard/google/veyron_mickey/Kconfig
```kconfig
## SPDX-License-Identifier: GPL-2.0-only

if BOARD_GOOGLE_VEYRON_MICKEY

config BOARD_SPECIFIC_OPTIONS
	def_bool y
	select BOARD_ROMSIZE_KB_4096
	select COMMON_CBFS_SPI_WRAPPER
	select MAINBOARD_HAS_CHROMEOS
	select SOC_ROCKCHIP_RK3288
	select SPI_FLASH
	select SPI_FLASH_GIGADEVICE
	select SPI_FLASH_WINBOND
	select I2C_TPM
	select MAINBOARD_HAS_TPM1

config VBOOT
	select VBOOT_VBNV_FLASH

config MAINBOARD_DIR
	default "google/veyron_mickey"

config MAINBOARD_PART_NUMBER
	default "Veyron_Mickey"

config BOOT_DEVICE_SPI_FLASH_BUS
	int
	default 2

config DRIVER_TPM_I2C_BUS
	hex
	default 0x1

config DRIVER_TPM_I2C_ADDR
	hex
	default 0x20

config CONSOLE_SERIAL_UART_ADDRESS
	hex
	depends on DRIVERS_UART
	default 0xFF690000

config PMIC_BUS
	int
	default 0

endif #  BOARD_GOOGLE_VEYRON_MICKEY
```

## src/mainboard/google/veyron_mickey/Kconfig.name
```kconfig
## SPDX-License-Identifier: GPL-2.0-only

comment "Veyron Mickey (Rockchip RK3288)"

config BOARD_GOOGLE_VEYRON_MICKEY
	bool "->  Veyron_Mickey (Asus Chromebit CS10)"
```
