## src/mainboard/google/zork/Kconfig
```kconfig
# SPDX-License-Identifier: GPL-2.0-or-later

config BOARD_GOOGLE_BASEBOARD_DALBOZ
	def_bool n

config BOARD_GOOGLE_BASEBOARD_TREMBYLE
	def_bool n

config BOARD_GOOGLE_BERKNIP
	select BOARD_GOOGLE_BASEBOARD_TREMBYLE

config BOARD_GOOGLE_DALBOZ
	select BOARD_GOOGLE_BASEBOARD_DALBOZ

config BOARD_GOOGLE_DIRINBOZ
	select BOARD_GOOGLE_BASEBOARD_DALBOZ

config BOARD_GOOGLE_EZKINIL
	select BOARD_GOOGLE_BASEBOARD_TREMBYLE

config BOARD_GOOGLE_GUMBOZ
	select BOARD_GOOGLE_BASEBOARD_DALBOZ

config BOARD_GOOGLE_MORPHIUS
	select BOARD_GOOGLE_BASEBOARD_TREMBYLE

config BOARD_GOOGLE_SHUBOZ
	select BOARD_GOOGLE_BASEBOARD_DALBOZ

config BOARD_GOOGLE_TREMBYLE
	select BOARD_GOOGLE_BASEBOARD_TREMBYLE

config BOARD_GOOGLE_VILBOZ
	select BOARD_GOOGLE_BASEBOARD_DALBOZ
	select DRIVERS_I2C_SX9324
	select DRIVERS_I2C_SX9324_SUPPORT_LEGACY_LINUX_DRIVER

config BOARD_GOOGLE_WOOMAX
	select BOARD_GOOGLE_BASEBOARD_TREMBYLE

if BOARD_GOOGLE_BASEBOARD_TREMBYLE || BOARD_GOOGLE_BASEBOARD_DALBOZ

config BOARD_SPECIFIC_OPTIONS
	def_bool y
	select AMD_FWM_POSITION_E20000_DEFAULT
	select AMD_SOC_CONSOLE_UART
	select BOARD_ROMSIZE_KB_16384
	select DISABLE_SPI_FLASH_ROM_SHARING
	select DRIVERS_AMD_I2S_MACHINE_DEV
	select DRIVERS_GENERIC_ALC1015
	select DRIVERS_GENERIC_BAYHUB_LV2
	select DRIVERS_GENERIC_GPIO_KEYS
	select DRIVERS_GENERIC_MAX98357A
	select DRIVERS_UART_ACPI
	select DRIVERS_USB_ACPI
	select DRIVERS_I2C_GENERIC
	select DRIVERS_I2C_HID
	select EC_GOOGLE_CHROMEEC
	select EC_GOOGLE_CHROMEEC_AUDIO_CODEC
	select EC_GOOGLE_CHROMEEC_BOARDID
	select EC_GOOGLE_CHROMEEC_ESPI
	select EC_GOOGLE_CHROMEEC_I2C_TUNNEL
	select EC_GOOGLE_CHROMEEC_INCLUDE_SSFC_IN_FW_CONFIG
	select EC_GOOGLE_CHROMEEC_SKUID
	select EC_GOOGLE_CHROMEEC_SMBIOS
	select ELOG
	select ELOG_BOOT_COUNT
	select ELOG_GSMI
	select FW_CONFIG
	select FW_CONFIG_SOURCE_CHROMEEC_CBI
	select GFXUMA
	select GOOGLE_SMBIOS_MAINBOARD_VERSION
	select HAVE_ACPI_RESUME
	select HAVE_EM100_SUPPORT
	select I2C_TPM
	select MAINBOARD_HAS_CHROMEOS
	select MAINBOARD_HAS_TPM2
	select PCIEXP_ASPM
	select PCIEXP_CLK_PM
	select PCIEXP_COMMON_CLOCK
	select PCIEXP_L1_SUB_STATE
	select SOC_AMD_COMMON_BLOCK_ACPI_DPTC if BOARD_GOOGLE_MORPHIUS
	select SOC_AMD_COMMON_BLOCK_USE_ESPI
	select SOC_AMD_COMMON_BLOCK_GRAPHICS_ATIF
	select SOC_AMD_PICASSO
	select SYSTEM_TYPE_LAPTOP
	select TPM_GOOGLE_CR50

config ELOG_BOOT_COUNT_CMOS_OFFSET
	int
	default 144

# FMDFILE is set here so that coreboot build picks up this flash map layout
# even when CHROMEOS is not selected when building upstream.
config FMDFILE
	default "src/mainboard/\$(CONFIG_MAINBOARD_DIR)/chromeos.fmd"

config MAINBOARD_DIR
	default "google/zork"

config VARIANT_DIR
	default "berknip" if BOARD_GOOGLE_BERKNIP
	default "dalboz" if BOARD_GOOGLE_DALBOZ
	default "dirinboz" if BOARD_GOOGLE_DIRINBOZ
	default "ezkinil" if BOARD_GOOGLE_EZKINIL
	default "gumboz" if BOARD_GOOGLE_GUMBOZ
	default "morphius" if BOARD_GOOGLE_MORPHIUS
	default "shuboz" if BOARD_GOOGLE_SHUBOZ
	default "trembyle" if BOARD_GOOGLE_TREMBYLE
	default "vilboz" if BOARD_GOOGLE_VILBOZ
	default "woomax" if BOARD_GOOGLE_WOOMAX

config MAINBOARD_PART_NUMBER
	default "Berknip" if BOARD_GOOGLE_BERKNIP
	default "Dalboz" if BOARD_GOOGLE_DALBOZ
	default "Dirinboz" if BOARD_GOOGLE_DIRINBOZ
	default "Ezkinil" if BOARD_GOOGLE_EZKINIL
	default "Gumboz" if BOARD_GOOGLE_GUMBOZ
	default "Morphius" if BOARD_GOOGLE_MORPHIUS
	default "Shuboz" if BOARD_GOOGLE_SHUBOZ
	default "Trembyle" if BOARD_GOOGLE_TREMBYLE
	default "Vilboz" if BOARD_GOOGLE_VILBOZ
	default "Woomax" if BOARD_GOOGLE_WOOMAX

config BASEBOARD_DIR
	string
	default "dalboz" if BOARD_GOOGLE_BASEBOARD_DALBOZ
	default "trembyle" if BOARD_GOOGLE_BASEBOARD_TREMBYLE

config DEVICETREE
	default "variants/baseboard/\$(CONFIG_BASEBOARD_DIR)/devicetree.cb"

config OVERRIDE_DEVICETREE
	default "variants/\$(CONFIG_VARIANT_DIR)/overridetree.cb"

config MAINBOARD_FAMILY
	string
	default "Google_Zork"

config ONBOARD_VGA_IS_PRIMARY
	bool
	default y

config VGA_BIOS
	default y if USE_AMD_BLOBS

config VBOOT
	bool
	# selected by default as PSP verstage required for booting at present time
	default y
	select EC_GOOGLE_CHROMEEC_SWITCHES
	select VBOOT_LID_SWITCH
	select VBOOT_STARTS_BEFORE_BOOTBLOCK

config VBOOT_VBNV_OFFSET
	hex
	default 0x2A

config CHROMEOS
	# Use default libpayload config
	select LP_DEFCONFIG_OVERRIDE if PAYLOAD_DEPTHCHARGE

config DRIVER_TPM_I2C_BUS
	hex
	default 0x03

config DRIVER_TPM_I2C_ADDR
	hex
	default 0x50

config GSC_IRQ_GPIO
	int
	default 3

config VARIANT_SUPPORTS_PRE_V3_SCHEMATICS
	bool
	default y if BOARD_GOOGLE_BERKNIP
	default y if BOARD_GOOGLE_DALBOZ
	default y if BOARD_GOOGLE_EZKINIL
	default y if BOARD_GOOGLE_MORPHIUS
	default y if BOARD_GOOGLE_TREMBYLE
	default n
	help
	  Whether this variant supports pre-v3 version of schematics.
	  Eventually, when a variant moves to a point where it no
	  longer has to support pre-v3 schematics, `default y` entry
	  for it can be dropped.

config VARIANT_SUPPORTS_PRE_V3_6_SCHEMATICS
	bool
	default y if BOARD_GOOGLE_BERKNIP
	default y if BOARD_GOOGLE_DALBOZ
	default y if BOARD_GOOGLE_DIRINBOZ
	default y if BOARD_GOOGLE_EZKINIL
	default y if BOARD_GOOGLE_MORPHIUS
	default y if BOARD_GOOGLE_TREMBYLE
	default y if BOARD_GOOGLE_VILBOZ
	default y if BOARD_GOOGLE_WOOMAX
	default n

config VARIANT_MIN_BOARD_ID_V3_6_SCHEMATICS
	int
	depends on VARIANT_SUPPORTS_PRE_V3_6_SCHEMATICS
	default 3 if BOARD_GOOGLE_BERKNIP
	default 3 if BOARD_GOOGLE_DALBOZ
	default 2 if BOARD_GOOGLE_DIRINBOZ
	default 3 if BOARD_GOOGLE_EZKINIL
	default 4 if BOARD_GOOGLE_MORPHIUS
	default 4 if BOARD_GOOGLE_TREMBYLE
	default 2 if BOARD_GOOGLE_VILBOZ
	default 1 if BOARD_GOOGLE_WOOMAX
	default 256
	help
	  Minimum board version where the variant starts supporting
	  v3.6+ version of reference schematics.

config VARIANT_MIN_BOARD_ID_V3_SCHEMATICS
	int
	depends on VARIANT_SUPPORTS_PRE_V3_SCHEMATICS
	default 2 if BOARD_GOOGLE_BERKNIP
	default 3 if BOARD_GOOGLE_DALBOZ
	default 3 if BOARD_GOOGLE_EZKINIL
	default 3 if BOARD_GOOGLE_MORPHIUS
	default 4 if BOARD_GOOGLE_TREMBYLE
	default 256
	help
	  Minimum board version where the variant starts supporting
	  v3 version of reference schematics.

config VARIANT_SUPPORTS_WIFI_POWER_ACTIVE_HIGH
	bool
	default y if VARIANT_SUPPORTS_PRE_V3_SCHEMATICS
	default y if BOARD_GOOGLE_BERKNIP
	default y if BOARD_GOOGLE_VILBOZ
	default y if BOARD_GOOGLE_WOOMAX
	default n
	help
	  Whether this variant supports active high power enable for
	  WiFi. For pre-v3 schematics, this is always true. There are
	  some variants which used v3 schematics, but did not pick up
	  the change for active low WiFi power enable. Those variants
	  will have to set this config to true. Eventually, when a
	  variant needs to only support v3 schematics with active low
	  power enable for WiFi, `default y` entry for it can be
	  dropped.

config VARIANT_MIN_BOARD_ID_WIFI_POWER_ACTIVE_LOW
	int
	depends on VARIANT_SUPPORTS_WIFI_POWER_ACTIVE_HIGH
	default 3 if BOARD_GOOGLE_BERKNIP
	default 2 if BOARD_GOOGLE_VILBOZ
	default 1 if BOARD_GOOGLE_WOOMAX
	default VARIANT_MIN_BOARD_ID_V3_SCHEMATICS
	help
	  Minimum board version where the variant starts supporting
	  active low power enable for WiFi.

config VARIANT_HAS_FPMCU
	bool
	default y if BOARD_GOOGLE_BERKNIP
	default y if BOARD_GOOGLE_MORPHIUS
	default n
	help
	  Select y if any SKU of the board has a fingerprint sensor

config VARIANT_MAX_BOARD_ID_BROKEN_FMPCU_POWER
	int
	default 3 if BOARD_GOOGLE_BERKNIP
	default 4 if BOARD_GOOGLE_MORPHIUS
	default 0
	help
	  Last board version that needs the extra delay for FPMCU init.

if !EM100	# EM100 defaults in soc/amd/common/blocks/spi/Kconfig
config EFS_SPI_READ_MODE
	default 4          # Dual IO (1-2-2)

config EFS_SPI_SPEED
	default 0	# 66MHz

config EFS_SPI_MICRON_FLAG
	default 0

config NORMAL_READ_SPI_SPEED
	default 1	# 33MHz

config ALT_SPI_SPEED
	default 0	# 66MHz

config TPM_SPI_SPEED
	default 0	# 66MHz

endif # !EM100

config CHROMEOS_WIFI_SAR
	bool
	default y if CHROMEOS
	select DRIVERS_WIFI_GENERIC
	select DSAR_ENABLE
	select GEO_SAR_ENABLE
	select SAR_ENABLE
	select USE_SAR

choice
	prompt "UMA Memory Allocation"
	default ZORK_UMA_SIZE_64MB if CHROMEOS
	default ZORK_UMA_SIZE_128MB
	help
	  The amount of system memory allocated for the integrated GPU.

config ZORK_UMA_SIZE_64MB
	bool "64MB"

config ZORK_UMA_SIZE_128MB
	bool "128MB"

config ZORK_UMA_SIZE_256MB
	bool "256MB"

config ZORK_UMA_SIZE_512MB
	bool "512MB"

endchoice

endif # BOARD_GOOGLE_BASEBOARD_TREMBYLE || BOARD_GOOGLE_BASEBOARD_DALBOZ
```

## src/mainboard/google/zork/Kconfig.name
```kconfig
## SPDX-License-Identifier: GPL-2.0-only

comment "Zork"

config BOARD_GOOGLE_BERKNIP
	bool "->  Berknip (HP Pro c645 Chromebook Enterprise)"

config BOARD_GOOGLE_DALBOZ
	bool "->  Dalboz"

config BOARD_GOOGLE_DIRINBOZ
	bool "->  Dirinboz (HP Chromebook 14a-nd0097nr)"

config BOARD_GOOGLE_EZKINIL
	bool "->  Ezkinil (Acer Chromebook Spin 514)"

config BOARD_GOOGLE_GUMBOZ
	bool "->  Gumboz (HP Chromebook x360 14a)"

config BOARD_GOOGLE_MORPHIUS
	bool "->  Morphius (Lenovo ThinkPad C13 Yoga Chromebook)"

config BOARD_GOOGLE_SHUBOZ
	bool "->  Shuboz"

config BOARD_GOOGLE_TREMBYLE
	bool "->  Trembyle"

config BOARD_GOOGLE_VILBOZ
	bool "->  Vilboz (Lenovo 100e/300e Gen3 AMD)"

config BOARD_GOOGLE_WOOMAX
	bool "->  Woomax (ASUS Chromebook Flip CM5)"
```

## src/mainboard/hardkernel/Kconfig
```kconfig
## SPDX-License-Identifier: GPL-2.0-only

if VENDOR_HARDKERNEL

choice
	prompt "Mainboard model"

source "src/mainboard/hardkernel/*/Kconfig.name"

endchoice

source "src/mainboard/hardkernel/*/Kconfig"

config MAINBOARD_VENDOR
	default "Hardkernel"

endif # VENDOR_HARDKERNEL
```

## src/mainboard/hardkernel/odroid-h4/Kconfig
```kconfig
## SPDX-License-Identifier: GPL-2.0-only

if BOARD_HARDKERNEL_ODROID_H4

config BOARD_SPECIFIC_OPTIONS
	def_bool y
	select BOARD_ROMSIZE_KB_16384
	select CRB_TPM
	select DRIVERS_UART_8250IO
	select FSP_TYPE_IOT
	select HAVE_ACPI_RESUME
	select HAVE_ACPI_TABLES
	select HAVE_INTEL_PTT
	select INTEL_GMA_HAVE_VBT
	select SUPERIO_ITE_IT8613E
	select SOC_INTEL_ALDERLAKE_PCH_N
	select SOC_INTEL_COMMON_BLOCK_HDA_VERB
	select DRAM_SUPPORT_DDR5

config MAINBOARD_DIR
	default "hardkernel/odroid-h4"

config MAINBOARD_PART_NUMBER
	default "ODROID-H4"

config ODROID_H4_ENABLE_SAGV
	bool "Enable SAGV"
	default y
	help
	  SAGV (System Agent GeyserVille) is Intel's implementation of
	  DVFS (Dynamic Voltage Frequency Scaling) that reduces energy
	  consumption of the SA and DRAM during low-load conditions by
	  automatically switching to lower voltages / frequencies when
	  the system load is low enough. When enabled, memory training
	  has to run multiple times (once per SAGV point), which slows
	  down booting (but only when the MRC cache is unusable).

	  If unsure, keep enabled. If reflashing often, disabling this
	  option can be useful to reduce memory training time.

endif #BOARD_HARDKERNEL_ODROID_H4
```

## src/mainboard/hardkernel/odroid-h4/Kconfig.name
```kconfig
## SPDX-License-Identifier: GPL-2.0-only

config BOARD_HARDKERNEL_ODROID_H4
	bool "ODROID-H4 / H4+ / H4 Ultra"
```

## src/mainboard/hp/260_g1_dm/Kconfig
```kconfig
## SPDX-License-Identifier: GPL-2.0-only

if BOARD_HP_260_G1_DM

config BOARD_SPECIFIC_OPTIONS
	def_bool y
	select BOARD_ROMSIZE_KB_8192
	select CPU_INTEL_HASWELL
	select HAVE_ACPI_RESUME
	select HAVE_ACPI_TABLES
	select INTEL_GMA_HAVE_VBT
	select INTEL_LYNXPOINT_LP
	select MAINBOARD_HAS_LIBGFXINIT
	select MAINBOARD_HAS_TPM1
	select MEMORY_MAPPED_TPM
	select NORTHBRIDGE_INTEL_HASWELL
	select SERIRQ_CONTINUOUS_MODE
	select SOUTHBRIDGE_INTEL_LYNXPOINT
	select SUPERIO_NUVOTON_NPCD378

config MAINBOARD_DIR
	default "hp/260_g1_dm"

config MAINBOARD_PART_NUMBER
	default "260 G1 DM"

config USBDEBUG_HCD_INDEX
	default 1
endif
```

## src/mainboard/hp/260_g1_dm/Kconfig.name
```kconfig
## SPDX-License-Identifier: GPL-2.0-only

config BOARD_HP_260_G1_DM
	bool "260 G1 DM"
```

## src/mainboard/hp/280_g2/Kconfig
```kconfig
# SPDX-License-Identifier: GPL-2.0-only

if BOARD_HP_280_G2

config BOARD_SPECIFIC_OPTIONS
	def_bool y
	select AZALIA_USE_LEGACY_VERB_TABLE
	select BOARD_ROMSIZE_KB_8192
	select HAVE_ACPI_RESUME
	select HAVE_ACPI_TABLES
	select INTEL_GMA_HAVE_VBT
	select INTEL_LPSS_UART_FOR_CONSOLE
	select MAINBOARD_HAS_LIBGFXINIT
	select SKYLAKE_SOC_PCH_H
	select SOC_INTEL_COMMON_BLOCK_HDA_VERB
	select SOC_INTEL_KABYLAKE
	select SPD_READ_BY_WORD
	select SUPERIO_ITE_COMMON_PRE_RAM

config DISABLE_HECI1_AT_PRE_BOOT
	default y

config MAINBOARD_DIR
	default "hp/280_g2"

config MAINBOARD_PART_NUMBER
	default "280 G2"

config DIMM_MAX
	default 2

config DIMM_SPD_SIZE
	default 512

config UART_FOR_CONSOLE
	int
	default 2

config USE_LEGACY_8254_TIMER
	default y

endif
```

## src/mainboard/hp/8460p/Kconfig
```kconfig
#
# This file is part of the coreboot project.
#
# Copyright (C) 2017 Iru Cai <mytbk920423@gmail.com>
#
# This program is free software; you can redistribute it and/or modify
# it under the terms of the GNU General Public License as published by
# the Free Software Foundation; version 2 of the License.
#
# This program is distributed in the hope that it will be useful,
# but WITHOUT ANY WARRANTY; without even the implied warranty of
# MERCHANTABILITY or FITNESS FOR A PARTICULAR PURPOSE.  See the
# GNU General Public License for more details.
#

if BOARD_HP_8460P

config BOARD_SPECIFIC_OPTIONS
	def_bool y
	select BOARD_ROMSIZE_KB_8192
	select HAVE_ACPI_RESUME
	select HAVE_ACPI_TABLES
	select INTEL_INT15
	select NORTHBRIDGE_INTEL_SANDYBRIDGE
	select SERIRQ_CONTINUOUS_MODE
	select SOUTHBRIDGE_INTEL_BD82X6X
	select SYSTEM_TYPE_LAPTOP
	select USE_NATIVE_RAMINIT
	select MAINBOARD_HAS_LIBGFXINIT
	select MAINBOARD_HAS_LPC_TPM
	select MAINBOARD_HAS_TPM1
	select GFX_GMA_INTERNAL_IS_LVDS
	select EC_HP_KBC1126
	select SUPERIO_SMSC_LPC47N217
	select HAVE_OPTION_TABLE
	select HAVE_CMOS_DEFAULT
	select MAINBOARD_USES_IFD_GBE_REGION

config MAINBOARD_DIR
	string
	default "hp/8460p"

config MAINBOARD_PART_NUMBER
	string
	default "EliteBook 8460p"

config VGA_BIOS_FILE
	string
	default "pci8086,0116.rom"

config VGA_BIOS_ID
	string
	default "8086,0116"

config MAX_CPUS
	int
	default 8

config USBDEBUG_HCD_INDEX
	int
	default 1

endif
```

## src/mainboard/hp/8470p/Kconfig
```kconfig
#
# This file is part of the coreboot project.
#
# Copyright (C) 2017 Iru Cai <mytbk920423@gmail.com>
#
# This program is free software; you can redistribute it and/or modify
# it under the terms of the GNU General Public License as published by
# the Free Software Foundation; version 2 of the License.
#
# This program is distributed in the hope that it will be useful,
# but WITHOUT ANY WARRANTY; without even the implied warranty of
# MERCHANTABILITY or FITNESS FOR A PARTICULAR PURPOSE.  See the
# GNU General Public License for more details.
#

if BOARD_HP_8470P

config BOARD_SPECIFIC_OPTIONS # dummy
	def_bool y
	select BOARD_ROMSIZE_KB_16384
	select CPU_INTEL_SOCKET_RPGA989
	select HAVE_ACPI_RESUME
	select HAVE_ACPI_TABLES
	select INTEL_INT15
	select NORTHBRIDGE_INTEL_IVYBRIDGE
	select SANDYBRIDGE_IVYBRIDGE_LVDS
	select SERIRQ_CONTINUOUS_MODE
	select SOUTHBRIDGE_INTEL_C216
	select SYSTEM_TYPE_LAPTOP
	select USE_NATIVE_RAMINIT
	select MAINBOARD_HAS_LIBGFXINIT
	select GFX_GMA_INTERNAL_IS_LVDS
	select EC_HP_KBC1126
	select SUPERIO_SMSC_LPC47N217
	select HAVE_OPTION_TABLE
	select HAVE_CMOS_DEFAULT

config MAINBOARD_DIR
	string
	default hp/8470p

config MAINBOARD_PART_NUMBER
	string
	default "EliteBook 8470p"

config VGA_BIOS_FILE
	string
	default "pci8086,0166.rom"

config VGA_BIOS_ID
	string
	default "8086,0166"

config MAINBOARD_PCI_SUBSYSTEM_DEVICE_ID
	hex
	default 0x179b

config MAINBOARD_PCI_SUBSYSTEM_VENDOR_ID
	hex
	default 0x103c

config MAX_CPUS
	int
	default 8

config USBDEBUG_HCD_INDEX
	int
	default 2

endif
```
