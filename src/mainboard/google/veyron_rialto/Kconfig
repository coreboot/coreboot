## src/mainboard/google/veyron_rialto/Kconfig
```kconfig
##
## This file is part of the coreboot project.
##
## Copyright 2014 Rockchip Inc.
##
## This program is free software; you can redistribute it and/or modify
## it under the terms of the GNU General Public License as published by
## the Free Software Foundation; version 2 of the License.
##
## This program is distributed in the hope that it will be useful,
## but WITHOUT ANY WARRANTY; without even the implied warranty of
## MERCHANTABILITY or FITNESS FOR A PARTICULAR PURPOSE.  See the
## GNU General Public License for more details.
##

if BOARD_GOOGLE_VEYRON_RIALTO

config BOARD_SPECIFIC_OPTIONS # dummy
	def_bool y
	select BOARD_ID_AUTO
	select BOARD_ROMSIZE_KB_4096
	select COMMON_CBFS_SPI_WRAPPER
	select HAVE_HARD_RESET
	select MAINBOARD_HAS_NATIVE_VGA_INIT
	select MAINBOARD_DO_NATIVE_VGA_INIT
	select MAINBOARD_HAS_CHROMEOS
	select RAM_CODE_SUPPORT
	select SOC_ROCKCHIP_RK3288
	select SPI_FLASH
	select SPI_FLASH_GIGADEVICE
	select SPI_FLASH_WINBOND

config CHROMEOS
	select CHROMEOS_VBNV_FLASH
	select PHYSICAL_REC_SWITCH
	select VIRTUAL_DEV_SWITCH

config MAINBOARD_DIR
	string
	default google/veyron_rialto

config MAINBOARD_PART_NUMBER
	string
	default "Veyron_Rialto"

config MAINBOARD_VENDOR
	string
	default "Google"

config BOOT_MEDIA_SPI_BUS
	int
	default 2

config DRIVER_TPM_I2C_BUS
	hex
	default 0x1

config DRIVER_TPM_I2C_ADDR
	hex
	default 0x20

config CONSOLE_SERIAL_UART_ADDRESS
	hex
	depends on DRIVERS_UART
	default 0xFF690000

config PMIC_BUS
	int
	default 0

endif #  BOARD_GOOGLE_VEYRON_RIALTO
```

## src/mainboard/google/veyron_rialto/Kconfig.name
```kconfig
## SPDX-License-Identifier: GPL-2.0-only

comment "Veyron Rialto (Rockchip RK3288)"

config BOARD_GOOGLE_VEYRON_RIALTO
	bool "->  Veyron_Rialto"
```

## src/mainboard/google/veyron_speedy/Kconfig
```kconfig
##
## This file is part of the coreboot project.
##
## Copyright 2014 Rockchip Inc.
##
## This program is free software; you can redistribute it and/or modify
## it under the terms of the GNU General Public License as published by
## the Free Software Foundation; version 2 of the License.
##
## This program is distributed in the hope that it will be useful,
## but WITHOUT ANY WARRANTY; without even the implied warranty of
## MERCHANTABILITY or FITNESS FOR A PARTICULAR PURPOSE.  See the
## GNU General Public License for more details.
##
## You should have received a copy of the GNU General Public License
## along with this program; if not, write to the Free Software
## Foundation, Inc., 51 Franklin St, Fifth Floor, Boston, MA 02110-1301 USA
##

if BOARD_GOOGLE_VEYRON_SPEEDY

config BOARD_SPECIFIC_OPTIONS # dummy
	def_bool y
	select BOARD_ID_AUTO
	select BOARD_ROMSIZE_KB_4096
	select CHROMEOS_VBNV_EC
	select COMMON_CBFS_SPI_WRAPPER
	select EC_GOOGLE_CHROMEEC
	select EC_GOOGLE_CHROMEEC_SPI
	select EC_SOFTWARE_SYNC
	select RAM_CODE_SUPPORT
	select SOC_ROCKCHIP_RK3288
	select MAINBOARD_DO_NATIVE_VGA_INIT
	select MAINBOARD_HAS_CHROMEOS
	select HAVE_HARD_RESET
	select RETURN_FROM_VERSTAGE
	select SPI_FLASH
	select SPI_FLASH_GIGADEVICE
	select SPI_FLASH_WINBOND
	select VIRTUAL_DEV_SWITCH

config MAINBOARD_DIR
	string
	default google/veyron_speedy

config MAINBOARD_PART_NUMBER
	string
	default "Veyron_Speedy"

config MAINBOARD_VENDOR
	string
	default "Google"

config EC_GOOGLE_CHROMEEC_SPI_BUS
	hex
	default 0

config EC_GOOGLE_CHROMEEC_SPI_WAKEUP_DELAY_US
	int
	default 100

config BOOT_MEDIA_SPI_BUS
	int
	default 2

config DRIVER_TPM_I2C_BUS
	hex
	default 0x1

config DRIVER_TPM_I2C_ADDR
	hex
	default 0x20

config CONSOLE_SERIAL_UART_ADDRESS
	hex
	depends on DRIVERS_UART
	default 0xFF690000

config PMIC_BUS
	int
	default 0

endif #  BOARD_GOOGLE_VEYRON_SPEEDY
```

## src/mainboard/google/volteer/Kconfig
```kconfig
config BOARD_GOOGLE_BASEBOARD_VOLTEER
	def_bool n
	select BOARD_ROMSIZE_KB_32768
	select DRIVERS_GENERIC_GPIO_KEYS
	select DRIVERS_GENERIC_MAX98357A
	select DRIVERS_GENESYSLOGIC_GL9763E
	select DRIVERS_I2C_GENERIC
	select DRIVERS_I2C_HID
	select DRIVERS_I2C_MAX98373
	select DRIVERS_I2C_SX9310
	select DRIVERS_INTEL_DPTF
	select DRIVERS_INTEL_PMC
	select DRIVERS_INTEL_SOUNDWIRE
	select DRIVERS_INTEL_USB4_RETIMER
	select DRIVERS_SOUNDWIRE_ALC5682
	select DRIVERS_SOUNDWIRE_MAX98373
	select DRIVERS_SPI_ACPI
	select DRIVERS_USB_ACPI
	select EC_GOOGLE_CHROMEEC
	select EC_GOOGLE_CHROMEEC_BOARDID
	select EC_GOOGLE_CHROMEEC_INCLUDE_SSFC_IN_FW_CONFIG
	select EC_GOOGLE_CHROMEEC_LPC
	select EC_GOOGLE_CHROMEEC_SKUID
	select FW_CONFIG
	select FW_CONFIG_SOURCE_CHROMEEC_CBI
	select GOOGLE_SMBIOS_MAINBOARD_VERSION
	select HAVE_ACPI_RESUME
	select HAVE_ACPI_TABLES
	select HAVE_SPD_IN_CBFS
	select INTEL_LPSS_UART_FOR_CONSOLE
	select MAINBOARD_HAS_CHROMEOS
	select I2C_TPM if BOARD_GOOGLE_VOLTEER2_TI50
	select SPI_TPM if !BOARD_GOOGLE_VOLTEER2_TI50
	select MAINBOARD_HAS_TPM2
	select SOC_INTEL_COMMON_BLOCK_TCSS
	select SOC_INTEL_CSE_LITE_SKU
	select SOC_INTEL_TIGERLAKE
	select TPM_GOOGLE_TI50 if BOARD_GOOGLE_VOLTEER2_TI50
	select TPM_GOOGLE_CR50 if !BOARD_GOOGLE_VOLTEER2_TI50

config BOARD_GOOGLE_DELBIN
	select BOARD_GOOGLE_BASEBOARD_VOLTEER
	select DRIVERS_GENESYSLOGIC_GL9755

config BOARD_GOOGLE_ELDRID
	select BOARD_GOOGLE_BASEBOARD_VOLTEER

config BOARD_GOOGLE_HALVOR
	select BOARD_GOOGLE_BASEBOARD_VOLTEER
	select INTEL_CAR_NEM

config BOARD_GOOGLE_LINDAR
	select BOARD_GOOGLE_BASEBOARD_VOLTEER
	select CHROMEOS_DSM_CALIB if CHROMEOS
	select DRIVERS_GENERIC_BAYHUB_LV2
	select DRIVERS_I2C_RT1011
	select INTEL_CAR_NEM

config BOARD_GOOGLE_MALEFOR
	select BOARD_GOOGLE_BASEBOARD_VOLTEER
	select INTEL_CAR_NEM

config BOARD_GOOGLE_TERRADOR
	select BOARD_GOOGLE_BASEBOARD_VOLTEER

config BOARD_GOOGLE_TODOR
	select BOARD_GOOGLE_BASEBOARD_VOLTEER
	select INTEL_CAR_NEM

config BOARD_GOOGLE_TRONDO
	select BOARD_GOOGLE_BASEBOARD_VOLTEER
	select INTEL_CAR_NEM

config BOARD_GOOGLE_VOLTEER
	select BOARD_GOOGLE_BASEBOARD_VOLTEER
	select INTEL_CAR_NEM
	select SOC_INTEL_ENABLE_USB4_PCIE_RESOURCES
	select VARIANT_HAS_MIPI_CAMERA

config BOARD_GOOGLE_VOLTEER2
	select BOARD_GOOGLE_BASEBOARD_VOLTEER
	select DRIVER_I2C_TPM_ACPI
	select DRIVERS_GENESYSLOGIC_GL9755
	select SOC_INTEL_ENABLE_USB4_PCIE_RESOURCES
	select VARIANT_HAS_MIPI_CAMERA

config BOARD_GOOGLE_VOLTEER2_TI50
	select BOARD_GOOGLE_BASEBOARD_VOLTEER
	select DRIVER_I2C_TPM_ACPI
	select DRIVERS_GENESYSLOGIC_GL9755
	select SOC_INTEL_ENABLE_USB4_PCIE_RESOURCES
	select VARIANT_HAS_MIPI_CAMERA

config BOARD_GOOGLE_VOXEL
	select BOARD_GOOGLE_BASEBOARD_VOLTEER
	select GEO_SAR_ENABLE if CHROMEOS_WIFI_SAR
	select SOC_INTEL_ENABLE_USB4_PCIE_RESOURCES

config BOARD_GOOGLE_ELEMI
	select BOARD_GOOGLE_BASEBOARD_VOLTEER

config BOARD_GOOGLE_VOEMA
	select BOARD_GOOGLE_BASEBOARD_VOLTEER
	select VARIANT_HAS_MIPI_CAMERA

config BOARD_GOOGLE_DROBIT
	select BOARD_GOOGLE_BASEBOARD_VOLTEER
	select DRIVERS_GENESYSLOGIC_GL9755
	select SOC_INTEL_ENABLE_USB4_PCIE_RESOURCES

config BOARD_GOOGLE_COPANO
	select BOARD_GOOGLE_BASEBOARD_VOLTEER
	select SOC_INTEL_ENABLE_USB4_PCIE_RESOURCES

config BOARD_GOOGLE_COLLIS
	select BOARD_GOOGLE_BASEBOARD_VOLTEER

config BOARD_GOOGLE_VOLET
	select BOARD_GOOGLE_BASEBOARD_VOLTEER

config BOARD_GOOGLE_CHRONICLER
	select BOARD_GOOGLE_BASEBOARD_VOLTEER

if BOARD_GOOGLE_BASEBOARD_VOLTEER

config CHROMEOS
	select CHROMEOS_CSE_BOARD_RESET_OVERRIDE
	select CHROMEOS_DRAM_PART_NUMBER_IN_CBI
	select EC_GOOGLE_CHROMEEC_SWITCHES
	select GBB_FLAG_FORCE_DEV_BOOT_ALTFW
	select GBB_FLAG_FORCE_DEV_BOOT_USB
	select GBB_FLAG_FORCE_DEV_SWITCH_ON
	select GBB_FLAG_FORCE_MANUAL_RECOVERY
	select HAS_RECOVERY_MRC_CACHE
	select VBOOT_EARLY_EC_SYNC
	select VBOOT_LID_SWITCH

config VBOOT_GSCVD
	bool
	default n

config CHROMEOS_WIFI_SAR
	bool "Enable SAR options for Chrome OS build"
	depends on CHROMEOS
	select DSAR_ENABLE
	select GEO_SAR_ENABLE
	select SAR_ENABLE
	select USE_SAR

config DEVICETREE
	default "variants/baseboard/devicetree.cb"

config OVERRIDE_DEVICETREE
	default "variants/\$(CONFIG_VARIANT_DIR)/overridetree.cb"

config DRIVER_TPM_SPI_BUS
	default 0x1

config DRIVER_TPM_I2C_BUS
	hex
	default 0x1

config DRIVER_TPM_I2C_ADDR
	hex
	default 0x50

config MAINBOARD_DIR
	default "google/volteer"

config MAINBOARD_FAMILY
	string
	default "Google_Volteer"

config MAINBOARD_PART_NUMBER
	default "Delbin" if BOARD_GOOGLE_DELBIN
	default "Eldrid" if BOARD_GOOGLE_ELDRID
	default "Halvor" if BOARD_GOOGLE_HALVOR
	default "Lindar" if BOARD_GOOGLE_LINDAR
	default "Malefor" if BOARD_GOOGLE_MALEFOR
	default "Terrador" if BOARD_GOOGLE_TERRADOR
	default "Todor" if BOARD_GOOGLE_TODOR
	default "Trondo" if BOARD_GOOGLE_TRONDO
	default "Volteer" if BOARD_GOOGLE_VOLTEER
	default "Volteer2" if BOARD_GOOGLE_VOLTEER2
	default "Volteer2_Ti50" if BOARD_GOOGLE_VOLTEER2_TI50
	default "Voxel" if BOARD_GOOGLE_VOXEL
	default "Elemi" if BOARD_GOOGLE_ELEMI
	default "Voema" if BOARD_GOOGLE_VOEMA
	default "Drobit" if BOARD_GOOGLE_DROBIT
	default "Copano" if BOARD_GOOGLE_COPANO
	default "Collis" if BOARD_GOOGLE_COLLIS
	default "Volet" if BOARD_GOOGLE_VOLET
	default "Chronicler" if BOARD_GOOGLE_CHRONICLER

config TPM_TIS_ACPI_INTERRUPT
	int
	default 21  # GPE0_DW0_21 (GPP_C21)

config VARIANT_DIR
	default "delbin" if BOARD_GOOGLE_DELBIN
	default "eldrid" if BOARD_GOOGLE_ELDRID
	default "halvor" if BOARD_GOOGLE_HALVOR
	default "lindar" if BOARD_GOOGLE_LINDAR
	default "malefor" if BOARD_GOOGLE_MALEFOR
	default "terrador" if BOARD_GOOGLE_TERRADOR
	default "todor" if BOARD_GOOGLE_TODOR
	default "trondo" if BOARD_GOOGLE_TRONDO
	default "volteer" if BOARD_GOOGLE_VOLTEER
	default "volteer2" if BOARD_GOOGLE_VOLTEER2
	default "volteer2" if BOARD_GOOGLE_VOLTEER2_TI50
	default "voxel" if BOARD_GOOGLE_VOXEL
	default "elemi" if BOARD_GOOGLE_ELEMI
	default "voema" if BOARD_GOOGLE_VOEMA
	default "drobit" if BOARD_GOOGLE_DROBIT
	default "copano" if BOARD_GOOGLE_COPANO
	default "collis" if BOARD_GOOGLE_COLLIS
	default "volet" if BOARD_GOOGLE_VOLET
	default "chronicler" if BOARD_GOOGLE_CHRONICLER

config VARIANT_HAS_MIPI_CAMERA
	bool
	default n

endif # BOARD_GOOGLE_BASEBOARD_VOLTEER
```

## src/mainboard/google/volteer/Kconfig.name
```kconfig
comment "Volteer"

config BOARD_GOOGLE_DELBIN
	bool "->  Delbin (ASUS Chromebook Flip CX5)"

config BOARD_GOOGLE_ELDRID
	bool "->  Eldrid"

config BOARD_GOOGLE_HALVOR
	bool "->  Halvor"

config BOARD_GOOGLE_LINDAR
	bool "->  Lindar"

config BOARD_GOOGLE_MALEFOR
	bool "->  Malefor"

config BOARD_GOOGLE_TERRADOR
	bool "->  Terrador"

config BOARD_GOOGLE_TODOR
	bool "->  Todor"

config BOARD_GOOGLE_TRONDO
	bool "->  Trondo"

config BOARD_GOOGLE_VOLTEER
	bool "->  Volteer"

config BOARD_GOOGLE_VOLTEER2
	bool "->  Volteer2"

# Reworked Volteer2 prototype, Haven chip replaced with Dauntless demo board
config BOARD_GOOGLE_VOLTEER2_TI50
	bool "->  Volteer2_Ti50"

config BOARD_GOOGLE_VOXEL
	bool "->  Voxel (Acer Chromebook Spin 713 (CP713-3W))"

config BOARD_GOOGLE_ELEMI
	bool "->  Elemi (HP Pro c640 G2 Chromebook)"

config BOARD_GOOGLE_VOEMA
	bool "->  Voema"

config BOARD_GOOGLE_DROBIT
	bool "->  Drobit (ASUS Chromebook CX9400)"

config BOARD_GOOGLE_COPANO
	bool "->  Copano (ASUS Chromebook Flip CX5400)"

config BOARD_GOOGLE_COLLIS
	bool "->  Collis"

config BOARD_GOOGLE_VOLET
	bool "->  Volet"

config BOARD_GOOGLE_CHRONICLER
	bool "->  Chronicler"
```

## src/mainboard/google/zoombini/Kconfig
```kconfig
config BOARD_GOOGLE_BASEBOARD_ZOOMBINI
	def_bool n
	select BOARD_ROMSIZE_KB_16384
	select DRIVERS_I2C_GENERIC
	select DRIVERS_I2C_HID
	select DRIVERS_I2C_MAX98373
	select DRIVERS_SPI_ACPI
	select EC_GOOGLE_CHROMEEC
	select EC_GOOGLE_CHROMEEC_LPC
	select HAVE_ACPI_TABLES
	select MAINBOARD_HAS_CHROMEOS
	select SOC_INTEL_CANNONLAKE
	select SOC_INTEL_CANNONLAKE_LPDDR4_INIT

if BOARD_GOOGLE_BASEBOARD_ZOOMBINI

config BASEBOARD_ZOOMBINI_LAPTOP
	def_bool n
	select SYSTEM_TYPE_LAPTOP

config DEVICETREE
	string
	default "variants/meowth/devicetree.cb" if BOARD_GOOGLE_MEOWTH
	default "variants/baseboard/devicetree.cb"

config DIMM_SPD_SIZE
	int
	default 512

config DRIVER_TPM_I2C_BUS
	depends on ZOOMBINI_USE_I2C_TPM
	default 0x1

config DRIVER_TPM_I2C_ADDR
	depends on ZOOMBINI_USE_I2C_TPM
	default 0x50

config DRIVER_TPM_SPI_BUS
	depends on ZOOMBINI_USE_SPI_TPM
	default 0x1

config GBB_HWID
	string
	depends on CHROMEOS
	default "MEOWTH TEST 5868" if BOARD_GOOGLE_MEOWTH
	default "ZOOMBINI TEST 5722" if BOARD_GOOGLE_ZOOMBINI

config MAINBOARD_DIR
	string
	default "google/zoombini"

config MAINBOARD_FAMILY
	string
	default "Google_Meowth" if BOARD_GOOGLE_MEOWTH
	default "Google_Zoombini" if BOARD_GOOGLE_ZOOMBINI

config MAINBOARD_PART_NUMBER
	string
	default "Meowth" if BOARD_GOOGLE_MEOWTH
	default "Zoombini" if BOARD_GOOGLE_ZOOMBINI

config MAINBOARD_VENDOR
	string
	default "Google"

config INCLUDE_SND_MAX98357_DA7219_NHLT
	bool "Include blobs for audio with MAX98357_DA7219"
	select NHLT_DMIC_4CH_16B
	select NHLT_DMIC_2CH_16B
	select NHLT_DA7219
	select NHLT_MAX98357

config INCLUDE_SND_MAX98373_NHLT
	bool "Include blobs for audio with MAX98373"
	select NHLT_DMIC_4CH_16B
	select NHLT_DMIC_2CH_16B
	select NHLT_MAX98373

config MAX_CPUS
	int
	default 4

config VARIANT_DIR
	string
	default "meowth" if BOARD_GOOGLE_MEOWTH
	default "zoombini" if BOARD_GOOGLE_ZOOMBINI

config VBOOT
	select EC_GOOGLE_CHROMEEC_SWITCHES
	select HAS_RECOVERY_MRC_CACHE
	select MRC_CLEAR_NORMAL_CACHE_ON_RECOVERY_RETRAIN
	select GBB_FLAG_DISABLE_EC_SOFTWARE_SYNC
	select VBOOT_LID_SWITCH if BASEBOARD_ZOOMBINI_LAPTOP

# Select this option to enable use of cr50 I2C TPM on zoombini.
config ZOOMBINI_USE_I2C_TPM
	bool
	default n
	select I2C_TPM
	select MAINBOARD_HAS_I2C_TPM_CR50
	select TPM2

# Select this option to enable use of cr50 SPI TPM on zoombini.
config ZOOMBINI_USE_SPI_TPM
	bool
	default y
	select MAINBOARD_HAS_SPI_TPM_CR50
	select SPI_TPM
	select TPM2

config TPM_TIS_ACPI_INTERRUPT
	int
	default 76 # GPE0_DW2_12 (GPP_C12)

endif # BOARD_GOOGLE_BASEBOARD_ZOOMBINI
```

## src/mainboard/google/zoombini/Kconfig.name
```kconfig
comment "Zoombini"

config BOARD_GOOGLE_ZOOMBINI
	bool "->  Zoombini"
	select BOARD_GOOGLE_BASEBOARD_ZOOMBINI
	select BASEBOARD_ZOOMBINI_LAPTOP

config BOARD_GOOGLE_MEOWTH
	bool "->  Meowth"
	select BOARD_GOOGLE_BASEBOARD_ZOOMBINI
	select BASEBOARD_ZOOMBINI_LAPTOP
```
