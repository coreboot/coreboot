## src/mainboard/hp/8770w/Kconfig
```kconfig
#
# This file is part of the coreboot project.
#
# Copyright (C) 2017 Iru Cai <mytbk920423@gmail.com>
# Copyright (C) 2018 Robert Reeves
#
# This program is free software; you can redistribute it and/or modify
# it under the terms of the GNU General Public License as published by
# the Free Software Foundation; version 2 of the License.
#
# This program is distributed in the hope that it will be useful,
# but WITHOUT ANY WARRANTY; without even the implied warranty of
# MERCHANTABILITY or FITNESS FOR A PARTICULAR PURPOSE.  See the
# GNU General Public License for more details.
#

if BOARD_HP_8770W

config BOARD_SPECIFIC_OPTIONS
	def_bool y
	select BOARD_ROMSIZE_KB_16384
	select HAVE_ACPI_RESUME
	select HAVE_ACPI_TABLES
	select INTEL_INT15
	select NORTHBRIDGE_INTEL_SANDYBRIDGE
	select SERIRQ_CONTINUOUS_MODE
	select SOUTHBRIDGE_INTEL_C216
	select SYSTEM_TYPE_LAPTOP
	select USE_NATIVE_RAMINIT
	select EC_HP_KBC1126
	select SUPERIO_SMSC_LPC47N217
	select HAVE_OPTION_TABLE
	select HAVE_CMOS_DEFAULT
	select MAINBOARD_USES_IFD_GBE_REGION

config MAINBOARD_DIR
	string
	default "hp/8770w"

config MAINBOARD_PART_NUMBER
	string
	default "EliteBook 8770w"

config MAX_CPUS
	int
	default 8

config USBDEBUG_HCD_INDEX
	int
	default 2

endif
```

## src/mainboard/hp/Kconfig
```kconfig
## SPDX-License-Identifier: GPL-2.0-only

if VENDOR_HP

choice
	prompt "Mainboard model"

source "src/mainboard/hp/*/Kconfig.name"

endchoice

source "src/mainboard/hp/*/Kconfig"

config MAINBOARD_VENDOR
	default "HP"

endif # VENDOR_HP
```

## src/mainboard/hp/abm/Kconfig
```kconfig
# SPDX-License-Identifier: GPL-2.0-only

if BOARD_HP_ABM

config BOARD_SPECIFIC_OPTIONS
	def_bool y
	select CPU_AMD_AGESA_FAMILY16_KB
	select NORTHBRIDGE_AMD_AGESA_FAMILY16_KB
	select SOUTHBRIDGE_AMD_AGESA_YANGTZE
	select DEFAULT_POST_ON_LPC
	select SUPERIO_NUVOTON_NCT5104D
	select HAVE_OPTION_TABLE
	select HAVE_PIRQ_TABLE
	select HAVE_ACPI_TABLES
	select BOARD_ROMSIZE_KB_8192

config MAINBOARD_DIR
	string
	default "hp/abm"

config MAINBOARD_PART_NUMBER
	string
	default "ABM"

config HW_MEM_HOLE_SIZEK
	hex
	default 0x200000

config MAX_CPUS
	int
	default 4

config IRQ_SLOT_COUNT
	int
	default 11

config HUDSON_LEGACY_FREE
	bool
	default n

endif # BOARD_HP_ABM
```

## src/mainboard/hp/compaq_8200_elite_sff/Kconfig
```kconfig
if BOARD_HP_COMPAQ_8200_ELITE_SFF_PC

config BOARD_SPECIFIC_OPTIONS
	def_bool y
	select BOARD_ROMSIZE_KB_8192
	select HAVE_ACPI_RESUME
	select HAVE_ACPI_TABLES
	select INTEL_INT15
	select NORTHBRIDGE_INTEL_SANDYBRIDGE
	select SERIRQ_CONTINUOUS_MODE
	select SOUTHBRIDGE_INTEL_BD82X6X
	select USE_NATIVE_RAMINIT
	select MEMORY_MAPPED_TPM
	select MAINBOARD_HAS_TPM1
	select HAVE_OPTION_TABLE
	select HAVE_CMOS_DEFAULT
	select SUPERIO_NUVOTON_NPCD378
	select MAINBOARD_HAS_LIBGFXINIT
	select INTEL_GMA_HAVE_VBT
	select MAINBOARD_USES_IFD_GBE_REGION

config CBFS_SIZE
	default 0x2F0000

config MAINBOARD_DIR
	default "hp/compaq_8200_elite_sff"

config MAINBOARD_PART_NUMBER
	default "HP Compaq 8200 Elite SFF PC"

config DRAM_RESET_GATE_GPIO
	int
	default 60

config USBDEBUG_HCD_INDEX
	int
	default 2
endif
```

## src/mainboard/hp/compaq_8200_elite_sff/Kconfig.name
```kconfig
## SPDX-License-Identifier: GPL-2.0-only

config BOARD_HP_COMPAQ_8200_ELITE_SFF_PC
	bool "Compaq 8200 Elite SFF"
```

## src/mainboard/hp/compaq_elite_8300_usdt/Kconfig
```kconfig
if BOARD_HP_COMPAQ_ELITE_8300_USDT

config BOARD_SPECIFIC_OPTIONS
	def_bool y
	select BOARD_ROMSIZE_KB_16384
	select HAVE_ACPI_RESUME
	select HAVE_ACPI_TABLES
	select HAVE_CMOS_DEFAULT
	select HAVE_OPTION_TABLE
	select INTEL_INT15
	select MAINBOARD_HAS_TPM1
	select MAINBOARD_HAS_LIBGFXINIT
	select MAINBOARD_USES_IFD_GBE_REGION
	select MEMORY_MAPPED_TPM
	select NORTHBRIDGE_INTEL_SANDYBRIDGE
	select SERIRQ_CONTINUOUS_MODE
	select SOUTHBRIDGE_INTEL_C216
	select SUPERIO_NUVOTON_NPCD378
	select USE_NATIVE_RAMINIT

config CBFS_SIZE
	default 0x570000

config MAINBOARD_DIR
	default "hp/compaq_elite_8300_usdt"

config MAINBOARD_PART_NUMBER
	default "HP Compaq Elite 8300 USDT"

config VGA_BIOS_ID
	default "8086,0152"

config DRAM_RESET_GATE_GPIO
	default 60

config USBDEBUG_HCD_INDEX # FIXME: check this
	default 2
endif
```

## src/mainboard/hp/compaq_elite_8300_usdt/Kconfig.name
```kconfig
## SPDX-License-Identifier: GPL-2.0-only

config BOARD_HP_COMPAQ_ELITE_8300_USDT
	bool "Compaq Elite 8300 USDT"
```

## src/mainboard/hp/dl145_g1/Kconfig
```kconfig
if BOARD_HP_DL145_G1

config BOARD_SPECIFIC_OPTIONS # dummy
	def_bool y
	select ARCH_X86
	select CPU_AMD_SOCKET_940
	select NORTHBRIDGE_AMD_AMDK8
	select SOUTHBRIDGE_AMD_AMD8131
	select SOUTHBRIDGE_AMD_AMD8111
	select SUPERIO_WINBOND_W83627HF
	select HAVE_OPTION_TABLE
	select HAVE_PIRQ_TABLE
	select HAVE_MP_TABLE
	select BOARD_ROMSIZE_KB_512
	select RAMINIT_SYSINFO
#	select SB_HT_CHAIN_UNITID_OFFSET_ONLY
	select QRANK_DIMM_SUPPORT
	select DRIVERS_I2C_I2CMUX

config MAINBOARD_DIR
	string
	default hp/dl145_g1

config APIC_ID_OFFSET
	hex
	default 0x0

config SB_HT_CHAIN_ON_BUS0
	int
	default 2

config MAINBOARD_PART_NUMBER
	string
	default "ProLiant DL145 G1"

config MAX_CPUS
	int
	default 4

config MAX_PHYSICAL_CPUS
	int
	default 2

config HT_CHAIN_UNITID_BASE
	hex
	default 0x1

config HT_CHAIN_END_UNITID_BASE
	hex
	default 0x6

config IRQ_SLOT_COUNT
	int
	default 9

endif # BOARD_HP_DL145_G1
```

## src/mainboard/hp/dl145_g3/Kconfig
```kconfig
if BOARD_HP_DL145_G3

config BOARD_SPECIFIC_OPTIONS # dummy
	def_bool y
	select ARCH_X86
	select CPU_AMD_SOCKET_F
	select DIMM_DDR2
	select DIMM_REGISTERED
	select NORTHBRIDGE_AMD_AMDK8
	select SOUTHBRIDGE_BROADCOM_BCM21000
	select SOUTHBRIDGE_BROADCOM_BCM5785
	select SUPERIO_NSC_PC87417
	select HAVE_OPTION_TABLE
	select HAVE_PIRQ_TABLE
	select HAVE_MP_TABLE
	select LIFT_BSP_APIC_ID
	select BOARD_ROMSIZE_KB_512
	select RAMINIT_SYSINFO
	select SB_HT_CHAIN_UNITID_OFFSET_ONLY
	select QRANK_DIMM_SUPPORT
	select K8_ALLOCATE_IO_RANGE
	select SET_FIDVID

config MAINBOARD_DIR
	string
	default hp/dl145_g3

config DCACHE_RAM_BASE
	hex
	default 0xcc000

config DCACHE_RAM_SIZE
	hex
	default 0x04000

config APIC_ID_OFFSET
	hex
	default 0x8

config SB_HT_CHAIN_ON_BUS0
	int
	default 2

config MAINBOARD_PART_NUMBER
	string
	default "ProLiant DL145 G3"

config MAX_CPUS
	int
	default 4

config MAX_PHYSICAL_CPUS
	int
	default 2

config HT_CHAIN_END_UNITID_BASE
	hex
	default 0x1

config HT_CHAIN_UNITID_BASE
	hex
	default 0x6

config SB_HT_CHAIN_ON_BUS0
	int
	default 2

config IRQ_SLOT_COUNT
	int
	default 15

endif # BOARD_HP_DL145_G3
```

## src/mainboard/hp/dl165_g6_fam10/Kconfig
```kconfig
if BOARD_HP_DL165_G6_FAM10

config BOARD_SPECIFIC_OPTIONS # dummy
	def_bool y
	select CPU_AMD_SOCKET_F_1207
	select NORTHBRIDGE_AMD_AMDFAM10
	select SOUTHBRIDGE_BROADCOM_BCM21000
	select SOUTHBRIDGE_BROADCOM_BCM5785
	select HT_CHAIN_DISTRIBUTE
	select SUPERIO_SERVERENGINES_PILOT
	select SUPERIO_NSC_PC87417
	select DIMM_DDR2
	select DIMM_REGISTERED
	select HAVE_OPTION_TABLE
	select HAVE_PIRQ_TABLE
	select HAVE_MP_TABLE
	select LIFT_BSP_APIC_ID
	select BOARD_ROMSIZE_KB_1024
	select ENABLE_APIC_EXT_ID

config MAINBOARD_DIR
	string
	default hp/dl165_g6_fam10

config DCACHE_RAM_BASE
	hex
	default 0xc4000

config DCACHE_RAM_SIZE
	hex
	default 0x0c000

config APIC_ID_OFFSET
	hex
	default 0x0

config MAINBOARD_PART_NUMBER
	string
	default "ProLiant DL165 G6 (Fam10)"

config MAX_CPUS
	int
	default 12

config MAX_PHYSICAL_CPUS
	int
	default 2

config HT_CHAIN_END_UNITID_BASE
	hex
	default 0x1

config HT_CHAIN_UNITID_BASE
	hex
	default 0x6

config IRQ_SLOT_COUNT
	int
	default 15

config BOOTBLOCK_MAINBOARD_INIT
	string
	default "mainboard/hp/dl165_g6_fam10/bootblock.c"

endif # BOARD_HP_DL165_G6_FAM10
```

## src/mainboard/hp/e_vectra_p2706t/Kconfig
```kconfig
##
## This file is part of the coreboot project.
##
## Copyright (C) 2009 Uwe Hermann <uwe@hermann-uwe.de>
##
## This program is free software; you can redistribute it and/or modify
## it under the terms of the GNU General Public License as published by
## the Free Software Foundation; version 2 of the License.
##
## This program is distributed in the hope that it will be useful,
## but WITHOUT ANY WARRANTY; without even the implied warranty of
## MERCHANTABILITY or FITNESS FOR A PARTICULAR PURPOSE.  See the
## GNU General Public License for more details.
##
## You should have received a copy of the GNU General Public License
## along with this program; if not, write to the Free Software
## Foundation, Inc., 51 Franklin St, Fifth Floor, Boston, MA 02110-1301 USA
##

# FIXME: It's a PC87360 actually.
# FIXME: It's an i810E actually!
# FIXME: ROM chip size really 512KB?
if BOARD_HP_E_VECTRA_P2706T

config BOARD_SPECIFIC_OPTIONS # dummy
	def_bool y
	select ARCH_X86
	select CPU_INTEL_SOCKET_PGA370
	select NORTHBRIDGE_INTEL_I82810
	select SOUTHBRIDGE_INTEL_I82801AX
	select SUPERIO_NSC_PC87360
	select HAVE_PIRQ_TABLE
	select UDELAY_TSC
	select BOARD_ROMSIZE_KB_512
	select GFXUMA

config MAINBOARD_DIR
	string
	default hp/e_vectra_p2706t

config MAINBOARD_PART_NUMBER
	string
	default "e-Vectra P2706T"

config IRQ_SLOT_COUNT
	int
	default 3

endif # BOARD_HP_E_VECTRA_P2706T
```

## src/mainboard/hp/elitebook_820_g2/Kconfig
```kconfig
# SPDX-License-Identifier: GPL-2.0-or-later

if BOARD_HP_ELITEBOOK_820_G2

config BOARD_SPECIFIC_OPTIONS
	def_bool y
	select AZALIA_USE_LEGACY_VERB_TABLE
	select BOARD_ROMSIZE_KB_12288
	select EC_HP_KBC1126
	select HAVE_ACPI_RESUME
	select HAVE_ACPI_TABLES
	select INTEL_GMA_HAVE_VBT
	select MAINBOARD_HAS_LIBGFXINIT
	select MAINBOARD_HAS_TPM1
	select MAINBOARD_USES_IFD_GBE_REGION
	select MEMORY_MAPPED_TPM
	select SOC_INTEL_BROADWELL
	select SYSTEM_TYPE_LAPTOP

config MAINBOARD_DIR
	default "hp/elitebook_820_g2"

config MAINBOARD_PART_NUMBER
	default "EliteBook 820 G2"

config EC_HP_KBC1126_ECFW_IN_CBFS
	default n

config EC_HP_KBC1126_GPE
	default 0x6

endif
```

## src/mainboard/hp/elitebook_820_g2/Kconfig.name
```kconfig
# SPDX-License-Identifier: GPL-2.0-or-later

config BOARD_HP_ELITEBOOK_820_G2
	bool "EliteBook 820 G2"
```

## src/mainboard/hp/folio_9470m/Kconfig
```kconfig
if BOARD_HP_FOLIO_9470M

config BOARD_SPECIFIC_OPTIONS # dummy
	def_bool y
	select BOARD_ROMSIZE_KB_16384
	select CPU_INTEL_SOCKET_RPGA989
	select EC_HP_KBC1126
	select HAVE_ACPI_RESUME
	select HAVE_ACPI_TABLES
	select INTEL_INT15
	select NORTHBRIDGE_INTEL_IVYBRIDGE
	select SANDYBRIDGE_IVYBRIDGE_LVDS
	select SERIRQ_CONTINUOUS_MODE
	select SOUTHBRIDGE_INTEL_C216
	select SYSTEM_TYPE_LAPTOP
	select USE_NATIVE_RAMINIT
	select MAINBOARD_HAS_LPC_TPM
	select HAVE_OPTION_TABLE
	select HAVE_CMOS_DEFAULT
	select ENABLE_VMX
	select MAINBOARD_HAS_LIBGFXINIT
	select GFX_GMA_INTERNAL_IS_LVDS

config MAINBOARD_DIR
	string
	default hp/folio_9470m

config MAINBOARD_PART_NUMBER
	string
	default "EliteBook Folio 9470m"

config VGA_BIOS_FILE
	string
	default "pci8086,0166.rom"

config VGA_BIOS_ID
	string
	default "8086,0166"

config MAINBOARD_PCI_SUBSYSTEM_DEVICE_ID
	hex
	default 0x18df

config MAINBOARD_PCI_SUBSYSTEM_VENDOR_ID
	hex
	default 0x103c

config MAX_CPUS
	int
	default 8

config USBDEBUG_HCD_INDEX
	int
	default 0
endif
```

## src/mainboard/hp/folio_9480m/Kconfig
```kconfig
if BOARD_HP_FOLIO_9480M

config BOARD_SPECIFIC_OPTIONS
	def_bool y
	# The board has a 16MB flash, but the end of the flash needs
	# to be reserved, so we use 12MB as default
	select BOARD_ROMSIZE_KB_12288
	select EC_HP_KBC1126
	select HAVE_ACPI_RESUME
	select HAVE_ACPI_TABLES
	select INTEL_GMA_HAVE_VBT
	select INTEL_LYNXPOINT_LP
	select MAINBOARD_HAS_LIBGFXINIT
	select MEMORY_MAPPED_TPM
	select MAINBOARD_HAS_TPM1
	select MAINBOARD_USES_IFD_GBE_REGION
	select NORTHBRIDGE_INTEL_HASWELL
	select SERIRQ_CONTINUOUS_MODE
	select SOUTHBRIDGE_INTEL_LYNXPOINT
	select SYSTEM_TYPE_LAPTOP

config MAINBOARD_DIR
	default "hp/folio_9480m"

config MAINBOARD_PART_NUMBER
	default "HP EliteBook Folio 9480m"

config VGA_BIOS_ID
	string
	default "8086,0a16"

config USBDEBUG_HCD_INDEX
	int
	default 1

config EC_HP_KBC1126_ECFW_IN_CBFS
	bool
	default n

config EC_HP_KBC1126_GPE
	hex
	default 0x6

endif
```

## src/mainboard/hp/folio_9480m/Kconfig.name
```kconfig
## SPDX-License-Identifier: GPL-2.0-only

config BOARD_HP_FOLIO_9480M
	bool "EliteBook Folio 9480m"
```

## src/mainboard/hp/pavilion_m6_1035dx/Kconfig
```kconfig
# SPDX-License-Identifier: GPL-2.0-only

if BOARD_HP_PAVILION_M6_1035DX

config BOARD_SPECIFIC_OPTIONS
	def_bool y
	select SYSTEM_TYPE_LAPTOP
	select CPU_AMD_AGESA_FAMILY15_TN
	select NORTHBRIDGE_AMD_AGESA_FAMILY15_TN
	select SOUTHBRIDGE_AMD_AGESA_HUDSON
	select DEFAULT_POST_ON_LPC
	select EC_COMPAL_ENE932
	select HAVE_OPTION_TABLE
	select HAVE_PIRQ_TABLE
	select HAVE_ACPI_RESUME
	select HAVE_SMI_HANDLER
	select HAVE_ACPI_TABLES
	select HAVE_CMOS_DEFAULT
	select BOARD_ROMSIZE_KB_4096
	select GFXUMA
	select NO_UART_ON_SUPERIO

config MAINBOARD_DIR
	string
	default "hp/pavilion_m6_1035dx"

config MAINBOARD_PART_NUMBER
	string
	default "Pavilion m6 1035dx"

config HW_MEM_HOLE_SIZEK
	hex
	default 0x200000

config MAX_CPUS
	int
	default 4

config IRQ_SLOT_COUNT
	int
	default 11

config ONBOARD_VGA_IS_PRIMARY
	bool
	default y

config VGA_BIOS_ID
	string
	default "1002,9900"

endif # BOARD_HP_PAVILION_M6_1035DX
```
