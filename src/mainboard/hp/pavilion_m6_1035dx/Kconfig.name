## src/mainboard/ibase/mb899/Kconfig.name
```kconfig
## SPDX-License-Identifier: GPL-2.0-only

config BOARD_IBASE_MB899
	bool "MB899"
```

## src/mainboard/ibm/Kconfig
```kconfig
if VENDOR_IBM

choice
	prompt "Mainboard model"

source "src/mainboard/ibm/*/Kconfig.name"

endchoice

source "src/mainboard/ibm/*/Kconfig"

config MAINBOARD_VENDOR
	string
	default "IBM"

endif # VENDOR_IBM
```

## src/mainboard/ibm/e325/Kconfig
```kconfig
if BOARD_IBM_E325

config BOARD_SPECIFIC_OPTIONS # dummy
	def_bool y
	select ARCH_X86
	select CPU_AMD_SOCKET_940
	select NORTHBRIDGE_AMD_AMDK8
	select SOUTHBRIDGE_AMD_AMD8111
	select SOUTHBRIDGE_AMD_AMD8131
	select SUPERIO_NSC_PC87366
	select HAVE_OPTION_TABLE
	select HAVE_PIRQ_TABLE
	select HAVE_MP_TABLE
	select SB_HT_CHAIN_UNITID_OFFSET_ONLY
	select BOARD_ROMSIZE_KB_512
	select QRANK_DIMM_SUPPORT

config MAINBOARD_DIR
	string
	default ibm/e325

config DCACHE_RAM_BASE
	hex
	default 0xcf000

config DCACHE_RAM_SIZE
	hex
	default 0x1000

config APIC_ID_OFFSET
	hex
	default 0x0

config MAINBOARD_PART_NUMBER
	string
	default "eServer 325"

config MAX_CPUS
	int
	default 1

config MAX_PHYSICAL_CPUS
	int
	default 1

config SB_HT_CHAIN_ON_BUS0
	int
	default 0

config HT_CHAIN_END_UNITID_BASE
	hex
	default 0x20

config HT_CHAIN_UNITID_BASE
	hex
	default 0x1

config SERIAL_CPU_INIT
	bool
	default n

config IRQ_SLOT_COUNT
	int
	default 12

endif # BOARD_IBM_E325
```

## src/mainboard/ibm/e326/Kconfig
```kconfig
if BOARD_IBM_E326

config BOARD_SPECIFIC_OPTIONS # dummy
	def_bool y
	select ARCH_X86
	select CPU_AMD_SOCKET_940
	select NORTHBRIDGE_AMD_AMDK8
	select SOUTHBRIDGE_AMD_AMD8111
	select SOUTHBRIDGE_AMD_AMD8131
	select SUPERIO_NSC_PC87366
	select HAVE_OPTION_TABLE
	select HAVE_PIRQ_TABLE
	select HAVE_MP_TABLE
	select SB_HT_CHAIN_UNITID_OFFSET_ONLY
	select BOARD_ROMSIZE_KB_512
	select QRANK_DIMM_SUPPORT

config MAINBOARD_DIR
	string
	default ibm/e326

config DCACHE_RAM_BASE
	hex
	default 0xcf000

config DCACHE_RAM_SIZE
	hex
	default 0x1000

config APIC_ID_OFFSET
	hex
	default 0x0

config MAINBOARD_PART_NUMBER
	string
	default "eServer 326"

config MAX_CPUS
	int
	default 2

config MAX_PHYSICAL_CPUS
	int
	default 2

config SB_HT_CHAIN_ON_BUS0
	int
	default 0

config HT_CHAIN_END_UNITID_BASE
	hex
	default 0x20

config HT_CHAIN_UNITID_BASE
	hex
	default 0x1

config SERIAL_CPU_INIT
	bool
	default n

config IRQ_SLOT_COUNT
	int
	default 12

endif # BOARD_IBM_E326
```

## src/mainboard/ibm/sbp1/Kconfig
```kconfig
if BOARD_IBM_SBP1

config BOARD_SPECIFIC_OPTIONS
	def_bool y
	select BOARD_ROMSIZE_KB_65536
	select IPMI_KCS
	select MAINBOARD_HAS_TPM2
	select MEMORY_MAPPED_TPM
	select MAINBOARD_USES_FSP2_0
	select SOC_INTEL_SAPPHIRERAPIDS_SP
	select HAVE_ACPI_TABLES
	select MAINBOARD_USES_IFD_GBE_REGION

config MAINBOARD_DIR
	string
	default "ibm/sbp1"

config MAINBOARD_PART_NUMBER
	string
	default "SBP1"

config FMDFILE
	string
	default "src/mainboard/\$(CONFIG_MAINBOARD_DIR)/board.fmd"

config MAX_SOCKET
	int
	default 4

config MAX_CPUS
	int
	default 480

endif
```
