## src/mainboard/hp/pro_3500_series/Kconfig
```kconfig
# SPDX-License-Identifier: GPL-2.0-or-later

if BOARD_HP_PRO_3500_SERIES

config BOARD_SPECIFIC_OPTIONS
	def_bool y
	select BOARD_ROMSIZE_KB_8192
	select HAVE_ACPI_RESUME
	select HAVE_ACPI_TABLES
	select INTEL_GMA_HAVE_VBT
	select MAINBOARD_HAS_LIBGFXINIT
	select MAINBOARD_USES_IFD_GBE_REGION
	select NORTHBRIDGE_INTEL_SANDYBRIDGE
	select NO_UART_ON_SUPERIO
	select SERIRQ_CONTINUOUS_MODE
	select SOUTHBRIDGE_INTEL_BD82X6X
	select SUPERIO_ITE_IT8772F
	select USE_NATIVE_RAMINIT

config CBFS_SIZE
	default 0x400000

config MAINBOARD_DIR
	default "hp/pro_3500_series"

config MAINBOARD_PART_NUMBER
	default "Pro 3500 Series"

config VGA_BIOS_ID
	default "8086,0152"

config DRAM_RESET_GATE_GPIO
	default 60

config USBDEBUG_HCD_INDEX
	default 2
endif
```

## src/mainboard/hp/pro_3x00_series/Kconfig
```kconfig
# SPDX-License-Identifier: GPL-2.0-or-later

config BOARD_HP_PRO_3X00_SERIES_COMMON
	def_bool n
	select HAVE_ACPI_RESUME
	select HAVE_ACPI_TABLES
	select HAVE_CMOS_DEFAULT
	select HAVE_OPTION_TABLE
	select INTEL_GMA_HAVE_VBT
	select MAINBOARD_HAS_LIBGFXINIT
	select NORTHBRIDGE_INTEL_SANDYBRIDGE
	select NO_UART_ON_SUPERIO
	select SERIRQ_CONTINUOUS_MODE
	select SOUTHBRIDGE_INTEL_BD82X6X
	select SUPERIO_ITE_IT8772F
	select USE_NATIVE_RAMINIT

config BOARD_HP_PRO_3400_SERIES
	select BOARD_HP_PRO_3X00_SERIES_COMMON
	select BOARD_ROMSIZE_KB_4096

config BOARD_HP_PRO_3500_SERIES
	select BOARD_HP_PRO_3X00_SERIES_COMMON
	select BOARD_ROMSIZE_KB_8192

if BOARD_HP_PRO_3X00_SERIES_COMMON

config CBFS_SIZE
	default 0x200000 if BOARD_ROMSIZE_KB_4096
	default 0x400000 if BOARD_ROMSIZE_KB_8192

config MAINBOARD_DIR
	default "hp/pro_3x00_series"

config VARIANT_DIR
	default "pro_3400_series" if BOARD_HP_PRO_3400_SERIES
	default "pro_3500_series" if BOARD_HP_PRO_3500_SERIES

config MAINBOARD_PART_NUMBER
	default "Pro 3400 Series" if BOARD_HP_PRO_3400_SERIES
	default "Pro 3500 Series" if BOARD_HP_PRO_3500_SERIES

config OVERRIDE_DEVICETREE
	default "variants/\$(CONFIG_VARIANT_DIR)/overridetree.cb"

config USBDEBUG_HCD_INDEX
	default 2
endif
```

## src/mainboard/hp/pro_3x00_series/Kconfig.name
```kconfig
# SPDX-License-Identifier: GPL-2.0-or-later

config BOARD_HP_PRO_3400_SERIES
	bool "Pro 3400 Series"

config BOARD_HP_PRO_3500_SERIES
	bool "Pro 3500 Series"
```

## src/mainboard/hp/prodesk_600_g1_sff/Kconfig
```kconfig
## SPDX-License-Identifier: GPL-2.0-only

if BOARD_HP_PRODESK_600_G1_SFF

config BOARD_SPECIFIC_OPTIONS
	def_bool y
	select AZALIA_USE_LEGACY_VERB_TABLE
	select BOARD_ROMSIZE_KB_16384
	select CPU_INTEL_HASWELL
	select HAVE_ACPI_RESUME
	select HAVE_ACPI_TABLES
	select HAVE_CMOS_DEFAULT
	select HAVE_OPTION_TABLE
	select INTEL_GMA_HAVE_VBT
	select MAINBOARD_HAS_LIBGFXINIT
	select MAINBOARD_HAS_TPM1
	select MAINBOARD_USES_IFD_GBE_REGION
	select MEMORY_MAPPED_TPM
	select NORTHBRIDGE_INTEL_HASWELL
	select SERIRQ_CONTINUOUS_MODE
	select SOUTHBRIDGE_INTEL_LYNXPOINT
	select SUPERIO_NUVOTON_NPCD378

config MAINBOARD_DIR
	default "hp/prodesk_600_g1_sff"

config MAINBOARD_PART_NUMBER
	default "ProDesk 600 G1 SFF"

config USBDEBUG_HCD_INDEX # FIXME: check this
	default 2

endif
```

## src/mainboard/hp/prodesk_600_g1_sff/Kconfig.name
```kconfig
## SPDX-License-Identifier: GPL-2.0-only

config BOARD_HP_PRODESK_600_G1_SFF
	bool "ProDesk 600 G1 SFF"
```

## src/mainboard/hp/snb_ivb_desktops/Kconfig
```kconfig
## SPDX-License-Identifier: GPL-2.0-only

config BOARD_HP_SNB_IVB_DESKTOPS_COMMON
	def_bool n
	select AZALIA_USE_LEGACY_VERB_TABLE
	select HAVE_ACPI_RESUME
	select HAVE_ACPI_TABLES
	select HAVE_CMOS_DEFAULT
	select HAVE_OPTION_TABLE
	select INTEL_GMA_HAVE_VBT
	select INTEL_INT15
	select MAINBOARD_HAS_LIBGFXINIT
	select MAINBOARD_HAS_TPM1
	select MAINBOARD_USES_IFD_GBE_REGION
	select MEMORY_MAPPED_TPM
	select NORTHBRIDGE_INTEL_SANDYBRIDGE
	select SERIRQ_CONTINUOUS_MODE
	select SUPERIO_NUVOTON_NPCD378
	select USE_NATIVE_RAMINIT

config BOARD_HP_COMPAQ_PRO_6300
	select BOARD_HP_SNB_IVB_DESKTOPS_COMMON
	select BOARD_ROMSIZE_KB_16384
	select SOUTHBRIDGE_INTEL_C216

config BOARD_HP_COMPAQ_8200_ELITE_SFF_PC
	select BOARD_HP_SNB_IVB_DESKTOPS_COMMON
	select SOUTHBRIDGE_INTEL_BD82X6X
	select BOARD_ROMSIZE_KB_8192

config BOARD_HP_COMPAQ_8200_ELITE_USDT
	select BOARD_HP_SNB_IVB_DESKTOPS_COMMON
	select SOUTHBRIDGE_INTEL_BD82X6X
	select BOARD_ROMSIZE_KB_8192

config BOARD_HP_COMPAQ_8300_ELITE_SFF
	select BOARD_HP_SNB_IVB_DESKTOPS_COMMON
	select BOARD_ROMSIZE_KB_16384
	select SOUTHBRIDGE_INTEL_BD82X6X

config BOARD_HP_COMPAQ_ELITE_8300_USDT
	select BOARD_HP_SNB_IVB_DESKTOPS_COMMON
	select SOUTHBRIDGE_INTEL_C216
	select BOARD_ROMSIZE_KB_16384

config BOARD_HP_Z220_CMT_WORKSTATION
	select BOARD_HP_SNB_IVB_DESKTOPS_COMMON
	select BOARD_ROMSIZE_KB_16384
	select GFX_GMA_ANALOG_I2C_HDMI_B
	select SOUTHBRIDGE_INTEL_BD82X6X

config BOARD_HP_Z220_SFF_WORKSTATION
	select BOARD_HP_SNB_IVB_DESKTOPS_COMMON
	select BOARD_ROMSIZE_KB_16384
	select GFX_GMA_ANALOG_I2C_HDMI_B
	select SOUTHBRIDGE_INTEL_BD82X6X

if BOARD_HP_SNB_IVB_DESKTOPS_COMMON

config VBOOT
	select GBB_FLAG_DISABLE_EC_SOFTWARE_SYNC
	select GBB_FLAG_DISABLE_FWMP
	select GBB_FLAG_DISABLE_LID_SHUTDOWN
	select GBB_FLAG_DISABLE_PD_SOFTWARE_SYNC
	select VBOOT_NO_BOARD_SUPPORT
	select VBOOT_VBNV_FLASH

config CBFS_SIZE
	default 0x2F0000 if BOARD_ROMSIZE_KB_8192
	default 0x570000 if BOARD_ROMSIZE_KB_16384

config MAINBOARD_DIR
	default "hp/snb_ivb_desktops"

config VARIANT_DIR
	default "compaq_pro_6300" if BOARD_HP_COMPAQ_PRO_6300
	default "compaq_8200_elite_sff" if BOARD_HP_COMPAQ_8200_ELITE_SFF_PC
	default "compaq_8200_elite_usdt" if BOARD_HP_COMPAQ_8200_ELITE_USDT
	default "compaq_8300_elite_sff" if BOARD_HP_COMPAQ_8300_ELITE_SFF
	default "compaq_elite_8300_usdt" if BOARD_HP_COMPAQ_ELITE_8300_USDT
	default "z220_cmt_workstation" if BOARD_HP_Z220_CMT_WORKSTATION
	default "z220_sff_workstation" if BOARD_HP_Z220_SFF_WORKSTATION

config MAINBOARD_PART_NUMBER
	default "HP Compaq Pro 6300 SFF/MT" if BOARD_HP_COMPAQ_PRO_6300
	default "HP Compaq 8200 Elite SFF PC" if BOARD_HP_COMPAQ_8200_ELITE_SFF_PC
	default "HP Compaq 8200 Elite USDT" if BOARD_HP_COMPAQ_8200_ELITE_USDT
	default "HP Compaq 8300 Elite SFF" if BOARD_HP_COMPAQ_8300_ELITE_SFF
	default "HP Compaq Elite 8300 USDT" if BOARD_HP_COMPAQ_ELITE_8300_USDT
	default "HP Z220 CMT Workstation" if BOARD_HP_Z220_CMT_WORKSTATION
	default "HP Z220 SFF Workstation" if BOARD_HP_Z220_SFF_WORKSTATION

config OVERRIDE_DEVICETREE
	default "variants/\$(CONFIG_VARIANT_DIR)/overridetree.cb"

config INTEL_GMA_VBT_FILE
	default "src/mainboard/\$(MAINBOARDDIR)/variants/\$(CONFIG_VARIANT_DIR)/data.vbt"

config DRAM_RESET_GATE_GPIO
	int
	default 60

config USBDEBUG_HCD_INDEX # FIXME: check this on USDT
	int
	default 2
endif
```

## src/mainboard/hp/snb_ivb_desktops/Kconfig.name
```kconfig
## SPDX-License-Identifier: GPL-2.0-only

config BOARD_HP_COMPAQ_8200_ELITE_SFF_PC
	bool "Compaq 8200 Elite SFF"

config BOARD_HP_COMPAQ_8200_ELITE_USDT
	bool "Compaq 8200 Elite USDT"

config BOARD_HP_COMPAQ_8300_ELITE_SFF
	bool "Compaq 8300 Elite SFF"

config BOARD_HP_COMPAQ_ELITE_8300_USDT
	bool "Compaq Elite 8300 USDT"

config BOARD_HP_Z220_CMT_WORKSTATION
	bool "Z220 CMT Workstation"

config BOARD_HP_Z220_SFF_WORKSTATION
	bool "Z220 SFF Workstation"
```

## src/mainboard/hp/snb_ivb_laptops/Kconfig
```kconfig
## SPDX-License-Identifier: GPL-2.0-only

config BOARD_HP_SNB_IVB_LAPTOPS_COMMON
	def_bool n
	select EC_HP_KBC1126
	select HAVE_ACPI_RESUME
	select HAVE_ACPI_TABLES
	select HAVE_CMOS_DEFAULT
	select HAVE_OPTION_TABLE
	select MEMORY_MAPPED_TPM
	select MAINBOARD_HAS_TPM1
	select MAINBOARD_USES_IFD_GBE_REGION
	select NORTHBRIDGE_INTEL_SANDYBRIDGE
	select SERIRQ_CONTINUOUS_MODE
	select SYSTEM_TYPE_LAPTOP
	select USE_NATIVE_RAMINIT

config BOARD_HP_2560P
	select BOARD_HP_SNB_IVB_LAPTOPS_COMMON
	select BOARD_ROMSIZE_KB_8192
	select GFX_GMA_PANEL_1_ON_LVDS
	select INTEL_GMA_HAVE_VBT
	select INTEL_INT15
	select MAINBOARD_HAS_LIBGFXINIT
	select SOUTHBRIDGE_INTEL_BD82X6X

config BOARD_HP_2570P
	select BOARD_HP_SNB_IVB_LAPTOPS_COMMON
	select BOARD_ROMSIZE_KB_16384
	select GFX_GMA_PANEL_1_ON_LVDS
	select INTEL_INT15
	select MAINBOARD_HAS_LIBGFXINIT
	select SOUTHBRIDGE_INTEL_C216

config BOARD_HP_2760P
	select BOARD_HP_SNB_IVB_LAPTOPS_COMMON
	select BOARD_ROMSIZE_KB_8192
	select GFX_GMA_PANEL_1_ON_LVDS
	select INTEL_INT15
	select MAINBOARD_HAS_LIBGFXINIT
	select SOUTHBRIDGE_INTEL_BD82X6X

config BOARD_HP_8460P
	select BOARD_HP_SNB_IVB_LAPTOPS_COMMON
	select BOARD_ROMSIZE_KB_8192
	select GFX_GMA_PANEL_1_ON_LVDS
	select INTEL_INT15
	select MAINBOARD_HAS_LIBGFXINIT
	select SOUTHBRIDGE_INTEL_BD82X6X
	select SUPERIO_SMSC_LPC47N217

config BOARD_HP_8470P
	select BOARD_HP_SNB_IVB_LAPTOPS_COMMON
	select BOARD_ROMSIZE_KB_16384
	select GFX_GMA_PANEL_1_ON_LVDS
	select INTEL_INT15
	select MAINBOARD_HAS_LIBGFXINIT
	select SOUTHBRIDGE_INTEL_C216
	select SUPERIO_SMSC_LPC47N217

config BOARD_HP_8770W
	select BOARD_HP_SNB_IVB_LAPTOPS_COMMON
	select BOARD_ROMSIZE_KB_16384
	select SOUTHBRIDGE_INTEL_C216
	select SUPERIO_SMSC_LPC47N217

config BOARD_HP_FOLIO_9470M
	select BOARD_HP_SNB_IVB_LAPTOPS_COMMON
	select BOARD_ROMSIZE_KB_16384
	select GFX_GMA_PANEL_1_ON_LVDS
	select INTEL_GMA_HAVE_VBT
	select INTEL_INT15
	select MAINBOARD_HAS_LIBGFXINIT
	select SOUTHBRIDGE_INTEL_C216

config BOARD_HP_PROBOOK_6360B
	select BOARD_HP_SNB_IVB_LAPTOPS_COMMON
	select BOARD_ROMSIZE_KB_4096
	select GFX_GMA_PANEL_1_ON_LVDS
	select INTEL_GMA_HAVE_VBT
	select INTEL_INT15
	select MAINBOARD_HAS_LIBGFXINIT
	select MEMORY_MAPPED_TPM
	select MAINBOARD_HAS_TPM1
	select SOUTHBRIDGE_INTEL_BD82X6X
	select SUPERIO_SMSC_LPC47N217

config BOARD_HP_REVOLVE_810_G1
	select BOARD_HP_SNB_IVB_LAPTOPS_COMMON
	select BOARD_ROMSIZE_KB_16384
	select HAVE_SPD_IN_CBFS
	select GFX_GMA_PANEL_1_ON_LVDS
	select INTEL_INT15
	select INTEL_GMA_HAVE_VBT
	select MAINBOARD_HAS_LIBGFXINIT
	select SOUTHBRIDGE_INTEL_C216

if BOARD_HP_SNB_IVB_LAPTOPS_COMMON

config MAINBOARD_DIR
	default "hp/snb_ivb_laptops"

config VARIANT_DIR
	default "2560p"          if BOARD_HP_2560P
	default "2570p"          if BOARD_HP_2570P
	default "2760p"          if BOARD_HP_2760P
	default "8460p"          if BOARD_HP_8460P
	default "8470p"          if BOARD_HP_8470P
	default "8770w"          if BOARD_HP_8770W
	default "folio_9470m"    if BOARD_HP_FOLIO_9470M
	default "probook_6360b"  if BOARD_HP_PROBOOK_6360B
	default "revolve_810_g1" if BOARD_HP_REVOLVE_810_G1

config MAINBOARD_PART_NUMBER
	default "EliteBook 2560p"          if BOARD_HP_2560P
	default "EliteBook 2570p"          if BOARD_HP_2570P
	default "EliteBook 2760p"          if BOARD_HP_2760P
	default "EliteBook 8460p"          if BOARD_HP_8460P
	default "EliteBook 8470p"          if BOARD_HP_8470P
	default "EliteBook 8770w"          if BOARD_HP_8770W
	default "EliteBook Folio 9470m"    if BOARD_HP_FOLIO_9470M
	default "ProBook 6360b"            if BOARD_HP_PROBOOK_6360B
	default "EliteBook Revolve 810 G1" if BOARD_HP_REVOLVE_810_G1

config OVERRIDE_DEVICETREE
	default "variants/\$(CONFIG_VARIANT_DIR)/overridetree.cb"

config VGA_BIOS_ID
	string
	default "8086,0116" if SOUTHBRIDGE_INTEL_BD82X6X
	default "8086,0166" if SOUTHBRIDGE_INTEL_C216

config USBDEBUG_HCD_INDEX
	int
	default 1 if BOARD_HP_2560P
	default 2 if BOARD_HP_2570P
	default 1 if BOARD_HP_2760P
	default 1 if BOARD_HP_8460P
	default 2 if BOARD_HP_8470P
	default 2 if BOARD_HP_8770W
	default 0 if BOARD_HP_FOLIO_9470M
	default 1 if BOARD_HP_PROBOOK_6360B # FIXME: check this
	default 2 if BOARD_HP_REVOLVE_810_G1 # FIXME: check this

endif
```

## src/mainboard/hp/snb_ivb_laptops/Kconfig.name
```kconfig
## SPDX-License-Identifier: GPL-2.0-only

config BOARD_HP_2560P
	bool "EliteBook 2560p"

config BOARD_HP_2570P
	bool "EliteBook 2570p"

config BOARD_HP_2760P
	bool "EliteBook 2760p"

config BOARD_HP_8460P
	bool "EliteBook 8460p"

config BOARD_HP_8470P
	bool "EliteBook 8470p"

config BOARD_HP_8770W
	bool "EliteBook 8770w"

config BOARD_HP_FOLIO_9470M
	bool "EliteBook Folio 9470m"

config BOARD_HP_PROBOOK_6360B
	bool "ProBook 6360b"

config BOARD_HP_REVOLVE_810_G1
	bool "EliteBook Revolve 810 G1"
```

## src/mainboard/hp/z220_series/Kconfig
```kconfig
config BOARD_HP_Z220_SERIES_COMMON
	def_bool n
	select BOARD_ROMSIZE_KB_16384
	select GFX_GMA_ANALOG_I2C_HDMI_B
	select HAVE_ACPI_RESUME
	select HAVE_ACPI_TABLES
	select HAVE_CMOS_DEFAULT
	select HAVE_OPTION_TABLE
	select INTEL_GMA_HAVE_VBT
	select INTEL_INT15
	select MAINBOARD_HAS_LIBGFXINIT
	select MAINBOARD_HAS_TPM1
	select MAINBOARD_USES_IFD_GBE_REGION
	select MEMORY_MAPPED_TPM
	select NORTHBRIDGE_INTEL_SANDYBRIDGE
	select SERIRQ_CONTINUOUS_MODE
	select SOUTHBRIDGE_INTEL_BD82X6X
	select SUPERIO_NUVOTON_NPCD378
	select USE_NATIVE_RAMINIT

config BOARD_HP_Z220_CMT_WORKSTATION
	select BOARD_HP_Z220_SERIES_COMMON

config BOARD_HP_Z220_SFF_WORKSTATION
	select BOARD_HP_Z220_SERIES_COMMON

if BOARD_HP_Z220_SERIES_COMMON

config VBOOT
	select GBB_FLAG_DISABLE_EC_SOFTWARE_SYNC
	select GBB_FLAG_DISABLE_FWMP
	select GBB_FLAG_DISABLE_LID_SHUTDOWN
	select GBB_FLAG_DISABLE_PD_SOFTWARE_SYNC
	select VBOOT_NO_BOARD_SUPPORT
	select VBOOT_VBNV_FLASH

config CBFS_SIZE
	default 0x570000

config MAINBOARD_DIR
	default "hp/z220_series"

config VARIANT_DIR
	default "z220_cmt_workstation" if BOARD_HP_Z220_CMT_WORKSTATION
	default "z220_sff_workstation" if BOARD_HP_Z220_SFF_WORKSTATION

config MAINBOARD_PART_NUMBER
	default "HP Z220 CMT Workstation" if BOARD_HP_Z220_CMT_WORKSTATION
	default "HP Z220 SFF Workstation" if BOARD_HP_Z220_SFF_WORKSTATION

config OVERRIDE_DEVICETREE
	default "variants/\$(CONFIG_VARIANT_DIR)/overridetree.cb"

config INTEL_GMA_VBT_FILE
	default "src/mainboard/\$(MAINBOARDDIR)/data.vbt"

config DRAM_RESET_GATE_GPIO
	int
	default 60

config USBDEBUG_HCD_INDEX
	int
	default 2
endif
```

## src/mainboard/hp/z220_sff_workstation/Kconfig
```kconfig
if BOARD_HP_Z220_SFF_WORKSTATION

config BOARD_SPECIFIC_OPTIONS
	def_bool y
	select BOARD_ROMSIZE_KB_16384
	select HAVE_ACPI_RESUME
	select HAVE_ACPI_TABLES
	select INTEL_INT15
	select NORTHBRIDGE_INTEL_SANDYBRIDGE
	select SERIRQ_CONTINUOUS_MODE
	select SOUTHBRIDGE_INTEL_BD82X6X
	select USE_NATIVE_RAMINIT
	select MAINBOARD_HAS_LPC_TPM
	select MAINBOARD_HAS_TPM1
	select HAVE_OPTION_TABLE
	select HAVE_CMOS_DEFAULT
	select SUPERIO_NUVOTON_NPCD378
	select MAINBOARD_HAS_LIBGFXINIT
	select INTEL_GMA_HAVE_VBT
	select GFX_GMA_ANALOG_I2C_HDMI_B
	select MAINBOARD_USES_IFD_GBE_REGION

config VBOOT
	select VBOOT_VBNV_CMOS
	select VBOOT_NO_BOARD_SUPPORT
	select GBB_FLAG_DISABLE_LID_SHUTDOWN
	select GBB_FLAG_DISABLE_PD_SOFTWARE_SYNC
	select GBB_FLAG_DISABLE_EC_SOFTWARE_SYNC
	select GBB_FLAG_DISABLE_FWMP

config VBOOT_VBNV_OFFSET
	hex
	default 0x2a

config CBFS_SIZE
	default 0x570000

config MAINBOARD_DIR
	string
	default "hp/z220_sff_workstation"

config MAINBOARD_PART_NUMBER
	string
	default "HP Z220 SFF Workstation"

config VGA_BIOS_FILE
	string
	default "pci8086,0102.rom"

config VGA_BIOS_ID
	string
	default "8086,0102"

config DRAM_RESET_GATE_GPIO
	int
	default 60

config USBDEBUG_HCD_INDEX
	int
	default 2
endif
```

## src/mainboard/ibase/Kconfig
```kconfig
if VENDOR_IBASE

choice
	prompt "Mainboard model"

source "src/mainboard/ibase/*/Kconfig.name"

endchoice

source "src/mainboard/ibase/*/Kconfig"

config MAINBOARD_VENDOR
	default "iBase"

endif # VENDOR_IBASE
```

## src/mainboard/ibase/mb899/Kconfig
```kconfig
if BOARD_IBASE_MB899

config BOARD_SPECIFIC_OPTIONS
	def_bool y
	select CPU_INTEL_SOCKET_M
	select NORTHBRIDGE_INTEL_I945
	select NORTHBRIDGE_INTEL_SUBTYPE_I945GM
	select CHECK_SLFRCS_ON_RESUME
	select SOUTHBRIDGE_INTEL_I82801GX
	select SUPERIO_WINBOND_W83627EHG
	select HAVE_ACPI_TABLES
	select HAVE_PIRQ_TABLE
	select HAVE_MP_TABLE
	select HAVE_OPTION_TABLE
	select HAVE_ACPI_RESUME
	select BOARD_ROMSIZE_KB_512
	select INTEL_INT15

config MAINBOARD_DIR
	default "ibase/mb899"

config MAINBOARD_PART_NUMBER
	default "MB899"

config IRQ_SLOT_COUNT
	int
	default 18

endif # BOARD_IBASE_MB899
```
