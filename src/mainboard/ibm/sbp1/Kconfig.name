## src/mainboard/iei/Kconfig
```kconfig
##
## This file is part of the coreboot project.
##
## Copyright (C) 2009 Uwe Hermann <uwe@hermann-uwe.de>
##
## This program is free software; you can redistribute it and/or modify
## it under the terms of the GNU General Public License as published by
## the Free Software Foundation; version 2 of the License.
##
## This program is distributed in the hope that it will be useful,
## but WITHOUT ANY WARRANTY; without even the implied warranty of
## MERCHANTABILITY or FITNESS FOR A PARTICULAR PURPOSE.  See the
## GNU General Public License for more details.
##
## You should have received a copy of the GNU General Public License
## along with this program; if not, write to the Free Software
## Foundation, Inc., 51 Franklin St, Fifth Floor, Boston, MA 02110-1301 USA
##
if VENDOR_IEI

choice
	prompt "Mainboard model"

config BOARD_IEI_JUKI_511P
	bool "JUKI-511P"
config BOARD_IEI_KINO_FAM10
	bool "Kino-780AM2(Fam10)"
config BOARD_IEI_NOVA_4899R
	bool "NOVA-4899R"
config BOARD_IEI_PCISA_LX_800_R10
	bool "PCISA LX-800-R10"
config BOARD_IEI_PM_LX_800_R11
	bool "PM LX-800-R11"
config BOARD_IEI_PM_LX2_800_R10
	bool "PM LX2-800-R10"

endchoice

source "src/mainboard/iei/juki-511p/Kconfig"
source "src/mainboard/iei/kino-780am2-fam10/Kconfig"
source "src/mainboard/iei/nova4899r/Kconfig"
source "src/mainboard/iei/pcisa-lx-800-r10/Kconfig"
source "src/mainboard/iei/pm-lx-800-r11/Kconfig"
source "src/mainboard/iei/pm-lx2-800-r10/Kconfig"

config MAINBOARD_VENDOR
	string
	default "IEI"

endif # VENDOR_IEI
```

## src/mainboard/iei/juki-511p/Kconfig
```kconfig
##
## This file is part of the coreboot project.
##
## Copyright (C) 2009 Uwe Hermann <uwe@hermann-uwe.de>
##
## This program is free software; you can redistribute it and/or modify
## it under the terms of the GNU General Public License as published by
## the Free Software Foundation; either version 2 of the License, or
## (at your option) any later version.
##
## This program is distributed in the hope that it will be useful,
## but WITHOUT ANY WARRANTY; without even the implied warranty of
## MERCHANTABILITY or FITNESS FOR A PARTICULAR PURPOSE.  See the
## GNU General Public License for more details.
##
## You should have received a copy of the GNU General Public License
## along with this program; if not, write to the Free Software
## Foundation, Inc., 51 Franklin St, Fifth Floor, Boston, MA  02110-1301 USA
##

config BOARD_IEI_JUKI_511P
	bool "JUKI-511P"
	select ARCH_X86
	select CPU_AMD_GX1
	select NORTHBRIDGE_AMD_GX1
	select SOUTHBRIDGE_AMD_CS5530
	select SUPERIO_WINBOND_W83977F
	select HAVE_PIRQ_TABLE
	select PIRQ_ROUTE
	select HAVE_OPTION_TABLE
	select UDELAY_TSC
	select TSC_X86RDTSC_CALIBRATE_WITH_TIMER2

config MAINBOARD_DIR
	string
	default iei/juki-511p
	depends on BOARD_IEI_JUKI_511P

config MAINBOARD_PART_NUMBER
	string
	default "JUKI-511P"
	depends on BOARD_IEI_JUKI_511P

config IRQ_SLOT_COUNT
	int
	default 2
	depends on BOARD_IEI_JUKI_511P
```

## src/mainboard/iei/pcisa-lx-800-r10/Kconfig
```kconfig
if BOARD_IEI_PCISA_LX_800_R10

config BOARD_SPECIFIC_OPTIONS # dummy
	def_bool y
	select ARCH_X86
	select CPU_AMD_GEODE_LX
	select NORTHBRIDGE_AMD_LX
	select SOUTHBRIDGE_AMD_CS5536
	select SUPERIO_WINBOND_W83627HF
	select HAVE_PIRQ_TABLE
	select PIRQ_ROUTE
	select BOARD_ROMSIZE_KB_256
	select POWER_BUTTON_FORCE_ENABLE
	select PLL_MANUAL_CONFIG
	select CORE_GLIU_500_266

config MAINBOARD_DIR
	string
	default iei/pcisa-lx-800-r10

config MAINBOARD_PART_NUMBER
	string
	default "PCISA-LX-800-R10"

config IRQ_SLOT_COUNT
	int
	default 9

config PLLMSRlo
	hex
	default 0x00DE6000

endif # BOARD_IEI_PCISA_LX_800_R10
```

## src/mainboard/iei/pm-lx-800-r11/Kconfig
```kconfig
##
## This file is part of the coreboot project.
##
## Copyright (C) 2012 Ricardo Martins <rasmartins@gmail.com>
##
## This program is free software; you can redistribute it and/or
## modify it under the terms of the GNU General Public License as
## published by the Free Software Foundation; version 2 of
## the License.
##
## This program is distributed in the hope that it will be useful,
## but WITHOUT ANY WARRANTY; without even the implied warranty of
## MERCHANTABILITY or FITNESS FOR A PARTICULAR PURPOSE.  See the
## GNU General Public License for more details.
##
## You should have received a copy of the GNU General Public License
## along with this program; if not, write to the Free Software
## Foundation, Inc., 51 Franklin St, Fifth Floor, Boston,
## MA 02110-1301 USA
##

if BOARD_IEI_PM_LX_800_R11

config BOARD_SPECIFIC_OPTIONS
	def_bool y
	select ARCH_X86
	select CPU_AMD_GEODE_LX
	select NORTHBRIDGE_AMD_LX
	select SOUTHBRIDGE_AMD_CS5536
	select SUPERIO_WINBOND_W83627EHG
	select HAVE_PIRQ_TABLE
	select PIRQ_ROUTE
	select BOARD_ROMSIZE_KB_512
	select POWER_BUTTON_FORCE_ENABLE
	select PLL_MANUAL_CONFIG
	select CORE_GLIU_500_266

config MAINBOARD_DIR
	string
	default iei/pm-lx-800-r11

config MAINBOARD_PART_NUMBER
	string
	default "PM-LX-800-R11"

config IRQ_SLOT_COUNT
	int
	default 7

config PLLMSRlo
	hex
	default 0x07de0000

endif # BOARD_IEI_PM_LX_800_R11
```

## src/mainboard/iei/pm-lx2-800-r10/Kconfig
```kconfig
##
## This file is part of the coreboot project.
##
## Copyright (C) 2012 Ricardo Martins <rasmartins@gmail.com>
##
## This program is free software; you can redistribute it and/or
## modify it under the terms of the GNU General Public License as
## published by the Free Software Foundation; version 2 of
## the License.
##
## This program is distributed in the hope that it will be useful,
## but WITHOUT ANY WARRANTY; without even the implied warranty of
## MERCHANTABILITY or FITNESS FOR A PARTICULAR PURPOSE.  See the
## GNU General Public License for more details.
##
## You should have received a copy of the GNU General Public License
## along with this program; if not, write to the Free Software
## Foundation, Inc., 51 Franklin St, Fifth Floor, Boston,
## MA 02110-1301 USA
##

if BOARD_IEI_PM_LX2_800_R10

config BOARD_SPECIFIC_OPTIONS
	def_bool y
	select ARCH_X86
	select CPU_AMD_GEODE_LX
	select NORTHBRIDGE_AMD_LX
	select SOUTHBRIDGE_AMD_CS5536
	select SUPERIO_SMSC_SMSCSUPERIO
	select HAVE_PIRQ_TABLE
	select PIRQ_ROUTE
	select BOARD_ROMSIZE_KB_512
	select POWER_BUTTON_FORCE_ENABLE
	select PLL_MANUAL_CONFIG
	select CORE_GLIU_500_266

config MAINBOARD_DIR
	string
	default iei/pm-lx2-800-r10

config MAINBOARD_PART_NUMBER
	string
	default "PM-LX2-800-R10"

config IRQ_SLOT_COUNT
	int
	default 3

config PLLMSRlo
	hex
	default 0x07de0000

endif # BOARD_IEI_PM_LX2_800_R10
```

## src/mainboard/iei/rocky-512/Kconfig
```kconfig
if BOARD_IEI_ROCKY_512

# Dummy for abuild

config MAINBOARD_PART_NUMBER
	string
	default "ROCKY-512"

endif
```

## src/mainboard/intel/Kconfig
```kconfig
## SPDX-License-Identifier: GPL-2.0-only

if VENDOR_INTEL

choice
	prompt "Mainboard model"

source "src/mainboard/intel/*/Kconfig.name"

endchoice

source "src/mainboard/intel/*/Kconfig"

config MAINBOARD_VENDOR
	default "Intel"

endif # VENDOR_INTEL
```

## src/mainboard/intel/adlrvp/Kconfig
```kconfig
config BOARD_INTEL_ADLRVP_COMMON
	def_bool n
	select BOARD_ROMSIZE_KB_32768
	select DRIVERS_I2C_GENERIC
	select DRIVERS_I2C_HID
	select DRIVERS_I2C_MAX98373
	select DRIVERS_INTEL_DPTF
	select DRIVERS_INTEL_MIPI_CAMERA
	select DRIVERS_INTEL_SOUNDWIRE
	select DRIVERS_SOUNDWIRE_ALC711
	select DRIVERS_SPI_ACPI
	select DRIVERS_USB_ACPI
	select HAVE_ACPI_RESUME
	select HAVE_ACPI_TABLES
	select HAVE_SPD_IN_CBFS
	select MAINBOARD_HAS_CHROMEOS
	select SOC_INTEL_COMMON_BLOCK_IPU
	select SOC_INTEL_CSE_LITE_SKU
	select SOC_INTEL_ENABLE_USB4_PCIE_RESOURCES

config BOARD_INTEL_ADLRVP_P
	select BOARD_INTEL_ADLRVP_COMMON
	select DRIVERS_UART_8250IO
	select MAINBOARD_USES_IFD_EC_REGION
	select SOC_INTEL_ALDERLAKE_PCH_P
	select GEN3_EXTERNAL_CLOCK_BUFFER

config BOARD_INTEL_ADLRVP_P_EXT_EC
	select BOARD_INTEL_ADLRVP_COMMON
	select DRIVERS_INTEL_PMC
	select INTEL_LPSS_UART_FOR_CONSOLE
	select SOC_INTEL_ALDERLAKE_PCH_P
	select GEN3_EXTERNAL_CLOCK_BUFFER

config BOARD_INTEL_ADLRVP_P_MCHP
	select BOARD_INTEL_ADLRVP_COMMON
	select DRIVERS_INTEL_MIPI_CAMERA
	select DRIVERS_INTEL_PMC
	select EC_GOOGLE_CHROMEEC_ACPI_MEMMAP
	select EC_GOOGLE_CHROMEEC_MEC
	select INTEL_LPSS_UART_FOR_CONSOLE
	select SOC_INTEL_ALDERLAKE_PCH_P

config BOARD_INTEL_ADLRVP_M
	select BOARD_INTEL_ADLRVP_COMMON
	select DRIVERS_UART_8250IO
	select MAINBOARD_USES_IFD_EC_REGION
	select SOC_INTEL_ALDERLAKE_PCH_M

config BOARD_INTEL_ADLRVP_M_EXT_EC
	select BOARD_INTEL_ADLRVP_COMMON
	select DRIVERS_INTEL_PMC
	select FW_CONFIG
	select FW_CONFIG_SOURCE_CHROMEEC_CBI
	select INTEL_LPSS_UART_FOR_CONSOLE
	select MAINBOARD_HAS_TPM2
	select SOC_INTEL_ALDERLAKE_PCH_M
	select SPI_TPM
	select TPM_GOOGLE_CR50

config BOARD_INTEL_ADLRVP_N
	select BOARD_INTEL_ADLRVP_COMMON
	select DRIVERS_UART_8250IO
	select MAINBOARD_USES_IFD_EC_REGION
	select SOC_INTEL_ALDERLAKE_PCH_N

config BOARD_INTEL_ADLRVP_N_EXT_EC
	select BOARD_INTEL_ADLRVP_COMMON
	select DRIVERS_INTEL_PMC
	select INTEL_LPSS_UART_FOR_CONSOLE
	select SOC_INTEL_ALDERLAKE_PCH_N
	select FW_CONFIG
	select FW_CONFIG_SOURCE_CHROMEEC_CBI

if BOARD_INTEL_ADLRVP_COMMON

config CHROMEOS
	select GBB_FLAG_FORCE_DEV_SWITCH_ON
	select GBB_FLAG_FORCE_DEV_BOOT_USB
	select GBB_FLAG_FORCE_DEV_BOOT_ALTFW
	select GBB_FLAG_FORCE_MANUAL_RECOVERY
	select GBB_FLAG_DISABLE_PD_SOFTWARE_SYNC
	select HAS_RECOVERY_MRC_CACHE

config MAINBOARD_DIR
	default "intel/adlrvp"

config VARIANT_DIR
	default "adlrvp_p" if BOARD_INTEL_ADLRVP_P
	default "adlrvp_p_ext_ec" if BOARD_INTEL_ADLRVP_P_EXT_EC
	default "adlrvp_p_mchp" if BOARD_INTEL_ADLRVP_P_MCHP
	default "adlrvp_m" if BOARD_INTEL_ADLRVP_M
	default "adlrvp_m_ext_ec" if BOARD_INTEL_ADLRVP_M_EXT_EC
	default "adlrvp_n" if BOARD_INTEL_ADLRVP_N
	default "adlrvp_n_ext_ec" if BOARD_INTEL_ADLRVP_N_EXT_EC

config GBB_HWID
	string
	depends on CHROMEOS
	default "ADLRVPM" if BOARD_INTEL_ADLRVP_M || BOARD_INTEL_ADLRVP_M_EXT_EC
	default "ADLRVPN" if BOARD_INTEL_ADLRVP_N || BOARD_INTEL_ADLRVP_N_EXT_EC
	default "ADLRVPP"

config MAINBOARD_PART_NUMBER
	default "Alder Lake Client Platform"

config MAINBOARD_VENDOR
	string
	default "Intel Corporation"

config MAINBOARD_FAMILY
	string
	default "Intel_adlrvp"

config DEVICETREE
	default "devicetree_m.cb" if BOARD_INTEL_ADLRVP_M || BOARD_INTEL_ADLRVP_M_EXT_EC
	default "devicetree_n.cb" if BOARD_INTEL_ADLRVP_N || BOARD_INTEL_ADLRVP_N_EXT_EC
	default "devicetree.cb"

config OVERRIDE_DEVICETREE
	default "variants/\$(CONFIG_VARIANT_DIR)/overridetree.cb"

config DIMM_SPD_SIZE
	default 512

choice
	prompt "ON BOARD EC"
	default ADL_INTEL_EC if BOARD_INTEL_ADLRVP_P || BOARD_INTEL_ADLRVP_M || BOARD_INTEL_ADLRVP_N
	default ADL_CHROME_EC if BOARD_INTEL_ADLRVP_P_EXT_EC || BOARD_INTEL_ADLRVP_M_EXT_EC || BOARD_INTEL_ADLRVP_P_MCHP || BOARD_INTEL_ADLRVP_N_EXT_EC
	help
	  This option allows you to select the on board EC to use.
	  Select whether the board has Intel EC or Chrome EC

config ADL_CHROME_EC
	bool "Chrome EC"
	select EC_GOOGLE_CHROMEEC
	select EC_GOOGLE_CHROMEEC_ESPI
	select EC_GOOGLE_CHROMEEC_BOARDID
	select EC_ACPI
	select EC_GOOGLE_CHROMEEC_LPC

config ADL_INTEL_EC
	bool "Intel EC"
	select EC_ACPI
endchoice

config VBOOT
	select VBOOT_LID_SWITCH
	select VBOOT_MOCK_SECDATA if BOARD_INTEL_ADLRVP_P_EXT_EC || BOARD_INTEL_ADLRVP_N_EXT_EC
	select EC_GOOGLE_CHROMEEC_SWITCHES if ADL_CHROME_EC
	select VBOOT_EARLY_EC_SYNC if BOARD_INTEL_ADLRVP_M_EXT_EC

config UART_FOR_CONSOLE
	int
	default 0

config DRIVER_TPM_SPI_BUS
	default 0x2 if BOARD_INTEL_ADLRVP_M_EXT_EC

config USE_PM_ACPI_TIMER
	default n if BOARD_INTEL_ADLRVP_N_EXT_EC || BOARD_INTEL_ADLRVP_N

config TPM_TIS_ACPI_INTERRUPT
	int
	default 67 if BOARD_INTEL_ADLRVP_M_EXT_EC  # GPE0_DW2_3 (GPP_E3)

config GEN3_EXTERNAL_CLOCK_BUFFER
	bool
	depends on SOC_INTEL_ALDERLAKE_PCH_P
	default n
	help
	  Support external Gen-3 clock chip for ADL-P.
	  `CONFIG_CLKSRC_FOR_EXTERNAL_BUFFER` provides feed clock to discrete buffer
	  for further distribution to platform. SRCCLKREQB[7:9] maps to internal
	  SRCCLKREQB[6]. If any of them asserted, SRC buffer
	  `CONFIG_CLKSRC_FOR_EXTERNAL_BUFFER` gets enabled.

config CLKSRC_FOR_EXTERNAL_BUFFER
	depends on GEN3_EXTERNAL_CLOCK_BUFFER
	int
	default 6  # CLKSRC 6
endif
```

## src/mainboard/intel/adlrvp/Kconfig.name
```kconfig
## SPDX-License-Identifier: GPL-2.0-only

config BOARD_INTEL_ADLRVP_P
	bool "Alderlake-P RVP"

config BOARD_INTEL_ADLRVP_P_EXT_EC
	bool "Alderlake-P RVP with Chrome EC"

config BOARD_INTEL_ADLRVP_P_MCHP
	bool "Alderlake-P RVP with Microchip EC"

config BOARD_INTEL_ADLRVP_N
	bool "Alderlake-N RVP"

config BOARD_INTEL_ADLRVP_N_EXT_EC
	bool "Alderlake-N RVP with Chrome EC"

config BOARD_INTEL_ADLRVP_RPL
	bool "Raptorlake silicon with Alderlake-P RVP"

config BOARD_INTEL_ADLRVP_RPL_EXT_EC
	bool "Raptorlake silicon with Alderlake-P RVP and Chrome EC"
```

## src/mainboard/intel/amenia/Kconfig
```kconfig
if BOARD_INTEL_AMENIA

config BOARD_SPECIFIC_OPTIONS
	def_bool y
	select SOC_INTEL_APOLLOLAKE
	select BOARD_ROMSIZE_KB_16384
	select EC_GOOGLE_CHROMEEC
	select EC_GOOGLE_CHROMEEC_LPC
	select EC_GOOGLE_CHROMEEC_PD
	select HAVE_ACPI_TABLES
	select MAINBOARD_HAS_LPC_TPM
	select HAVE_ACPI_RESUME
	select MAINBOARD_HAS_CHROMEOS
	select SYSTEM_TYPE_LAPTOP
	select TPM_ON_FAST_SPI

config CHROMEOS
	select LID_SWITCH

config MAINBOARD_DIR
	string
	default intel/amenia

config MAINBOARD_FAMILY
	string
	default "Intel_Amenia"

config MAINBOARD_PART_NUMBER
	string
	default "Amenia"

config MAINBOARD_VENDOR
	string
	default "Intel"

config GBB_HWID
	string
	depends on CHROMEOS
	default "AMENIA TEST"

config FMAP_FILE
	string
	default "amenia"

config MAX_CPUS
	int
	default 8

config INCLUDE_NHLT_BLOBS
	bool "Include blobs for audio."
	select NHLT_DMIC_2CH_16B
	select NHLT_DA7219
	select NHLT_MAX98357

config DRIVERS_GENERIC_MAX98357A
	default y

config DRIVERS_I2C_DA7219
	default y

config UART_FOR_CONSOLE
	int
	default 2

endif # BOARD_INTEL_AMENIA
```

## src/mainboard/intel/apollolake_rvp/Kconfig
```kconfig
if BOARD_INTEL_APOLLOLAKE_RVP1 || BOARD_INTEL_APOLLOLAKE_RVP2

config BOARD_SPECIFIC_OPTIONS
	def_bool y
	select SOC_INTEL_APOLLOLAKE
	select BOARD_ROMSIZE_KB_8192
	select HAVE_ACPI_TABLES
	select INTEL_LPSS_UART_FOR_CONSOLE

config MAINBOARD_DIR
	string
	default "intel/apollolake_rvp"

config MAINBOARD_PART_NUMBER
	string
	default "Apollolake RVP"

config UART_FOR_CONSOLE
	default 2
endif
```

## src/mainboard/intel/apollolake_rvp/Kconfig.name
```kconfig
## SPDX-License-Identifier: GPL-2.0-only

config BOARD_INTEL_APOLLOLAKE_RVP1
	bool "Apollolake DDR3 RVP1"

config BOARD_INTEL_APOLLOLAKE_RVP2
	bool "Apollolake LPDDR3 RVP2"
```

## src/mainboard/intel/archercity_crb/Kconfig
```kconfig
## SPDX-License-Identifier: GPL-2.0-only

if BOARD_INTEL_ARCHERCITY_CRB

config BOARD_SPECIFIC_OPTIONS
	def_bool y
	select BOARD_ROMSIZE_KB_65536
	select CPU_INTEL_SOCKET_LGA4677
	select CONSOLE_OVERRIDE_LOGLEVEL
	select IPMI_KCS
	select IPMI_KCS_ROMSTAGE
	select IPMI_OCP
	select MEMORY_MAPPED_TPM
	select MAINBOARD_HAS_TPM2
	select DRIVERS_ASPEED_AST2050
	select SOC_INTEL_SAPPHIRERAPIDS_SP
	select SUPERIO_ASPEED_AST2400
	select HAVE_ACPI_TABLES
	select MAINBOARD_USES_IFD_GBE_REGION
	select VPD
	select OCP_EWL
	select OCP_VPD
	select RUNTIME_CONFIGURABLE_SMM_LOGLEVEL

config MAINBOARD_DIR
	string
	default "intel/archercity_crb"

config MAINBOARD_PART_NUMBER
	string
	default "Archer City CRB"

config FMDFILE
	string
	default "src/mainboard/\$(CONFIG_MAINBOARD_DIR)/board.fmd"

config MAX_SOCKET
	int
	default 2

config DEBUG_SMI
	default y

endif
```

## src/mainboard/intel/archercity_crb/Kconfig.name
```kconfig
## SPDX-License-Identifier: GPL-2.0-only

config BOARD_INTEL_ARCHERCITY_CRB
	bool "Archer City CRB"
```
