## src/mainboard/intel/avenuecity_crb/Kconfig
```kconfig
## SPDX-License-Identifier: GPL-2.0-only

if BOARD_INTEL_AVENUECITY_CRB

config BOARD_SPECIFIC_OPTIONS
	def_bool y
	select BOARD_ROMSIZE_KB_65536
	select SOC_INTEL_GRANITERAPIDS
	select SUPERIO_ASPEED_AST2400
	select HAVE_ACPI_TABLES
	select IPMI_KCS
	select IPMI_KCS_ROMSTAGE
	select VPD
	select OCP_VPD
	select MEMORY_MAPPED_TPM

config CARDBUS_PLUGIN_SUPPORT
	bool
	default n

config MAINBOARD_DIR
	string
	default "intel/avenuecity_crb"

config MAINBOARD_PART_NUMBER
	string
	default "Avenue City CRB"

config FMDFILE
	string
	default "src/mainboard/\$(CONFIG_MAINBOARD_DIR)/board.fmd"

config DIMM_MAX
	int
	default 1

endif
```

## src/mainboard/intel/avenuecity_crb/Kconfig.name
```kconfig
## SPDX-License-Identifier: GPL-2.0-only

config BOARD_INTEL_AVENUECITY_CRB
	bool "Avenue City CRB"
```
