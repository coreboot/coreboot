## src/mainboard/intel/dg43gt/Kconfig
```kconfig
# SPDX-License-Identifier: GPL-2.0-only

if BOARD_INTEL_DG43GT

config BOARD_SPECIFIC_OPTIONS
	def_bool y
	select CPU_INTEL_SOCKET_LGA775
	select NORTHBRIDGE_INTEL_X4X
	select SOUTHBRIDGE_INTEL_I82801JX
	select SUPERIO_WINBOND_W83627DHG
	select HAVE_ACPI_TABLES
	select BOARD_ROMSIZE_KB_4096
	select PCIEXP_ASPM
	select PCIEXP_CLK_PM
	select HAVE_OPTION_TABLE
	select HAVE_CMOS_DEFAULT
	select HAVE_ACPI_RESUME
	select GFX_GMA_ANALOG_I2C_HDMI_C
	select DRIVERS_I2C_CK505
	select INTEL_GMA_HAVE_VBT
	select MAINBOARD_HAS_LIBGFXINIT
	select MAINBOARD_USES_IFD_GBE_REGION

config VGA_BIOS_ID
	string
	default "8086,2e22"

config MAINBOARD_DIR
	default "intel/dg43gt"

config MAINBOARD_PART_NUMBER
	default "DG43GT"

endif # BOARD_INTEL_DG43GT
```
