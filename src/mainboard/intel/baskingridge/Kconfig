## src/mainboard/intel/baskingridge/Kconfig
```kconfig
## SPDX-License-Identifier: GPL-2.0-only

if BOARD_INTEL_BASKING_RIDGE

config BOARD_SPECIFIC_OPTIONS
	def_bool y
	select AZALIA_USE_LEGACY_VERB_TABLE
	select NORTHBRIDGE_INTEL_HASWELL
	select SOUTHBRIDGE_INTEL_LYNXPOINT
	select BOARD_ROMSIZE_KB_8192
	select HAVE_ACPI_TABLES
	select HAVE_OPTION_TABLE
	select HAVE_ACPI_RESUME
	select MAINBOARD_HAS_CHROMEOS
	select MEMORY_MAPPED_TPM
	select INTEL_INT15

config VBOOT
	select VBOOT_VBNV_CMOS

config MAINBOARD_DIR
	default "intel/baskingridge"

config MAINBOARD_PART_NUMBER
	default "BASKING RIDGE"

config MAX_CPUS
	int
	default 16

endif # BOARD_INTEL_BASKING_RIDGE
```

## src/mainboard/intel/baskingridge/Kconfig.name
```kconfig
## SPDX-License-Identifier: GPL-2.0-only

config BOARD_INTEL_BASKING_RIDGE
	bool "Basking Ridge CRB"
```

## src/mainboard/intel/bayleybay_fsp/Kconfig
```kconfig
##
## This file is part of the coreboot project.
##
## Copyright (C) 2013-2014 Sage Electronic Engineering, LLC.
##
## This program is free software; you can redistribute it and/or modify
## it under the terms of the GNU General Public License as published by
## the Free Software Foundation; version 2 of the License.
##
## This program is distributed in the hope that it will be useful,
## but WITHOUT ANY WARRANTY; without even the implied warranty of
## MERCHANTABILITY or FITNESS FOR A PARTICULAR PURPOSE.  See the
## GNU General Public License for more details.
##

if BOARD_INTEL_BAYLEYBAY_FSP || BOARD_INTEL_BAKERSPORT_FSP

config BOARD_SPECIFIC_OPTIONS # dummy
	def_bool y
	select SOC_INTEL_FSP_BAYTRAIL
	select BOARD_ROMSIZE_KB_2048
	select HAVE_ACPI_TABLES
	select HAVE_OPTION_TABLE
	select ENABLE_BUILTIN_COM1 if FSP_PACKAGE_DEFAULT
	select HAVE_FSP_BIN if FSP_PACKAGE_DEFAULT
	select TSC_MONOTONIC_TIMER

config MAINBOARD_DIR
	string
	default "intel/bayleybay_fsp"

config MAINBOARD_PART_NUMBER
	string
	default "Bakersport CRB (FSP)" if BOARD_INTEL_BAKERSPORT_FSP
	default "Bayley Bay CRB (FSP)"

config MAX_CPUS
	int
	default 16

config FSP_FILE
	string
	default "../intel/fsp/baytrail/BAYTRAIL_FSP_ECC.fd" if BOARD_INTEL_BAKERSPORT_FSP
	default "../intel/fsp/baytrail/BAYTRAIL_FSP.fd"

config CBFS_SIZE
	hex
	default 0x00200000

config ENABLE_FSP_FAST_BOOT
	bool
	depends on HAVE_FSP_BIN
	default y

config VIRTUAL_ROM_SIZE
	hex
	depends on ENABLE_FSP_FAST_BOOT
	default 0x800000

config FSP_PACKAGE_DEFAULT
	bool "Configure defaults for the Intel FSP package"
	default n

config VGA_BIOS
	bool
	default y if FSP_PACKAGE_DEFAULT

endif # BOARD_INTEL_BAYLEYBAY_FSP || BOARD_INTEL_BAKERSPORT_FSP
```

## src/mainboard/intel/bayleybay_fsp/Kconfig.name
```kconfig
config BOARD_INTEL_BAKERSPORT_FSP
	bool "Bakersport FSP-based CRB"

config BOARD_INTEL_BAYLEYBAY_FSP
	bool "Bayley Bay FSP-based CRB"
```

## src/mainboard/intel/beechnutcity_crb/Kconfig.name
```kconfig
## SPDX-License-Identifier: GPL-2.0-only

config BOARD_INTEL_BEECHNUTCITY_CRB
	bool "Beechnut City CRB"
```

## src/mainboard/intel/camelbackmountain_fsp/Kconfig.name
```kconfig
config BOARD_INTEL_CAMELBACKMOUNTAIN_FSP
	bool "Camelback Mountain FSP-based CRB"
```

## src/mainboard/intel/cannonlake_rvp/Kconfig
```kconfig
if BOARD_INTEL_CANNONLAKE_RVPU || BOARD_INTEL_CANNONLAKE_RVPY

config BOARD_SPECIFIC_OPTIONS
	def_bool y
	select BOARD_ROMSIZE_KB_16384
	select HAVE_SPD_IN_CBFS
	select HAVE_ACPI_RESUME
	select HAVE_ACPI_TABLES
	select MAINBOARD_HAS_CHROMEOS
	select HAVE_SPD_IN_CBFS
	select DRIVERS_I2C_HID
	select DRIVERS_I2C_GENERIC
	select DRIVERS_I2C_DA7219
	select DRIVERS_I2C_MAX98373
	select DRIVERS_GENERIC_MAX98357A
	select SOC_INTEL_CANNONLAKE
	select MAINBOARD_USES_IFD_EC_REGION
	select INTEL_LPSS_UART_FOR_CONSOLE
	select MAINBOARD_HAS_LPC_TPM

config MAINBOARD_DIR
	string
	default "intel/cannonlake_rvp"

config VARIANT_DIR
	string
	default "cnl_u" if BOARD_INTEL_CANNONLAKE_RVPU
	default "cnl_y" if BOARD_INTEL_CANNONLAKE_RVPY

config MAINBOARD_PART_NUMBER
	string
	default "Cannonlake RVP"

config MAINBOARD_FAMILY
	string
	default "Intel_cannonlake_rvp"

config MAX_CPUS
	int
	default 8

config DEVICETREE
	string
	default "variants/\$(CONFIG_VARIANT_DIR)/devicetree.cb"

config INCLUDE_SND_MAX98357_DA7219_NHLT
	bool "Include blobs for audio with MAX98357_DA7219"
	select NHLT_DMIC_4CH_16B
	select NHLT_DMIC_2CH_16B
	select NHLT_DA7219
	select NHLT_MAX98357

config INCLUDE_SND_MAX98373_NHLT
	bool "Include blobs for audio with MAX98373"
	select NHLT_DMIC_4CH_16B
	select NHLT_DMIC_2CH_16B
	select NHLT_MAX98373

config DIMM_SPD_SIZE
	int
	default 512

config VBOOT
	select VBOOT_LID_SWITCH
	select VBOOT_MOCK_SECDATA

config UART_FOR_CONSOLE
	int
	default 2
endif
```

## src/mainboard/intel/cannonlake_rvp/Kconfig.name
```kconfig
config BOARD_INTEL_CANNONLAKE_RVPU
	bool "Cannonlake U DDR4 RVP"
config BOARD_INTEL_CANNONLAKE_RVPY
	bool "Cannonlake Y LPDDR4 RVP"
```

## src/mainboard/intel/cedarisland_crb/Kconfig
```kconfig
## SPDX-License-Identifier: GPL-2.0-only

if BOARD_INTEL_CEDARISLAND_CRB

config BOARD_SPECIFIC_OPTIONS
	def_bool y
	select BOARD_ROMSIZE_KB_65536
	select CPU_INTEL_SOCKET_LGA4189
	select SOC_INTEL_COOPERLAKE_SP
	select SUPERIO_ASPEED_AST2400
	select HAVE_ACPI_TABLES

config MAINBOARD_DIR
	default "intel/cedarisland_crb"

config MAINBOARD_PART_NUMBER
	default "Cedar Island CRB"

config FMDFILE
	default "src/mainboard/\$(CONFIG_MAINBOARD_DIR)/board.fmd"

endif
```

## src/mainboard/intel/cedarisland_crb/Kconfig.name
```kconfig
## SPDX-License-Identifier: GPL-2.0-only

config BOARD_INTEL_CEDARISLAND_CRB
	bool "Cedar Island CRB"
```

## src/mainboard/intel/coffeelake_rvp/Kconfig
```kconfig
config BOARD_INTEL_COFFEELAKE_RVP_COMMON
	def_bool n
	select DRIVERS_GENERIC_MAX98357A
	select DRIVERS_I2C_DA7219
	select DRIVERS_I2C_GENERIC
	select DRIVERS_I2C_HID
	select DRIVERS_I2C_MAX98373
	select HAVE_ACPI_RESUME
	select HAVE_ACPI_TABLES
	select INTEL_LPSS_UART_FOR_CONSOLE
	select MAINBOARD_HAS_CHROMEOS
	select MEMORY_MAPPED_TPM
	select MAINBOARD_USES_IFD_EC_REGION

config BOARD_INTEL_COFFEELAKE_RVP8
	select BOARD_INTEL_COFFEELAKE_RVP_COMMON
	select BOARD_ROMSIZE_KB_16384
	select MAINBOARD_USES_IFD_GBE_REGION
	select SOC_INTEL_CANNONLAKE_PCH_H
	select SOC_INTEL_COFFEELAKE
	select SOC_INTEL_COMMON_BLOCK_HDA_VERB

config BOARD_INTEL_COFFEELAKE_RVP11
	select BOARD_INTEL_COFFEELAKE_RVP_COMMON
	select BOARD_ROMSIZE_KB_16384
	select MAINBOARD_USES_IFD_GBE_REGION
	select SOC_INTEL_CANNONLAKE_PCH_H
	select SOC_INTEL_COFFEELAKE
	select SOC_INTEL_COMMON_BLOCK_HDA_VERB

config BOARD_INTEL_COFFEELAKE_RVPU
	select BOARD_INTEL_COFFEELAKE_RVP_COMMON
	select BOARD_ROMSIZE_KB_32768
	select SOC_INTEL_COFFEELAKE

config BOARD_INTEL_WHISKEYLAKE_RVP
	select BOARD_INTEL_COFFEELAKE_RVP_COMMON
	select BOARD_ROMSIZE_KB_16384
	select SOC_INTEL_COMMON_BLOCK_HDA_VERB
	select SOC_INTEL_WHISKEYLAKE

config BOARD_INTEL_COMETLAKE_RVPU
	select BOARD_INTEL_COFFEELAKE_RVP_COMMON
	select BOARD_ROMSIZE_KB_16384
	select SOC_INTEL_COMETLAKE_1
	select SOC_INTEL_COMMON_BLOCK_HDA_VERB

if BOARD_INTEL_COFFEELAKE_RVP_COMMON

config MAINBOARD_DIR
	default "intel/coffeelake_rvp"

config VARIANT_DIR
	default "cfl_u" if BOARD_INTEL_COFFEELAKE_RVPU
	default "cfl_h" if BOARD_INTEL_COFFEELAKE_RVP11
	default "whl_u" if BOARD_INTEL_WHISKEYLAKE_RVP
	default "cfl_s" if BOARD_INTEL_COFFEELAKE_RVP8
	default "cml_u" if BOARD_INTEL_COMETLAKE_RVPU

config MAINBOARD_PART_NUMBER
	default "whlrvp" if BOARD_INTEL_WHISKEYLAKE_RVP
	default "cmlrvp" if BOARD_INTEL_COMETLAKE_RVPU
	default "cflrvp"

config MAINBOARD_FAMILY
	string
	default "Intel_whlrvp" if BOARD_INTEL_WHISKEYLAKE_RVP
	default "Intel_cmlrvp" if BOARD_INTEL_COMETLAKE_RVPU
	default "Intel_cflrvp"

config CHROMEOS
	select GBB_FLAG_FORCE_MANUAL_RECOVERY

config MAX_CPUS
	int
	default 12 if BOARD_INTEL_COFFEELAKE_RVP11
	default 16 if BOARD_INTEL_COFFEELAKE_RVP8
	default 8

config UART_FOR_CONSOLE
	int
	default 2

config DEVICETREE
	default "variants/baseboard/devicetree.cb"

config OVERRIDE_DEVICETREE
	default "variants/\$(CONFIG_VARIANT_DIR)/overridetree.cb"

config FMDFILE
	depends on VBOOT
	default "src/mainboard/\$(CONFIG_MAINBOARD_DIR)/chromeos.fmd" if BOARD_ROMSIZE_KB_16384
	default "src/mainboard/\$(CONFIG_MAINBOARD_DIR)/chromeos_32MB.fmd" if BOARD_ROMSIZE_KB_32768

config INCLUDE_SND_MAX98357_DA7219_NHLT
	bool "Include blobs for audio with MAX98357_DA7219"
	select NHLT_DMIC_4CH_16B
	select NHLT_DMIC_2CH_16B
	select NHLT_DA7219
	select NHLT_MAX98357

config INCLUDE_SND_MAX98373_NHLT
	bool "Include blobs for audio with MAX98373"
	select NHLT_DMIC_4CH_16B
	select NHLT_DMIC_2CH_16B
	select NHLT_MAX98373

config DIMM_SPD_SIZE
	default 512

config VBOOT
	select VBOOT_LID_SWITCH
	select VBOOT_MOCK_SECDATA
endif
```

## src/mainboard/intel/coffeelake_rvp/Kconfig.name
```kconfig
comment "Coffeelake RVP"

config BOARD_INTEL_COFFEELAKE_RVPU
	bool "-> Coffeelake U SO-DIMM DDR4 RVP"

config BOARD_INTEL_COFFEELAKE_RVP11
	bool "-> Coffeelake H SO-DIMM DDR4 RVP11"

config BOARD_INTEL_WHISKEYLAKE_RVP
	bool "-> Whiskeylake U DDR4 RVP"

config BOARD_INTEL_COFFEELAKE_RVP8
	bool "-> Coffeelake S U-DIMM DDR4 RVP8"

config BOARD_INTEL_COMETLAKE_RVPU
	bool "-> Cometlake U DDR4 RVP"
```

## src/mainboard/intel/cougar_canyon2/Kconfig
```kconfig
if BOARD_INTEL_COUGAR_CANYON2

config BOARD_SPECIFIC_OPTIONS # dummy
	def_bool y
	select CPU_INTEL_SOCKET_RPGA989
	select NORTHBRIDGE_INTEL_FSP_IVYBRIDGE
	select SOUTHBRIDGE_INTEL_FSP_BD82X6X
	select BOARD_ROMSIZE_KB_8192
	select HAVE_ACPI_TABLES
	select HAVE_OPTION_TABLE
	select MMCONF_SUPPORT
	select SUPERIO_SMSC_SIO1007
	select ENABLE_VMX
	select INTEL_INT15
	select VGA

config MAINBOARD_DIR
	string
	default intel/cougar_canyon2

config MAINBOARD_PART_NUMBER
	string
	default "Cougar Canyon 2"

config MMCONF_BASE_ADDRESS
	hex
	default 0xf8000000	# set to match FSP

config MAX_CPUS
	int
	default 16

config SMBIOS_SYSTEM_ENCLOSURE_TYPE
	hex
	default 0x09	# This is a mobile platform

config UDELAY_LAPIC_FIXED_FSB
	int
	default 100

config VIRTUAL_ROM_SIZE
	hex
	default 0x1000000

if HAVE_FSP_BIN

config VGA_BIOS
	bool
	default y

config VGA_BIOS_FILE
	string
	default "../intel/mainboard/intel/cougar_canyon2/vbios/snm_2170.dat"

config VGA_BIOS_ID
	string
	default "8086,0166"


endif # HAVE_FSP_BIN

endif # BOARD_INTEL_COUGAR_CANYON2
```

## src/mainboard/intel/d510mo/Kconfig
```kconfig
#
# This file is part of the coreboot project.
#
# Copyright (C) 2015  Damien Zammit <damien@zamaudio.com>
#
# This program is free software; you can redistribute it and/or modify
# it under the terms of the GNU General Public License as published by
# the Free Software Foundation; version 2 of the License.
#
# This program is distributed in the hope that it will be useful,
# but WITHOUT ANY WARRANTY; without even the implied warranty of
# MERCHANTABILITY or FITNESS FOR A PARTICULAR PURPOSE.  See the
# GNU General Public License for more details.
#

if BOARD_INTEL_D510MO

config BOARD_SPECIFIC_OPTIONS
	def_bool y
	select CPU_INTEL_SOCKET_FCBGA559
	select NORTHBRIDGE_INTEL_PINEVIEW
	select SOUTHBRIDGE_INTEL_I82801GX
	select SUPERIO_WINBOND_W83627THG
	select HAVE_ACPI_TABLES
	select HAVE_ACPI_RESUME
	select BOARD_ROMSIZE_KB_1024
	select MAINBOARD_HAS_NATIVE_VGA_INIT
	select INTEL_INT15
	select HAVE_OPTION_TABLE
	select HAVE_CMOS_DEFAULT
	select DRIVERS_I2C_CK505

config MAX_CPUS
	int
	default 4

config MAINBOARD_DIR
	string
	default intel/d510mo

config MAINBOARD_PART_NUMBER
	string
	default "D510MO"

endif # BOARD_INTEL_D510MO
```

## src/mainboard/intel/d510mo/Kconfig.name
```kconfig
## SPDX-License-Identifier: GPL-2.0-only

config BOARD_INTEL_D510MO
	bool "D510MO / D410PT"
```

## src/mainboard/intel/d810e2cb/Kconfig
```kconfig
##
## This file is part of the coreboot project.
##
## Copyright (C) 2010 Joseph Smith <joe@settoplinux.org>
##
## This program is free software; you can redistribute it and/or modify
## it under the terms of the GNU General Public License as published by
## the Free Software Foundation; version 2 of the License.
##
## This program is distributed in the hope that it will be useful,
## but WITHOUT ANY WARRANTY; without even the implied warranty of
## MERCHANTABILITY or FITNESS FOR A PARTICULAR PURPOSE.  See the
## GNU General Public License for more details.
##
## You should have received a copy of the GNU General Public License
## along with this program; if not, write to the Free Software
## Foundation, Inc., 51 Franklin St, Fifth Floor, Boston, MA 02110-1301 USA
##
if BOARD_INTEL_D810E2CB

config BOARD_SPECIFIC_OPTIONS # dummy
	def_bool y
	select ARCH_X86
	select CPU_INTEL_SOCKET_FC_PGA370
	select NORTHBRIDGE_INTEL_I82810
	select SOUTHBRIDGE_INTEL_I82801BX
	select SUPERIO_SMSC_SMSCSUPERIO
	select HAVE_PIRQ_TABLE
	select USE_WATCHDOG_ON_BOOT
	select UDELAY_TSC
	select BOARD_ROMSIZE_KB_512
	select GFXUMA

config MAINBOARD_DIR
	string
	default intel/d810e2cb

config MAINBOARD_PART_NUMBER
	string
	default "D810E2CB"

config IRQ_SLOT_COUNT
	int
	default 7

endif # BOARD_INTEL_D810E2CB
```

## src/mainboard/intel/d945gclf/Kconfig
```kconfig
## SPDX-License-Identifier: GPL-2.0-only

if BOARD_INTEL_D945GCLF

config BOARD_SPECIFIC_OPTIONS
	def_bool y
	select AZALIA_USE_LEGACY_VERB_TABLE
	select CPU_INTEL_SOCKET_441
	select NORTHBRIDGE_INTEL_I945
	select NORTHBRIDGE_INTEL_SUBTYPE_I945GC
	select SOUTHBRIDGE_INTEL_I82801GX
	select SUPERIO_SMSC_LPC47M15X
	select HAVE_OPTION_TABLE
	select HAVE_CMOS_DEFAULT
	select HAVE_PIRQ_TABLE
	select HAVE_MP_TABLE
	select HAVE_ACPI_TABLES
	select HAVE_ACPI_RESUME
	select BOARD_ROMSIZE_KB_512
	select MAINBOARD_HAS_NATIVE_VGA_INIT
	select INTEL_GMA_HAVE_VBT

config MAINBOARD_DIR
	default "intel/d945gclf"

config MAINBOARD_PART_NUMBER
	default "D945GCLF"

config IRQ_SLOT_COUNT
	int
	default 18

endif # BOARD_INTEL_D945GCLF
```

## src/mainboard/intel/dcp847ske/Kconfig
```kconfig
if BOARD_INTEL_DCP847SKE

config BOARD_SPECIFIC_OPTIONS
	def_bool y
	select BOARD_ROMSIZE_KB_8192
	select SUPERIO_NUVOTON_NCT6776
	select HAVE_ACPI_RESUME
	select HAVE_ACPI_TABLES
	select NORTHBRIDGE_INTEL_SANDYBRIDGE
	select SOUTHBRIDGE_INTEL_C216
	select SERIRQ_CONTINUOUS_MODE
	select INTEL_INT15
	select MAINBOARD_HAS_LIBGFXINIT
	select MAINBOARD_USES_IFD_GBE_REGION

menu "Debugging"

config DISABLE_UART_ON_TESTPADS
	bool "Disable UART on testpads"
	default y
	select NO_UART_ON_SUPERIO
	help
	  Serial output requires soldering to the testpad next to
	  NCT5577D pin 18 (txd) and gnd.

endmenu

config MAINBOARD_DIR
	default "intel/dcp847ske"

config MAINBOARD_PART_NUMBER
	default "Intel NUC DCP847SKE"

config VGA_BIOS_ID
	string
	default "8086,0106"

config MAX_CPUS
	int
	default 2

config USBDEBUG_HCD_INDEX
	int
	default 2

config CBFS_SIZE
	default 0x00640000

config MAINBOARD_SMBIOS_MANUFACTURER
	string
	default "Intel Corporation"

config MAINBOARD_SMBIOS_PRODUCT_NAME
	string
	default "DCP847SKE"

endif # BOARD_INTEL_DCP847SKE
```

## src/mainboard/intel/dg41wv/Kconfig
```kconfig
# SPDX-License-Identifier: GPL-2.0-only

if BOARD_INTEL_DG41WV

config BOARD_SPECIFIC_OPTIONS
	def_bool y
	select CPU_INTEL_SOCKET_LGA775
	select NORTHBRIDGE_INTEL_X4X
	select SOUTHBRIDGE_INTEL_I82801GX
	select SUPERIO_WINBOND_W83627DHG
	select HAVE_ACPI_TABLES
	select BOARD_ROMSIZE_KB_2048
	select HAVE_OPTION_TABLE
	select HAVE_CMOS_DEFAULT
	select HAVE_ACPI_RESUME
	select DRIVERS_I2C_CK505
	select INTEL_GMA_HAVE_VBT
	select MAINBOARD_HAS_LIBGFXINIT

config MAINBOARD_DIR
	default "intel/dg41wv"

config MAINBOARD_PART_NUMBER
	default "DG41WV"

endif # BOARD_INTEL_DG41WV
```

## src/mainboard/intel/dg41wv/Kconfig.name
```kconfig
## SPDX-License-Identifier: GPL-2.0-only

config BOARD_INTEL_DG41WV
	bool "DG41WV"
```
