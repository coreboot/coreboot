## src/mainboard/intel/kblrvp/Kconfig
```kconfig
config BOARD_INTEL_KBLRVP_COMMON
	def_bool n
	select BOARD_ROMSIZE_KB_16384
	select EC_ACPI
	select HAVE_ACPI_RESUME
	select HAVE_ACPI_TABLES
	select HAVE_OPTION_TABLE
	select HAVE_SPD_IN_CBFS
	select INTEL_LPSS_UART_FOR_CONSOLE
	select MAINBOARD_HAS_CHROMEOS
	select MAINBOARD_HAS_LPC_TPM
	select SOC_INTEL_KABYLAKE

config BOARD_INTEL_KBLRVP3
	select BOARD_INTEL_KBLRVP_COMMON
	select SOC_INTEL_COMMON_BLOCK_HDA_VERB

config BOARD_INTEL_KBLRVP7
	select BOARD_INTEL_KBLRVP_COMMON
	select SOC_INTEL_COMMON_BLOCK_HDA_VERB

config BOARD_INTEL_KBLRVP8
	select BOARD_INTEL_KBLRVP_COMMON
	select MAINBOARD_USES_IFD_GBE_REGION
	select SKYLAKE_SOC_PCH_H

config BOARD_INTEL_KBLRVP11
	select BOARD_INTEL_KBLRVP_COMMON
	select SOC_INTEL_COMMON_BLOCK_HDA_VERB
	select SKYLAKE_SOC_PCH_H

if BOARD_INTEL_KBLRVP_COMMON

config DISABLE_HECI1_AT_PRE_BOOT
	default y

config VBOOT
	select VBOOT_LID_SWITCH

config MAINBOARD_DIR
	default "intel/kblrvp"

config VARIANT_DIR
	default "rvp3" if BOARD_INTEL_KBLRVP3
	default "rvp7" if BOARD_INTEL_KBLRVP7
	default "rvp8" if BOARD_INTEL_KBLRVP8
	default "rvp11" if BOARD_INTEL_KBLRVP11

config MAINBOARD_PART_NUMBER
	default "Kblrvp"

config MAINBOARD_FAMILY
	string
	default "Intel_Kblrvp"

config TPM_PIRQ
	hex
	default 0x18  # GPP_E0_IRQ

config DEVICETREE
	default "variants/baseboard/devicetree.cb"

config OVERRIDE_DEVICETREE
	default "variants/\$(CONFIG_VARIANT_DIR)/overridetree.cb"

config IFD_BIN_PATH
	string
	depends on HAVE_IFD_BIN
	default "3rdparty/blobs/mainboard/\$(CONFIG_MAINBOARD_DIR)/descriptor.rvp3.bin" if BOARD_INTEL_KBLRVP3
	default "3rdparty/blobs/mainboard/\$(CONFIG_MAINBOARD_DIR)/descriptor.rvp7.bin" if BOARD_INTEL_KBLRVP7
	default "3rdparty/blobs/mainboard/\$(CONFIG_MAINBOARD_DIR)/descriptor.rvp8.bin" if BOARD_INTEL_KBLRVP8

config ME_BIN_PATH
	string
	depends on HAVE_ME_BIN
	default "3rdparty/blobs/mainboard/\$(CONFIG_MAINBOARD_DIR)/me.rvp3.bin" if BOARD_INTEL_KBLRVP3
	default "3rdparty/blobs/mainboard/\$(CONFIG_MAINBOARD_DIR)/me.rvp7.bin" if BOARD_INTEL_KBLRVP7
	default "3rdparty/blobs/mainboard/\$(CONFIG_MAINBOARD_DIR)/me.rvp8.bin" if BOARD_INTEL_KBLRVP8

config PRERAM_CBMEM_CONSOLE_SIZE
	hex
	default 0xd00

config DIMM_SPD_SIZE
	default 512 if BOARD_INTEL_KBLRVP8 || BOARD_INTEL_KBLRVP11 #DDR4

config UART_FOR_CONSOLE
	int
	default 2

config USE_PM_ACPI_TIMER
	default n if BOARD_INTEL_KBLRVP3
	default n if BOARD_INTEL_KBLRVP7

endif
```

## src/mainboard/intel/kblrvp/Kconfig.name
```kconfig
config BOARD_INTEL_KBLRVP3
	bool "Kabylake LPDDR3 RVP3"

config BOARD_INTEL_KBLRVP7
	bool "Kabylake DDR3L RVP7"

config BOARD_INTEL_KBLRVP8
	bool "Kabylake DDR4 RVP8"

config BOARD_INTEL_KBLRVP11
	bool "Kabylake DDR4 RVP11"
```
