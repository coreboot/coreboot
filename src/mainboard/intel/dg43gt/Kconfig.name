## src/mainboard/intel/dg43gt/Kconfig.name
```kconfig
## SPDX-License-Identifier: GPL-2.0-only

config BOARD_INTEL_DG43GT
	bool "DG43GT"
```

## src/mainboard/intel/dq67sw/Kconfig
```kconfig
## SPDX-License-Identifier: GPL-2.0-only

if BOARD_INTEL_DQ67SW

config BOARD_SPECIFIC_OPTIONS
	def_bool y
	select AZALIA_USE_LEGACY_VERB_TABLE
	select BOARD_ROMSIZE_KB_8192
	select GFX_GMA_ANALOG_I2C_HDMI_B
	select HAVE_ACPI_RESUME
	select HAVE_ACPI_TABLES
	select HAVE_CMOS_DEFAULT
	select HAVE_OPTION_TABLE
	select INTEL_GMA_HAVE_VBT
	select MAINBOARD_HAS_LIBGFXINIT
	select NORTHBRIDGE_INTEL_SANDYBRIDGE
	select SERIRQ_CONTINUOUS_MODE
	select SOUTHBRIDGE_INTEL_BD82X6X
	select SUPERIO_WINBOND_W83667HG_A
	select USE_NATIVE_RAMINIT

config MAINBOARD_DIR
	default "intel/dq67sw"

config MAINBOARD_PART_NUMBER
	default "DQ67SW"

endif
```

## src/mainboard/intel/dq67sw/Kconfig.name
```kconfig
## SPDX-License-Identifier: GPL-2.0-only

config BOARD_INTEL_DQ67SW
	bool "DQ67SW"
```

## src/mainboard/intel/eagleheights/Kconfig
```kconfig
if BOARD_INTEL_EAGLEHEIGHTS

config BOARD_SPECIFIC_OPTIONS # dummy
	def_bool y
	select ARCH_X86
	select CPU_INTEL_SOCKET_BGA956
	select NORTHBRIDGE_INTEL_I3100
	select SOUTHBRIDGE_INTEL_I3100
	select SUPERIO_INTEL_I3100
	select SUPERIO_SMSC_SMSCSUPERIO
	select HAVE_OPTION_TABLE
	select HAVE_HARD_RESET
	select HAVE_PIRQ_TABLE
	select HAVE_MP_TABLE
	select UDELAY_TSC
	select HAVE_ACPI_TABLES
	select BOARD_ROMSIZE_KB_1024

config MAINBOARD_DIR
	string
	default intel/eagleheights

config MMCONF_BASE_ADDRESS
	hex
	default 0xe0000000

config MAINBOARD_PART_NUMBER
	string
	default "EagleHeights"

config MMCONF_BASE_ADDRESS
	hex
	default 0xe0000000

config IRQ_SLOT_COUNT
	int
	default 9

config MAX_CPUS
	int
	default 4

endif # BOARD_INTEL_EAGLEHEIGHTS
```

## src/mainboard/intel/elkhartlake_crb/Kconfig
```kconfig
if BOARD_INTEL_ELKHARTLAKE_CRB

config BOARD_SPECIFIC_OPTIONS
	def_bool y
	select BOARD_ROMSIZE_KB_32768
	select DRIVERS_I2C_HID
	select DRIVERS_INTEL_DPTF
	select DRIVERS_I2C_GENERIC
	select DRIVERS_SPI_ACPI
	select DRIVERS_USB_ACPI
	select EC_ACPI
	select HAVE_SPD_IN_CBFS
	select HAVE_ACPI_RESUME
	select HAVE_ACPI_TABLES
	select INTEL_LPSS_UART_FOR_CONSOLE
	select SOC_INTEL_ELKHARTLAKE

config MAINBOARD_DIR
	default "intel/elkhartlake_crb"

config VARIANT_DIR
	default "ehlcrb" if BOARD_INTEL_ELKHARTLAKE_CRB

config MAINBOARD_PART_NUMBER
	default "ehlcrb"

config MAINBOARD_FAMILY
	string
	default "Intel_ehlcrb"

config DEVICETREE
	default "variants/\$(CONFIG_VARIANT_DIR)/devicetree.cb"

config DIMM_SPD_SIZE
	default 512

config VBOOT
	select GBB_FLAG_DISABLE_EC_SOFTWARE_SYNC
	select GBB_FLAG_DISABLE_FW_ROLLBACK_CHECK
	select GBB_FLAG_DISABLE_FWMP
	select GBB_FLAG_DISABLE_LID_SHUTDOWN
	select GBB_FLAG_DISABLE_PD_SOFTWARE_SYNC
	select GBB_FLAG_ENABLE_ALTERNATE_OS
	select GBB_FLAG_FORCE_DEV_SWITCH_ON
	select VBOOT_ALWAYS_ALLOW_UDC
	select VBOOT_ALWAYS_ENABLE_DISPLAY
	select VBOOT_MOCK_SECDATA if !MAINBOARD_HAS_TPM2
	select VBOOT_NO_BOARD_SUPPORT
	select VBOOT_VBNV_FLASH

config UART_FOR_CONSOLE
	int
	default 2

endif
```

## src/mainboard/intel/elkhartlake_crb/Kconfig.name
```kconfig
## SPDX-License-Identifier: GPL-2.0-only

config BOARD_INTEL_ELKHARTLAKE_CRB
	bool "Elkhartlake LPDDR4x CRB"
```

## src/mainboard/intel/emeraldlake2/Kconfig
```kconfig
## SPDX-License-Identifier: GPL-2.0-only

if BOARD_INTEL_EMERALDLAKE2

config BOARD_SPECIFIC_OPTIONS
	def_bool y
	select AZALIA_USE_LEGACY_VERB_TABLE
	select NORTHBRIDGE_INTEL_SANDYBRIDGE
	select SOUTHBRIDGE_INTEL_C216
	select SUPERIO_SMSC_SIO1007
	select BOARD_ROMSIZE_KB_8192
	select HAVE_ACPI_TABLES
	select HAVE_OPTION_TABLE
	select HAVE_ACPI_RESUME
	select INTEL_INT15
	select HAVE_IFD_BIN
	select HAVE_ME_BIN
	#select MAINBOARD_HAS_CHROMEOS

config MAINBOARD_DIR
	default "intel/emeraldlake2"

config MAINBOARD_PART_NUMBER
	default "EMERALD LAKE 2"

config MAX_CPUS
	int
	default 16

endif # BOARD_INTEL_EMERALDLAKE2
```

## src/mainboard/intel/emeraldlake2/Kconfig.name
```kconfig
## SPDX-License-Identifier: GPL-2.0-only

config BOARD_INTEL_EMERALDLAKE2
	bool "Emerald Lake 2 CRB"
```

## src/mainboard/intel/frost_creek/Kconfig
```kconfig
## SPDX-License-Identifier: GPL-2.0-only

if BOARD_INTEL_FROST_CREEK

config BOARD_SPECIFIC_OPTIONS
	def_bool y
	select SOC_INTEL_SNOWRIDGE
	select BOARD_ROMSIZE_KB_32768
	select HAVE_ACPI_TABLES
	select NO_UART_ON_SUPERIO

config MAINBOARD_DIR
	default "intel/frost_creek"

config MAINBOARD_PART_NUMBER
	default "Frost Creek"

config FMDFILE
	default "src/mainboard/\$(CONFIG_MAINBOARD_DIR)/board.fmd"

config CBFS_SIZE
	default 0xc00000

config DIMM_MAX
	default 4

config DIMM_SPD_SIZE
	default 512

endif # BOARD_INTEL_FROST_CREEK
```

## src/mainboard/intel/galileo/Kconfig
```kconfig
## SPDX-License-Identifier: GPL-2.0-only

if BOARD_INTEL_GALILEO

config BOARD_SPECIFIC_OPTIONS
	def_bool y
	select BOARD_ROMSIZE_KB_8192
	select ENABLE_BUILTIN_HSUART1
	select HAVE_ACPI_TABLES
	select SOC_INTEL_QUARK
	select I2C_TPM
	select TPM_ATMEL
	select MAINBOARD_HAS_TPM2
	select UDK_2017_BINDING


config MAINBOARD_DIR
	default "intel/galileo"

config MAINBOARD_PART_NUMBER
	default "Galileo"

config GALILEO_GEN2
	bool "Board generation: GEN1 (n) or GEN2 (y)"
	default y
	help
	  The coreboot binary will configure only one generation of the Galileo
	  board since coreboot can not determine the board generation at
	  runtime.  Select which generation of the Galileo that coreboot
	  should initialize.

choice
	prompt "FSP binary type"
	default FSP_BUILD_TYPE_DEBUG

config FSP_BUILD_TYPE_DEBUG
	bool "Debug"
	help
	  Use the debug version of FSP
config FSP_BUILD_TYPE_RELEASE
	bool "Release"
	help
	  Use the release version of FSP

endchoice

config FSP_BUILD_TYPE
	string
	default "DEBUG" if FSP_BUILD_TYPE_DEBUG
	default "RELEASE" if FSP_BUILD_TYPE_RELEASE

choice
	prompt "FSP type"
	default FSP_TYPE_2_0_PEI

config FSP_TYPE_2_0
	bool "MemInit subroutine"
	help
	  FSP 2.0 implemented as subroutines, no EDK-II cores
config FSP_TYPE_2_0_PEI
	bool "SEC + PEI Core + MemInit PEIM"
	help
	  FSP 2.0 implemented using SEC and PEI core

endchoice

config FSP_TYPE
	string
	default "Fsp2_0" if FSP_TYPE_2_0
	default "Fsp2_0Pei" if FSP_TYPE_2_0_PEI

config FSP_DEBUG_ALL
	bool "Enable all FSP debug support"
	default y
# Enable display and verification for coreboot build tests
	select DISPLAY_HOBS
	select DISPLAY_MTRRS
	select DISPLAY_UPD_DATA
	select DISPLAY_ESRAM_LAYOUT
	select DISPLAY_FSP_CALLS_AND_STATUS
	select DISPLAY_FSP_HEADER
	select VERIFY_HOBS
	help
	  Turn on debug support to display HOBS, MTRRS, SMM_MEMORY_MAP, UPD_DATA
	  also turn on FSP 2.0 debug support for ESRAM_LAYOUT,
	  FSP_CALLS_AND_STATUS, FSP_HEADER, POSTCAR_CONSOLE and VERIFY_HOBS

config VBOOT_WITH_CRYPTO_SHIELD
	bool "Verified boot using the Crypto Shield board"
	default n
	select COLLECT_TIMESTAMPS
	select VBOOT_SEPARATE_VERSTAGE
	select VBOOT
	select VBOOT_STARTS_IN_BOOTBLOCK
	select VBOOT_VBNV_CMOS
	help
	  Perform a verified boot using the TPM on the Crypto Shield board.

config DRIVER_TPM_I2C_ADDR
	hex "Address of the I2C TPM chip"
	depends on VBOOT_WITH_CRYPTO_SHIELD
	default 0x29
	help
	  I2C address of the TPM chip on the Crypto Shield board.

config FMDFILE
	default "src/mainboard/\$(CONFIG_MAINBOARD_DIR)/vboot.fmd" if VBOOT

config ENABLE_SD_TESTING
	bool "Enable SD card testing"
	default y
	select COMMONLIB_STORAGE_SD
	select SDHC_DEBUG
	select STORAGE_LOG
	select STORAGE_TEST

endif # BOARD_INTEL_QUARK
```

## src/mainboard/intel/galileo/Kconfig.name
```kconfig
## SPDX-License-Identifier: GPL-2.0-only

config BOARD_INTEL_GALILEO
	bool "Galileo"
```

## src/mainboard/intel/glkrvp/Kconfig
```kconfig
config BOARD_INTEL_BASEBOARD_GLKRVP
	def_bool n
	select SOC_INTEL_GEMINILAKE
	select BOARD_ROMSIZE_KB_16384
	select DRIVERS_I2C_GENERIC
	select DRIVERS_I2C_HID
	select HAVE_ACPI_RESUME
	select HAVE_ACPI_TABLES
	select INTEL_LPSS_UART_FOR_CONSOLE
	select MAINBOARD_HAS_CHROMEOS
	select MEMORY_MAPPED_TPM
	select DRIVERS_GENERIC_MAX98357A
	select DRIVERS_I2C_DA7219
	select SOC_ESPI

if BOARD_INTEL_BASEBOARD_GLKRVP

config BASEBOARD_GLKRVP_LAPTOP
	def_bool n
	select SYSTEM_TYPE_LAPTOP

choice
	prompt "ON BOARD EC"
	default GLK_CHROME_EC
	help
	  This option allows you to select the on board EC to use.
	  Select whether the board  has Intel EC or Chrome EC

config GLK_CHROME_EC
	bool "Chrome EC"
	select EC_GOOGLE_CHROMEEC
	select EC_GOOGLE_CHROMEEC_ESPI

config GLK_INTEL_EC
	bool "Intel EC"
	select EC_ACPI
endchoice

config CHROMEOS
	select GBB_FLAG_DISABLE_EC_SOFTWARE_SYNC
	select VBOOT_LID_SWITCH if GLK_CHROME_EC

config VBOOT
	select HAS_RECOVERY_MRC_CACHE
	select EC_GOOGLE_CHROMEEC_SWITCHES if GLK_CHROME_EC

config MAINBOARD_DIR
	default "intel/glkrvp"

config VARIANT_DIR
	default "glkrvp" if BOARD_INTEL_GLKRVP

config DEVICETREE
	default "variants/baseboard/devicetree.cb"

config MAINBOARD_PART_NUMBER
	default "glkrvp" if BOARD_INTEL_GLKRVP

config MAINBOARD_FAMILY
	string
	default "Intel_Glkrvp" if BOARD_INTEL_GLKRVP

config UART_FOR_CONSOLE
	int
	default 2

config INCLUDE_NHLT_BLOBS
	bool "Include blobs for audio."
	select NHLT_DMIC_4CH_16B
	select NHLT_DA7219
	select NHLT_MAX98357

config IS_GLK_RVP_1
	bool "Is this RVP1?"
	default n

config SOC_INTEL_COMMON_BLOCK_SGX_ENABLE
	bool
	default y

endif # BOARD_INTEL_GLKRVP
```

## src/mainboard/intel/glkrvp/Kconfig.name
```kconfig
## SPDX-License-Identifier: GPL-2.0-only

config BOARD_INTEL_GLKRVP
	bool "Glkrvp"
```

## src/mainboard/intel/graysreef/Kconfig
```kconfig
if BOARD_INTEL_GRAYSREEF

config BOARD_SPECIFIC_OPTIONS # dummy
	def_bool y
	select ARCH_X86
	select CPU_INTEL_SOCKET_RPGA989
	select NORTHBRIDGE_INTEL_HASWELL
	select SOUTHBRIDGE_INTEL_LYNXPOINT
	select BOARD_ROMSIZE_KB_8192
	select BOARD_HAS_FADT
	select HAVE_ACPI_TABLES
	select HAVE_OPTION_TABLE
	select HAVE_ACPI_RESUME
	select HAVE_MAINBOARD_RESOURCES
	select MMCONF_SUPPORT
	select HAVE_SMI_HANDLER
	select GFXUMA
	select CHROMEOS
	select EXTERNAL_MRC_BLOB

config MAINBOARD_DIR
	string
	default intel/graysreef

config MAINBOARD_PART_NUMBER
	string
	default "GRAYS REEF"

config MMCONF_BASE_ADDRESS
	hex
	default 0xf0000000

config IRQ_SLOT_COUNT
	int
	default 18

config MAX_CPUS
	int
	default 16

config VGA_BIOS_FILE
	string
	default "pci8086,0166.rom"

endif # BOARD_INTEL_GRAYSREEF
```

## src/mainboard/intel/harcuvar/Kconfig
```kconfig
## SPDX-License-Identifier: GPL-2.0-only

if BOARD_INTEL_HARCUVAR

config BOARD_SPECIFIC_OPTIONS
	def_bool y
	select SOC_INTEL_DENVERTON_NS
	select BOARD_ROMSIZE_KB_16384
	select HAVE_ACPI_TABLES

config MAINBOARD_DIR
	string
	default "intel/harcuvar"

config MAINBOARD_PART_NUMBER
	string
	default "Harcuvar CRB"

config ENABLE_FSP_MEMORY_DOWN
	bool "Enable Memory Down"
	default n
	select GENERIC_SPD_BIN
	help
	  Select this option to enable Memory Down function.

config SPD_LOC
	depends on ENABLE_FSP_MEMORY_DOWN
	hex "SPD binary location in cbfs"
	default 0xfffdf000
	help
	  Location of SPD binary for memory down function.

endif # BOARD_INTEL_HARCUVAR
```

## src/mainboard/intel/harcuvar/Kconfig.name
```kconfig
## SPDX-License-Identifier: GPL-2.0-only

config BOARD_INTEL_HARCUVAR
	bool "Harcuvar CRB"
```

## src/mainboard/intel/icelake_rvp/Kconfig
```kconfig
if BOARD_INTEL_ICELAKE_RVPU || BOARD_INTEL_ICELAKE_RVPY

config BOARD_SPECIFIC_OPTIONS
	def_bool y
	select BOARD_ROMSIZE_KB_16384
	select EC_ACPI
	select HAVE_SPD_IN_CBFS
	select HAVE_ACPI_RESUME
	select HAVE_ACPI_TABLES
	select MAINBOARD_HAS_CHROMEOS
	select HAVE_SPD_IN_CBFS
	select DRIVERS_I2C_HID
	select DRIVERS_I2C_GENERIC
	select DRIVERS_SPI_ACPI
	select DRIVERS_USB_ACPI
	select SOC_INTEL_COMMON_BLOCK_HDA_VERB
	select SOC_INTEL_ICELAKE
	select MAINBOARD_USES_IFD_EC_REGION
	select INTEL_LPSS_UART_FOR_CONSOLE

config MAINBOARD_DIR
	string
	default "intel/icelake_rvp"

config VARIANT_DIR
	string
	default "icl_u" if BOARD_INTEL_ICELAKE_RVPU
	default "icl_y" if BOARD_INTEL_ICELAKE_RVPY

config MAINBOARD_PART_NUMBER
	string
	default "Icelake RVP"

config MAINBOARD_FAMILY
	string
	default "Intel_icelake_rvp"

config MAX_CPUS
	int
	default 8

config DEVICETREE
	string
	default "variants/\$(CONFIG_VARIANT_DIR)/devicetree.cb"

config DIMM_SPD_SIZE
	int
	default 512

config VBOOT
	select VBOOT_LID_SWITCH
	select VBOOT_MOCK_SECDATA

config UART_FOR_CONSOLE
	int
	default 2
endif
```

## src/mainboard/intel/icelake_rvp/Kconfig.name
```kconfig
config BOARD_INTEL_ICELAKE_RVPU
	bool "Icelake U DDR4/LPDDR4 RVP"
config BOARD_INTEL_ICELAKE_RVPY
	bool "Icelake Y LPDDR4 RVP"
```

## src/mainboard/intel/jarrell/Kconfig
```kconfig
if BOARD_INTEL_JARRELL

config BOARD_SPECIFIC_OPTIONS # dummy
	def_bool y
	select ARCH_X86
	select CPU_INTEL_SOCKET_MPGA604
	select NORTHBRIDGE_INTEL_E7520
	select SOUTHBRIDGE_INTEL_PXHD
	select SOUTHBRIDGE_INTEL_I82801EX
	select SUPERIO_NSC_PC87427
	select ROMCC
	select HAVE_OPTION_TABLE
	select HAVE_PIRQ_TABLE
	select HAVE_MP_TABLE
	select UDELAY_TSC
	select USE_WATCHDOG_ON_BOOT
	select DRIVERS_ATI_RAGEXL
	select BOARD_ROMSIZE_KB_2048

config MAINBOARD_DIR
	string
	default intel/jarrell

config MAINBOARD_PART_NUMBER
	string
	default "Jarrell"

config MAX_CPUS
	int
	default 4

config IRQ_SLOT_COUNT
	int
	default 18

config DIMM_MAP_LOGICAL
	hex
	default 0x0124

endif # BOARD_INTEL_JARRELL
```

## src/mainboard/intel/jasperlake_rvp/Kconfig
```kconfig
config BOARD_INTEL_JASPERLAKE_RVP_COMMON
	def_bool n
	select BOARD_ROMSIZE_KB_16384
	select DRIVERS_I2C_DA7219
	select DRIVERS_I2C_GENERIC
	select DRIVERS_I2C_HID
	select DRIVERS_I2C_MAX98373
	select DRIVERS_INTEL_DPTF
	select DRIVERS_INTEL_MIPI_CAMERA
	select DRIVERS_SPI_ACPI
	select DRIVERS_USB_ACPI
	select EC_ACPI
	select HAVE_ACPI_RESUME
	select HAVE_ACPI_TABLES
	select HAVE_SPD_IN_CBFS
	select MAINBOARD_HAS_CHROMEOS
	select SOC_INTEL_COMMON_BLOCK_DTT
	select SOC_INTEL_COMMON_BLOCK_IPU
	select SOC_INTEL_CSE_LITE_SKU
	select SOC_INTEL_JASPERLAKE

config BOARD_INTEL_JASPERLAKE_RVP
	select BOARD_INTEL_JASPERLAKE_RVP_COMMON
	select DRIVERS_UART_8250IO
	select MAINBOARD_USES_IFD_EC_REGION

config BOARD_INTEL_JASPERLAKE_RVP_EXT_EC
	select BOARD_INTEL_JASPERLAKE_RVP_COMMON
	select EC_GOOGLE_CHROMEEC
	select EC_GOOGLE_CHROMEEC_LPC
	select EC_GOOGLE_CHROMEEC_SWITCHES if VBOOT
	select INTEL_LPSS_UART_FOR_CONSOLE

if BOARD_INTEL_JASPERLAKE_RVP_COMMON

config DISABLE_HECI1_AT_PRE_BOOT
	default y

config MAINBOARD_DIR
	default "intel/jasperlake_rvp"

config VARIANT_DIR
	default "jslrvp" if BOARD_INTEL_JASPERLAKE_RVP || BOARD_INTEL_JASPERLAKE_RVP_EXT_EC

config MAINBOARD_PART_NUMBER
	default "jslrvp"

config MAINBOARD_FAMILY
	string
	default "Intel_jslrvp"

config MAX_CPUS
	int
	default 8

config DEVICETREE
	default "variants/\$(CONFIG_VARIANT_DIR)/devicetree.cb"

config DIMM_SPD_SIZE
	default 512

config CHROMEOS
	select GBB_FLAG_FORCE_DEV_SWITCH_ON
	select GBB_FLAG_FORCE_DEV_BOOT_USB
	select GBB_FLAG_FORCE_DEV_BOOT_ALTFW
	select GBB_FLAG_FORCE_MANUAL_RECOVERY
	select GBB_FLAG_DISABLE_PD_SOFTWARE_SYNC
	select HAS_RECOVERY_MRC_CACHE

config VBOOT
	select VBOOT_LID_SWITCH
	select VBOOT_MOCK_SECDATA if !MAINBOARD_HAS_TPM2

config UART_FOR_CONSOLE
	int
	default 2 if INTEL_LPSS_UART_FOR_CONSOLE
	default 0

config TPM_TIS_ACPI_INTERRUPT
	int
	default 45  # GPE0_DW1_13 (GPP_H13)
endif
```

## src/mainboard/intel/jasperlake_rvp/Kconfig.name
```kconfig
config BOARD_INTEL_JASPERLAKE_RVP
	bool "Jasperlake DDR4/LPDDR4 RVP"

config BOARD_INTEL_JASPERLAKE_RVP_EXT_EC
	bool "Jasperlake DDR4/LPDDR4 RVP with Chrome EC"
```
