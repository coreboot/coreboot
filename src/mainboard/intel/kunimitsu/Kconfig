## src/mainboard/intel/kunimitsu/Kconfig
```kconfig
if BOARD_INTEL_KUNIMITSU

config BOARD_SPECIFIC_OPTIONS
	def_bool y
	select BOARD_ROMSIZE_KB_16384
	select DRIVERS_GENERIC_MAX98357A
	select DRIVERS_I2C_GENERIC
	select DRIVERS_I2C_NAU8825
	select EC_GOOGLE_CHROMEEC
	select EC_GOOGLE_CHROMEEC_ACPI_MEMMAP
	select EC_GOOGLE_CHROMEEC_BOARDID
	select EC_GOOGLE_CHROMEEC_LPC
	select EC_GOOGLE_CHROMEEC_MEC
	select EC_GOOGLE_CHROMEEC_PD
	select HAVE_ACPI_RESUME
	select HAVE_ACPI_TABLES
	select HAVE_OPTION_TABLE
	select INTEL_LPSS_UART_FOR_CONSOLE
	select MAINBOARD_HAS_CHROMEOS
	select MEMORY_MAPPED_TPM
	select SOC_INTEL_SKYLAKE
	select HAVE_SPD_IN_CBFS

config DISABLE_HECI1_AT_PRE_BOOT
	default y

config VBOOT
	select EC_GOOGLE_CHROMEEC_SWITCHES
	select VBOOT_LID_SWITCH

config MAINBOARD_DIR
	default "intel/kunimitsu"

config MAINBOARD_PART_NUMBER
	default "Kunimitsu"

config MAINBOARD_FAMILY
	string
	default "Intel_Kunimitsu"

config TPM_PIRQ
	hex
	default 0x18  # GPP_E0_IRQ

config INCLUDE_NHLT_BLOBS
	bool "Include blobs for audio."
	select NHLT_DMIC_2CH
	select NHLT_DMIC_4CH
	select NHLT_MAX98357
	select NHLT_NAU88L25
	select NHLT_SSM4567

config UART_FOR_CONSOLE
	int
	default 2

config USE_PM_ACPI_TIMER
	default n

endif
```

## src/mainboard/intel/leafhill/Kconfig
```kconfig
if BOARD_INTEL_LEAFHILL

config BOARD_SPECIFIC_OPTIONS
	def_bool y
	select SOC_INTEL_APOLLOLAKE
	select BOARD_ROMSIZE_KB_16384
	select HAVE_ACPI_TABLES
	select INTEL_LPSS_UART_FOR_CONSOLE

config MAINBOARD_DIR
	default "intel/leafhill"

config MAINBOARD_PART_NUMBER
	default "Leafhill"

config FMDFILE
	default "src/mainboard/\$(CONFIG_MAINBOARD_DIR)/leafhill.\$(CONFIG_COREBOOT_ROMSIZE_KB).fmd"

config UART_FOR_CONSOLE
	default 2

config NEED_IFWI
	# this must be set to y
	bool "Use IFWI stitching"
	default n

config IFWI_FMAP_NAME
	string "section in .fmd file to place ifwi blob"
	depends on NEED_IFWI
	default "IFWI"

config IFWI_FILE_NAME
	string "path to image coming from FIT tool"
	depends on NEED_IFWI
	default ""

config IFD_BIN_PATH
	string "path to descriptor.bin"
	depends on NEED_IFWI
	default ""

config HAVE_IFD_BIN
	bool
	depends on NEED_IFWI
	default y

endif # BOARD_INTEL_LEAFHILL
```

## src/mainboard/intel/minnow3/Kconfig
```kconfig
if BOARD_INTEL_MINNOW3

config BOARD_SPECIFIC_OPTIONS
	def_bool y
	select SOC_INTEL_APOLLOLAKE
	select BOARD_ROMSIZE_KB_16384
	select HAVE_ACPI_TABLES
	select INTEL_LPSS_UART_FOR_CONSOLE

config MAINBOARD_DIR
	default "intel/minnow3"

config MAINBOARD_PART_NUMBER
	default "Minnow3"

config FMDFILE
	default "src/mainboard/\$(CONFIG_MAINBOARD_DIR)/minnow3.fmd"

config UART_FOR_CONSOLE
	default 2

config NEED_IFWI
	# this must be set to y
	bool "Use IFWI stitching"
	default n

config IFWI_FMAP_NAME
	string "section in .fmd file to place ifwi blob"
	depends on NEED_IFWI
	default "IFWI"

config IFWI_FILE_NAME
	string "path to image coming from FIT tool"
	depends on NEED_IFWI
	default ""

config IFD_BIN_PATH
	string "path to descriptor.bin"
	depends on NEED_IFWI
	default ""

config HAVE_IFD_BIN
	bool
	depends on NEED_IFWI
	default y

endif # BOARD_INTEL_MINNOW3
```

## src/mainboard/intel/minnow3/Kconfig.name
```kconfig
## SPDX-License-Identifier: GPL-2.0-only

config BOARD_INTEL_MINNOW3
	bool "Minnow3"
```

## src/mainboard/intel/mtarvon/Kconfig
```kconfig
if BOARD_INTEL_MTARVON

config BOARD_SPECIFIC_OPTIONS # dummy
	def_bool y
	select ARCH_X86
	select CPU_INTEL_SOCKET_MPGA479M
	select NORTHBRIDGE_INTEL_I3100
	select SOUTHBRIDGE_INTEL_I3100
	select SUPERIO_INTEL_I3100
	select HAVE_PIRQ_TABLE
	select HAVE_MP_TABLE
	select UDELAY_TSC
	select BOARD_ROMSIZE_KB_2048

config MAINBOARD_DIR
	string
	default intel/mtarvon

config MAINBOARD_PART_NUMBER
	string
	default "3100 devkit (Mt. Arvon)"

config IRQ_SLOT_COUNT
	int
	default 1

config DCACHE_RAM_BASE
	hex
	default 0xffdf8000

config DCACHE_RAM_SIZE
	hex
	default 0x8000

config MAX_CPUS
	int
	default 4

endif # BOARD_INTEL_MTARVON
```

## src/mainboard/intel/mtlrvp/Kconfig
```kconfig
## SPDX-License-Identifier: GPL-2.0-only

config BOARD_INTEL_MTLRVP_COMMON
	def_bool n
	select BOARD_ROMSIZE_KB_32768
	select CPU_INTEL_SOCKET_OTHER
	select DRIVERS_GENERIC_MAX98357A
	select DRIVERS_I2C_GENERIC
	select DRIVERS_I2C_HID
	select DRIVERS_I2C_MAX98373
	select DRIVERS_INTEL_DPTF
	select DRIVERS_INTEL_DPTF_SUPPORTS_TPCH
	select DRIVERS_INTEL_MIPI_CAMERA
	select DRIVERS_INTEL_SOUNDWIRE
	select DRIVERS_SOUNDWIRE_ALC5682
	select DRIVERS_SOUNDWIRE_ALC_BASE_7XX
	select DRIVERS_SOUNDWIRE_MAX98373
	select DRIVERS_USB_ACPI
	select HAVE_ACPI_RESUME
	select HAVE_ACPI_TABLES
	select HAVE_SPD_IN_CBFS
	select MAINBOARD_HAS_CHROMEOS
	select SOC_INTEL_COMMON_BLOCK_VARIANT_POWER_LIMIT
	select SOC_INTEL_CSE_LITE_SKU
	select SOC_INTEL_METEORLAKE_U_H

config BOARD_INTEL_MTLRVP_P
	select BOARD_INTEL_MTLRVP_COMMON

config BOARD_INTEL_MTLRVP_P_EXT_EC
	select BOARD_EXT_EC_SPECIFIC_OPTIONS

config BOARD_INTEL_MTLRVP4ES_P_EXT_EC
	select BOARD_EXT_EC_SPECIFIC_OPTIONS
	select SOC_INTEL_METEORLAKE_PRE_PRODUCTION_SILICON

config BOARD_INTEL_MTLRVP_P_MCHP
	select BOARD_EXT_EC_SPECIFIC_OPTIONS
	select EC_GOOGLE_CHROMEEC_MEC
	select SOC_INTEL_METEORLAKE_PRE_PRODUCTION_SILICON

config BOARD_EXT_EC_SPECIFIC_OPTIONS
	def_bool n
	select BOARD_INTEL_MTLRVP_COMMON
	select DRIVERS_INTEL_PMC
	select EC_ACPI
	select EC_GOOGLE_CHROMEEC
	select EC_GOOGLE_CHROMEEC_ESPI
	select EC_GOOGLE_CHROMEEC_BOARDID
	select FW_CONFIG
	select FW_CONFIG_SOURCE_CHROMEEC_CBI

if BOARD_INTEL_MTLRVP_COMMON

config CHROMEOS
	select GBB_FLAG_FORCE_DEV_BOOT_ALTFW
	select GBB_FLAG_FORCE_DEV_SWITCH_ON
	select GBB_FLAG_FORCE_DEV_BOOT_USB
	select GBB_FLAG_FORCE_MANUAL_RECOVERY
	select GBB_FLAG_DISABLE_PD_SOFTWARE_SYNC
	select HAS_RECOVERY_MRC_CACHE

config BOARD_SPECIFIC_OPTIONS
	def_bool y
	select INTEL_LPSS_UART_FOR_CONSOLE
	select DRIVERS_INTEL_USB4_RETIMER
	select DRIVERS_WWAN_FM350GL

config MAINBOARD_DIR
	default "intel/mtlrvp"

config BASEBOARD_DIR
	string
	default "mtlrvp_p" if BOARD_INTEL_MTLRVP_P || BOARD_INTEL_MTLRVP_P_EXT_EC || BOARD_INTEL_MTLRVP_P_MCHP || BOARD_INTEL_MTLRVP4ES_P_EXT_EC

config GBB_HWID
	string
	depends on CHROMEOS
	default "MTLRVP"

config MAINBOARD_PART_NUMBER
	string
	default "Mtlrvp_P_Ext_Ec" if BOARD_INTEL_MTLRVP_P_EXT_EC || BOARD_INTEL_MTLRVP4ES_P_EXT_EC
	default "Mtlrvp_P_Mchp" if BOARD_INTEL_MTLRVP_P_MCHP
	default "Mtlrvp" if BOARD_INTEL_MTLRVP_P

config FMDFILE
	default "src/mainboard/\$(CONFIG_MAINBOARD_DIR)/chromeos-debug-fsp.fmd" if CHROMEOS && BUILDING_WITH_DEBUG_FSP
	default "src/mainboard/\$(CONFIG_MAINBOARD_DIR)/chromeos.fmd"

config MAINBOARD_FAMILY
	string
	default "Intel_mtlrvp"

config VARIANT_DIR
	string
	default "mtlrvp_p" if BOARD_INTEL_MTLRVP_P
	default "mtlrvp_p_ext_ec" if BOARD_INTEL_MTLRVP_P_EXT_EC || BOARD_INTEL_MTLRVP_P_MCHP || BOARD_INTEL_MTLRVP4ES_P_EXT_EC

config DEVICETREE
	string
	default "variants/baseboard/\$(CONFIG_BASEBOARD_DIR)/devicetree.cb"

config OVERRIDE_DEVICETREE
	string
	default "variants/\$(CONFIG_VARIANT_DIR)/overridetree.cb"

config DIMM_SPD_SIZE
	default 512

choice
	prompt "ON BOARD EC"
	default MTL_INTEL_EC if BOARD_INTEL_MTLRVP_P
	default MTL_CHROME_EC if BOARD_INTEL_MTLRVP_P_EXT_EC || BOARD_INTEL_MTLRVP4ES_P_EXT_EC
	default MTL_CHROME_EC_SHARED_SPI if BOARD_INTEL_MTLRVP_P_MCHP
	help
	  This option allows you to select the on board EC to use.
	  Select whether the board has Intel EC or/and Chrome EC

config MTL_CHROME_EC
	bool "Chrome EC with Internal SPI flash"

config MTL_CHROME_EC_SHARED_SPI
	bool "Chrome EC with External Shared SPI flash"
	select MAINBOARD_USES_IFD_EC_REGION

config MTL_INTEL_EC
	bool "Intel EC"
	select EC_ACPI
endchoice

config VBOOT
	select VBOOT_LID_SWITCH
	select EC_GOOGLE_CHROMEEC_SWITCHES if MTL_CHROME_EC || MTL_CHROME_EC_SHARED_SPI

config UART_FOR_CONSOLE
	int
	default 0

config USE_PM_ACPI_TIMER
	default n

endif # BOARD_INTEL_MTLRVP_COMMON
```

## src/mainboard/intel/mtlrvp/Kconfig.name
```kconfig
## SPDX-License-Identifier: GPL-2.0-only

config BOARD_INTEL_MTLRVP_P
	bool "Meteorlake-P RVP"

config BOARD_INTEL_MTLRVP_P_EXT_EC
	bool "Meteorlake-P RVP with Chrome EC for Prod Silicon"

config BOARD_INTEL_MTLRVP4ES_P_EXT_EC
	bool "Meteorlake-P RVP with Chrome EC for non-Prod Silicon"

config BOARD_INTEL_MTLRVP_P_MCHP
	bool "Meteorlake-P RVP with Microchip EC"
```

## src/mainboard/intel/nuc_golden_lake/Kconfig
```kconfig
## SPDX-License-Identifier: GPL-2.0-only

config BOARD_INTEL_NUC_GOLDEN_LAKE_COMMON
	def_bool n
	select BOARD_ROMSIZE_KB_8192
	select HAVE_ACPI_RESUME
	select HAVE_ACPI_TABLES
	select INTEL_INT15
	select MAINBOARD_HAS_LIBGFXINIT
	select MAINBOARD_USES_IFD_GBE_REGION
	select NORTHBRIDGE_INTEL_SANDYBRIDGE
	select SERIRQ_CONTINUOUS_MODE
	select SOUTHBRIDGE_INTEL_C216
	select SUPERIO_NUVOTON_NCT6776

config BOARD_INTEL_DCP847SKE
	select BOARD_INTEL_NUC_GOLDEN_LAKE_COMMON

config BOARD_INTEL_D33217GKE
	select BOARD_INTEL_NUC_GOLDEN_LAKE_COMMON
	select INTEL_GMA_HAVE_VBT

if BOARD_INTEL_NUC_GOLDEN_LAKE_COMMON

menu "Debugging"

config DISABLE_UART_ON_TESTPADS
	bool "Disable UART on testpads"
	default y
	select NO_UART_ON_SUPERIO
	help
	  Serial output requires soldering to the testpad next to
	  NCT5577D pin 18 (txd) and gnd.

endmenu

config MAINBOARD_DIR
	default "intel/nuc_golden_lake"

config MAINBOARD_PART_NUMBER
	default "NUC DCP847SKE" if BOARD_INTEL_DCP847SKE
	default "NUC D33217GKE" if BOARD_INTEL_D33217GKE

config OVERRIDE_DEVICETREE
	default "variants/\$(CONFIG_VARIANT_DIR)/overridetree.cb"

config VARIANT_DIR
	default "dcp847ske" if BOARD_INTEL_DCP847SKE
	default "d33217gke" if BOARD_INTEL_D33217GKE

config USBDEBUG_HCD_INDEX
	int
	default 2

config CBFS_SIZE
	default 0x00640000

config MAINBOARD_SMBIOS_MANUFACTURER
	string
	default "Intel Corporation"

config MAINBOARD_SMBIOS_PRODUCT_NAME
	string
	default "DCP847SKE" if BOARD_INTEL_DCP847SKE
	default "D33217GKE" if BOARD_INTEL_D33217GKE

endif # BOARD_INTEL_NUC_GOLDEN_LAKE_COMMON
```

## src/mainboard/intel/nuc_golden_lake/Kconfig.name
```kconfig
## SPDX-License-Identifier: GPL-2.0-only

config BOARD_INTEL_DCP847SKE
	bool "Intel NUC DCP847SKE"

config BOARD_INTEL_D33217GKE
	bool "Intel NUC D33217GKE"
```

## src/mainboard/intel/pantherlake_crb/Kconfig
```kconfig
## SPDX-License-Identifier: GPL-2.0-only

if BOARD_INTEL_PANTHERLAKE_CRB

config BOARD_SPECIFIC_OPTIONS
	def_bool y
	select BOARD_ROMSIZE_KB_32768
	select CPU_INTEL_SOCKET_OTHER
	select CRB_TPM
	select DRIVERS_INTEL_DPTF
	select DRIVERS_INTEL_MIPI_CAMERA
	select DRIVERS_INTEL_MIPI_SUPPORTS_PRE_PRODUCTION_SOC if SOC_INTEL_PANTHERLAKE_PRE_PRODUCTION_SILICON
	select DRIVERS_INTEL_PMC
	select DRIVERS_INTEL_USB4_RETIMER
	select DRIVERS_INTEL_SOUNDWIRE
	select DRIVERS_SOUNDWIRE_ALC_BASE_7XX
	select DRIVERS_GFX_GENERIC
	select DRIVERS_I2C_GENERIC
	select DRIVERS_USB_ACPI
	select DRIVERS_SPI_ACPI
	select DUMP_SMBIOS_TYPE17
	select GENERATE_SMBIOS_TABLES
	select HAVE_ACPI_RESUME
	select HAVE_ACPI_TABLES
	select HAVE_INTEL_PTT
	select INTEL_GMA_HAVE_VBT
	select DRIVERS_UART_8250IO
	select MAINBOARD_USES_IFD_GBE_REGION
	select MAINBOARD_USES_IFD_EC_REGION
	select PMC_IPC_ACPI_INTERFACE
	select SOC_INTEL_COMMON_BLOCK_HDA_VERB
	select AZALIA_USE_LEGACY_VERB_TABLE
	select SOC_INTEL_COMMON_BLOCK_MEMINIT
	select SOC_INTEL_IOE_DIE_SUPPORT
	select SOC_INTEL_ENABLE_USB4_PCIE_RESOURCES
	select SOC_INTEL_PANTHERLAKE_H
	select SOC_INTEL_TCSS_USE_PDC_PMC_USBC_MUX_CONFIGURATION
	select SUPERIO_ITE_IT8659E
	# To be removed when we receive production SKUs for testing
	select SOC_INTEL_PANTHERLAKE_PRE_PRODUCTION_SILICON
	select FSP_UGOP_EARLY_SIGN_OF_LIFE

config MAINBOARD_SMBIOS_PRODUCT_NAME
	default "PantherLake CRB"

config MAINBOARD_DIR
	default "intel/pantherlake_crb"

config MAINBOARD_PART_NUMBER
	default "PantherLake CRB"

config CBFS_SIZE
	default 0xA00000

config USE_PM_ACPI_TIMER
	default n

endif
```

## src/mainboard/intel/pantherlake_crb/Kconfig.name
```kconfig
## SPDX-License-Identifier: GPL-2.0-only

config BOARD_INTEL_PANTHERLAKE_CRB
	bool "Intel PantherLake CRB for Edge"
```
