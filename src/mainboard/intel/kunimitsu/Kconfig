## src/mainboard/intel/ptlrvp/Kconfig
```kconfig
## SPDX-License-Identifier: GPL-2.0-only

config BOARD_INTEL_PTLRVP_COMMON
	def_bool n
	select BOARD_ROMSIZE_KB_32768
	select CPU_INTEL_SOCKET_OTHER
	select DRIVERS_GFX_GENERIC
	select DRIVERS_I2C_GENERIC
	select DRIVERS_I2C_HID
	select DRIVERS_INTEL_DPTF
	select DRIVERS_INTEL_MIPI_CAMERA
	select DRIVERS_INTEL_PMC
	select DRIVERS_INTEL_SOUNDWIRE
	select DRIVERS_WWAN_FM350GL
	select DRIVERS_AUDIO_SOF
	select DRIVERS_SOUNDWIRE_ALC_BASE_7XX
	select DRIVERS_SPI_ACPI
	select DUMP_SMBIOS_TYPE17
	select EC_ACPI
	select FW_CONFIG
	select GENERATE_SMBIOS_TABLES
	select GOOGLE_SMBIOS_MAINBOARD_VERSION
	select HAVE_ACPI_RESUME
	select HAVE_ACPI_TABLES
	select HAVE_SPD_IN_CBFS
	select INTEL_LPSS_UART_FOR_CONSOLE
	select MAINBOARD_DISABLE_STAGE_CACHE
	select MB_COMPRESS_RAMSTAGE_LZ4
	select PMC_IPC_ACPI_INTERFACE
	select SOC_INTEL_COMMON_BLOCK_VARIANT_POWER_LIMIT
	select SOC_INTEL_CSE_LITE_SYNC_BY_PAYLOAD
	select SOC_INTEL_CSE_SEND_EOP_BY_PAYLOAD
	select SOC_INTEL_PANTHERLAKE_U_H
	select SOC_INTEL_TCSS_USE_PDC_PMC_USBC_MUX_CONFIGURATION

config BOARD_INTEL_BASEBOARD_PTLRVP
	def_bool n
	select BOARD_INTEL_PTLRVP_COMMON
	select CHROMEOS_WIFI_SAR if CHROMEOS
	select DRIVERS_INTEL_ISH
	select DRIVER_INTEL_ISH_HAS_MAIN_FW
	select DRIVERS_INTEL_USB4_RETIMER
	select MAINBOARD_HAS_CHROMEOS
	select MEMORY_SOLDERDOWN
	select SOC_INTEL_COMMON_BLOCK_HDA_VERB
	select SOC_INTEL_IOE_DIE_SUPPORT
	select SOC_INTEL_ENABLE_USB4_PCIE_RESOURCES
	select SYSTEM_TYPE_LAPTOP

config BOARD_INTEL_MODEL_PTLRVP
	def_bool n
	select BOARD_INTEL_BASEBOARD_PTLRVP
	select DRIVERS_GENERIC_BAYHUB_LV2
	select DRIVERS_GENERIC_MAX98357A
	select DRIVERS_INTEL_TOUCH

config BOARD_INTEL_PTLRVP
	select BOARD_INTEL_MODEL_PTLRVP
	select MAINBOARD_USES_IFD_EC_REGION
	select FW_CONFIG_SOURCE_CBFS

config BOARD_INTEL_PTLRVP_CHROMEEC
	select BOARD_INTEL_MODEL_PTLRVP
	select EC_GOOGLE_CHROMEEC
	select EC_GOOGLE_CHROMEEC_BOARDID
	select EC_GOOGLE_CHROMEEC_ESPI
	select EC_GOOGLE_CHROMEEC_MEC
	select EC_GOOGLE_CHROMEEC_SKUID
	select EC_GOOGLE_CHROMEEC_SMBIOS
	select FW_CONFIG_SOURCE_CHROMEEC_CBI
	select I2C_TPM
	select MAINBOARD_HAS_TPM2
	select MAINBOARD_USES_IFD_EC_REGION
	select TPM_GOOGLE_TI50

if BOARD_INTEL_PTLRVP_COMMON

config BASEBOARD_DIR
	string
	default "ptlrvp"

config CHROMEOS
	select EC_GOOGLE_CHROMEEC_SWITCHES if BOARD_INTEL_PTLRVP_CHROMEEC
	select GBB_FLAG_DISABLE_EC_SOFTWARE_SYNC if EC_GOOGLE_CHROMEEC_MEC
	select GBB_FLAG_FORCE_DEV_BOOT_USB
	select GBB_FLAG_FORCE_MANUAL_RECOVERY
	select HAS_RECOVERY_MRC_CACHE

config CHROMEOS_WIFI_SAR
	bool "Enable SAR options for ChromeOS build"
	depends on CHROMEOS
	select DSAR_ENABLE
	select GEO_SAR_ENABLE
	select SAR_ENABLE
	select USE_SAR

config DEVICETREE
	default "variants/baseboard/\$(CONFIG_BASEBOARD_DIR)/devicetree.cb"

config DIMM_SPD_SIZE
	default 512

config DRIVER_TPM_I2C_ADDR
	hex
	default 0x50 if BOARD_INTEL_PTLRVP_CHROMEEC

config DRIVER_TPM_I2C_BUS
	hex
	default 0x03 if BOARD_INTEL_PTLRVP_CHROMEEC

config HAVE_SLP_S0_GATE
	def_bool n

config MAINBOARD_DIR
	default "intel/ptlrvp"

config MAINBOARD_FAMILY
	string
	default "Intel_Ptlrvp"

config MAINBOARD_PART_NUMBER
	default "Ptlrvp" if BOARD_INTEL_PTLRVP
	default "Ptlrvp_chromeec" if BOARD_INTEL_PTLRVP_CHROMEEC

config MEMORY_SOLDERDOWN
	def_bool n
	select CHROMEOS_DRAM_PART_NUMBER_IN_CBI if CHROMEOS && EC_GOOGLE_CHROMEEC_MEC
	select HAVE_SPD_IN_CBFS

config TPM_TIS_ACPI_INTERRUPT
	int
	default 47 if BOARD_INTEL_PTLRVP_CHROMEEC # GPE0_DW1_15 (GPP_D15)

# FIXME: update as per board schematics
config UART_FOR_CONSOLE
	int
	default 0

config USE_PM_ACPI_TIMER
	default n

config VARIANT_DIR
	string
	default "ptlrvp" if BOARD_INTEL_MODEL_PTLRVP

config OVERRIDE_DEVICETREE
	default "variants/\$(CONFIG_VARIANT_DIR)/overridetree.cb" if BOARD_INTEL_PTLRVP
	default "variants/\$(CONFIG_VARIANT_DIR)_chromeec/overridetree.cb" if BOARD_INTEL_PTLRVP_CHROMEEC

config VBOOT
	select VBOOT_LID_SWITCH
	select VBOOT_MOCK_SECDATA if BOARD_INTEL_PTLRVP

endif # BOARD_INTEL_PTLRVP_COMMON
```

## src/mainboard/intel/ptlrvp/Kconfig.name
```kconfig
## SPDX-License-Identifier: GPL-2.0-only

comment "Ptlrvp"

config BOARD_INTEL_PTLRVP
	bool "-> Ptlrvp"

config BOARD_INTEL_PTLRVP4ES
	bool "-> Ptlrvp4es"

config BOARD_INTEL_PTLRVP_CHROMEEC
	bool "-> Google Chrome EC"

config BOARD_INTEL_PTLRVP_CHROMEEC4ES
	bool "-> Google Chrome EC for Early Silicon"
```

## src/mainboard/intel/saddlebrook/Kconfig
```kconfig
## SPDX-License-Identifier: GPL-2.0-only

if BOARD_INTEL_SKLSDLBRK

config BOARD_SPECIFIC_OPTIONS
	def_bool y
	select BOARD_ROMSIZE_KB_4096
	select DRIVERS_UART
	select HAVE_ACPI_RESUME
	select HAVE_ACPI_TABLES
	select HAVE_OPTION_TABLE
	select SKYLAKE_SOC_PCH_H
	select SOC_INTEL_SKYLAKE
	select SUPERIO_NUVOTON_COMMON_COM_A
	select SUPERIO_NUVOTON_NCT6776
	select HAVE_CMOS_DEFAULT
	select MAINBOARD_USES_IFD_GBE_REGION

config IRQ_SLOT_COUNT
	int
	default 18

config MAINBOARD_DIR
	string
	default "intel/saddlebrook"

config MAINBOARD_PART_NUMBER
	string
	default "Skylake Saddle Brook"

config MAINBOARD_FAMILY
	string
	default "Intel_SaddleBrook"

config TPM_PIRQ
	hex
	default 0x18  # GPP_E0_IRQ

endif
```

## src/mainboard/intel/shadowmountain/Kconfig
```kconfig
if BOARD_INTEL_SHADOWMOUNTAIN

config BOARD_SPECIFIC_OPTIONS
	def_bool y
	select BOARD_ROMSIZE_KB_32768
	select DRIVERS_I2C_GENERIC
	select DRIVERS_I2C_HID
	select DRIVERS_I2C_MAX98373
	select DRIVERS_INTEL_DPTF
	select DRIVERS_INTEL_PMC
	select DRIVERS_INTEL_USB4_RETIMER
	select DRIVERS_SPI_ACPI
	select DRIVERS_USB_ACPI
	select EC_GOOGLE_CHROMEEC
	select EC_GOOGLE_CHROMEEC_BOARDID
	select EC_GOOGLE_CHROMEEC_SKUID
	select EC_GOOGLE_CHROMEEC_LPC
	select HAVE_ACPI_RESUME
	select HAVE_ACPI_TABLES
	select HAVE_SPD_IN_CBFS
	select INTEL_LPSS_UART_FOR_CONSOLE
	select MAINBOARD_HAS_CHROMEOS
	select MAINBOARD_HAS_TPM2
	select PCIEXP_HOTPLUG
	select SOC_INTEL_ALDERLAKE_PCH_P
	select SOC_INTEL_CSE_LITE_SKU
	select SPI_TPM
	select TPM_GOOGLE_CR50
	select INTEL_CAR_NEM #TODO - Enable INTEL_CAR_NEM_ENHANCED

config CHROMEOS
	select GBB_FLAG_FORCE_DEV_SWITCH_ON
	select GBB_FLAG_FORCE_DEV_BOOT_USB
	select GBB_FLAG_FORCE_DEV_BOOT_ALTFW
	select GBB_FLAG_FORCE_MANUAL_RECOVERY

config VBOOT
	select EC_GOOGLE_CHROMEEC_SWITCHES
	select VBOOT_LID_SWITCH
	select HAS_RECOVERY_MRC_CACHE
	select VBOOT_EARLY_EC_SYNC

config DIMM_SPD_SIZE
	default 512

config DEVICETREE
	default "variants/baseboard/devicetree.cb"

config MAINBOARD_DIR
	default "intel/shadowmountain"

config MAINBOARD_FAMILY
	string
	default "Intel_shadowmountain"

config MAINBOARD_PART_NUMBER
	default "shadowmountain"

config PCIEXP_HOTPLUG_BUSES
	int
	default 42

config PCIEXP_HOTPLUG_MEM
	hex
	default 0xc200000  # 194 MiB

config PCIEXP_HOTPLUG_PREFETCH_MEM
	hex
	default 0x1c000000 # 448 MiB

config DRIVER_TPM_SPI_BUS
	default 0x1

config TPM_TIS_ACPI_INTERRUPT
	int
	default 3	# GPE0_DW0_3 (GPP_C3)

endif # BOARD_INTEL_SHADOWMOUNTAIN
```

## src/mainboard/intel/sklrvp/Kconfig
```kconfig
if BOARD_INTEL_SKLRVP

config BOARD_SPECIFIC_OPTIONS # dummy
	def_bool y
	select BOARD_ROMSIZE_KB_16384
	select CACHE_ROM
	select HAVE_ACPI_RESUME
	select HAVE_ACPI_TABLES
	select HAVE_OPTION_TABLE
	select HAVE_SMI_HANDLER
	select MAINBOARD_HAS_CHROMEOS
	select MARK_GRAPHICS_MEM_WRCOMB
	select MMCONF_SUPPORT
	select MONOTONIC_TIMER_MSR
	select PCIEXP_L1_SUB_STATE
	select SOC_INTEL_SKYLAKE

config CHROMEOS
	select LID_SWITCH
	select CHROMEOS_RAMOOPS_DYNAMIC
	select CHROMEOS_VBNV_CMOS
	select VBOOT_DYNAMIC_WORK_BUFFER
	select VIRTUAL_DEV_SWITCH

config IRQ_SLOT_COUNT
	int
	default 18

config BOOT_MEDIA_SPI_BUS
	int
	default 0

config MAINBOARD_DIR
	string
	default "intel/sklrvp"

config MAINBOARD_PART_NUMBER
	string
	default "Skylake RVP"

config MAX_CPUS
	int
	default 8

config VBOOT_RAMSTAGE_INDEX
	hex
	default 0x3

endif
```
