## src/mainboard/intel/stargo2/Kconfig
```kconfig
if BOARD_INTEL_STARGO2

config BOARD_SPECIFIC_OPTIONS # dummy
	def_bool y
	select CPU_INTEL_SOCKET_BGA1284
	select NORTHBRIDGE_INTEL_FSP_IVYBRIDGE
	select SOUTHBRIDGE_INTEL_FSP_I89XX
	select BOARD_ROMSIZE_KB_4096
	select HAVE_ACPI_TABLES
	select HAVE_OPTION_TABLE
	select MMCONF_SUPPORT
	select SUPERIO_WINBOND_WPCD376I
	select SUPERIO_INTEL_I8900
	select SERIRQ_CONTINUOUS_MODE
	select ENABLE_VMX

config MAINBOARD_DIR
	string
	default intel/stargo2

config MAINBOARD_PART_NUMBER
	string
	default "Stargo2"

config MMCONF_BASE_ADDRESS
	hex
	default 0xf8000000

config IRQ_SLOT_COUNT
	int
	default 18

config MAX_CPUS
	int
	default 16


config VGA_BIOS
	bool
	default n


endif # BOARD_INTEL_STARGO2
```

## src/mainboard/intel/strago/Kconfig
```kconfig
if BOARD_INTEL_STRAGO

config BOARD_SPECIFIC_OPTIONS
	def_bool y
	select BOARD_ROMSIZE_KB_8192
	select EC_GOOGLE_CHROMEEC
	select EC_GOOGLE_CHROMEEC_BOARDID
	select EC_GOOGLE_CHROMEEC_LPC
	select EC_GOOGLE_CHROMEEC_MEC
	select EC_GOOGLE_CHROMEEC_ACPI_MEMMAP
	select ENABLE_BUILTIN_COM1
	select HAVE_ACPI_RESUME
	select HAVE_ACPI_TABLES
	select HAVE_OPTION_TABLE
	select MAINBOARD_HAS_CHROMEOS
	select MEMORY_MAPPED_TPM
	select SOC_INTEL_BRASWELL
	select PCIEXP_L1_SUB_STATE

config VBOOT
	select EC_GOOGLE_CHROMEEC_SWITCHES
	select VBOOT_LID_SWITCH
	select VBOOT_VBNV_FLASH

config MAINBOARD_DIR
	default "intel/strago"

config MAINBOARD_PART_NUMBER
	default "Strago"

config VGA_BIOS_ID
	string
	depends on VGA_BIOS
	default "8086,22b0"
	help
	  The VGA_BIOS_ID for the C0 version of the video BIOS is hardcoded
	  in soc/intel/braswell/Makefile.inc as 8086,22b1

config CBFS_SIZE
	default 0x200000

endif # BOARD_INTEL_STRAGO
```

## src/mainboard/intel/strago/Kconfig.name
```kconfig
## SPDX-License-Identifier: GPL-2.0-only

config BOARD_INTEL_STRAGO
	bool "Strago"
```

## src/mainboard/intel/tglrvp/Kconfig
```kconfig
if BOARD_INTEL_TGLRVP_UP3 || BOARD_INTEL_TGLRVP_UP4

config BOARD_SPECIFIC_OPTIONS
	def_bool y
	select BOARD_ROMSIZE_KB_32768
	select HAVE_ACPI_RESUME
	select HAVE_ACPI_TABLES
	select MAINBOARD_HAS_CHROMEOS
	select DRIVERS_I2C_HID
	select DRIVERS_INTEL_DPTF
	select DRIVERS_I2C_GENERIC
	select DRIVERS_I2C_MAX98373
	select DRIVERS_INTEL_PMC
	select DRIVERS_USB_ACPI
	select DRIVERS_SPI_ACPI
	select SOC_INTEL_TIGERLAKE
	select SOC_INTEL_COMMON_BLOCK_DTT
	select INTEL_LPSS_UART_FOR_CONSOLE
	select DRIVERS_INTEL_ISH
	select EC_ACPI
	select HAVE_SPD_IN_CBFS
	select SOC_INTEL_CSE_LITE_SKU
	select MAINBOARD_HAS_TPM2
	select SOC_INTEL_ENABLE_USB4_PCIE_RESOURCES
	select SPI_TPM
	select TPM_GOOGLE_CR50

config CHROMEOS
	select EC_GOOGLE_CHROMEEC_SWITCHES if TGL_CHROME_EC
	select GBB_FLAG_FORCE_MANUAL_RECOVERY
	select HAS_RECOVERY_MRC_CACHE
	select GBB_FLAG_FORCE_DEV_SWITCH_ON
	select GBB_FLAG_FORCE_DEV_BOOT_USB
	select VBOOT_EARLY_EC_SYNC

config MAINBOARD_DIR
	default "intel/tglrvp"

config VARIANT_DIR
	default "tglrvp_up3" if BOARD_INTEL_TGLRVP_UP3
	default "tglrvp_up4" if BOARD_INTEL_TGLRVP_UP4

config GBB_HWID
	string
	depends on CHROMEOS
	default "TGLRVPUP3" if BOARD_INTEL_TGLRVP_UP3
	default "TGLRVPUP4" if BOARD_INTEL_TGLRVP_UP4

config MAINBOARD_PART_NUMBER
	default "tglrvpu" if BOARD_INTEL_TGLRVP_UP3
	default "tglrvpy" if BOARD_INTEL_TGLRVP_UP4

config MAINBOARD_FAMILY
	string
	default "Intel_tglrvp"

config DEVICETREE
	default "variants/\$(CONFIG_VARIANT_DIR)/devicetree.cb"

choice
	prompt "ON BOARD EC"
	default TGL_CHROME_EC
	help
	  This option allows you to select the on board EC to use.
	  Select whether the board  has Intel EC or Chrome EC

config TGL_CHROME_EC
	bool "Chrome EC"
	select EC_GOOGLE_CHROMEEC
	select EC_GOOGLE_CHROMEEC_LPC
	select EC_GOOGLE_CHROMEEC_ESPI
	select EC_GOOGLE_CHROMEEC_BOARDID

config TGL_INTEL_EC
	bool "Intel EC"
	select EC_ACPI
	select GBB_FLAG_DISABLE_EC_SOFTWARE_SYNC
endchoice

config VBOOT
	select VBOOT_LID_SWITCH

config UART_FOR_CONSOLE
	int
	default 2

config DRIVER_TPM_SPI_BUS
	default 0x2

config TPM_TIS_ACPI_INTERRUPT
	int
	default 54  # GPE0_DW1_22 (GPP_C22)

endif
```

## src/mainboard/intel/tglrvp/Kconfig.name
```kconfig
config BOARD_INTEL_TGLRVP_UP3
	bool "Tigerlake UP3 RVP"

config BOARD_INTEL_TGLRVP_UP4
	bool "Tigerlake UP4 RVP"
```

## src/mainboard/intel/truxton/Kconfig
```kconfig
if BOARD_INTEL_TRUXTON

config BOARD_SPECIFIC_OPTIONS # dummy
	def_bool y
	select ARCH_X86
	select CPU_INTEL_EP80579
	select NORTHBRIDGE_INTEL_I3100
	select SOUTHBRIDGE_INTEL_I3100
	select SUPERIO_INTEL_I3100
	select SUPERIO_SMSC_SMSCSUPERIO
	select ROMCC
	select HAVE_HARD_RESET
	select HAVE_PIRQ_TABLE
	select HAVE_MP_TABLE
	select UDELAY_TSC
	select BOARD_ROMSIZE_KB_2048

config MAINBOARD_DIR
	string
	default intel/truxton

config MAINBOARD_PART_NUMBER
	string
	default "Truxton"

config IRQ_SLOT_COUNT
	int
	default 1

config MAX_CPUS
	int
	default 4

endif # BOARD_INTEL_TRUXTON
```

## src/mainboard/intel/wtm2/Kconfig
```kconfig
if BOARD_INTEL_WTM2

config BOARD_SPECIFIC_OPTIONS
	def_bool y
	select SOC_INTEL_BROADWELL
	select BOARD_ROMSIZE_KB_8192
	select HAVE_ACPI_TABLES
	select HAVE_OPTION_TABLE
	select HAVE_ACPI_RESUME
	select MAINBOARD_HAS_CHROMEOS
	select MEMORY_MAPPED_TPM
	select INTEL_INT15

config VBOOT
	select VBOOT_VBNV_CMOS

config MAINBOARD_DIR
	default "intel/wtm2"

config MAINBOARD_PART_NUMBER
	default "WHITETIP MOUNTAIN 2"

endif # BOARD_INTEL_WTM2
```

## src/mainboard/intel/wtm2/Kconfig.name
```kconfig
## SPDX-License-Identifier: GPL-2.0-only

config BOARD_INTEL_WTM2
	bool "Whitetip Mountain 2 CRB"
```

## src/mainboard/intel/xe7501devkit/Kconfig
```kconfig
if BOARD_INTEL_XE7501DEVKIT

config BOARD_SPECIFIC_OPTIONS # dummy
	def_bool y
	select ARCH_X86
	select CPU_INTEL_SOCKET_MPGA604
	select NORTHBRIDGE_INTEL_E7501
	select SOUTHBRIDGE_INTEL_I82870
	select SOUTHBRIDGE_INTEL_I82801CX
	select SUPERIO_SMSC_LPC47B272
	select ROMCC
	select HAVE_PIRQ_TABLE
	select HAVE_MP_TABLE
	select UDELAY_TSC
	select HAVE_ACPI_TABLES
	select BOARD_ROMSIZE_KB_2048

config MAINBOARD_DIR
	string
	default intel/xe7501devkit

config MAINBOARD_PART_NUMBER
	string
	default "XE7501devkit"

config IRQ_SLOT_COUNT
	int
	default 12

config MAX_CPUS
	int
	default 2

endif # BOARD_INTEL_XE7501DEVKIT
```

## src/mainboard/inventec/Kconfig
```kconfig
if VENDOR_INVENTEC

choice
	prompt "Mainboard model"

source "src/mainboard/inventec/*/Kconfig.name"

endchoice

source "src/mainboard/inventec/*/Kconfig"

config MAINBOARD_VENDOR
	default "Inventec"

endif # VENDOR_INVENTEC
```

## src/mainboard/inventec/transformers/Kconfig
```kconfig
if BOARD_INVENTEC_TRANSFORMERS

config BOARD_SPECIFIC_OPTIONS
	def_bool y
	select BOARD_ROMSIZE_KB_65536
	select CONSOLE_OVERRIDE_LOGLEVEL
	select IPMI_OCP
	select IPMI_KCS
	select IPMI_KCS_ROMSTAGE
	select MEMORY_MAPPED_TPM
	select MAINBOARD_HAS_TPM2
	select MAINBOARD_USES_FSP2_0
	select SOC_INTEL_SAPPHIRERAPIDS_SP
	select SUPERIO_ASPEED_AST2400
	select HAVE_ACPI_TABLES
	select MAINBOARD_USES_IFD_GBE_REGION
	select VPD
	select OCP_VPD
	select OCP_EWL
	select SOC_INTEL_XEON_RAS
	select RUNTIME_CONFIGURABLE_SMM_LOGLEVEL

config MAINBOARD_DIR
	default "inventec/transformers"

config MAINBOARD_PART_NUMBER
	default "Transformers"

config FMDFILE
	default "src/mainboard/\$(CONFIG_MAINBOARD_DIR)/board.fmd"

config MAX_SOCKET
	default 2

config DEBUG_SMI
	default y

endif
```

## src/mainboard/inventec/transformers/Kconfig.name
```kconfig
## SPDX-License-Identifier: GPL-2.0-only

config BOARD_INVENTEC_TRANSFORMERS
	bool "Transformers"
```

## src/mainboard/iwave/Kconfig
```kconfig
if VENDOR_IWAVE

choice
	prompt "Mainboard model"
	depends on VENDOR_IWAVE

source "src/mainboard/iwave/*/Kconfig.name"

endchoice

source "src/mainboard/iwave/*/Kconfig"

config MAINBOARD_VENDOR
	string
	default "iWave"

endif # VENDOR_IWAVE
```

## src/mainboard/iwave/iWRainbowG6/Kconfig
```kconfig
if BOARD_IWAVE_RAINBOW_G6

# TODO: move options to chipset components as appropriate
config BOARD_SPECIFIC_OPTIONS # dummy
	def_bool y
	select ARCH_X86
	select CPU_INTEL_SOCKET_441
	select NORTHBRIDGE_INTEL_SCH
	select SOUTHBRIDGE_INTEL_SCH
	select HAVE_PIRQ_TABLE
#	select HAVE_MP_TABLE
	select USE_PRINTK_IN_CAR
	select UDELAY_LAPIC
	select HAVE_ACPI_TABLES
	select BOARD_ROMSIZE_KB_1024
	select GFXUMA

config MAINBOARD_DIR
	string
	default iwave/iWRainbowG6

config MAINBOARD_PART_NUMBER
	string
	default "iWRainbowG6"

config MMCONF_BASE_ADDRESS
	hex
	default 0xe0000000

config IRQ_SLOT_COUNT
	int
	default 10

# This mainboard might have a higher clocked UART or might not be able to run
# serial output at 115200 baud

endif
```

## src/mainboard/iwill/Kconfig
```kconfig
if VENDOR_IWILL

choice
	prompt "Mainboard model"

source "src/mainboard/iwill/*/Kconfig.name"

endchoice

source "src/mainboard/iwill/*/Kconfig"

config MAINBOARD_VENDOR
	string
	default "IWILL"

endif # VENDOR_IWILL
```

## src/mainboard/iwill/dk8_htx/Kconfig
```kconfig
if BOARD_IWILL_DK8_HTX

config BOARD_SPECIFIC_OPTIONS # dummy
	def_bool y
	select CPU_AMD_SOCKET_940
	select NORTHBRIDGE_AMD_AMDK8
	select SOUTHBRIDGE_AMD_AMD8111
	select SOUTHBRIDGE_AMD_AMD8131
	select HT_CHAIN_DISTRIBUTE
	select SUPERIO_WINBOND_W83627HF
	select PARALLEL_CPU_INIT
	select HAVE_OPTION_TABLE
	select HAVE_PIRQ_TABLE
	select HAVE_MP_TABLE
	select LIFT_BSP_APIC_ID
	select SB_HT_CHAIN_UNITID_OFFSET_ONLY
	select HAVE_ACPI_TABLES
	select BOARD_ROMSIZE_KB_512
	select RAMINIT_SYSINFO
	select QRANK_DIMM_SUPPORT

config MAINBOARD_DIR
	string
	default iwill/dk8_htx

config APIC_ID_OFFSET
	hex
	default 0x10

config MAINBOARD_PART_NUMBER
	string
	default "DK8-HTX"

config MAX_CPUS
	int
	default 4

config MAX_PHYSICAL_CPUS
	int
	default 2

config HT_CHAIN_END_UNITID_BASE
	hex
	default 0x6

config HT_CHAIN_UNITID_BASE
	hex
	default 0xa

config IRQ_SLOT_COUNT
	int
	default 11

endif # BOARD_IWILL_DK8_HTX
```

## src/mainboard/iwill/dk8s2/Kconfig
```kconfig
if BOARD_IWILL_DK8S2

config BOARD_SPECIFIC_OPTIONS # dummy
	def_bool y
	select ARCH_X86
	select CPU_AMD_SOCKET_940
	select NORTHBRIDGE_AMD_AMDK8
	select SOUTHBRIDGE_AMD_AMD8111
	select SOUTHBRIDGE_AMD_AMD8131
	select SUPERIO_WINBOND_W83627HF
	select HAVE_PIRQ_TABLE
	select HAVE_OPTION_TABLE
	select HAVE_MP_TABLE
	select SB_HT_CHAIN_UNITID_OFFSET_ONLY
	select DRIVERS_ATI_RAGEXL
	select BOARD_ROMSIZE_KB_512
	select RAMINIT_SYSINFO
	select QRANK_DIMM_SUPPORT

config MAINBOARD_DIR
	string
	default iwill/dk8s2

config APIC_ID_OFFSET
	hex
	default 0x0

config MAINBOARD_PART_NUMBER
	string
	default "DK8S2"

config MAX_CPUS
	int
	default 2

config MAX_PHYSICAL_CPUS
	int
	default 2

config SB_HT_CHAIN_ON_BUS0
	int
	default 0

config HT_CHAIN_END_UNITID_BASE
	hex
	default 0x20

config HT_CHAIN_UNITID_BASE
	hex
	default 0x1

config SERIAL_CPU_INIT
	bool
	default n

config IRQ_SLOT_COUNT
	int
	default 12

endif # BOARD_IWILL_DK8S2
```
