## src/mainboard/iwill/dk8x/Kconfig
```kconfig
if BOARD_IWILL_DK8X

config BOARD_SPECIFIC_OPTIONS # dummy
	def_bool y
	select ARCH_X86
	select CPU_AMD_SOCKET_940
	select NORTHBRIDGE_AMD_AMDK8
	select SOUTHBRIDGE_AMD_AMD8111
	select SOUTHBRIDGE_AMD_AMD8131
	select SUPERIO_WINBOND_W83627THG
	select HAVE_OPTION_TABLE
	select HAVE_PIRQ_TABLE
	select HAVE_MP_TABLE
	select SB_HT_CHAIN_UNITID_OFFSET_ONLY
	select BOARD_ROMSIZE_KB_512
	select RAMINIT_SYSINFO
	select QRANK_DIMM_SUPPORT

config MAINBOARD_DIR
	string
	default iwill/dk8x

config APIC_ID_OFFSET
	hex
	default 0x0

config MAINBOARD_PART_NUMBER
	string
	default "DK8X"

config MAX_CPUS
	int
	default 2

config MAX_PHYSICAL_CPUS
	int
	default 2

config SB_HT_CHAIN_ON_BUS0
	int
	default 0

config HT_CHAIN_END_UNITID_BASE
	hex
	default 0x20

config HT_CHAIN_UNITID_BASE
	hex
	default 0x1

config SERIAL_CPU_INIT
	bool
	default n

config IRQ_SLOT_COUNT
	int
	default 9

endif # BOARD_IWILL_DK8X
```

## src/mainboard/jetway/Kconfig
```kconfig
if VENDOR_JETWAY

choice
	prompt "Mainboard model"

source "src/mainboard/jetway/*/Kconfig.name"

endchoice

source "src/mainboard/jetway/*/Kconfig"

config MAINBOARD_VENDOR
	default "Jetway"

endif # VENDOR_JETWAY
```

## src/mainboard/jetway/j7f2/Kconfig
```kconfig
if BOARD_JETWAY_J7F2 || BOARD_JETWAY_J7F4K1G2E || BOARD_JETWAY_J7F4K1G5D

config BOARD_SPECIFIC_OPTIONS # dummy
	def_bool y
	select CPU_VIA_C7
	select NORTHBRIDGE_VIA_CN700
	select SOUTHBRIDGE_VIA_VT8237R
	select SUPERIO_FINTEK_F71805F
	select HAVE_OPTION_TABLE
	select HAVE_PIRQ_TABLE
	select BOARD_ROMSIZE_KB_512

config MAINBOARD_DIR
	string
	default jetway/j7f2

if BOARD_JETWAY_J7F2
config MAINBOARD_PART_NUMBER
	string
	default "J7f2"
endif # BOARD_JETWAY_J7F2

config IRQ_SLOT_COUNT
	int
	default 10

endif # BOARD_JETWAY_J7F2 || BOARD_JETWAY_J7F4K1G2E || BOARD_JETWAY_J7F4K1G5D
```

## src/mainboard/jetway/j7f24/Kconfig
```kconfig
# FIXME: There is no such board, "J7F24" is probably too generic and/or wrong.
if BOARD_JETWAY_J7F24

config BOARD_SPECIFIC_OPTIONS # dummy
	def_bool y
	select ARCH_X86
	select CPU_VIA_C7
	select NORTHBRIDGE_VIA_CN700
	select SOUTHBRIDGE_VIA_VT8237R
	select SUPERIO_FINTEK_F71805F
	select HAVE_OPTION_TABLE
	select HAVE_PIRQ_TABLE
	select BOARD_ROMSIZE_KB_512

config MAINBOARD_DIR
	string
	default jetway/j7f24

config MAINBOARD_PART_NUMBER
	string
	default "J7f24"

config IRQ_SLOT_COUNT
	int
	default 10

endif # BOARD_JETWAY_J7F24
```

## src/mainboard/jetway/j7f4k1g2e/Kconfig
```kconfig
if BOARD_JETWAY_J7F4K1G2E

# Dummy for abuild

config MAINBOARD_PART_NUMBER
	string
	default "J7f4K1G2E"
endif
```

## src/mainboard/jetway/j7f4k1g5d/Kconfig
```kconfig
if BOARD_JETWAY_J7F4K1G5D

# Dummy for abuild
#select ARCH_X86

config MAINBOARD_PART_NUMBER
	string
	default "J7f4K1G5D"
endif
```

## src/mainboard/jetway/nf81-t56n-lf/Kconfig
```kconfig
#
# This file is part of the coreboot project.
#
# Copyright (C) 2011 Advanced Micro Devices, Inc.
# Copyright (C) 2014 Edward O'Callaghan <eocallaghan@alterapraxis.com>.
#
# This program is free software; you can redistribute it and/or modify
# it under the terms of the GNU General Public License as published by
# the Free Software Foundation; version 2 of the License.
#
# This program is distributed in the hope that it will be useful,
# but WITHOUT ANY WARRANTY; without even the implied warranty of
# MERCHANTABILITY or FITNESS FOR A PARTICULAR PURPOSE.  See the
# GNU General Public License for more details.
#

if BOARD_JETWAY_NF81_T56N_LF

config BOARD_SPECIFIC_OPTIONS # dummy
	def_bool y
	select CPU_AMD_AGESA_FAMILY14
	select NORTHBRIDGE_AMD_AGESA_FAMILY14
	select SOUTHBRIDGE_AMD_CIMX_SB800
	select SUPERIO_FINTEK_F71869AD
	select HAVE_OPTION_TABLE
	select HAVE_PIRQ_TABLE
	select HAVE_MP_TABLE
	select HAVE_ACPI_RESUME
	select HAVE_ACPI_TABLES
	select BOARD_ROMSIZE_KB_2048
	select GFXUMA

config MAINBOARD_DIR
	string
	default jetway/nf81-t56n-lf

config MAINBOARD_PART_NUMBER
	string
	default "NF81-T56N-LF"

config HW_MEM_HOLE_SIZEK
	hex
	default 0x200000

config MAX_CPUS
	int
	default 2

config HW_MEM_HOLE_SIZE_AUTO_INC
	bool
	default n

config IRQ_SLOT_COUNT
	int
	default 11

config ONBOARD_VGA_IS_PRIMARY
	bool
	default y

config VGA_BIOS
	bool
	default n

#config VGA_BIOS_FILE
#	string "VGA BIOS path and filename"
#	depends on VGA_BIOS
#	default "rom/video/OntarioGenericVbios.bin"

config VGA_BIOS_ID
	string
	default "1002,9806" # FUSION_G_T56N

config SB800_AHCI_ROM
	bool
	default n

endif # BOARD_JETWAY_NF81_T56N_LF
```

## src/mainboard/jetway/pa78vm5/Kconfig
```kconfig
config BOARD_JETWAY_PA78VM5
	bool "PA78VM5 (Fam10)"
	select ARCH_X86
	select CPU_AMD_SOCKET_AM2R2
	select NORTHBRIDGE_AMD_AMDFAM10
	select SOUTHBRIDGE_AMD_RS780
	select SOUTHBRIDGE_AMD_SB700
	select SUPERIO_FINTEK_F71863FG
	select BOARD_HAS_FADT
	select HAVE_BUS_CONFIG
	select HAVE_OPTION_TABLE
	select GENERATE_PIRQ_TABLE
	select GENERATE_MP_TABLE
	select HAVE_MAINBOARD_RESOURCES
	select USE_DCACHE_RAM
	select HAVE_HARD_RESET
	select SB_HT_CHAIN_UNITID_OFFSET_ONLY
	select LIFT_BSP_APIC_ID
	select SERIAL_CPU_INIT
	select AMDMCT
	select GENERATE_ACPI_TABLES
	select BOARD_ROMSIZE_KB_1024
	select ENABLE_APIC_EXT_ID
	select TINY_BOOTBLOCK
	select GFXUMA

config MAINBOARD_DIR
	string
	default jetway/pa78vm5
	depends on BOARD_JETWAY_PA78VM5

config APIC_ID_OFFSET
	hex
	default 0x0
	depends on BOARD_JETWAY_PA78VM5

config MAINBOARD_PART_NUMBER
	string
	default "PA78VM5 (Fam10)"
	depends on BOARD_JETWAY_PA78VM5

config HW_MEM_HOLE_SIZEK
	hex
	default 0x100000
	depends on BOARD_JETWAY_PA78VM5

config MAX_CPUS
	int
	default 8
	depends on BOARD_JETWAY_PA78VM5

config MAX_PHYSICAL_CPUS
	int
	default 2
	depends on BOARD_JETWAY_PA78VM5

config HW_MEM_HOLE_SIZE_AUTO_INC
	bool
	default n
	depends on BOARD_JETWAY_PA78VM5

config MEM_TRAIN_SEQ
	int
	default 2
	depends on BOARD_JETWAY_PA78VM5

config SB_HT_CHAIN_ON_BUS0
	int
	default 1
	depends on BOARD_JETWAY_PA78VM5

config HT_CHAIN_END_UNITID_BASE
	hex
	default 0x1
	depends on BOARD_JETWAY_PA78VM5

config HT_CHAIN_UNITID_BASE
	hex
	default 0x0
	depends on BOARD_JETWAY_PA78VM5

config IRQ_SLOT_COUNT
	int
	default 11
	depends on BOARD_JETWAY_PA78VM5

config AMD_UCODE_PATCH_FILE
	string
	default "mc_patch_010000b6.h"
	depends on BOARD_JETWAY_PA78VM5

config RAMTOP
	hex
	default 0x2000000
	depends on BOARD_JETWAY_PA78VM5

config HEAP_SIZE
	hex
	default 0xc0000
	depends on BOARD_JETWAY_PA78VM5

config ACPI_SSDTX_NUM
	int
	default 0
	depends on BOARD_JETWAY_PA78VM5

config MAINBOARD_PCI_SUBSYSTEM_DEVICE_ID
	hex
	default 0x3060
	depends on BOARD_JETWAY_PA78VM5

config MAINBOARD_PCI_SUBSYSTEM_VENDOR_ID
	hex
	default 0x1022
	depends on BOARD_JETWAY_PA78VM5

config RAMBASE
	hex
	default 0x200000
	depends on BOARD_JETWAY_PA78VM5

config COMPRESS
	hex
	default 0
	depends on BOARD_JETWAY_PA78VM5
```

## src/mainboard/kontron/986lcd-m/Kconfig
```kconfig
if BOARD_KONTRON_986LCD_M

config BOARD_SPECIFIC_OPTIONS
	def_bool y
	select CPU_INTEL_SOCKET_M
	select NORTHBRIDGE_INTEL_I945
	select NORTHBRIDGE_INTEL_SUBTYPE_I945GM
	select CHECK_SLFRCS_ON_RESUME
	select SOUTHBRIDGE_INTEL_I82801GX
	select SUPERIO_WINBOND_W83627THG
	select HAVE_ACPI_TABLES
	select HAVE_PIRQ_TABLE
	select HAVE_MP_TABLE
	select HAVE_OPTION_TABLE
	select HAVE_ACPI_RESUME
	select BOARD_ROMSIZE_KB_1024
	select INTEL_INT15
	select OVERRIDE_CLOCK_DISABLE
	select BOOT_DEVICE_NOT_SPI_FLASH

config MAINBOARD_DIR
	default "kontron/986lcd-m"

config MAINBOARD_PART_NUMBER
	default "986LCD-M"

config IRQ_SLOT_COUNT
	int
	default 18

endif # BOARD_KONTRON_986LCD_M
```

## src/mainboard/kontron/986lcd-m/Kconfig.name
```kconfig
## SPDX-License-Identifier: GPL-2.0-only

config BOARD_KONTRON_986LCD_M
	bool "986LCD-M/mITX"
```

## src/mainboard/kontron/Kconfig
```kconfig
if VENDOR_KONTRON

choice
	prompt "Mainboard model"

source "src/mainboard/kontron/*/Kconfig.name"

endchoice

source "src/mainboard/kontron/*/Kconfig"

config MAINBOARD_VENDOR
	string
	default "Kontron"

endif # VENDOR_KONTRON
```

## src/mainboard/kontron/bsl6/Kconfig
```kconfig
# SPDX-License-Identifier: GPL-2.0-only

config BOARD_KONTRON_BSL6_COMMON
	def_bool n
	select BOARD_ROMSIZE_KB_16384
	select SOC_INTEL_SKYLAKE
	select SKYLAKE_SOC_PCH_H
	select EXCLUDE_NATIVE_SD_INTERFACE
	select NO_FADT_8042
	select HAVE_ACPI_TABLES
	select HAVE_OPTION_TABLE
	select HAVE_CMOS_DEFAULT
	select MEMORY_MAPPED_TPM
	select EC_KONTRON_KEMPLD
	select MAINBOARD_HAS_LIBGFXINIT
	select DRIVERS_I2C_NCT7802Y

config BOARD_KONTRON_BSL6
	select BOARD_KONTRON_BSL6_COMMON
	select HAVE_ACPI_RESUME

config BOARD_SIEMENS_BOXER26
	select BOARD_KONTRON_BSL6_COMMON
	select DRIVERS_I2C_LM96000
	select SECUNET_DMI

if BOARD_KONTRON_BSL6_COMMON

config DISABLE_HECI1_AT_PRE_BOOT
	default y

config MAINBOARD_DIR
	default "kontron/bsl6"

config MAINBOARD_VENDOR
	string
	default "Siemens" if BOARD_SIEMENS_BOXER26

config MAINBOARD_PART_NUMBER
	default "bSL6" if BOARD_KONTRON_BSL6
	default "Boxer26" if BOARD_SIEMENS_BOXER26

config VARIANT_DIR
	default "bsl6" if BOARD_KONTRON_BSL6
	default "boxer26" if BOARD_SIEMENS_BOXER26

config OVERRIDE_DEVICETREE
	default "variants/\$(CONFIG_VARIANT_DIR)/overridetree.cb"

config CBFS_SIZE
	default 0x600000 if BOARD_SIEMENS_BOXER26

config DIMM_MAX
	default 2

config DIMM_SPD_SIZE
	default 512

endif
```

## src/mainboard/kontron/bsl6/Kconfig.name
```kconfig
config BOARD_KONTRON_BSL6
	bool "COMe-bSL6"
	select BOARD_KONTRON_BSL6_OPTIONS

config BOARD_SIEMENS_BOXER26
	bool "COMe-bSL6 on Siemens/Boxer26"
	select BOARD_KONTRON_BOXER26_OPTIONS
```

## src/mainboard/kontron/kt690/Kconfig
```kconfig
if BOARD_KONTRON_KT690

config BOARD_SPECIFIC_OPTIONS # dummy
	def_bool y
	select ARCH_X86
	select CPU_AMD_SOCKET_S1G1
	select NORTHBRIDGE_AMD_AMDK8
	select SOUTHBRIDGE_AMD_RS690
	select SOUTHBRIDGE_AMD_SB600
	select SUPERIO_WINBOND_W83627DHG
	select HAVE_OPTION_TABLE
	select HAVE_PIRQ_TABLE
	select HAVE_MP_TABLE
	select GFXUMA
	select HAVE_ACPI_TABLES
	select BOARD_ROMSIZE_KB_1024
	select RAMINIT_SYSINFO
	select SB_HT_CHAIN_UNITID_OFFSET_ONLY
	select QRANK_DIMM_SUPPORT
	select SET_FIDVID

config MAINBOARD_DIR
	string
	default kontron/kt690

config APIC_ID_OFFSET
	hex
	default 0x0

config MAINBOARD_PART_NUMBER
	string
	default "KT690/mITX"

config HEAP_SIZE
	hex
	default 0x8000

config MAX_CPUS
	int
	default 2

config MAX_PHYSICAL_CPUS
	int
	default 1

config SB_HT_CHAIN_ON_BUS0
	int
	default 1

config HT_CHAIN_END_UNITID_BASE
	hex
	default 0x1

config HT_CHAIN_UNITID_BASE
	hex
	default 0x0

config IRQ_SLOT_COUNT
	int
	default 11

endif # BOARD_KONTRON_KT690
```

## src/mainboard/kontron/ktqm77/Kconfig
```kconfig
## SPDX-License-Identifier: GPL-2.0-only

if BOARD_KONTRON_KTQM77

config BOARD_SPECIFIC_OPTIONS
	def_bool y
	select AZALIA_USE_LEGACY_VERB_TABLE
	select NORTHBRIDGE_INTEL_SANDYBRIDGE
	select SOUTHBRIDGE_INTEL_C216
	select SUPERIO_WINBOND_W83627DHG
	select EC_KONTRON_IT8516E
	select BOARD_ROMSIZE_KB_8192
	select HAVE_ACPI_TABLES
	select HAVE_OPTION_TABLE
	select HAVE_ACPI_RESUME
	select MAINBOARD_HAS_LIBGFXINIT
	select GFX_GMA_ANALOG_I2C_HDMI_B
	select GFX_GMA_PANEL_1_ON_LVDS
	select MAINBOARD_USES_IFD_GBE_REGION

config MAINBOARD_DIR
	default "kontron/ktqm77"

config MAINBOARD_PART_NUMBER
	default "KTQM77/mITX"

endif # BOARD_KONTRON_KTQM77
```

## src/mainboard/kontron/ktqm77/Kconfig.name
```kconfig
## SPDX-License-Identifier: GPL-2.0-only

config BOARD_KONTRON_KTQM77
	bool "KTQM77/mITX"
```
