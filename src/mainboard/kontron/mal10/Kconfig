## src/mainboard/kontron/mal10/Kconfig
```kconfig
if BOARD_KONTRON_COME_MAL10

config BOARD_SPECIFIC_OPTIONS
	def_bool y
	select BOARD_ROMSIZE_KB_16384
	select DRIVERS_I2C_NCT7802Y
	select EC_KONTRON_KEMPLD
	select HAVE_ACPI_TABLES
	select HAVE_ACPI_RESUME
	select HAVE_CMOS_DEFAULT
	select HAVE_OPTION_TABLE
	select INTEL_GMA_HAVE_VBT
	select CRB_TPM
	select MAINBOARD_HAS_LIBGFXINIT
	select ONBOARD_VGA_IS_PRIMARY
	select SOC_INTEL_APOLLOLAKE

config MAINBOARD_DIR
	default "kontron/mal10"

# TODO: Add a new carrier boards here
choice
	prompt "Carrier board"
	default BOARD_KONTRON_T10_TNI
	help
	  This option sets the type of carrier board to be used with
	  the Kontron mAL10 COMe module.

config BOARD_KONTRON_T10_TNI
	bool "Kontron i-T10-TNIx"
	help
	  By selecting this option, the target ROM image will be built for
	  the Kontron Ref.Carrier-i T10-TNI carrier board.

endchoice

config VARIANT_DIR
	default "mal10"

config CARRIER_DIR
	string
	default "t10-tni" if BOARD_KONTRON_T10_TNI

config MAINBOARD_PART_NUMBER
	default "COMe-mAL10"

config DEVICETREE
	default "variants/\$(CONFIG_VARIANT_DIR)/devicetree.cb"

config OVERRIDE_DEVICETREE
	default "carriers/\$(CONFIG_CARRIER_DIR)/overridetree.cb"

endif
```

## src/mainboard/kontron/mal10/Kconfig.name
```kconfig
## SPDX-License-Identifier: GPL-2.0-only

config BOARD_KONTRON_COME_MAL10
	bool "COMe-mAL10"
```

## src/mainboard/lanner/Kconfig
```kconfig
if VENDOR_LANNER

choice
	prompt "Mainboard model"

source "src/mainboard/lanner/*/Kconfig.name"

endchoice

source "src/mainboard/lanner/*/Kconfig"

config MAINBOARD_VENDOR
	string
	default "Lanner"

endif # VENDOR_LANNER
```

## src/mainboard/lanner/em8510/Kconfig
```kconfig
if BOARD_LANNER_EM8510

config BOARD_SPECIFIC_OPTIONS # dummy
	def_bool y
	select ARCH_X86
	select CPU_INTEL_SOCKET_MPGA479M
	select NORTHBRIDGE_INTEL_I855
	select SOUTHBRIDGE_INTEL_I82801DX
	select SUPERIO_WINBOND_W83627THG
	select HAVE_OPTION_TABLE
	select HAVE_PIRQ_TABLE
	select BOARD_ROMSIZE_KB_512

config MAINBOARD_DIR
	string
	default lanner/em8510

config MAINBOARD_PART_NUMBER
	string
	default "EM-8510"

config DCACHE_RAM_BASE
	hex
	default 0xffdf8000

config DCACHE_RAM_SIZE
	hex
	default 0x8000

config IRQ_SLOT_COUNT
	int
	default 10

endif # BOARD_LANNER_EM8510
```

## src/mainboard/lattepanda/Kconfig
```kconfig
## SPDX-License-Identifier: GPL-2.0-only

if VENDOR_LATTEPANDA

choice
	prompt "Mainboard model"

source "src/mainboard/lattepanda/*/Kconfig.name"

endchoice

source "src/mainboard/lattepanda/*/Kconfig"

config MAINBOARD_VENDOR
	default "LattePanda"

endif # VENDOR_LATTEPANDA
```

## src/mainboard/lattepanda/Kconfig.name
```kconfig
## SPDX-License-Identifier: GPL-2.0-only

config VENDOR_LATTEPANDA
	bool "LattePanda"
```

## src/mainboard/lattepanda/mu/Kconfig
```kconfig
## SPDX-License-Identifier: GPL-2.0-only

config BOARD_LATTEPANDA_MU_COMMON
	def_bool n
	select BOARD_ROMSIZE_KB_16384
	select CRB_TPM
	select DRIVERS_I2C_HID
	select DRIVERS_INTEL_PMC
	select DRIVERS_OPTION_CFR_ENABLED if PAYLOAD_EDK2 && SMMSTORE
	select DRIVERS_SPI_ACPI
	select DRIVERS_UART_8250IO
	select DRIVERS_USB_ACPI
	select FSP_TYPE_IOT
	select HAVE_ACPI_RESUME
	select HAVE_ACPI_TABLES
	select HAVE_SPD_IN_CBFS
	select HAVE_INTEL_PTT
	select INTEL_GMA_HAVE_VBT
	select MAINBOARD_HAS_TPM2
	select PCIEXP_ASPM
	select PCIEXP_CLK_PM
	select PCIEXP_L1_SUB_STATE
	select PMC_IPC_ACPI_INTERFACE
	select SOC_INTEL_ALDERLAKE_PCH_N
	select SUPERIO_ITE_IT8613E

config BOARD_LATTEPANDA_MU
	select BOARD_LATTEPANDA_MU_COMMON

config BOARD_LATTEPANDA_MU_DFR1141
	select BOARD_LATTEPANDA_MU_COMMON
	select SOC_INTEL_COMMON_BLOCK_HDA_VERB

config BOARD_LATTEPANDA_MU_DFR1142
	select BOARD_LATTEPANDA_MU_COMMON
	select REALTEK_8168_RESET
	select RT8168_GEN_ACPI_POWER_RESOURCE

if BOARD_LATTEPANDA_MU_COMMON

config CBFS_SIZE
	default 0xa00000

config INTEL_GMA_VBT_FILE
	default "src/mainboard/\$(MAINBOARDDIR)/data.vbt"

config MAINBOARD_DIR
	default "lattepanda/mu"

config MAINBOARD_SMBIOS_MANUFACTURER
	default "DFRobot"

config MAINBOARD_PART_NUMBER
	default "LattePanda Mu (SOM only)" if BOARD_LATTEPANDA_MU
	default "LattePanda Mu with DFR1142" if BOARD_LATTEPANDA_MU_DFR1142
	default "LattePanda Mu with DFR1141" if BOARD_LATTEPANDA_MU_DFR1141

config VARIANT_DIR
	default "dfr1141" if BOARD_LATTEPANDA_MU_DFR1141
	default "dfr1142" if BOARD_LATTEPANDA_MU_DFR1142

config DEVICETREE
	default "variants/baseboard/devicetree.cb"

config OVERRIDE_DEVICETREE
	default "variants/\$(CONFIG_VARIANT_DIR)/overridetree.cb" if (!BOARD_LATTEPANDA_MU)

config UART_FOR_CONSOLE
	default 0

choice
	prompt "On-board LP5X memory size"
	default BOARD_LATTEPANDA_MU_MEMORY_16GB
	help
	  Select the soldered memory density on your Mu module. The matching
	  SPD image is included in CBFS at index 0.

config BOARD_LATTEPANDA_MU_MEMORY_8GB
	bool "8 GB"

config BOARD_LATTEPANDA_MU_MEMORY_16GB
	bool "16 GB"
endchoice

if BOARD_LATTEPANDA_MU_DFR1141

choice
	prompt "HSIO configuration (x4 slot mux)"
	default DFR1141_HSIO_PCIE_X4
	help
	  On the DFR1141 carrier, HSIO10+11 are multiplexed with the x4 slot connector:

	  - PCIe 3.0 x4: all four lanes to the slot.
	    SATA is disabled in ramstage.
	  - PCIe 3.0 x2 + SATA: HSIO10+11 to SATA, slot runs x2.

	  This option only controls the ramstage/devicetree side of the mux. The
	  actual lane routing is fixed by soft straps in the Intel Flash Descriptor,
	  which cannot be changed at runtime. You MUST build with a matching
	  IFD (set CONFIG_IFD_BIN_PATH to the descriptor extracted from the
	  corresponding vendor stock firmware branch: PCIe/Default for x4,
	  SATA for x2 + SATA). A mismatched descriptor leaves the slot and/or
	  SATA port non-functional.

config DFR1141_HSIO_PCIE_X4
	bool "PCIe 3.0 x4"
	help
	  Route all four lanes to the x4 slot and disable SATA. Requires an IFD
	  built from the vendor PCIe/Default (SR-B) firmware branch.

config DFR1141_HSIO_PCIE_X2_SATA
	bool "PCIe 3.0 x2 + SATA"
	help
	  Route HSIO10+11 to SATA; the slot runs x2. Requires an IFD built from
	  the vendor SATA (SR-B-SATA) firmware branch.
endchoice

endif

endif
```

## src/mainboard/lattepanda/mu/Kconfig.name
```kconfig
## SPDX-License-Identifier: GPL-2.0-only

config BOARD_LATTEPANDA_MU
	bool "LattePanda Mu (SOM only)"

config BOARD_LATTEPANDA_MU_DFR1141
	bool "LattePanda Mu with DFR1141 full eval carrier"

config BOARD_LATTEPANDA_MU_DFR1142
	bool "LattePanda Mu with DFR1142 lite carrier"
```

## src/mainboard/lenovo/Kconfig
```kconfig
if VENDOR_LENOVO

choice
	prompt "Mainboard model"

source "src/mainboard/lenovo/*/Kconfig.name"

endchoice

source "src/mainboard/lenovo/*/Kconfig"

config MAINBOARD_VENDOR
	default "LENOVO"

config MAINBOARD_FAMILY
	string
	default MAINBOARD_PART_NUMBER

endif # VENDOR_LENOVO
```

## src/mainboard/lenovo/g505s/Kconfig
```kconfig
# SPDX-License-Identifier: GPL-2.0-only

if BOARD_LENOVO_G505S

config BOARD_SPECIFIC_OPTIONS
	def_bool y
	select SYSTEM_TYPE_LAPTOP
	select CPU_AMD_AGESA_FAMILY15_TN
	select NORTHBRIDGE_AMD_AGESA_FAMILY15_TN
	select SOUTHBRIDGE_AMD_AGESA_HUDSON
	select DEFAULT_POST_ON_LPC
	select EC_COMPAL_ENE932
	select HAVE_OPTION_TABLE
	select HAVE_ACPI_RESUME
	select HAVE_SMI_HANDLER
	select HAVE_ACPI_TABLES
	select BOARD_ROMSIZE_KB_4096
	select GFXUMA
	select NO_UART_ON_SUPERIO

config MAINBOARD_DIR
	string
	default "lenovo/g505s"

config MAINBOARD_PART_NUMBER
	string
	default "LENOVO G505S"

config HW_MEM_HOLE_SIZEK
	hex
	default 0x200000

config MAX_CPUS
	int
	default 4

config ONBOARD_VGA_IS_PRIMARY
	bool
	default y

config VGA_BIOS_ID
	string
	default "1002,990b"

config PAYLOAD_CONFIGFILE
	string
	default "\$(top)/src/mainboard/\$(MAINBOARDDIR)/config_seabios" if PAYLOAD_SEABIOS

endif # BOARD_LENOVO_G505S
```

## src/mainboard/lenovo/haswell/Kconfig
```kconfig
config BOARD_LENOVO_HASWELL_COMMON
	def_bool n
	select BOARD_ROMSIZE_KB_12288
	select EC_LENOVO_H8
	select EC_LENOVO_PMH7
	select H8_HAS_BAT_THRESHOLDS_IMPL
	select H8_HAS_PRIMARY_FN_KEYS
	select HAVE_ACPI_RESUME
	select HAVE_ACPI_TABLES
	select HAVE_CMOS_DEFAULT
	select HAVE_OPTION_TABLE
	select INTEL_GMA_HAVE_VBT
	select INTEL_INT15
	select MAINBOARD_HAS_LIBGFXINIT
	select MAINBOARD_HAS_TPM1
	select MAINBOARD_USES_IFD_GBE_REGION
	select MEMORY_MAPPED_TPM
	select NORTHBRIDGE_INTEL_HASWELL
	select NO_UART_ON_SUPERIO
	select SERIRQ_CONTINUOUS_MODE
	select SOUTHBRIDGE_INTEL_LYNXPOINT
	select SYSTEM_TYPE_LAPTOP

config BOARD_LENOVO_THINKPAD_T440P
	select BOARD_LENOVO_HASWELL_COMMON

if BOARD_LENOVO_HASWELL_COMMON

config VBOOT
	select GBB_FLAG_DISABLE_EC_SOFTWARE_SYNC
	select GBB_FLAG_DISABLE_FWMP
	select GBB_FLAG_DISABLE_LID_SHUTDOWN
	select GBB_FLAG_DISABLE_PD_SOFTWARE_SYNC
	select HAS_RECOVERY_MRC_CACHE
	select VBOOT_VBNV_CMOS

config VBOOT_SLOTS_RW_AB
	default y

config VBOOT_VBNV_OFFSET
	hex
	default 0x2a

config VARIANT_DIR
	default "t440p" if BOARD_LENOVO_THINKPAD_T440P

config DEVICETREE
	default "variants/\$(CONFIG_VARIANT_DIR)/devicetree.cb"

config FMDFILE
	default "src/mainboard/\$(CONFIG_MAINBOARD_DIR)/vboot-rwab.fmd" if VBOOT

config MAINBOARD_DIR
	default "lenovo/haswell"

config MAINBOARD_PART_NUMBER
	default "ThinkPad T440p" if BOARD_LENOVO_THINKPAD_T440P

config VGA_BIOS_ID
	string
	default "8086,0416"

config USBDEBUG_HCD_INDEX
	int
	default 2

config DRIVER_LENOVO_SERIALS
	bool
	default n

config PS2K_EISAID
	default "LEN0071"

config PS2M_EISAID
	default "LEN0036"

config THINKPADEC_HKEY_EISAID
	default "LEN0068"

endif
```

## src/mainboard/lenovo/haswell/Kconfig.name
```kconfig
## SPDX-License-Identifier: GPL-2.0-only

config BOARD_LENOVO_THINKPAD_T440P
	bool "ThinkPad T440p"

config BOARD_LENOVO_THINKPAD_W541
	bool "ThinkPad W541"
```

## src/mainboard/lenovo/l520/Kconfig
```kconfig
## SPDX-License-Identifier: GPL-2.0-only

if BOARD_LENOVO_L520

config BOARD_SPECIFIC_OPTIONS
	def_bool y
	select BOARD_ROMSIZE_KB_4096
	select DRIVER_LENOVO_SERIALS
	select EC_LENOVO_H8
	select EC_LENOVO_PMH7
	select HAVE_ACPI_RESUME
	select HAVE_ACPI_TABLES
	select INTEL_INT15
	select HAVE_OPTION_TABLE
	select HAVE_CMOS_DEFAULT
	select NORTHBRIDGE_INTEL_SANDYBRIDGE
	select MAINBOARD_HAS_LIBGFXINIT
	select GFX_GMA_PANEL_1_ON_LVDS
	select SERIRQ_CONTINUOUS_MODE
	select SOUTHBRIDGE_INTEL_BD82X6X
	select SYSTEM_TYPE_LAPTOP
	select USE_NATIVE_RAMINIT

config MAINBOARD_DIR
	default "lenovo/l520"

config MAINBOARD_PART_NUMBER
	default "ThinkPad L520"

config VGA_BIOS_ID
	string
	default "8086,0126"

config DRAM_RESET_GATE_GPIO
	int
	default 10

config USBDEBUG_HCD_INDEX
	int
	default 2

config PS2K_EISAID
	default "PNP0303"

config PS2M_EISAID
	default "LEN0017"

endif
```

## src/mainboard/lenovo/l520/Kconfig.name
```kconfig
## SPDX-License-Identifier: GPL-2.0-only

config BOARD_LENOVO_L520
	bool "ThinkPad L520"
```

## src/mainboard/lenovo/m720q_m920q/Kconfig
```kconfig
# SPDX-License-Identifier: GPL-2.0-only

if BOARD_LENOVO_M920Q || BOARD_LENOVO_M720Q

config BOARD_SPECIFIC_OPTIONS
	def_bool y
	select AZALIA_USE_LEGACY_VERB_TABLE
	select BOARD_ROMSIZE_KB_16384 if BOARD_LENOVO_M720Q
	select BOARD_ROMSIZE_KB_24576 if BOARD_LENOVO_M920Q
	select DRIVERS_UART_8250IO
	select HAVE_ACPI_RESUME
	select HAVE_ACPI_TABLES
	select HAVE_CMOS_DEFAULT
	select HAVE_OPTION_TABLE
	select INTEL_GMA_HAVE_VBT
	select MAINBOARD_HAS_LIBGFXINIT
	select MAINBOARD_HAS_TPM2
	select MAINBOARD_USES_IFD_GBE_REGION
	select MEMORY_MAPPED_TPM
	select SOC_INTEL_CANNONLAKE_PCH_H
	select SOC_INTEL_COFFEELAKE
	select SOC_INTEL_COMMON_BLOCK_HDA_VERB
	select SUPERIO_NUVOTON_NCT6687D

config MAINBOARD_DIR
	default "lenovo/m720q_m920q"

config MAINBOARD_PART_NUMBER
	default "ThinkCentre M720 Tiny" if BOARD_LENOVO_M720Q
	default "ThinkCentre M920 Tiny" if BOARD_LENOVO_M920Q

config CBFS_SIZE
	default 0x900000

endif
```

## src/mainboard/lenovo/m900/Kconfig.name
```kconfig
## SPDX-License-Identifier: GPL-2.0-only

config BOARD_LENOVO_M900
	bool "ThinkCentre M900"
```

## src/mainboard/lenovo/m900_tiny/Kconfig
```kconfig
# SPDX-License-Identifier: GPL-2.0-only

if BOARD_LENOVO_THINKCENTRE_M900_TINY

# TODO: fix and enable DRIVER_LENOVO_SERIALS
config BOARD_SPECIFIC_OPTIONS
	def_bool y
	select AZALIA_USE_LEGACY_VERB_TABLE
	select BOARD_ROMSIZE_KB_16384
	select DRIVERS_EFI_VARIABLE_STORE
	select DRIVERS_OPTION_CFR
	select DRIVERS_UART_8250IO
	select HAVE_ACPI_RESUME
	select HAVE_ACPI_TABLES
	select HAVE_CMOS_DEFAULT
	select HAVE_OPTION_TABLE
	select INTEL_GMA_HAVE_VBT
	select INTEL_INT15
	select MAINBOARD_HAS_LIBGFXINIT
	select MAINBOARD_HAS_TPM1
	select MAINBOARD_USES_IFD_GBE_REGION
	select MEMORY_MAPPED_TPM
	select SKYLAKE_SOC_PCH_H
	select SOC_INTEL_COMMON_BLOCK_HDA_VERB
	select SOC_INTEL_KABYLAKE
	select SUPERIO_NUVOTON_NCT6687D

config UART_FOR_CONSOLE
	default 2 if INTEL_LPSS_UART_FOR_CONSOLE
	default 0

config MAINBOARD_DIR
	default "lenovo/m900_tiny"

config MAINBOARD_PART_NUMBER
	default "ThinkCentre M700 / M900 Tiny"

config PRERAM_CBMEM_CONSOLE_SIZE
	default 0xd00

config DIMM_SPD_SIZE
	default 512 #DDR4

endif
```

## src/mainboard/lenovo/m900_tiny/Kconfig.name
```kconfig
# SPDX-License-Identifier: GPL-2.0-only

config BOARD_LENOVO_THINKCENTRE_M900_TINY
	bool "ThinkCentre M700 / M900 Tiny"
```

## src/mainboard/lenovo/m920q/Kconfig
```kconfig
# SPDX-License-Identifier: GPL-2.0-only

if BOARD_LENOVO_M920Q

config BOARD_SPECIFIC_OPTIONS
	def_bool y
	select AZALIA_USE_LEGACY_VERB_TABLE
	select BOARD_ROMSIZE_KB_24576
	select DRIVERS_UART_8250IO
	select HAVE_ACPI_RESUME
	select HAVE_ACPI_TABLES
	select HAVE_CMOS_DEFAULT
	select HAVE_OPTION_TABLE
	select INTEL_GMA_HAVE_VBT
	select MAINBOARD_HAS_LIBGFXINIT
	select MAINBOARD_HAS_TPM2
	select MAINBOARD_USES_IFD_GBE_REGION
	select MEMORY_MAPPED_TPM
	select SOC_INTEL_CANNONLAKE_PCH_H
	select SOC_INTEL_COFFEELAKE
	select SOC_INTEL_COMMON_BLOCK_HDA_VERB
	select SUPERIO_NUVOTON_NCT6687D

config MAINBOARD_DIR
	default "lenovo/m920q"

config MAINBOARD_PART_NUMBER
	default "ThinkCentre M920 Tiny"

config CBFS_SIZE
	default 0x900000

endif
```

## src/mainboard/lenovo/m920q/Kconfig.name
```kconfig
# SPDX-License-Identifier: GPL-2.0-only

config BOARD_LENOVO_M920Q
	bool "ThinkCentre M920 Tiny"
```

## src/mainboard/lenovo/r400/Kconfig
```kconfig
if BOARD_LENOVO_R400

config MAINBOARD_PART_NUMBER
	string
	default "ThinkPad R400"

# TODO: Remove this when platform ASL is fixed
config IASL_WARNINGS_ARE_ERRORS
	def_bool n

endif
```
