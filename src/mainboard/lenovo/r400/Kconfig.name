## src/mainboard/lenovo/t520/Kconfig
```kconfig
config BOARD_LENOVO_BASEBOARD_T520
	def_bool n
	select SYSTEM_TYPE_LAPTOP
	select NORTHBRIDGE_INTEL_SANDYBRIDGE
	select USE_NATIVE_RAMINIT
	select SOUTHBRIDGE_INTEL_BD82X6X
	select EC_LENOVO_PMH7
	select EC_LENOVO_H8
	select H8_HAS_BAT_THRESHOLDS_IMPL
	select NO_UART_ON_SUPERIO
	select BOARD_ROMSIZE_KB_8192
	select HAVE_ACPI_TABLES
	select HAVE_OPTION_TABLE
	select HAVE_CMOS_DEFAULT
	select HAVE_ACPI_RESUME
	select INTEL_INT15
	select GFX_GMA_PANEL_1_ON_LVDS
	select MAINBOARD_HAS_LIBGFXINIT
	select MEMORY_MAPPED_TPM
	select MAINBOARD_HAS_TPM1
	select DRIVERS_LENOVO_HYBRID_GRAPHICS
	select INTEL_GMA_HAVE_VBT if BOARD_LENOVO_T520
	select MAINBOARD_USES_IFD_GBE_REGION

	# Workaround for EC/KBC IRQ1.
	select SERIRQ_CONTINUOUS_MODE

if BOARD_LENOVO_BASEBOARD_T520

config VBOOT
	select VBOOT_VBNV_CMOS
	select GBB_FLAG_DISABLE_LID_SHUTDOWN
	select GBB_FLAG_DISABLE_PD_SOFTWARE_SYNC
	select GBB_FLAG_DISABLE_EC_SOFTWARE_SYNC
	select GBB_FLAG_DISABLE_FWMP
	select HAS_RECOVERY_MRC_CACHE

config VBOOT_SLOTS_RW_A
	default y

config VBOOT_VBNV_OFFSET
	hex
	default 0x2a

config VARIANT_DIR
	default "t520" if BOARD_LENOVO_T520
	default "w520" if BOARD_LENOVO_W520

config MAINBOARD_DIR
	default "lenovo/t520"

config OVERRIDE_DEVICETREE
	default "variants/\$(CONFIG_VARIANT_DIR)/overridetree.cb"

config FMDFILE
	default "src/mainboard/\$(CONFIG_MAINBOARD_DIR)/vboot-rwa.fmd" if VBOOT

config MAINBOARD_PART_NUMBER
	default "ThinkPad T520" if BOARD_LENOVO_T520
	default "ThinkPad W520" if BOARD_LENOVO_W520

config USBDEBUG_HCD_INDEX
	int
	default 2

config DRAM_RESET_GATE_GPIO
	int
	default 10

config VGA_BIOS_ID
	string
	default "8086,0126"

config PS2K_EISAID
	default "PNP0303"

config PS2M_EISAID
	default "LEN0015"

config THINKPADEC_HKEY_EISAID
	default "LEN0068"

endif
```

## src/mainboard/lenovo/t520/Kconfig.name
```kconfig
## SPDX-License-Identifier: GPL-2.0-only

config BOARD_LENOVO_T520
	bool "ThinkPad T520"

config BOARD_LENOVO_W520
	bool "ThinkPad W520"
```

## src/mainboard/lenovo/t530/Kconfig
```kconfig
config BOARD_LENOVO_BASEBOARD_T530
	def_bool n
	select BOARD_ROMSIZE_KB_12288
	select DRIVERS_LENOVO_HYBRID_GRAPHICS
	select EC_LENOVO_H8
	select EC_LENOVO_PMH7
	select GFX_GMA_PANEL_1_ON_LVDS
	select H8_HAS_BAT_THRESHOLDS_IMPL
	select HAVE_ACPI_RESUME
	select HAVE_ACPI_TABLES
	select HAVE_CMOS_DEFAULT
	select HAVE_OPTION_TABLE
	select INTEL_GMA_HAVE_VBT
	select INTEL_INT15
	select MAINBOARD_HAS_LIBGFXINIT
	select MAINBOARD_HAS_TPM1
	select MAINBOARD_USES_IFD_GBE_REGION
	select MEMORY_MAPPED_TPM
	select NO_UART_ON_SUPERIO
	select NORTHBRIDGE_INTEL_SANDYBRIDGE
	# Workaround for EC/KBC IRQ1.
	select SERIRQ_CONTINUOUS_MODE
	select SOUTHBRIDGE_INTEL_C216
	select SYSTEM_TYPE_LAPTOP
	select USE_NATIVE_RAMINIT

config BOARD_LENOVO_T530
	select BOARD_LENOVO_BASEBOARD_T530

config BOARD_LENOVO_W530
	select BOARD_LENOVO_BASEBOARD_T530
	select DRIVERS_RICOH_RCE822

if BOARD_LENOVO_BASEBOARD_T530

config VBOOT
	select GBB_FLAG_DISABLE_EC_SOFTWARE_SYNC
	select GBB_FLAG_DISABLE_FWMP
	select GBB_FLAG_DISABLE_LID_SHUTDOWN
	select GBB_FLAG_DISABLE_PD_SOFTWARE_SYNC
	select HAS_RECOVERY_MRC_CACHE
	select VBOOT_VBNV_CMOS

config VBOOT_SLOTS_RW_AB
	default y

config VBOOT_VBNV_OFFSET
	hex
	default 0x2a

config FMDFILE
	default "src/mainboard/\$(CONFIG_MAINBOARD_DIR)/vboot-rwab.fmd" if VBOOT

config VARIANT_DIR
	default "t530" if BOARD_LENOVO_T530
	default "w530" if BOARD_LENOVO_W530

config MAINBOARD_DIR
	default "lenovo/t530"

config OVERRIDE_DEVICETREE
	default "variants/\$(CONFIG_VARIANT_DIR)/overridetree.cb"

config MAINBOARD_PART_NUMBER
	default "ThinkPad T530" if BOARD_LENOVO_T530
	default "ThinkPad W530" if BOARD_LENOVO_W530

config USBDEBUG_HCD_INDEX
	int
	default 2

config DRAM_RESET_GATE_GPIO
	int
	default 10

config VGA_BIOS_ID
	string
	default "8086,0166"

config PS2K_EISAID
	default "LEN0071"

config PS2M_EISAID
	default "LEN0015"

config THINKPADEC_HKEY_EISAID
	default "LEN0068"

endif
```

## src/mainboard/lenovo/t530/Kconfig.name
```kconfig
config BOARD_LENOVO_T530
	bool "ThinkPad T530"

config BOARD_LENOVO_W530
	bool "ThinkPad W530"
```
