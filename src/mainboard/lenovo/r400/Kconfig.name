## src/mainboard/lenovo/s230u/Kconfig
```kconfig
if BOARD_LENOVO_S230U

config BOARD_SPECIFIC_OPTIONS
	def_bool y
	select BOARD_ROMSIZE_KB_12288
	select EC_ACPI
	select EC_COMPAL_ENE932
	select GFX_GMA_PANEL_1_ON_LVDS
	select HAVE_ACPI_RESUME
	select HAVE_ACPI_TABLES
	select HAVE_SPD_IN_CBFS
	select INTEL_INT15
	select MAINBOARD_HAS_LIBGFXINIT
	select MAINBOARD_HAS_TPM1
	select MEMORY_MAPPED_TPM
	select NO_UART_ON_SUPERIO
	select NORTHBRIDGE_INTEL_SANDYBRIDGE
	select SERIRQ_CONTINUOUS_MODE
	select SOUTHBRIDGE_INTEL_C216
	select SYSTEM_TYPE_LAPTOP
	select USE_NATIVE_RAMINIT

config MAINBOARD_DIR
	default "lenovo/s230u"

config MAINBOARD_PART_NUMBER
	default "ThinkPad S230U (Twist)"

config EC_BASE_ADDRESS
	hex
	default 0xff000000

config USBDEBUG_HCD_INDEX
	int
	default 1

config DRAM_RESET_GATE_GPIO
	int
	default 60

config VGA_BIOS_ID
	string
	default "8086,0166"

config PS2K_EISAID
	default "PTL0001"

config PS2M_EISAID
	default "LEN0031"

endif # BOARD_LENOVO_S230U
```

## src/mainboard/lenovo/s230u/Kconfig.name
```kconfig
## SPDX-License-Identifier: GPL-2.0-only

config BOARD_LENOVO_S230U
	bool "ThinkPad S230U (Twist)"
```

## src/mainboard/lenovo/sklkbl_thinkpad/Kconfig
```kconfig
# SPDX-License-Identifier: GPL-2.0-only

config BOARD_LENOVO_SKLKBL_THINKPAD_COMMON
	bool
	select BOARD_ROMSIZE_KB_16384
	select DRIVERS_OPTION_CFR_ENABLED if PAYLOAD_EDK2 && SMMSTORE
	select EC_LENOVO_H8
	select EC_LENOVO_MEC1653
	select EC_LENOVO_PMH7
	select H8_HAS_BAT_THRESHOLDS_IMPL
	select H8_HAS_LEDLOGO
	select H8_HAS_PRIMARY_FN_KEYS
	select H8_SUPPORT_BT_ON_WIFI
	select HAVE_ACPI_RESUME
	select HAVE_ACPI_TABLES
	select INTEL_GMA_HAVE_VBT
	select MAINBOARD_HAS_LIBGFXINIT
	select MAINBOARD_HAS_TPM2
	select MAINBOARD_USES_IFD_GBE_REGION
	select MEMORY_MAPPED_TPM
	select SOC_INTEL_COMMON_BLOCK_HDA_VERB
	select SOC_INTEL_KABYLAKE
	select SPD_READ_BY_WORD
	select SYSTEM_TYPE_LAPTOP

config BOARD_LENOVO_T480
	bool
	select BOARD_LENOVO_SKLKBL_THINKPAD_COMMON
	select MEC1653_HAS_DEBUG_UNLOCK
	select VARIANT_HAS_DGPU

config BOARD_LENOVO_T480S
	bool
	select BOARD_LENOVO_SKLKBL_THINKPAD_COMMON
	select VARIANT_HAS_DGPU

if BOARD_LENOVO_SKLKBL_THINKPAD_COMMON

config MAINBOARD_DIR
	default "lenovo/sklkbl_thinkpad"

config VARIANT_DIR
	default "t480" if BOARD_LENOVO_T480
	default "t480s" if BOARD_LENOVO_T480S

config OVERRIDE_DEVICETREE
	default "variants/\$(CONFIG_VARIANT_DIR)/overridetree.cb"

config MAINBOARD_PART_NUMBER
	default "T480" if BOARD_LENOVO_T480
	default "T480s" if BOARD_LENOVO_T480S

config CBFS_SIZE
	default 0x900000

config DIMM_MAX
	default 2

config DIMM_SPD_SIZE
	default 512	# DDR4

config CONSOLE_SERIAL
	default n

config NO_POST
	default y

config EDK2_BOOT_MANAGER_ESCAPE
	default y

config EDK2_FOLLOW_BGRT_SPEC
	default y

config EDK2_FULL_SCREEN_SETUP
	default n

config PS2K_EISAID
	default "LEN0071"

config PS2M_EISAID
	default "LEN0094"

config THINKPADEC_HKEY_EISAID
	default "LEN0268"

config MEC1653_DEBUG_UNLOCK_KEY
	default "7a41b149fe2101cf" if BOARD_LENOVO_T480

config VARIANT_HAS_DGPU
	bool

endif
```

## src/mainboard/lenovo/sklkbl_thinkpad/Kconfig.name
```kconfig
# SPDX-License-Identifier: GPL-2.0-only

config BOARD_LENOVO_T470S
	bool "ThinkPad T470s"

config BOARD_LENOVO_T480
	bool "ThinkPad T480"

config BOARD_LENOVO_T480S
	bool "ThinkPad T480s"

config BOARD_LENOVO_T580
	bool "ThinkPad T580"
```

## src/mainboard/lenovo/t400/Kconfig
```kconfig
if BOARD_LENOVO_T400 || BOARD_LENOVO_T500 || BOARD_LENOVO_R400 \
	|| BOARD_LENOVO_W500 || BOARD_LENOVO_R500

config BOARD_SPECIFIC_OPTIONS
	def_bool y
	select SYSTEM_TYPE_LAPTOP
	select CPU_INTEL_SOCKET_P
	select NORTHBRIDGE_INTEL_GM45
	select SOUTHBRIDGE_INTEL_I82801IX
	select EC_LENOVO_PMH7
	select EC_LENOVO_H8
	select H8_HAS_BAT_THRESHOLDS_IMPL
	select BOARD_ROMSIZE_KB_8192 if !BOARD_LENOVO_R500
	select BOARD_ROMSIZE_KB_4096 if BOARD_LENOVO_R500
	select HAVE_ACPI_TABLES
	select EC_ACPI
	select HAVE_OPTION_TABLE
	select HAVE_CMOS_DEFAULT
	select HAVE_ACPI_RESUME
	select INTEL_INT15
	select SUPERIO_NSC_PC87382
	select SUPERIO_NSC_PC87384
	select DRIVERS_LENOVO_HYBRID_GRAPHICS
	select MAINBOARD_HAS_LIBGFXINIT
	select MAINBOARD_USES_IFD_GBE_REGION if !BOARD_LENOVO_R500
	select INTEL_GMA_HAVE_VBT

config VBOOT
	select VBOOT_VBNV_CMOS
	select GBB_FLAG_DISABLE_LID_SHUTDOWN
	select GBB_FLAG_DISABLE_PD_SOFTWARE_SYNC
	select GBB_FLAG_DISABLE_EC_SOFTWARE_SYNC
	select GBB_FLAG_DISABLE_FWMP

config VBOOT_SLOTS_RW_A
	default y

config VBOOT_VBNV_OFFSET
	hex
	default 0x82

config FMDFILE
	default "src/mainboard/\$(CONFIG_MAINBOARD_DIR)/vboot-rwa.fmd" if VBOOT

config MAINBOARD_DIR
	default "lenovo/t400"

config VARIANT_DIR
	default "t400" if BOARD_LENOVO_T400 || BOARD_LENOVO_T500 \
		|| BOARD_LENOVO_R400 || BOARD_LENOVO_W500
	default "r500" if BOARD_LENOVO_R500

config MAINBOARD_PART_NUMBER
	default "ThinkPad T400" if BOARD_LENOVO_T400
	default "ThinkPad T500" if BOARD_LENOVO_T500
	default "ThinkPad R400" if BOARD_LENOVO_R400
	default "ThinkPad R500" if BOARD_LENOVO_R500
	default "ThinkPad W500" if BOARD_LENOVO_W500

config OVERRIDE_DEVICETREE
	default "variants/\$(CONFIG_VARIANT_DIR)/overridetree.cb"

config USBDEBUG_HCD_INDEX
	int
	default 2

config CBFS_SIZE
	default 0x200000

config PS2K_EISAID
	default "LEN0010"

config PS2M_EISAID
	default "IBM3780"

endif # BOARD_LENOVO_T400
```

## src/mainboard/lenovo/t400/Kconfig.name
```kconfig
config BOARD_LENOVO_T400
	bool "ThinkPad T400"

config BOARD_LENOVO_T500
	bool "ThinkPad T500"

config BOARD_LENOVO_R400
	bool "ThinkPad R400"

config BOARD_LENOVO_W500
	bool "ThinkPad W500"
```

## src/mainboard/lenovo/t410/Kconfig
```kconfig
if BOARD_LENOVO_T410

config BOARD_SPECIFIC_OPTIONS
	def_bool y
	select SYSTEM_TYPE_LAPTOP
	select NORTHBRIDGE_INTEL_IRONLAKE
	select SOUTHBRIDGE_INTEL_IBEXPEAK
	select EC_LENOVO_PMH7
	select EC_LENOVO_H8
	select NO_UART_ON_SUPERIO
	select HAVE_OPTION_TABLE
	select HAVE_CMOS_DEFAULT
	select BOARD_ROMSIZE_KB_8192
	select HAVE_ACPI_TABLES
	select INTEL_INT15
	select HAVE_ACPI_RESUME
	select DRIVERS_LENOVO_WACOM
	select MEMORY_MAPPED_TPM
	select MAINBOARD_HAS_TPM1
	select DRIVERS_LENOVO_HYBRID_GRAPHICS
	select INTEL_GMA_HAVE_VBT
	select MAINBOARD_USES_IFD_GBE_REGION
	select H8_HAS_BAT_TRESHOLDS_IMPL
	select MAINBOARD_HAS_LIBGFXINIT
	select DRIVERS_RICOH_RCE822

config VBOOT
	select VBOOT_VBNV_CMOS
	select GBB_FLAG_DISABLE_LID_SHUTDOWN
	select GBB_FLAG_DISABLE_PD_SOFTWARE_SYNC
	select GBB_FLAG_DISABLE_EC_SOFTWARE_SYNC
	select GBB_FLAG_DISABLE_FWMP
	select HAS_RECOVERY_MRC_CACHE

config VBOOT_SLOTS_RW_A
	default y

config VBOOT_VBNV_OFFSET
	hex
	default 0x2a

config CBFS_SIZE
	default 0x300000

config FMDFILE
	default "src/mainboard/\$(CONFIG_MAINBOARD_DIR)/vboot-rwa.fmd" if VBOOT

config MAINBOARD_DIR
	default "lenovo/t410"

config MAINBOARD_PART_NUMBER
	default "ThinkPad T410"

config USBDEBUG_HCD_INDEX
	int
	default 2

config MAX_CPUS
	int
	default 8

config DRAM_RESET_GATE_GPIO
	int
	default 10

config PS2K_EISAID
	default "PNP0303"

config PS2M_EISAID
	default "LEN0015"

endif
```

## src/mainboard/lenovo/t420/Kconfig
```kconfig
if BOARD_LENOVO_T420

config BOARD_SPECIFIC_OPTIONS # dummy
	def_bool y
	select SYSTEM_TYPE_LAPTOP
	select CPU_INTEL_SOCKET_RPGA988B
	select NORTHBRIDGE_INTEL_SANDYBRIDGE
	select USE_NATIVE_RAMINIT
	select SOUTHBRIDGE_INTEL_BD82X6X
	select EC_LENOVO_PMH7
	select EC_LENOVO_H8
	select NO_UART_ON_SUPERIO
	select BOARD_ROMSIZE_KB_8192
	select HAVE_ACPI_TABLES
	select HAVE_OPTION_TABLE
	select HAVE_CMOS_DEFAULT
	select HAVE_ACPI_RESUME
	select INTEL_INT15
	select SANDYBRIDGE_IVYBRIDGE_LVDS
	select ENABLE_VMX
	select DRIVERS_RICOH_RCE822
	select MAINBOARD_HAS_LPC_TPM
	select MAINBOARD_HAS_TPM1
	select MAINBOARD_HAS_LIBGFXINIT
	select GFX_GMA_INTERNAL_IS_LVDS
	select DRIVERS_LENOVO_HYBRID_GRAPHICS
	select INTEL_GMA_HAVE_VBT

	# Workaround for EC/KBC IRQ1.
	select SERIRQ_CONTINUOUS_MODE

config MAINBOARD_DIR
	string
	default lenovo/t420

config MAINBOARD_PART_NUMBER
	string
	default "ThinkPad T420"

config MAX_CPUS
	int
	default 8

config USBDEBUG_HCD_INDEX
	int
	default 2

config DRAM_RESET_GATE_GPIO
	int
	default 10

config VGA_BIOS_FILE
	string
	default "pci8086,0126.rom"

config VGA_BIOS_ID
	string
	default "8086,0126"

config MAINBOARD_PCI_SUBSYSTEM_VENDOR_ID
	hex
	default 0x17aa

config MAINBOARD_PCI_SUBSYSTEM_DEVICE_ID
	hex
	default 0x21ce

config ONBOARD_VGA_IS_PRIMARY
	bool
	default y

endif # BOARD_LENOVO_T420
```

## src/mainboard/lenovo/t420/Kconfig.name
```kconfig
## SPDX-License-Identifier: GPL-2.0-only

config BOARD_LENOVO_T420
	bool "ThinkPad T420"
```

## src/mainboard/lenovo/t420s/Kconfig
```kconfig
if BOARD_LENOVO_T420S

config BOARD_SPECIFIC_OPTIONS
	def_bool y
	select BOARD_ROMSIZE_KB_8192
	select DRIVERS_LENOVO_HYBRID_GRAPHICS
	select EC_LENOVO_H8
	select EC_LENOVO_PMH7
	select GFX_GMA_PANEL_1_ON_LVDS
	select H8_HAS_BAT_THRESHOLDS_IMPL
	select HAVE_ACPI_RESUME
	select HAVE_ACPI_TABLES
	select HAVE_CMOS_DEFAULT
	select HAVE_OPTION_TABLE
	select INTEL_GMA_HAVE_VBT
	select INTEL_INT15
	select MAINBOARD_HAS_LIBGFXINIT
	select MAINBOARD_HAS_TPM1
	select MAINBOARD_USES_IFD_GBE_REGION
	select MEMORY_MAPPED_TPM
	select NO_UART_ON_SUPERIO
	select NORTHBRIDGE_INTEL_SANDYBRIDGE
	# Workaround for EC/KBC IRQ1.
	select SERIRQ_CONTINUOUS_MODE
	select SOUTHBRIDGE_INTEL_BD82X6X
	select SYSTEM_TYPE_LAPTOP
	select USE_NATIVE_RAMINIT

config VBOOT
	select GBB_FLAG_DISABLE_EC_SOFTWARE_SYNC
	select GBB_FLAG_DISABLE_FWMP
	select GBB_FLAG_DISABLE_LID_SHUTDOWN
	select GBB_FLAG_DISABLE_PD_SOFTWARE_SYNC
	select HAS_RECOVERY_MRC_CACHE
	select VBOOT_VBNV_CMOS

config VBOOT_SLOTS_RW_A
	default y

config VBOOT_VBNV_OFFSET
	hex
	default 0x2a

config FMDFILE
	default "src/mainboard/\$(CONFIG_MAINBOARD_DIR)/vboot-rwa.fmd" if VBOOT

config MAINBOARD_DIR
	default "lenovo/t420s"

config MAINBOARD_PART_NUMBER
	default "ThinkPad T420s"

config USBDEBUG_HCD_INDEX
	int
	default 2

config DRAM_RESET_GATE_GPIO
	int
	default 10

config VGA_BIOS_ID
	string
	default "8086,0126"

config PS2K_EISAID
	default "PNP0303"

config PS2M_EISAID
	default "LEN0015"

endif # BOARD_LENOVO_T420S
```

## src/mainboard/lenovo/t420s/Kconfig.name
```kconfig
## SPDX-License-Identifier: GPL-2.0-only

config BOARD_LENOVO_T420S
	bool "ThinkPad T420s"
```

## src/mainboard/lenovo/t430/Kconfig
```kconfig
if BOARD_LENOVO_THINKPAD_T430

config BOARD_SPECIFIC_OPTIONS
	def_bool y
	select BOARD_ROMSIZE_KB_12288
	select DRIVERS_LENOVO_HYBRID_GRAPHICS
	select DRIVERS_RICOH_RCE822
	select EC_LENOVO_H8
	select EC_LENOVO_PMH7
	select GFX_GMA_PANEL_1_ON_LVDS
	select H8_HAS_BAT_THRESHOLDS_IMPL
	select HAVE_ACPI_RESUME
	select HAVE_ACPI_TABLES
	select HAVE_CMOS_DEFAULT
	select HAVE_OPTION_TABLE
	select INTEL_GMA_HAVE_VBT
	select INTEL_INT15
	select MAINBOARD_HAS_LIBGFXINIT
	select MAINBOARD_HAS_TPM1
	select MAINBOARD_USES_IFD_GBE_REGION
	select MEMORY_MAPPED_TPM
	select NO_UART_ON_SUPERIO
	select NORTHBRIDGE_INTEL_SANDYBRIDGE
	select SERIRQ_CONTINUOUS_MODE
	select SOUTHBRIDGE_INTEL_C216
	select SYSTEM_TYPE_LAPTOP
	select USE_NATIVE_RAMINIT

config VBOOT
	select GBB_FLAG_DISABLE_EC_SOFTWARE_SYNC
	select GBB_FLAG_DISABLE_FWMP
	select GBB_FLAG_DISABLE_LID_SHUTDOWN
	select GBB_FLAG_DISABLE_PD_SOFTWARE_SYNC
	select HAS_RECOVERY_MRC_CACHE
	select VBOOT_VBNV_CMOS

config VBOOT_SLOTS_RW_AB
	default y

config VBOOT_VBNV_OFFSET
	hex
	default 0x2a

config FMDFILE
	default "src/mainboard/\$(CONFIG_MAINBOARD_DIR)/vboot-rwab.fmd" if VBOOT

config MAINBOARD_DIR
	default "lenovo/t430"

config MAINBOARD_PART_NUMBER
	default "ThinkPad T430"

config VGA_BIOS_ID
	string
	default "8086,0166"

config DRAM_RESET_GATE_GPIO
	int
	default 10

config USBDEBUG_HCD_INDEX
	int
	default 2

config PS2K_EISAID
	default "PNP0303"

config PS2M_EISAID
	default "LEN0015"

config THINKPADEC_HKEY_EISAID
	default "LEN0068"

endif
```

## src/mainboard/lenovo/t430/Kconfig.name
```kconfig
## SPDX-License-Identifier: GPL-2.0-only

config BOARD_LENOVO_THINKPAD_T430
	bool "ThinkPad T430"
```

## src/mainboard/lenovo/t430s/Kconfig
```kconfig
if BOARD_LENOVO_T430S || BOARD_LENOVO_T431S

config BOARD_SPECIFIC_OPTIONS
	def_bool y
	select SYSTEM_TYPE_LAPTOP
	select NORTHBRIDGE_INTEL_SANDYBRIDGE
	select USE_NATIVE_RAMINIT
	select SOUTHBRIDGE_INTEL_C216
	select EC_LENOVO_PMH7
	select EC_LENOVO_H8
	select H8_HAS_BAT_THRESHOLDS_IMPL
	select H8_HAS_PRIMARY_FN_KEYS if BOARD_LENOVO_T431S
	select NO_UART_ON_SUPERIO
	select BOARD_ROMSIZE_KB_16384
	select HAVE_ACPI_TABLES
	select HAVE_OPTION_TABLE
	select HAVE_CMOS_DEFAULT
	select HAVE_ACPI_RESUME
	select INTEL_INT15
	select MEMORY_MAPPED_TPM
	select MAINBOARD_HAS_TPM1
	select MAINBOARD_HAS_LIBGFXINIT
	select GFX_GMA_PANEL_1_ON_LVDS if BOARD_LENOVO_T430S
	select INTEL_GMA_HAVE_VBT
	select MAINBOARD_USES_IFD_GBE_REGION
	select DRIVERS_RICOH_RCE822 if BOARD_LENOVO_T431S
	select HAVE_SPD_IN_CBFS if BOARD_LENOVO_T431S

	# Workaround for EC/KBC IRQ1.
	select SERIRQ_CONTINUOUS_MODE

config VBOOT
	select VBOOT_VBNV_CMOS
	select GBB_FLAG_DISABLE_LID_SHUTDOWN
	select GBB_FLAG_DISABLE_PD_SOFTWARE_SYNC
	select GBB_FLAG_DISABLE_EC_SOFTWARE_SYNC
	select GBB_FLAG_DISABLE_FWMP
	select HAS_RECOVERY_MRC_CACHE

config VBOOT_SLOTS_RW_AB
	default y

config VBOOT_VBNV_OFFSET
	hex
	default 0x2a

config FMDFILE
	default "src/mainboard/\$(CONFIG_MAINBOARD_DIR)/vboot-rwab.fmd" if VBOOT

config MAINBOARD_DIR
	default "lenovo/t430s"

config VARIANT_DIR
	default "t430s" if BOARD_LENOVO_T430S
	default "t431s" if BOARD_LENOVO_T431S

config MAINBOARD_PART_NUMBER
	default "ThinkPad T430s" if BOARD_LENOVO_T430S
	default "ThinkPad T431s" if BOARD_LENOVO_T431S

config OVERRIDE_DEVICETREE
	default "variants/\$(CONFIG_VARIANT_DIR)/overridetree.cb"

config USBDEBUG_HCD_INDEX
	int
	default 2

config DRAM_RESET_GATE_GPIO
	int
	default 10

config ONBOARD_VGA_IS_PRIMARY
	bool
	default y

config PS2K_EISAID
	default "PNP0303"

config PS2M_EISAID
	default "LEN0015"

endif # BOARD_LENOVO_T430S || BOARD_LENOVO_T431S
```

## src/mainboard/lenovo/t430s/Kconfig.name
```kconfig
## SPDX-License-Identifier: GPL-2.0-only

config BOARD_LENOVO_T430S
	bool "ThinkPad T430s"

config BOARD_LENOVO_T431S
	bool "ThinkPad T431s"
```

## src/mainboard/lenovo/t440p/Kconfig
```kconfig
if BOARD_LENOVO_THINKPAD_T440P

config BOARD_SPECIFIC_OPTIONS
	def_bool y
	select BOARD_ROMSIZE_KB_12288
	select EC_LENOVO_H8
	select H8_HAS_PRIMARY_FN_KEYS
	select EC_LENOVO_PMH7
	select NO_UART_ON_SUPERIO
	select HAVE_ACPI_RESUME
	select HAVE_ACPI_TABLES
	select HAVE_OPTION_TABLE
	select HAVE_CMOS_DEFAULT
	select MAINBOARD_HAS_LPC_TPM
	select MAINBOARD_HAS_TPM1
	select INTEL_GMA_HAVE_VBT
	select INTEL_INT15
	select MAINBOARD_HAS_LIBGFXINIT
	select NORTHBRIDGE_INTEL_HASWELL
	select SERIRQ_CONTINUOUS_MODE
	select SOUTHBRIDGE_INTEL_LYNXPOINT
	select SYSTEM_TYPE_LAPTOP
	select MAINBOARD_USES_IFD_GBE_REGION
	select H8_HAS_BAT_TRESHOLDS_IMPL

config VBOOT
	select VBOOT_VBNV_CMOS
	select GBB_FLAG_DISABLE_LID_SHUTDOWN
	select GBB_FLAG_DISABLE_PD_SOFTWARE_SYNC
	select GBB_FLAG_DISABLE_EC_SOFTWARE_SYNC
	select GBB_FLAG_DISABLE_FWMP
	select HAS_RECOVERY_MRC_CACHE

config VBOOT_SLOTS_RW_AB
	default y

config VBOOT_VBNV_OFFSET
	hex
	default 0x2a

config FMDFILE
	string
	default "src/mainboard/\$(CONFIG_MAINBOARD_DIR)/vboot-rwab.fmd" if VBOOT

config MAINBOARD_DIR
	string
	default "lenovo/t440p"

config MAINBOARD_PART_NUMBER
	string
	default "ThinkPad T440p"

config VGA_BIOS_FILE
	string
	default "pci8086,0416.rom"

config VGA_BIOS_ID
	string
	default "8086,0416"

config USBDEBUG_HCD_INDEX
	int
	default 2

config DRIVER_LENOVO_SERIALS
	bool
	default n

config PS2K_EISAID
	default "LEN0071"

config PS2M_EISAID
	default "LEN0036"

config THINKPADEC_HKEY_EISAID
	default "LEN0068"

endif
```

## src/mainboard/lenovo/t500/Kconfig
```kconfig
if BOARD_LENOVO_T500

config MAINBOARD_PART_NUMBER
	string
	default "ThinkPad T500"

endif
```
