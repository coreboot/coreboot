## src/mainboard/lenovo/t540p/Kconfig
```kconfig
if BOARD_LENOVO_THINKPAD_T540P

config BOARD_SPECIFIC_OPTIONS
	def_bool y
	select BOARD_ROMSIZE_KB_2048 # FIXME: correct this
	select CPU_INTEL_HASWELL
	select EC_LENOVO_H8
	select EC_LENOVO_PMH7
	select HAVE_ACPI_RESUME
	select HAVE_ACPI_TABLES
	select INTEL_INT15
	select MAINBOARD_HAS_LIBGFXINIT # FIXME: check this
	select NORTHBRIDGE_INTEL_HASWELL
	select SERIRQ_CONTINUOUS_MODE
	select SOUTHBRIDGE_INTEL_LYNXPOINT
	select SYSTEM_TYPE_LAPTOP

config MAINBOARD_DIR
	string
	default lenovo/t540p

config MAINBOARD_PART_NUMBER
	string
	default "ThinkPad T540p"

config VGA_BIOS_FILE
	string
	default "pci8086,0416.rom"

config VGA_BIOS_ID
	string
	default "8086,0416"

config MAX_CPUS
	int
	default 8

config USBDEBUG_HCD_INDEX # FIXME: check this
	int
	default 2
endif
```

## src/mainboard/lenovo/t60/Kconfig
```kconfig
## SPDX-License-Identifier: GPL-2.0-only

if BOARD_LENOVO_T60 || BOARD_LENOVO_Z61T || BOARD_LENOVO_R60

config BOARD_SPECIFIC_OPTIONS
	def_bool y
	select SYSTEM_TYPE_LAPTOP
	select CPU_INTEL_SOCKET_M
	select NORTHBRIDGE_INTEL_I945
	select NORTHBRIDGE_INTEL_SUBTYPE_I945GM
	select SOUTHBRIDGE_INTEL_I82801GX
	select SUPERIO_NSC_PC87382
	select SUPERIO_NSC_PC87384
	select SOUTHBRIDGE_TI_PCI1X2X
	select EC_LENOVO_PMH7
	select EC_LENOVO_H8
	select DRIVERS_I2C_CK505
	select DRIVER_LENOVO_SERIALS
	select HAVE_OPTION_TABLE
	select INTEL_INT15
	select HAVE_MP_TABLE
	select BOARD_ROMSIZE_KB_2048
	select HAVE_ACPI_TABLES
	select HAVE_ACPI_RESUME
	select HAVE_CMOS_DEFAULT
	select I945_LVDS
	select INTEL_GMA_HAVE_VBT

config MAINBOARD_DIR
	default "lenovo/t60"

config VARIANT_DIR
	default "t60" if BOARD_LENOVO_T60 || BOARD_LENOVO_R60
	default "z61t" if BOARD_LENOVO_Z61T

config OVERRIDE_DEVICETREE
	default "variants/\$(CONFIG_VARIANT_DIR)/overridetree.cb"

config MAINBOARD_PART_NUMBER
	default "ThinkPad T60" if BOARD_LENOVO_T60
	default "ThinkPad Z61t" if BOARD_LENOVO_Z61T
	default "ThinkPad R60" if BOARD_LENOVO_R60

config MAX_CPUS
	int
	default 2

config PS2K_EISAID
	default "PNP0303" if BOARD_LENOVO_T60
	default "PNP0303" if BOARD_LENOVO_R60

config PS2M_EISAID
	default "IBM0057" if BOARD_LENOVO_T60
	default "IBM0057" if BOARD_LENOVO_R60

endif # BOARD_LENOVO_T60 || BOARD_LENOVO_Z61T || BOARD_LENOVO_R60
```

## src/mainboard/lenovo/t60/Kconfig.name
```kconfig
## SPDX-License-Identifier: GPL-2.0-only

config BOARD_LENOVO_T60
	bool "ThinkPad T60 / T60p"

config BOARD_LENOVO_Z61T
	bool "ThinkPad Z61t"

config BOARD_LENOVO_R60
	bool "ThinkPad R60"
```

## src/mainboard/lenovo/thinkcentre_a58/Kconfig
```kconfig
# SPDX-License-Identifier: GPL-2.0-only

if BOARD_LENOVO_THINKCENTRE_A58

config BOARD_SPECIFIC_OPTIONS
	def_bool y
	select AZALIA_USE_LEGACY_VERB_TABLE
	select CPU_INTEL_SOCKET_LGA775
	select NORTHBRIDGE_INTEL_X4X
	select SOUTHBRIDGE_INTEL_I82801GX
	select SUPERIO_SMSC_SMSCSUPERIO
	select HAVE_ACPI_TABLES
	select BOARD_ROMSIZE_KB_1024
	select HAVE_OPTION_TABLE
	select HAVE_CMOS_DEFAULT
	select HAVE_ACPI_RESUME
	select DRIVERS_I2C_CK505
	select DRIVER_LENOVO_SERIALS
	select INTEL_GMA_HAVE_VBT
	select MAINBOARD_HAS_LIBGFXINIT

config MAINBOARD_DIR
	default "lenovo/thinkcentre_a58"

config MAINBOARD_PART_NUMBER
	default "ThinkCentre A58"

endif # BOARD_LENOVO_THINKCENTRE_A58
```

## src/mainboard/lenovo/thinkcentre_a58/Kconfig.name
```kconfig
## SPDX-License-Identifier: GPL-2.0-only

config BOARD_LENOVO_THINKCENTRE_A58
	bool "ThinkCentre A58 (L-IG41M)"
```

## src/mainboard/lenovo/thinkcentre_m710s/Kconfig
```kconfig
# SPDX-License-Identifier: GPL-2.0-only

if BOARD_LENOVO_THINKCENTRE_M710S

config BOARD_SPECIFIC_OPTIONS
	def_bool y
	select AZALIA_USE_LEGACY_VERB_TABLE
	select BOARD_ROMSIZE_KB_8192
	select DRIVERS_USB_ACPI
	select HAVE_ACPI_RESUME
	select HAVE_ACPI_TABLES
	select INTEL_GMA_HAVE_VBT
	select MAINBOARD_HAS_LIBGFXINIT
	select MAINBOARD_HAS_TPM2
	select MEMORY_MAPPED_TPM
	select SKYLAKE_SOC_PCH_H
	select SOC_INTEL_COMMON_BLOCK_HDA_VERB
	select SOC_INTEL_KABYLAKE
	select SUPERIO_ITE_IT8629E

config MAINBOARD_DIR
	default "lenovo/thinkcentre_m710s"

config MAINBOARD_PART_NUMBER
	default "ThinkCentre M710s"

endif # BOARD_LENOVO_THINKCENTRE_M710S
```

## src/mainboard/lenovo/thinkcentre_m710s/Kconfig.name
```kconfig
# SPDX-License-Identifier: GPL-2.0-only

config BOARD_LENOVO_THINKCENTRE_M710S
	bool "ThinkCentre M710s"
```

## src/mainboard/lenovo/w500/Kconfig
```kconfig
if BOARD_LENOVO_W500

config MAINBOARD_PART_NUMBER
	string
	default "ThinkPad W500"

endif
```

## src/mainboard/lenovo/w541/Kconfig
```kconfig
if BOARD_LENOVO_THINKPAD_W541

config BOARD_SPECIFIC_OPTIONS
	def_bool y
	select BOARD_ROMSIZE_KB_12288
	select EC_LENOVO_H8
	select EC_LENOVO_PMH7
	select H8_HAS_BAT_THRESHOLDS_IMPL
	select H8_HAS_PRIMARY_FN_KEYS
	select HAVE_ACPI_RESUME
	select HAVE_ACPI_TABLES
	select HAVE_CMOS_DEFAULT
	select HAVE_OPTION_TABLE
	select INTEL_GMA_HAVE_VBT
	select MAINBOARD_HAS_LIBGFXINIT
	select MAINBOARD_HAS_TPM1
	select MAINBOARD_USES_IFD_GBE_REGION
	select MEMORY_MAPPED_TPM
	select NORTHBRIDGE_INTEL_HASWELL
	select NO_UART_ON_SUPERIO
	select SERIRQ_CONTINUOUS_MODE
	select SOUTHBRIDGE_INTEL_LYNXPOINT
	select SYSTEM_TYPE_LAPTOP

config GFX_GMA_PANEL_1_PORT
	default "DP3"

config MAINBOARD_DIR
	default "lenovo/w541"

config MAINBOARD_PART_NUMBER
	default "ThinkPad W541"

config DRIVER_LENOVO_SERIALS
	bool
	default n

config PS2K_EISAID
	default "LEN0071"

config PS2M_EISAID
	default "LEN004A"

config THINKPADEC_HKEY_EISAID
	default "LEN0068"

endif
```

## src/mainboard/lenovo/x131e/Kconfig
```kconfig
if BOARD_LENOVO_X131E

config BOARD_SPECIFIC_OPTIONS
	def_bool y
	select BOARD_ROMSIZE_KB_12288
	select EC_LENOVO_H8
	select GFX_GMA_PANEL_1_ON_LVDS
	select HAVE_ACPI_RESUME
	select HAVE_ACPI_TABLES
	select HAVE_CMOS_DEFAULT
	select HAVE_OPTION_TABLE
	select INTEL_GMA_HAVE_VBT
	select INTEL_INT15
	select MAINBOARD_HAS_LIBGFXINIT
	select MAINBOARD_HAS_TPM1
	select MEMORY_MAPPED_TPM
	select NO_UART_ON_SUPERIO
	select NORTHBRIDGE_INTEL_SANDYBRIDGE
	select SERIRQ_CONTINUOUS_MODE
	select SOUTHBRIDGE_INTEL_C216
	select SYSTEM_TYPE_LAPTOP
	select USE_NATIVE_RAMINIT

config VBOOT
	select GBB_FLAG_DISABLE_EC_SOFTWARE_SYNC
	select GBB_FLAG_DISABLE_FWMP
	select GBB_FLAG_DISABLE_LID_SHUTDOWN
	select GBB_FLAG_DISABLE_PD_SOFTWARE_SYNC
	select HAS_RECOVERY_MRC_CACHE
	select VBOOT_VBNV_CMOS

config VBOOT_SLOTS_RW_AB
	default y

config VBOOT_VBNV_OFFSET
	hex
	default 0x2a

config FMDFILE
	default "src/mainboard/\$(CONFIG_MAINBOARD_DIR)/vboot-rwab.fmd" if VBOOT

config MAINBOARD_DIR
	default "lenovo/x131e"

config MAINBOARD_PART_NUMBER
	default "ThinkPad X131e"

config MAX_CPUS
	int
	default 4

config USBDEBUG_HCD_INDEX
	int
	default 2

config PS2K_EISAID
	default "MSF0001"

config PS2M_EISAID
	default "LEN0026"

endif # BOARD_LENOVO_X131E
```

## src/mainboard/lenovo/x131e/Kconfig.name
```kconfig
## SPDX-License-Identifier: GPL-2.0-only

config BOARD_LENOVO_X131E
	bool "ThinkPad X131e"
```

## src/mainboard/lenovo/x1_carbon_gen1/Kconfig.name
```kconfig
## SPDX-License-Identifier: GPL-2.0-only

config BOARD_LENOVO_X1_CARBON_GEN1
	bool "ThinkPad X1 carbon gen 1"
```

## src/mainboard/lenovo/x200/Kconfig
```kconfig
if BOARD_LENOVO_X200 || BOARD_LENOVO_X301

config BOARD_SPECIFIC_OPTIONS
	def_bool y
	select SYSTEM_TYPE_LAPTOP
	select CPU_INTEL_SOCKET_BGA956
	select NORTHBRIDGE_INTEL_GM45
	select SOUTHBRIDGE_INTEL_I82801IX
	select EC_LENOVO_PMH7
	select EC_LENOVO_H8
	select H8_HAS_BAT_THRESHOLDS_IMPL
	select NO_UART_ON_SUPERIO
	select BOARD_ROMSIZE_KB_8192
	select DRIVERS_GENERIC_IOAPIC
	select HAVE_MP_TABLE
	select HAVE_ACPI_TABLES
	select EC_ACPI
	select HAVE_OPTION_TABLE
	select HAVE_CMOS_DEFAULT
	select HAVE_ACPI_RESUME
	select INTEL_INT15
	select SUPERIO_NSC_PC87382
	select DRIVERS_LENOVO_WACOM
	select MAINBOARD_HAS_LIBGFXINIT
	select MAINBOARD_USES_IFD_GBE_REGION

config VBOOT
	select VBOOT_VBNV_CMOS
	select GBB_FLAG_DISABLE_LID_SHUTDOWN
	select GBB_FLAG_DISABLE_PD_SOFTWARE_SYNC
	select GBB_FLAG_DISABLE_EC_SOFTWARE_SYNC
	select GBB_FLAG_DISABLE_FWMP

config VBOOT_SLOTS_RW_A
	default y

config VBOOT_VBNV_OFFSET
	hex
	default 0x82

config FMDFILE
	default "src/mainboard/\$(CONFIG_MAINBOARD_DIR)/vboot-rwa.fmd" if VBOOT

config MAINBOARD_DIR
	default "lenovo/x200"

config VARIANT_DIR
	default "x200" if BOARD_LENOVO_X200
	default "x301" if BOARD_LENOVO_X301

config MAINBOARD_PART_NUMBER
	default "ThinkPad X200" if BOARD_LENOVO_X200
	default "ThinkPad X301" if BOARD_LENOVO_X301

config OVERRIDE_DEVICETREE
	default "variants/\$(CONFIG_VARIANT_DIR)/overridetree.cb"

config USBDEBUG_HCD_INDEX
	int
	default 2

config CBFS_SIZE
	default 0x200000

config PS2K_EISAID
	default "LEN0010" if BOARD_LENOVO_X200

config PS2M_EISAID
	default "IBM3780" if BOARD_LENOVO_X200

endif # BOARD_LENOVO_X200 || BOARD_LENOVO_X301
```

## src/mainboard/lenovo/x200/Kconfig.name
```kconfig
config BOARD_LENOVO_X200
	bool "ThinkPad X200 / X200s / X200t"

config BOARD_LENOVO_X301
	bool "ThinkPad X301"
```

## src/mainboard/lenovo/x201/Kconfig
```kconfig
if BOARD_LENOVO_X201

config BOARD_SPECIFIC_OPTIONS
	def_bool y
	select SYSTEM_TYPE_LAPTOP
	select NORTHBRIDGE_INTEL_IRONLAKE
	select SOUTHBRIDGE_INTEL_IBEXPEAK
	select EC_LENOVO_PMH7
	select EC_LENOVO_H8
	select NO_UART_ON_SUPERIO
	select HAVE_OPTION_TABLE
	select HAVE_CMOS_DEFAULT
	select BOARD_ROMSIZE_KB_8192
	select HAVE_ACPI_TABLES
	select INTEL_INT15
	select HAVE_ACPI_RESUME
	select MAINBOARD_HAS_LIBGFXINIT
	select SUPERIO_NSC_PC87382
	select DRIVERS_LENOVO_WACOM
	select MEMORY_MAPPED_TPM
	select MAINBOARD_HAS_TPM1
	select INTEL_GMA_HAVE_VBT
	select MAINBOARD_USES_IFD_GBE_REGION
	select H8_HAS_BAT_TRESHOLDS_IMPL

config VBOOT
	select VBOOT_VBNV_CMOS
	select GBB_FLAG_DISABLE_LID_SHUTDOWN
	select GBB_FLAG_DISABLE_PD_SOFTWARE_SYNC
	select GBB_FLAG_DISABLE_EC_SOFTWARE_SYNC
	select GBB_FLAG_DISABLE_FWMP
	select HAS_RECOVERY_MRC_CACHE

config VBOOT_SLOTS_RW_A
	default y

config VBOOT_VBNV_OFFSET
	hex
	default 0x2a

config FMDFILE
	default "src/mainboard/\$(CONFIG_MAINBOARD_DIR)/vboot-rwa.fmd" if VBOOT

config MAINBOARD_DIR
	default "lenovo/x201"

config MAINBOARD_PART_NUMBER
	default "ThinkPad X201"

config USBDEBUG_HCD_INDEX
	int
	default 2

config DRAM_RESET_GATE_GPIO
	int
	default 10

# Without the Intel ME's EFFS partition some PCIe devices (like the USB and SATA
# controllers) don't work as expected
config ME_CLEANER_ARGS
	string
	default "-S -w EFFS"

config PS2K_EISAID
	default "PNP0303"

config PS2M_EISAID
	default "LEN0018"

endif
```

## src/mainboard/lenovo/x201/Kconfig.name
```kconfig
## SPDX-License-Identifier: GPL-2.0-only

config BOARD_LENOVO_X201
	bool "ThinkPad X201 / X201i / X201s / X201t"
```

## src/mainboard/lenovo/x201t/Kconfig
```kconfig
if BOARD_LENOVO_X201T

config TABLET_SPECIFIC_OPTIONS # dummy
	def_bool y
	select SUPERIO_NSC_PC87382
	# Following ones are for scripts benefit
	select ARCH_X86
	select NORTHBRIDGE_INTEL_NEHALEM
	select SOUTHBRIDGE_INTEL_IBEXPEAK
	select EC_LENOVO_PMH7
	select EC_LENOVO_H8
	select DRIVERS_ICS_954309

config MAINBOARD_PART_NUMBER
	string
	default "0831CTO"

config MAINBOARD_VERSION
	string
	default "ThinkPad X201 Tablet"

endif
```

## src/mainboard/lenovo/x220/Kconfig
```kconfig
if BOARD_LENOVO_X220 || BOARD_LENOVO_X220I || BOARD_LENOVO_X1

config BOARD_SPECIFIC_OPTIONS
	def_bool y
	select BOARD_ROMSIZE_KB_8192
	select DRIVERS_RICOH_RCE822
	select EC_LENOVO_H8
	select EC_LENOVO_PMH7
	select GFX_GMA_PANEL_1_ON_LVDS
	select H8_HAS_BAT_THRESHOLDS_IMPL
	select HAVE_ACPI_RESUME
	select HAVE_ACPI_TABLES
	select HAVE_CMOS_DEFAULT
	select HAVE_OPTION_TABLE
	select INTEL_GMA_HAVE_VBT
	select INTEL_INT15
	select MAINBOARD_HAS_LIBGFXINIT
	select MAINBOARD_HAS_TPM1
	select MAINBOARD_USES_IFD_GBE_REGION
	select MEMORY_MAPPED_TPM
	select NO_UART_ON_SUPERIO
	select NORTHBRIDGE_INTEL_SANDYBRIDGE
	# Workaround for EC/KBC IRQ1.
	select SERIRQ_CONTINUOUS_MODE
	select SOUTHBRIDGE_INTEL_C216
	select SYSTEM_TYPE_LAPTOP


config VBOOT
	select GBB_FLAG_DISABLE_EC_SOFTWARE_SYNC
	select GBB_FLAG_DISABLE_FWMP
	select GBB_FLAG_DISABLE_LID_SHUTDOWN
	select GBB_FLAG_DISABLE_PD_SOFTWARE_SYNC
	select HAS_RECOVERY_MRC_CACHE
	select VBOOT_VBNV_CMOS

config VBOOT_SLOTS_RW_A
	default y

config VBOOT_VBNV_OFFSET
	hex
	default 0x2a

config MAINBOARD_DIR
	default "lenovo/x220"

config VARIANT_DIR
	default "x220" if BOARD_LENOVO_X220 || BOARD_LENOVO_X220I
	default "x1" if BOARD_LENOVO_X1

config FMDFILE
	default "src/mainboard/\$(CONFIG_MAINBOARD_DIR)/vboot-rwa.fmd" if VBOOT

config MAINBOARD_PART_NUMBER
	default "ThinkPad X220" if BOARD_LENOVO_X220
	default "ThinkPad X220i" if BOARD_LENOVO_X220I
	default "ThinkPad X1" if BOARD_LENOVO_X1

config OVERRIDE_DEVICETREE
	default "variants/\$(CONFIG_VARIANT_DIR)/overridetree.cb"

config USBDEBUG_HCD_INDEX
	int
	default 2

config DRAM_RESET_GATE_GPIO
	int
	default 10

config VGA_BIOS_ID
	string
	default "8086,0116" if BOARD_LENOVO_X220I
	# FIXME: x1 with i3 cpu may also use "8086,0116"
	default "8086,0126"

config PS2K_EISAID
	default "PNP0303"

config PS2M_EISAID
	default "LEN0020"

endif # BOARD_LENOVO_X220 || BOARD_LENOVO_X220I || BOARD_LENOVO_X1
```

## src/mainboard/lenovo/x220/Kconfig.name
```kconfig
config BOARD_LENOVO_X220
	bool "ThinkPad X220"

config BOARD_LENOVO_X220I
	bool "ThinkPad X220i"

config BOARD_LENOVO_X1
	bool "ThinkPad X1"
```

## src/mainboard/lenovo/x230/Kconfig
```kconfig
## SPDX-License-Identifier: GPL-2.0-only

if BOARD_LENOVO_X230 || BOARD_LENOVO_X230T || BOARD_LENOVO_X230S || BOARD_LENOVO_X230_EDP

config BOARD_SPECIFIC_OPTIONS
	def_bool y
	select AZALIA_USE_LEGACY_VERB_TABLE
	select SYSTEM_TYPE_LAPTOP
	select NORTHBRIDGE_INTEL_SANDYBRIDGE
	select USE_NATIVE_RAMINIT
	select SOUTHBRIDGE_INTEL_C216
	select EC_LENOVO_PMH7
	select EC_LENOVO_H8
	select H8_HAS_BAT_THRESHOLDS_IMPL
	select H8_HAS_PRIMARY_FN_KEYS if BOARD_LENOVO_X230S
	select H8_HAS_WWAN_GPIO_DETECTION if !BOARD_LENOVO_X230S
	select NO_UART_ON_SUPERIO
	select BOARD_ROMSIZE_KB_12288 if BOARD_LENOVO_X230 || BOARD_LENOVO_X230T || BOARD_LENOVO_X230_EDP
	select BOARD_ROMSIZE_KB_16384 if BOARD_LENOVO_X230S
	select HAVE_ACPI_TABLES
	select HAVE_OPTION_TABLE
	select HAVE_CMOS_DEFAULT
	select HAVE_ACPI_RESUME
	select INTEL_INT15
	select DRIVERS_RICOH_RCE822
	select DRIVER_LENOVO_SERIALS
	select MEMORY_MAPPED_TPM
	select MAINBOARD_HAS_TPM1 if BOARD_LENOVO_X230 || BOARD_LENOVO_X230T || BOARD_LENOVO_X230_EDP
	select MAINBOARD_HAS_LIBGFXINIT
	select GFX_GMA_PANEL_1_ON_LVDS if BOARD_LENOVO_X230 || BOARD_LENOVO_X230T
	select INTEL_GMA_HAVE_VBT
	select MAINBOARD_USES_IFD_GBE_REGION

	# Workaround for EC/KBC IRQ1.
	select SERIRQ_CONTINUOUS_MODE

config VBOOT
	select VBOOT_VBNV_FLASH
	select GBB_FLAG_DISABLE_LID_SHUTDOWN
	select GBB_FLAG_DISABLE_PD_SOFTWARE_SYNC
	select GBB_FLAG_DISABLE_EC_SOFTWARE_SYNC
	select GBB_FLAG_DISABLE_FWMP
	select HAS_RECOVERY_MRC_CACHE

config VBOOT_SLOTS_RW_AB
	default y

config FMDFILE
	default "src/mainboard/\$(CONFIG_MAINBOARD_DIR)/vboot-rwab.fmd" if VBOOT

config MAINBOARD_DIR
	default "lenovo/x230"

config VARIANT_DIR
	default "x230" if BOARD_LENOVO_X230 || BOARD_LENOVO_X230T || BOARD_LENOVO_X230_EDP
	default "x230s" if BOARD_LENOVO_X230S

config MAINBOARD_PART_NUMBER
	default "ThinkPad X230" if BOARD_LENOVO_X230 || BOARD_LENOVO_X230_EDP
	default "ThinkPad X230t" if BOARD_LENOVO_X230T
	default "ThinkPad X230s" if BOARD_LENOVO_X230S

config OVERRIDE_DEVICETREE
	default "variants/\$(CONFIG_VARIANT_DIR)/overridetree.cb"

config INTEL_GMA_VBT_FILE
	default "src/mainboard/\$(MAINBOARDDIR)/variants/x230_edp/data.vbt" if BOARD_LENOVO_X230_EDP

config USBDEBUG_HCD_INDEX
	int
	default 2

config DRAM_RESET_GATE_GPIO
	int
	default 10

config VGA_BIOS_ID
	string
	default "8086,0166"

config PS2K_EISAID
	default "PNP0303"

config PS2M_EISAID
	default "LEN0020"

config THINKPADEC_HKEY_EISAID
	default "LEN0068"

endif # BOARD_LENOVO_X230 || BOARD_LENOVO_X230T ||  BOARD_LENOVO_X230S || BOARD_LENOVO_X230_EDP
```
