## src/mainboard/lenovo/x230/Kconfig.name
```kconfig
## SPDX-License-Identifier: GPL-2.0-only

config BOARD_LENOVO_X230
	bool "ThinkPad X230"

config BOARD_LENOVO_X230T
	bool "ThinkPad X230t"

config BOARD_LENOVO_X230S
	bool "ThinkPad X230s"

config BOARD_LENOVO_X230_EDP
	bool "ThinkPad X230 eDP Mod (2K/FHD)"
```

## src/mainboard/lenovo/x60/Kconfig
```kconfig
## SPDX-License-Identifier: GPL-2.0-only

if BOARD_LENOVO_X60

config BOARD_SPECIFIC_OPTIONS
	def_bool y
	select SYSTEM_TYPE_LAPTOP
	select CPU_INTEL_SOCKET_M
	select NORTHBRIDGE_INTEL_I945
	select NORTHBRIDGE_INTEL_SUBTYPE_I945GM
	select SOUTHBRIDGE_INTEL_I82801GX
	select SOUTHBRIDGE_RICOH_RL5C476
	select SUPERIO_NSC_PC87382
	select SUPERIO_NSC_PC87392
	select EC_LENOVO_PMH7
	select EC_LENOVO_H8
	select DRIVERS_I2C_CK505
	select DRIVER_LENOVO_SERIALS
	select H8_HAS_2ND_THERMAL_ZONE
	select H8_HAS_BDC_GPIO_DETECTION
	select HAVE_OPTION_TABLE
	select INTEL_INT15
	select HAVE_CMOS_DEFAULT
	select HAVE_PIRQ_TABLE
	select HAVE_MP_TABLE
	select BOARD_ROMSIZE_KB_2048
	select HAVE_ACPI_TABLES
	select HAVE_ACPI_RESUME
	select DRIVERS_LENOVO_WACOM
	select I945_LVDS
	select INTEL_GMA_HAVE_VBT

config VBOOT
	select VBOOT_VBNV_FLASH
	select GBB_FLAG_DISABLE_LID_SHUTDOWN
	select GBB_FLAG_DISABLE_PD_SOFTWARE_SYNC
	select GBB_FLAG_DISABLE_EC_SOFTWARE_SYNC
	select GBB_FLAG_DISABLE_FWMP

config VBOOT_SLOTS_RW_A
	default y

config FMDFILE
	default "src/mainboard/\$(CONFIG_MAINBOARD_DIR)/vboot-rwa.fmd" if VBOOT

config MAINBOARD_DIR
	default "lenovo/x60"

config MAINBOARD_PART_NUMBER
	default "ThinkPad X60"

config IRQ_SLOT_COUNT
	int
	default 18

config MAX_CPUS
	int
	default 2

config PS2K_EISAID
	default "PNP0303"

config PS2M_EISAID
	default "IBM3780"

endif
```
