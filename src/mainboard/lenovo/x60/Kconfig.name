## src/mainboard/lenovo/x60/Kconfig.name
```kconfig
## SPDX-License-Identifier: GPL-2.0-only

config BOARD_LENOVO_X60
	bool "ThinkPad X60 / X60s / X60t"
```

## src/mainboard/lenovo/x60t/Kconfig
```kconfig
if BOARD_LENOVO_X60T

# Dummy for abuild
#select ARCH_X86

config MAINBOARD_PART_NUMBER
	string
	default "ThinkPad X60 Tablet"

endif
```

## src/mainboard/lenovo/x61/Kconfig
```kconfig
## SPDX-License-Identifier: GPL-2.0-only

if BOARD_LENOVO_X61

config BOARD_SPECIFIC_OPTIONS
	def_bool y
	select SYSTEM_TYPE_LAPTOP
	select CPU_INTEL_SOCKET_M
	select NORTHBRIDGE_INTEL_GM965
	select SOUTHBRIDGE_INTEL_I82801HX
	select DRIVERS_I2C_CK505
	select SOUTHBRIDGE_RICOH_RL5C476
	select SUPERIO_NSC_PC87382
	select SUPERIO_NSC_PC87392
	select EC_LENOVO_PMH7
	select EC_LENOVO_H8
	select DRIVER_LENOVO_SERIALS
	select H8_HAS_2ND_THERMAL_ZONE
	select H8_HAS_BDC_GPIO_DETECTION
	select HAVE_OPTION_TABLE
	select INTEL_INT15
	select HAVE_CMOS_DEFAULT
	select BOARD_ROMSIZE_KB_4096
	select HAVE_ACPI_TABLES
	select HAVE_ACPI_RESUME
	select DRIVERS_LENOVO_WACOM
	select INTEL_GMA_HAVE_VBT
	select MAINBOARD_HAS_TPM1
	select MAINBOARD_USES_IFD_GBE_REGION
	select MEMORY_MAPPED_TPM

config CBFS_SIZE
	default 0x180000 # size of the BIOS region

config VBOOT_SLOTS_RW_A
	default y

config MAINBOARD_DIR
	default "lenovo/x61"

config MAINBOARD_PART_NUMBER
	default "ThinkPad X61"

config MAX_CPUS
	int
	default 2

config PS2K_EISAID
	default "PNP0303"

config PS2M_EISAID
	default "IBM3780"

endif
```

## src/mainboard/lenovo/x61/Kconfig.name
```kconfig
## SPDX-License-Identifier: GPL-2.0-only

config BOARD_LENOVO_X61
	bool "ThinkPad X61 / X61s"
```

## src/mainboard/libretrend/Kconfig
```kconfig
if VENDOR_LIBRETREND

choice
	prompt "Mainboard model"

source "src/mainboard/libretrend/*/Kconfig.name"

endchoice

source "src/mainboard/libretrend/*/Kconfig"

config MAINBOARD_VENDOR
	default "Libretrend"

endif # VENDOR_LIBRETREND
```

## src/mainboard/libretrend/Kconfig.name
```kconfig
## SPDX-License-Identifier: GPL-2.0-only

config VENDOR_LIBRETREND
	bool "Libretrend"
```

## src/mainboard/libretrend/lt1000/Kconfig
```kconfig
if BOARD_LIBRETREND_LT1000

config BOARD_SPECIFIC_OPTIONS
	def_bool y
	select BOARD_ROMSIZE_KB_8192
	select HAVE_ACPI_RESUME
	select HAVE_ACPI_TABLES
	select INTEL_GMA_HAVE_VBT
	select MAINBOARD_HAS_LIBGFXINIT
	select MEMORY_MAPPED_TPM
	select SOC_INTEL_SKYLAKE
	select SPD_READ_BY_WORD
	select SUPERIO_ITE_IT8786E

config MAINBOARD_PART_NUMBER
	default "LT1000"

config MAINBOARD_DIR
	default "libretrend/lt1000"

config MAX_CPUS
	int
	default 4

config VGA_BIOS_ID
	string
	default "8086,1916"

config DIMM_MAX
	default 2

config DIMM_SPD_SIZE
	default 512

config CBFS_SIZE
	default 0x600000

config USE_PM_ACPI_TIMER
	default n

endif
```

## src/mainboard/libretrend/lt1000/Kconfig.name
```kconfig
## SPDX-License-Identifier: GPL-2.0-only

config BOARD_LIBRETREND_LT1000
	bool "LT1000"
```

## src/mainboard/linutop/Kconfig
```kconfig
if VENDOR_LINUTOP

choice
	prompt "Mainboard model"

source "src/mainboard/linutop/*/Kconfig.name"

endchoice

config MAINBOARD_VENDOR
	string
	default "Linutop"

source "src/mainboard/linutop/*/Kconfig"

endif # VENDOR_LINUTOP
```

## src/mainboard/linutop/linutop1/Kconfig
```kconfig
if BOARD_LINUTOP_LINUTOP1

# Dummy for abuild

config MAINBOARD_PART_NUMBER
	string
	default "Linutop-1"

endif
```

## src/mainboard/lippert/Kconfig
```kconfig
if VENDOR_LIPPERT

comment "was acquired by ADLINK"

choice
	prompt "Mainboard model"

config LIPPERT_BOARDS_DISABLED
	bool "Boards from vendor are disabled"

source "src/mainboard/lippert/*/Kconfig.name"

endchoice

source "src/mainboard/lippert/*/Kconfig"

config MAINBOARD_VENDOR
	string
	default "LiPPERT"

endif # VENDOR_LIPPERT
```

## src/mainboard/lippert/frontrunner-af/Kconfig
```kconfig
# SPDX-License-Identifier: GPL-2.0-only

if BOARD_LIPPERT_FRONTRUNNER_AF || BOARD_LIPPERT_TOUCAN_AF

config BOARD_SPECIFIC_OPTIONS
	def_bool y
	select CPU_AMD_AGESA_FAMILY14
	select NORTHBRIDGE_AMD_AGESA_FAMILY14
	select SOUTHBRIDGE_AMD_CIMX_SB800
	select SUPERIO_SMSC_SMSCSUPERIO if BOARD_LIPPERT_FRONTRUNNER_AF
	# The Toucan-AF is meant to work on any COM Express Type 6 baseboard.
	# The ADLINK ExpressBase-6 baseboard happens to use this SIO:
	select SUPERIO_WINBOND_W83627DHG if BOARD_LIPPERT_TOUCAN_AF
	select HAVE_OPTION_TABLE
	select HAVE_PIRQ_TABLE
	# This erases 28 KB and writes 10 KB register dumps to SPI flash on every
	# boot, wasting 3 s and causing wear!  Therefore disable S3 for now.
	#select HAVE_ACPI_RESUME
	select HAVE_ACPI_TABLES
	select BOARD_ROMSIZE_KB_4096
	select GFXUMA

config MAINBOARD_DIR
	string
	default "lippert/frontrunner-af"

config VARIANT_DIR
	string
	default "frontrunner-af" if BOARD_LIPPERT_FRONTRUNNER_AF
	default "toucan-af"      if BOARD_LIPPERT_TOUCAN_AF

config DEVICETREE
	string
	default "variants/\$(CONFIG_VARIANT_DIR)/devicetree.cb"

config MAINBOARD_PART_NUMBER
	string
	default "FrontRunner-AF" if BOARD_LIPPERT_FRONTRUNNER_AF
	default "Toucan-AF"      if BOARD_LIPPERT_TOUCAN_AF

config HW_MEM_HOLE_SIZEK
	hex
	default 0x200000

config MAX_CPUS
	int
	default 2

config IRQ_SLOT_COUNT
	int
	default 11

config ONBOARD_VGA_IS_PRIMARY
	bool
	default y

config VGA_BIOS_ID
	string
	default "1002,9802"

config SB800_AHCI_ROM
	bool
	default n

endif # BOARD_LIPPERT_FRONTRUNNER_AF || BOARD_LIPPERT_TOUCAN_AF
```

## src/mainboard/lippert/frontrunner-af/Kconfig.name
```kconfig
config BOARD_LIPPERT_FRONTRUNNER_AF
	bool "FrontRunner-AF aka ADLINK CoreModule2-GF"
```

## src/mainboard/lippert/frontrunner/Kconfig
```kconfig
if BOARD_LIPPERT_FRONTRUNNER

config BOARD_SPECIFIC_OPTIONS # dummy
	def_bool y
	select ARCH_X86
	select CPU_AMD_GEODE_GX2
	select NORTHBRIDGE_AMD_GX2
	select SOUTHBRIDGE_AMD_CS5535
	select HAVE_DEBUG_SMBUS
	select UDELAY_TSC
	select HAVE_PIRQ_TABLE
	select BOARD_ROMSIZE_KB_256
	select GX2_PROCESSOR_MHZ_366

config MAINBOARD_DIR
	string
	default lippert/frontrunner

config MAINBOARD_PART_NUMBER
	string
	default "Cool Frontrunner"

config IRQ_SLOT_COUNT
	int
	default 2

endif # BOARD_LIPPERT_FRONTRUNNER
```

## src/mainboard/lippert/hurricane-lx/Kconfig
```kconfig
if BOARD_LIPPERT_HURRICANE_LX

config BOARD_SPECIFIC_OPTIONS # dummy
	def_bool y
	select ARCH_X86
	select CPU_AMD_GEODE_LX
	select NORTHBRIDGE_AMD_LX
	select SOUTHBRIDGE_AMD_CS5536
	select SUPERIO_ITE_IT8712F
	select HAVE_PIRQ_TABLE
	select PIRQ_ROUTE
	select UDELAY_TSC
	# Board is equipped with a 1 MB SPI flash, however, due to limitations
	# of the IT8712F Super I/O, only the top 512 KB are directly mapped.
	select BOARD_ROMSIZE_KB_512
	select PLL_MANUAL_CONFIG
	select CORE_GLIU_500_333

config MAINBOARD_DIR
	string
	default lippert/hurricane-lx

config MAINBOARD_PART_NUMBER
	string
	default "Hurricane-LX"

config IRQ_SLOT_COUNT
	int
	default 8

config BOARD_OLD_REVISION
	bool "Board is old pre-3.0 revision"
	default n
	select POWER_BUTTON_DEFAULT_DISABLE
	help
	  Look on the bottom side for a number like 406-0001-30.  The last 2
	  digits state the PCB revision (3.0 in this example).  For 2.0 or older
	  boards choose Y, for 3.0 and newer say N.

	  Old revision boards need a jumper shorting the power button to
	  power on automatically.  You may enable the button only after this
	  jumper has been removed.  New revision boards are not restricted
	  in this way, and always have the power button enabled.

config POWER_BUTTON_FORCE_ENABLE
	def_bool y if !BOARD_OLD_REVISION

config ONBOARD_UARTS_RS485
	bool "Switch on-board serial ports to RS485"
	default n
	help
	  If selected, both on-board serial ports will operate in RS485 mode
	  instead of RS232.

config PLLMSRlo
	hex
	default 0x00de6001

endif # BOARD_LIPPERT_HURRICANE_LX
```

## src/mainboard/lippert/literunner-lx/Kconfig
```kconfig
if BOARD_LIPPERT_LITERUNNER_LX

config BOARD_SPECIFIC_OPTIONS # dummy
	def_bool y
	select ARCH_X86
	select CPU_AMD_GEODE_LX
	select NORTHBRIDGE_AMD_LX
	select SOUTHBRIDGE_AMD_CS5536
	select SUPERIO_ITE_IT8712F
	select HAVE_DEBUG_SMBUS
	select HAVE_PIRQ_TABLE
	select PIRQ_ROUTE
	select UDELAY_TSC
	# Board is equipped with a 1 MB SPI flash, however, due to limitations
	# of the IT8712F Super I/O, only the top 512 KB are directly mapped.
	select BOARD_ROMSIZE_KB_512
	select POWER_BUTTON_FORCE_ENABLE
	select PLL_MANUAL_CONFIG
	select CORE_GLIU_500_400

config MAINBOARD_DIR
	string
	default lippert/literunner-lx

config MAINBOARD_PART_NUMBER
	string
	default "Cool LiteRunner-LX"

config IRQ_SLOT_COUNT
	int
	default 5

config ONBOARD_UARTS_RS485
	bool "Switch on-board serial ports 1 & 2 to RS485"
	default n
	help
	  If selected, the first two on-board serial ports will operate in RS485
	  mode instead of RS232.

config ONBOARD_IDE_SLAVE
	bool "Make on-board CF socket act as Slave"
	default n
	help
	  If selected, the on-board Compact Flash card socket will act as IDE
	  Slave instead of Master.

config PLLMSRlo
	hex
	default 0x00de6001

endif # BOARD_LIPPERT_LITERUNNER_LX
```

## src/mainboard/lippert/roadrunner-lx/Kconfig
```kconfig
if BOARD_LIPPERT_ROADRUNNER_LX

config BOARD_SPECIFIC_OPTIONS # dummy
	def_bool y
	select ARCH_X86
	select CPU_AMD_GEODE_LX
	select NORTHBRIDGE_AMD_LX
	select SOUTHBRIDGE_AMD_CS5536
	select SUPERIO_ITE_IT8712F
	select HAVE_PIRQ_TABLE
	select PIRQ_ROUTE
	select UDELAY_TSC
	# Standard chip is a 512 KB FWH. Replacing it with a 1 MB
	# SST 49LF008A is possible.
	select BOARD_ROMSIZE_KB_512
	select POWER_BUTTON_FORCE_ENABLE
	select PLL_MANUAL_CONFIG
	select CORE_GLIU_500_333

config MAINBOARD_DIR
	string
	default lippert/roadrunner-lx

config MAINBOARD_PART_NUMBER
	string
	default "Cool RoadRunner-LX"

config IRQ_SLOT_COUNT
	int
	default 7

config ONBOARD_UARTS_RS485
	bool "Switch on-board serial ports to RS485"
	default n
	help
	  If selected, both on-board serial ports will operate in RS485 mode
	  instead of RS232.

config PLLMSRlo
	hex
	default 0x00de6001

endif # BOARD_LIPPERT_ROADRUNNER_LX
```
