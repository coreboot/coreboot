## src/mainboard/lippert/spacerunner-lx/Kconfig
```kconfig
if BOARD_LIPPERT_SPACERUNNER_LX

config BOARD_SPECIFIC_OPTIONS # dummy
	def_bool y
	select ARCH_X86
	select CPU_AMD_GEODE_LX
	select NORTHBRIDGE_AMD_LX
	select SOUTHBRIDGE_AMD_CS5536
	select SUPERIO_ITE_IT8712F
	select HAVE_DEBUG_SMBUS
	select HAVE_PIRQ_TABLE
	select PIRQ_ROUTE
	select UDELAY_TSC
	# Board is equipped with a 1 MB SPI flash, however, due to limitations
	# of the IT8712F Super I/O, only the top 512 KB are directly mapped.
	select BOARD_ROMSIZE_KB_512
	select POWER_BUTTON_FORCE_ENABLE
	select PLL_MANUAL_CONFIG
	select CORE_GLIU_500_400

config MAINBOARD_DIR
	string
	default lippert/spacerunner-lx

config MAINBOARD_PART_NUMBER
	string
	default "Cool SpaceRunner-LX"

config IRQ_SLOT_COUNT
	int
	default 7

config ONBOARD_UARTS_RS485
	bool "Switch on-board serial ports to RS485"
	default n
	help
	  If selected, both on-board serial ports will operate in RS485 mode
	  instead of RS232.

config ONBOARD_IDE_SLAVE
	bool "Make on-board SSD act as Slave"
	default n
	help
	  If selected, the on-board SSD will act as IDE Slave instead of Master.

config PLLMSRlo
	hex
	default 0x00de6001

endif # BOARD_LIPPERT_SPACERUNNER_LX
```

## src/mainboard/lippert/toucan-af/Kconfig
```kconfig
#
# This file is part of the coreboot project.
#
# Copyright (C) 2011 Advanced Micro Devices, Inc.
#
# This program is free software; you can redistribute it and/or modify
# it under the terms of the GNU General Public License as published by
# the Free Software Foundation; version 2 of the License.
#
# This program is distributed in the hope that it will be useful,
# but WITHOUT ANY WARRANTY; without even the implied warranty of
# MERCHANTABILITY or FITNESS FOR A PARTICULAR PURPOSE.  See the
# GNU General Public License for more details.
#
# You should have received a copy of the GNU General Public License
# along with this program; if not, write to the Free Software
# Foundation, Inc.
#

if BOARD_LIPPERT_TOUCAN_AF

config BOARD_SPECIFIC_OPTIONS # dummy
	def_bool y
	select CPU_AMD_AGESA_FAMILY14
	select NORTHBRIDGE_AMD_AGESA_FAMILY14
	select SOUTHBRIDGE_AMD_CIMX_SB800
	# The Toucan-AF is meant to work on any COM Express Type 6 baseboard.
	# The ADLINK ExpressBase-6 baseboard happens to use this SIO:
	select SUPERIO_WINBOND_W83627DHG
	select HAVE_OPTION_TABLE
	select HAVE_PIRQ_TABLE
	select HAVE_MP_TABLE
	# This erases 28 KB and writes 10 KB register dumps to SPI flash on every
	# boot, wasting 3 s and causing wear!  Therefore disable S3 for now.
	#select HAVE_ACPI_RESUME
	select HAVE_ACPI_TABLES
	select BOARD_ROMSIZE_KB_4096
	select GFXUMA

config MAINBOARD_DIR
	string
	default lippert/toucan-af

config MAINBOARD_PART_NUMBER
	string
	default "Toucan-AF"

config HW_MEM_HOLE_SIZEK
	hex
	default 0x200000

config MAX_CPUS
	int
	default 2

config HW_MEM_HOLE_SIZE_AUTO_INC
	bool
	default n

config IRQ_SLOT_COUNT
	int
	default 11

config ONBOARD_VGA_IS_PRIMARY
	bool
	default y

config VGA_BIOS
	bool
	default n

#config VGA_BIOS_FILE
#	string "VGA BIOS path and filename"
#	depends on VGA_BIOS
#	default "rom/video/OntarioGenericVbios.bin"

config VGA_BIOS_ID
	string
	default "1002,9802"

config SB800_AHCI_ROM
	bool
	default n

endif # BOARD_LIPPERT_TOUCAN_AF
```

## src/mainboard/lowrisc/Kconfig
```kconfig
if VENDOR_LOWRISC

choice
	prompt "Mainboard model"

source "src/mainboard/lowrisc/*/Kconfig.name"

endchoice

source "src/mainboard/lowrisc/*/Kconfig"

config MAINBOARD_VENDOR
	string
	default "lowrisc"

endif # VENDOR_LOWRISC
```

## src/mainboard/lowrisc/nexys4ddr/Kconfig
```kconfig
##
## This file is part of the coreboot project.
##
## Copyright (C) 2016 Google Inc.
##
## This software is licensed under the terms of the GNU General Public
## License version 2, as published by the Free Software Foundation, and
## may be copied, distributed, and modified under those terms.
##
## This program is distributed in the hope that it will be useful,
## but WITHOUT ANY WARRANTY; without even the implied warranty of
## MERCHANTABILITY or FITNESS FOR A PARTICULAR PURPOSE.  See the
## GNU General Public License for more details.

if BOARD_LOWRISC_NEXYS4DDR

config BOARD_SPECIFIC_OPTIONS # dummy
	def_bool y
	select SOC_LOWRISC_LOWRISC
	select BOARD_ROMSIZE_KB_4096
	select DRIVERS_UART_8250MEM
	select BOOT_DEVICE_NOT_SPI_FLASH
	select UART_OVERRIDE_REFCLK

config MAINBOARD_DIR
	string
	default lowrisc/nexys4ddr

config MAINBOARD_PART_NUMBER
	string
	default "LOWRISC NEXYS4DDR"

config MAX_CPUS
	int
	default 1

endif #  BOARD_LOWRISC_NEXYS4DDR
```

## src/mainboard/micropassion/Kconfig
```kconfig
if VENDOR_MICROPASSION

choice
	prompt "Mainboard model"

config BOARD_MICROPASSION_KRATOSX1
	bool "KRATOS-X1"
endchoice

source "src/mainboard/micropassion/kratosx1/Kconfig"

config MAINBOARD_VENDOR
	string
	default "Micro Passion Ltd"

endif # VENDOR_MICROPASSION
```

## src/mainboard/mitac/6513wu/Kconfig
```kconfig
##
## This file is part of the coreboot project.
##
## Copyright (C) 2009 Uwe Hermann <uwe@hermann-uwe.de>
##
## This program is free software; you can redistribute it and/or modify
## it under the terms of the GNU General Public License as published by
## the Free Software Foundation; either version 2 of the License, or
## (at your option) any later version.
##
## This program is distributed in the hope that it will be useful,
## but WITHOUT ANY WARRANTY; without even the implied warranty of
## MERCHANTABILITY or FITNESS FOR A PARTICULAR PURPOSE.  See the
## GNU General Public License for more details.
##
## You should have received a copy of the GNU General Public License
## along with this program; if not, write to the Free Software
## Foundation, Inc., 51 Franklin St, Fifth Floor, Boston, MA  02110-1301 USA
##

config BOARD_MITAC_6513WU
	bool "6513WU"
	select ARCH_X86
	select CPU_INTEL_SOCKET_PGA370
	select NORTHBRIDGE_INTEL_I82810
	select SOUTHBRIDGE_INTEL_I82801XX
	select SUPERIO_SMSC_SMSCSUPERIO
	select ROMCC
	select HAVE_PIRQ_TABLE
	select UDELAY_TSC
	select BOARD_ROMSIZE_KB_512

config MAINBOARD_DIR
	string
	default mitac/6513wu
	depends on BOARD_MITAC_6513WU

config MAINBOARD_PART_NUMBER
	string
	default "6513WU"
	depends on BOARD_MITAC_6513WU

config HAVE_OPTION_TABLE
	bool
	default n
	depends on BOARD_MITAC_6513WU

config IRQ_SLOT_COUNT
	int
	default 8
	depends on BOARD_MITAC_6513WU
```

## src/mainboard/mitaccomputing/Kconfig
```kconfig
if VENDOR_MITAC_COMPUTING

choice
	prompt "Mainboard model"

source "src/mainboard/mitaccomputing/*/Kconfig.name"

endchoice

source "src/mainboard/mitaccomputing/*/Kconfig"

config MAINBOARD_VENDOR
	default "MiTAC Computing"

endif # VENDOR_MITAC_COMPUTING
```

## src/mainboard/mitaccomputing/r520g6sb/Kconfig
```kconfig
## SPDX-License-Identifier: GPL-2.0-only

if BOARD_MITAC_COMPUTING_R520G6SB

config BOARD_SPECIFIC_OPTIONS
	def_bool y
	select BOARD_ROMSIZE_KB_65536
	select SOC_INTEL_GRANITERAPIDS_SP
	select SUPERIO_ASPEED_AST2400
	select CONSOLE_OVERRIDE_LOGLEVEL
	select HAVE_ACPI_TABLES
	select IPMI_KCS
	select IPMI_KCS_ROMSTAGE
	select VPD
	select OCP_VPD
	select MEMORY_MAPPED_TPM

config CARDBUS_PLUGIN_SUPPORT
	bool
	default n

config MAINBOARD_DIR
	string
	default "mitaccomputing/r520g6sb"

config MAINBOARD_PART_NUMBER
	string
	default "R520G6SB"

config FMDFILE
	string
	default "src/mainboard/\$(CONFIG_MAINBOARD_DIR)/board.fmd"

config DIMM_MAX
	int
	default 32

endif
```

## src/mainboard/mitaccomputing/r520g6sb/Kconfig.name
```kconfig
## SPDX-License-Identifier: GPL-2.0-only

config BOARD_MITAC_COMPUTING_R520G6SB
	bool "R520G6SB"
```

## src/mainboard/mitaccomputing/sc513g6/Kconfig
```kconfig
## SPDX-License-Identifier: GPL-2.0-only

if BOARD_MITAC_COMPUTING_SC513G6

config BOARD_SPECIFIC_OPTIONS
	def_bool y
	select BOARD_ROMSIZE_KB_65536
	select SOC_INTEL_GRANITERAPIDS
	select SUPERIO_ASPEED_AST2400
	select CONSOLE_OVERRIDE_LOGLEVEL
	select HAVE_ACPI_TABLES
	select IPMI_KCS
	select IPMI_KCS_ROMSTAGE
	select VPD
	select OCP_VPD
	select MEMORY_MAPPED_TPM

config CARDBUS_PLUGIN_SUPPORT
	bool
	default n

config MAINBOARD_DIR
	string
	default "mitaccomputing/sc513g6"

config MAINBOARD_PART_NUMBER
	string
	default "SC513G6"

config FMDFILE
	string
	default "src/mainboard/\$(CONFIG_MAINBOARD_DIR)/board.fmd"

config DIMM_MAX
	int
	default 8

config MAX_SOCKET
	int
	default 1

endif
```

## src/mainboard/mitaccomputing/sc513g6/Kconfig.name
```kconfig
## SPDX-License-Identifier: GPL-2.0-only

config BOARD_MITAC_COMPUTING_SC513G6
	bool "SC513G6"
```

## src/mainboard/mitaccomputing/whitestone-2/Kconfig
```kconfig
## SPDX-License-Identifier: GPL-2.0-only

if BOARD_MITAC_COMPUTING_WHITESTONE_2

config BOARD_SPECIFIC_OPTIONS
	def_bool y
	select BOARD_ROMSIZE_KB_65536
	select CPU_INTEL_SOCKET_LGA4677
	select CONSOLE_OVERRIDE_LOGLEVEL
	select IPMI_KCS
	select IPMI_KCS_ROMSTAGE
	select IPMI_OCP
	select MEMORY_MAPPED_TPM
	select MAINBOARD_HAS_TPM2
	select DRIVERS_ASPEED_AST2050
	select SOC_INTEL_SAPPHIRERAPIDS_SP
	select SUPERIO_ASPEED_AST2400
	select HAVE_ACPI_TABLES
	select MAINBOARD_USES_IFD_GBE_REGION
	select VPD
	select OCP_EWL
	select OCP_VPD

config MAINBOARD_DIR
	string
	default "mitaccomputing/whitestone-2"

config MAINBOARD_PART_NUMBER
	string
	default "Whitestone 2"

config MAINBOARD_FAMILY
	default "Intel Eagle Stream Server"

config FMDFILE
	string
	default "src/mainboard/\$(CONFIG_MAINBOARD_DIR)/board.fmd"

config MAX_SOCKET
	int
	default 1

config DIMM_MAX
	int
	default 16

config UART_FOR_CONSOLE
	int
	default 0

config TTYS0_BAUD
	default 115200

endif
```

## src/mainboard/mitaccomputing/whitestone-2/Kconfig.name
```kconfig
## SPDX-License-Identifier: GPL-2.0-only

config BOARD_MITAC_COMPUTING_WHITESTONE_2
	bool "Whitestone 2"
```

## src/mainboard/msi/Kconfig
```kconfig
## SPDX-License-Identifier: GPL-2.0-only

if VENDOR_MSI

choice
	prompt "Mainboard model"

source "src/mainboard/msi/*/Kconfig.name"

endchoice

source "src/mainboard/msi/*/Kconfig"

config MAINBOARD_VENDOR
	default "MSI"

endif # VENDOR_MSI
```

## src/mainboard/msi/h81m-p33/Kconfig
```kconfig
# SPDX-License-Identifier: GPL-2.0-or-later

if BOARD_MSI_H81M_P33

config BOARD_SPECIFIC_OPTIONS
	def_bool y
	select BOARD_ROMSIZE_KB_8192
	select CPU_INTEL_HASWELL
	select HAVE_ACPI_RESUME
	select HAVE_ACPI_TABLES
	select INTEL_GMA_HAVE_VBT
	select MAINBOARD_HAS_LIBGFXINIT
	select NORTHBRIDGE_INTEL_HASWELL
	select SERIRQ_CONTINUOUS_MODE
	select SOUTHBRIDGE_INTEL_LYNXPOINT
	select SUPERIO_NUVOTON_NCT6779D

config MAINBOARD_DIR
	string
	default msi/h81m-p33

config MAINBOARD_PART_NUMBER
	string
	default "H81M-P33"

endif
```

## src/mainboard/msi/ms6119/Kconfig
```kconfig
##
## This file is part of the coreboot project.
##
## Copyright (C) 2009 Uwe Hermann <uwe@hermann-uwe.de>
##
## This program is free software; you can redistribute it and/or modify
## it under the terms of the GNU General Public License as published by
## the Free Software Foundation; either version 2 of the License, or
## (at your option) any later version.
##
## This program is distributed in the hope that it will be useful,
## but WITHOUT ANY WARRANTY; without even the implied warranty of
## MERCHANTABILITY or FITNESS FOR A PARTICULAR PURPOSE.  See the
## GNU General Public License for more details.
##
## You should have received a copy of the GNU General Public License
## along with this program; if not, write to the Free Software
## Foundation, Inc., 51 Franklin St, Fifth Floor, Boston, MA  02110-1301 USA
##

config BOARD_MSI_MS_6119
	bool "MS-6119"
	select ARCH_X86
	select CPU_INTEL_SLOT_2
	select NORTHBRIDGE_INTEL_I440BX
	select SOUTHBRIDGE_INTEL_I82371EB
	select SUPERIO_WINBOND_W83977TF
	select HAVE_PIRQ_TABLE
	select UDELAY_TSC
	select TSC_X86RDTSC_CALIBRATE_WITH_TIMER2

config MAINBOARD_DIR
	string
	default msi/ms6119
	depends on BOARD_MSI_MS_6119

config MAINBOARD_PART_NUMBER
	string
	default "MS-6119"
	depends on BOARD_MSI_MS_6119

config HAVE_OPTION_TABLE
	bool
	default n
	depends on BOARD_MSI_MS_6119

config IRQ_SLOT_COUNT
	int
	default 7
	depends on BOARD_MSI_MS_6119
```
