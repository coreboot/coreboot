## src/mainboard/msi/ms9282/Kconfig
```kconfig
if BOARD_MSI_MS9282

config BOARD_SPECIFIC_OPTIONS # dummy
	def_bool y
	select ARCH_X86
	select CPU_AMD_SOCKET_F
	select DIMM_DDR2
	select DIMM_REGISTERED
	select NORTHBRIDGE_AMD_AMDK8
	select SOUTHBRIDGE_NVIDIA_MCP55
	select SUPERIO_WINBOND_W83627EHG
	select HAVE_OPTION_TABLE
	select HAVE_PIRQ_TABLE
	select HAVE_MP_TABLE
	select K8_REV_F_SUPPORT
	select BOARD_ROMSIZE_KB_512
	select RAMINIT_SYSINFO
	select QRANK_DIMM_SUPPORT
	select DRIVERS_I2C_ADM1027
	select DRIVERS_I2C_I2CMUX2

config MAINBOARD_DIR
	string
	default msi/ms9282

config DCACHE_RAM_BASE
	hex
	default 0xcc000

config DCACHE_RAM_SIZE
	hex
	default 0x04000

config APIC_ID_OFFSET
	hex
	default 0x10

config SB_HT_CHAIN_ON_BUS0
	int
	default 1

config MAINBOARD_PART_NUMBER
	string
	default "MS-9282"

config PCI_64BIT_PREF_MEM
	bool
	default n

config MAX_CPUS
	int
	default 4

config MAX_PHYSICAL_CPUS
	int
	default 2

config HT_CHAIN_UNITID_BASE
	hex
	default 0x0

config HT_CHAIN_END_UNITID_BASE
	hex
	default 0x20

config SERIAL_CPU_INIT
	bool
	default n

config IRQ_SLOT_COUNT
	int
	default 11

endif # BOARD_MSI_MS9282
```
