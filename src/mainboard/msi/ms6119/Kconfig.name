## src/mainboard/msi/ms6147/Kconfig
```kconfig
##
## This file is part of the coreboot project.
##
## Copyright (C) 2009 Uwe Hermann <uwe@hermann-uwe.de>
##
## This program is free software; you can redistribute it and/or modify
## it under the terms of the GNU General Public License as published by
## the Free Software Foundation; either version 2 of the License, or
## (at your option) any later version.
##
## This program is distributed in the hope that it will be useful,
## but WITHOUT ANY WARRANTY; without even the implied warranty of
## MERCHANTABILITY or FITNESS FOR A PARTICULAR PURPOSE.  See the
## GNU General Public License for more details.
##
## You should have received a copy of the GNU General Public License
## along with this program; if not, write to the Free Software
## Foundation, Inc., 51 Franklin St, Fifth Floor, Boston, MA  02110-1301 USA
##

config BOARD_MSI_MS_6147
	bool "MS-6147"
	select ARCH_X86
	select CPU_INTEL_SLOT_2
	select NORTHBRIDGE_INTEL_I440BX
	select SOUTHBRIDGE_INTEL_I82371EB
	select SUPERIO_WINBOND_W83977TF
	select HAVE_PIRQ_TABLE
	select UDELAY_IO

config MAINBOARD_DIR
	string
	default msi/ms6147
	depends on BOARD_MSI_MS_6147

config MAINBOARD_PART_NUMBER
	string
	default "MS-6147"
	depends on BOARD_MSI_MS_6147

config HAVE_OPTION_TABLE
	bool
	default n
	depends on BOARD_MSI_MS_6147

config IRQ_SLOT_COUNT
	int
	default 8
	depends on BOARD_MSI_MS_6147
```

## src/mainboard/msi/ms6156/Kconfig
```kconfig
##
## This file is part of the coreboot project.
##
## Copyright (C) 2009 Uwe Hermann <uwe@hermann-uwe.de>
##
## This program is free software; you can redistribute it and/or modify
## it under the terms of the GNU General Public License as published by
## the Free Software Foundation; version 2 of the License.
##
## This program is distributed in the hope that it will be useful,
## but WITHOUT ANY WARRANTY; without even the implied warranty of
## MERCHANTABILITY or FITNESS FOR A PARTICULAR PURPOSE.  See the
## GNU General Public License for more details.
##
## You should have received a copy of the GNU General Public License
## along with this program; if not, write to the Free Software
## Foundation, Inc., 51 Franklin St, Fifth Floor, Boston, MA 02110-1301 USA
##
if BOARD_MSI_MS_6156

config BOARD_SPECIFIC_OPTIONS # dummy
	def_bool y
	select ARCH_X86
	select CPU_INTEL_SLOT_1
	select NORTHBRIDGE_INTEL_I440BX
	select SOUTHBRIDGE_INTEL_I82371EB
	select SUPERIO_WINBOND_W83977TF
	select HAVE_PIRQ_TABLE
	select UDELAY_TSC
	select BOARD_ROMSIZE_KB_256

config MAINBOARD_DIR
	string
	default msi/ms6156

config MAINBOARD_PART_NUMBER
	string
	default "MS-6156"

config IRQ_SLOT_COUNT
	int
	default 7

endif # BOARD_MSI_MS_6156
```

## src/mainboard/msi/ms6178/Kconfig
```kconfig
##
## This file is part of the coreboot project.
##
## Copyright (C) 2009 Uwe Hermann <uwe@hermann-uwe.de>
##
## This program is free software; you can redistribute it and/or modify
## it under the terms of the GNU General Public License as published by
## the Free Software Foundation; version 2 of the License.
##
## This program is distributed in the hope that it will be useful,
## but WITHOUT ANY WARRANTY; without even the implied warranty of
## MERCHANTABILITY or FITNESS FOR A PARTICULAR PURPOSE.  See the
## GNU General Public License for more details.
##
## You should have received a copy of the GNU General Public License
## along with this program; if not, write to the Free Software
## Foundation, Inc., 51 Franklin St, Fifth Floor, Boston, MA 02110-1301 USA
##
if BOARD_MSI_MS_6178

config BOARD_SPECIFIC_OPTIONS # dummy
	def_bool y
	select ARCH_X86
	select CPU_INTEL_SOCKET_PGA370
	select NORTHBRIDGE_INTEL_I82810
	select SOUTHBRIDGE_INTEL_I82801AX
	select SUPERIO_WINBOND_W83627HF
	select HAVE_PIRQ_TABLE
	select BOARD_ROMSIZE_KB_512
	select GFXUMA

config MAINBOARD_DIR
	string
	default msi/ms6178

config MAINBOARD_PART_NUMBER
	string
	default "MS-6178"

config IRQ_SLOT_COUNT
	int
	default 4

# No need to override the chipset VGA_BIOS_ID.
config VGA_BIOS_FILE
	string
	default "i810.vga"

endif # BOARD_MSI_MS_6178
```

## src/mainboard/msi/ms7135/Kconfig
```kconfig
if BOARD_MSI_MS7135

config BOARD_SPECIFIC_OPTIONS # dummy
	def_bool y
	select ARCH_X86
	select CPU_AMD_SOCKET_754
	select NORTHBRIDGE_AMD_AMDK8
	select SOUTHBRIDGE_NVIDIA_CK804
	select SUPERIO_WINBOND_W83627THG
	select HAVE_OPTION_TABLE
	select HAVE_PIRQ_TABLE
	select HAVE_MP_TABLE
	select BOARD_ROMSIZE_KB_512
	select CK804_USE_NIC
	select CK804_USE_ACI
	select QRANK_DIMM_SUPPORT
	select HAVE_ACPI_TABLES

config MAINBOARD_DIR
	string
	default msi/ms7135

config APIC_ID_OFFSET
	hex
	default 0x0

config MEM_TRAIN_SEQ
	int
	default 2

config MAINBOARD_PART_NUMBER
	string
	default "MS-7135"

config MAX_CPUS
	int
	default 2

config MAX_PHYSICAL_CPUS
	int
	default 1

config HT_CHAIN_UNITID_BASE
	hex
	default 0

config HT_CHAIN_END_UNITID_BASE
	hex
	default 0x20

config SB_HT_CHAIN_ON_BUS0
	int
	default 2

config IRQ_SLOT_COUNT
	int
	default 13

config CK804_PCI_E_X
	int
	default 0

endif # BOARD_MSI_MS7135
```

## src/mainboard/msi/ms7260/Kconfig
```kconfig
if BOARD_MSI_MS7260

config BOARD_SPECIFIC_OPTIONS # dummy
	def_bool y
	select ARCH_X86
	select CPU_AMD_SOCKET_AM2
	select DIMM_DDR2
	select NORTHBRIDGE_AMD_AMDK8
	select SOUTHBRIDGE_NVIDIA_MCP55
	select MCP55_USE_NIC
	select MCP55_USE_AZA
	select SUPERIO_WINBOND_W83627EHG
	select HAVE_OPTION_TABLE
	select HAVE_PIRQ_TABLE
	select HAVE_MP_TABLE
	select LIFT_BSP_APIC_ID
	select K8_REV_F_SUPPORT
	select BOARD_ROMSIZE_KB_512
	select RAMINIT_SYSINFO
	select QRANK_DIMM_SUPPORT
	select K8_ALLOCATE_IO_RANGE
	select SET_FIDVID

config MAINBOARD_DIR
	string
	default msi/ms7260

config DCACHE_RAM_BASE
	hex
	default 0xc8000

config DCACHE_RAM_SIZE
	hex
	default 0x08000

config APIC_ID_OFFSET
	hex
	default 0x10

config MEM_TRAIN_SEQ
	int
	default 2

config SB_HT_CHAIN_ON_BUS0
	int
	default 2

config MAINBOARD_PART_NUMBER
	string
	default "MS-7260"

config PCI_64BIT_PREF_MEM
	bool
	default n

config MAX_CPUS
	int
	default 2

config MAX_PHYSICAL_CPUS
	int
	default 1

config HT_CHAIN_UNITID_BASE
	hex
	default 0x0

config HT_CHAIN_END_UNITID_BASE
	hex
	default 0x20

config SERIAL_CPU_INIT
	bool
	default n

config IRQ_SLOT_COUNT
	int
	default 11

config MCP55_PCI_E_X_0
	int
	default 0

endif # BOARD_MSI_MS7260
```

## src/mainboard/msi/ms7707/Kconfig
```kconfig
## SPDX-License-Identifier: GPL-2.0-only

if BOARD_MSI_MS7707

config BOARD_SPECIFIC_OPTIONS
	def_bool y
	select AZALIA_USE_LEGACY_VERB_TABLE
	select NORTHBRIDGE_INTEL_SANDYBRIDGE
	select USE_NATIVE_RAMINIT
	select SOUTHBRIDGE_INTEL_BD82X6X
	select SUPERIO_FINTEK_F71808A
	select BOARD_ROMSIZE_KB_4096
	select HAVE_ACPI_TABLES
	select HAVE_ACPI_RESUME
	select MAINBOARD_USES_IFD_GBE_REGION
	select NO_UART_ON_SUPERIO
	select SERIRQ_CONTINUOUS_MODE

config MAINBOARD_DIR
	default "msi/ms7707"

config MAINBOARD_PART_NUMBER
	default "MS-7707"

config DRAM_RESET_GATE_GPIO
	int
	default 60

config USBDEBUG_HCD_INDEX # FIXME: check this
	int
	default 2

config CBFS_SIZE
	default 0x200000

endif
```

## src/mainboard/msi/ms7707/Kconfig.name
```kconfig
## SPDX-License-Identifier: GPL-2.0-only

config BOARD_MSI_MS7707
	bool "MS-7707"
```

## src/mainboard/msi/ms7721/Kconfig
```kconfig
# SPDX-License-Identifier: GPL-2.0-only

if BOARD_MSI_MS7721

config BOARD_SPECIFIC_OPTIONS
	def_bool y
	select CPU_AMD_AGESA_FAMILY15_TN
	select NORTHBRIDGE_AMD_AGESA_FAMILY15_TN
	select SOUTHBRIDGE_AMD_AGESA_HUDSON
	select HAVE_OPTION_TABLE
	select HAVE_PIRQ_TABLE
	select HAVE_ACPI_TABLES
	select SUPERIO_FINTEK_F71869AD
	select BOARD_ROMSIZE_KB_8192
	select GFXUMA

config MAINBOARD_DIR
	string
	default "msi/ms7721"

config MAINBOARD_PART_NUMBER
	string
	default "MS-7721"

config HW_MEM_HOLE_SIZEK
	hex
	default 0x200000

config MAX_CPUS
	int
	default 4

config HUDSON_XHCI_FWM
	bool
	default n

config HUDSON_IMC_FWM
	bool
	default n

config IRQ_SLOT_COUNT
	int
	default 11

config ONBOARD_VGA_IS_PRIMARY
	bool
	default y

config VGA_BIOS_ID
	string
	default "1002,990e"

config HUDSON_LEGACY_FREE
	bool
	default n

config POST_IO
	bool
	default n

endif # BOARD_MSI_MS7721
```

## src/mainboard/msi/ms7d25/Kconfig
```kconfig
config BOARD_MSI_Z690_A_PRO_WIFI_DDR4
	select BOARD_MSI_MS7D25

config BOARD_MSI_Z690_A_PRO_WIFI_DDR5
	select BOARD_MSI_MS7D25

config BOARD_MSI_MS7D25
	def_bool n
	select SOC_INTEL_ALDERLAKE_PCH_S
	select BOARD_ROMSIZE_KB_32768
	select SOC_INTEL_COMMON_BLOCK_HDA_VERB
	select SUPERIO_NUVOTON_NCT6687D
	select DRIVERS_UART_8250IO
	select HAVE_ACPI_RESUME
	select HAVE_ACPI_TABLES
	select INTEL_GMA_HAVE_VBT
	select CRB_TPM
	select HAVE_INTEL_PTT

if BOARD_MSI_MS7D25

config MAINBOARD_DIR
	default "msi/ms7d25"

config MAINBOARD_PART_NUMBER
	default "PRO Z690-A WIFI DDR4(MS-7D25)" if BOARD_MSI_Z690_A_PRO_WIFI_DDR4
	default "PRO Z690-A WIFI (MS-7D25)" if BOARD_MSI_Z690_A_PRO_WIFI_DDR5

config MAINBOARD_VENDOR
	string
	default "Micro-Star International Co., Ltd."

config MAINBOARD_FAMILY
	string
	default "Default string"

config MAINBOARD_VERSION
	string
	default "2.0" if BOARD_MSI_Z690_A_PRO_WIFI_DDR5

config DIMM_SPD_SIZE
	default 512

config UART_FOR_CONSOLE
	int
	default 0

config USE_PM_ACPI_TIMER
	bool
	default n

config USE_LEGACY_8254_TIMER
	bool
	default n

config CBFS_SIZE
	hex
	default 0x1000000

config VBOOT
	select GBB_FLAG_DISABLE_EC_SOFTWARE_SYNC
	select GBB_FLAG_DISABLE_FWMP
	select GBB_FLAG_DISABLE_LID_SHUTDOWN
	select GBB_FLAG_DISABLE_PD_SOFTWARE_SYNC
	select VBOOT_ALWAYS_ENABLE_DISPLAY
	select VBOOT_NO_BOARD_SUPPORT
	select HAS_RECOVERY_MRC_CACHE

config VBOOT_SLOTS_RW_AB
	default y if VBOOT

config FMDFILE
	string
	default "src/mainboard/\$(CONFIG_MAINBOARD_DIR)/vboot-rwab.fmd" if VBOOT && VBOOT_SLOTS_RW_AB

# gen_test_hwid.sh script doesn't like parentheses in the MAINBOARD_PART_NUMBER
# Override the GBB_HWID
config GBB_HWID
	string
	default "MSI_MS7D25"

endif
```

## src/mainboard/msi/ms7d25/Kconfig.name
```kconfig
config BOARD_MSI_Z690_A_PRO_WIFI_DDR4
	bool "PRO Z690-A (WIFI) DDR4"

config BOARD_MSI_Z690_A_PRO_WIFI_DDR5
	bool "PRO Z690-A (WIFI)"
```

## src/mainboard/msi/ms7d98/Kconfig
```kconfig
## SPDX-License-Identifier: GPL-2.0-only

if BOARD_MSI_MS7D98

config BOARD_SPECIFIC_OPTIONS
	def_bool y
	select BOARD_ROMSIZE_KB_32768
	select CRB_TPM
	select DRIVERS_UART_8250IO
	select DRIVERS_PCIE_RTD3_DEVICE
	select HAVE_ACPI_TABLES
	select HAVE_ACPI_RESUME
	select HAVE_INTEL_PTT
	select INTEL_GMA_HAVE_VBT
	select MEMORY_MAPPED_TPM
	select SOC_INTEL_COMMON_BLOCK_HDA_VERB
	select SOC_INTEL_COMMON_BLOCK_MEMINIT
	select SOC_INTEL_RAPTORLAKE_PCH_S
	select SUPERIO_NUVOTON_NCT6687D

config MAINBOARD_VENDOR
	default "Micro-Star International Co., Ltd."

config MAINBOARD_PART_NUMBER
	default "MS-7D98"

config MAINBOARD_SMBIOS_PRODUCT_NAME
	default "PRO B760-P WIFI DDR4 (MS-7D98)"

config MAINBOARD_DIR
	default "msi/ms7d98"

config USE_LEGACY_8254_TIMER
	default y		# Required for proper S3

config CBFS_SIZE
	default 0x1000000 	# 16MB
endif
```

## src/mainboard/msi/ms7d98/Kconfig.name
```kconfig
## SPDX-License-Identifier: GPL-2.0-only

config BOARD_MSI_MS7D98
	bool "PRO B760-P WIFI DDR4 (MS-7D98)"
```

## src/mainboard/msi/ms7e06/Kconfig
```kconfig
## SPDX-License-Identifier: GPL-2.0-only

config BOARD_MSI_Z790_P_PRO_WIFI_DDR4
	select BOARD_MSI_MS7E06

config BOARD_MSI_Z790_P_PRO_WIFI
	select BOARD_MSI_MS7E06

config BOARD_MSI_MS7E06
	def_bool n
	select AZALIA_USE_LEGACY_VERB_TABLE
	select SOC_INTEL_RAPTORLAKE_PCH_S
	select BOARD_ROMSIZE_KB_32768
	select SOC_INTEL_COMMON_BLOCK_HDA_VERB
	select SUPERIO_NUVOTON_NCT6687D
	select DRIVERS_UART_8250IO
	select HAVE_ACPI_RESUME
	select HAVE_ACPI_TABLES
	select INTEL_GMA_HAVE_VBT
	select MEMORY_MAPPED_TPM
	select CRB_TPM
	select HAVE_INTEL_PTT

if BOARD_MSI_MS7E06

config MAINBOARD_DIR
	default "msi/ms7e06"

config MAINBOARD_PART_NUMBER
	default "PRO Z790-P WIFI DDR4(MS-7E06)" if BOARD_MSI_Z790_P_PRO_WIFI_DDR4
	default "PRO Z790-P WIFI (MS-7E06)" if BOARD_MSI_Z790_P_PRO_WIFI

config MAINBOARD_VENDOR
	default "Micro-Star International Co., Ltd."

config MAINBOARD_FAMILY
	default "Default string"

config UART_FOR_CONSOLE
	default 0

config USE_PM_ACPI_TIMER
	default n

config USE_LEGACY_8254_TIMER
	default y

config CBFS_SIZE
	default 0x1000000

config TPM_PIRQ
	default 0x3f # GPP_E7_IRQ

config VBOOT
	select GBB_FLAG_DISABLE_EC_SOFTWARE_SYNC
	select GBB_FLAG_DISABLE_FWMP
	select GBB_FLAG_DISABLE_LID_SHUTDOWN
	select GBB_FLAG_DISABLE_PD_SOFTWARE_SYNC
	select VBOOT_ALWAYS_ENABLE_DISPLAY
	select VBOOT_NO_BOARD_SUPPORT
	select HAS_RECOVERY_MRC_CACHE

config VBOOT_SLOTS_RW_AB
	default y if VBOOT

config SOC_INTEL_CSE_SEND_EOP_EARLY
	default n

config FMDFILE
	default "src/mainboard/\$(CONFIG_MAINBOARD_DIR)/vboot-rwab.fmd" if VBOOT && VBOOT_SLOTS_RW_AB

# gen_test_hwid.sh script doesn't like parentheses in the MAINBOARD_PART_NUMBER
# Override the GBB_HWID
config GBB_HWID
	default "MSI_MS7E06"

endif
```

## src/mainboard/msi/ms7e06/Kconfig.name
```kconfig
## SPDX-License-Identifier: GPL-2.0-only

config BOARD_MSI_Z790_P_PRO_WIFI_DDR4
	bool "PRO Z790-P (WIFI) DDR4"

config BOARD_MSI_Z790_P_PRO_WIFI
	bool "PRO Z790-P (WIFI)"
```

## src/mainboard/msi/ms9185/Kconfig
```kconfig
config BOARD_MSI_MS9185
	bool "MS-9185 (K9SD Master-S2R)"
	select ARCH_X86
	select CPU_AMD_SOCKET_F
	select NORTHBRIDGE_AMD_AMDK8
	select NORTHBRIDGE_AMD_AMDK8_ROOT_COMPLEX
	select SOUTHBRIDGE_BROADCOM_BCM5780
	select SOUTHBRIDGE_BROADCOM_BCM5785
	select SUPERIO_NSC_PC87417
	select HAVE_BUS_CONFIG
	select HAVE_PIRQ_TABLE
	select HAVE_MP_TABLE
	select USE_PRINTK_IN_CAR
	select USE_DCACHE_RAM
	select HAVE_HARD_RESET
	select LIFT_BSP_APIC_ID
	select BOARD_ROMSIZE_KB_512
	select SB_HT_CHAIN_UNITID_OFFSET_ONLY

config MAINBOARD_DIR
	string
	default msi/ms9185
	depends on BOARD_MSI_MS9185

config DCACHE_RAM_BASE
	hex
	default 0xcc000
	depends on BOARD_MSI_MS9185

config DCACHE_RAM_SIZE
	hex
	default 0x04000
	depends on BOARD_MSI_MS9185

config DCACHE_RAM_GLOBAL_VAR_SIZE
	hex
	default 0x01000
	depends on BOARD_MSI_MS9185

config APIC_ID_OFFSET
	hex
	default 0x8
	depends on BOARD_MSI_MS9185

config SB_HT_CHAIN_ON_BUS0
	int
	default 2
	depends on BOARD_MSI_MS9185

config LB_CKS_RANGE_END
	int
	default 122
	depends on BOARD_MSI_MS9185

config LB_CKS_LOC
	int
	default 123
	depends on BOARD_MSI_MS9185

config MAINBOARD_PART_NUMBER
	string
	default "MS-9185"
	depends on BOARD_MSI_MS9185

config HW_MEM_HOLE_SIZEK
	hex
	default 0x100000
	depends on BOARD_MSI_MS9185

config MAX_CPUS
	int
	default 4
	depends on BOARD_MSI_MS9185

config MAX_PHYSICAL_CPUS
	int
	default 2
	depends on BOARD_MSI_MS9185

config HT_CHAIN_END_UNITID_BASE
	hex
	default 0x1
	depends on BOARD_MSI_MS9185

config HT_CHAIN_UNITID_BASE
	hex
	default 0x6
	depends on BOARD_MSI_MS9185

config USE_INIT
	bool
	default n
	depends on BOARD_MSI_MS9185

config IRQ_SLOT_COUNT
	int
	default 11
	depends on BOARD_MSI_MS9185

config MAINBOARD_PCI_SUBSYSTEM_VENDOR_ID
	hex
	default 0x1022
	depends on BOARD_MSI_MS9185

config MAINBOARD_PCI_SUBSYSTEM_DEVICE_ID
	hex
	default 0x2b80
	depends on BOARD_MSI_MS9185
```
