## src/mainboard/msi/ms9652_fam10/Kconfig
```kconfig
if BOARD_MSI_MS9652_FAM10

config BOARD_SPECIFIC_OPTIONS # dummy
	def_bool y
	select ARCH_X86
	select CPU_AMD_SOCKET_F_1207
	select DIMM_DDR2
	select DIMM_REGISTERED
	select NORTHBRIDGE_AMD_AMDFAM10
	select SOUTHBRIDGE_NVIDIA_MCP55
	select MCP55_USE_NIC
	select MCP55_USE_AZA
	select SUPERIO_WINBOND_W83627EHG
	select HAVE_PIRQ_TABLE
	select HAVE_MP_TABLE
	select HAVE_ACPI_TABLES
	select HAVE_OPTION_TABLE
	select BOARD_ROMSIZE_KB_512
	select RAMINIT_SYSINFO
	select ENABLE_APIC_EXT_ID
	select AMDMCT
	select SB_HT_CHAIN_UNITID_OFFSET_ONLY
	select QRANK_DIMM_SUPPORT
	select LIFT_BSP_APIC_ID

config MAINBOARD_DIR
	string
	default msi/ms9652_fam10

config DCACHE_RAM_BASE
	hex
	default 0xc4000

config DCACHE_RAM_SIZE
	hex
	default 0x0c000

# Define to 0 because the IRQ slot count is
# determined dynamically for this board.
config IRQ_SLOT_COUNT
	int
	default 0

config MAX_CPUS
	int
	default 8

config MAX_PHYSICAL_CPUS
	int
	default 2

config LOGICAL_CPUS
	bool
	default y

config IOAPIC
	bool
	default y

config SMP
	bool
	default y

config HEAP_SIZE
	hex
	default 0x20000

config USE_OPTION_TABLE
	bool
	default n

config MAINBOARD_PART_NUMBER
	string
	default "MS-9652"

config RAMBASE
	hex
	default 0x200000

config TTYS0_BAUD
	int
	default 115200

config TTYS0_BASE
	hex
	default 0x3f8

config TTYS0_LCS
	int
	default 3

config DEFAULT_CONSOLE_LOGLEVEL
	int
	default 9

config MAINBOARD_POWER_ON_AFTER_POWER_FAIL
	bool
	default y

config CONSOLE_SERIAL8250
	bool
	default y

config PCI_ROM_RUN
	bool
	default y

config USBDEBUG
	bool
	default n

config HT_CHAIN_UNITID_BASE
	hex
	default 0x20

config HT_CHAIN_END_UNITID_BASE
	hex
	default 0x00

config SB_HT_CHAIN_ON_BUS0
	int
	default 1

config VAR_MTRR_HOLE
	bool
	default n

config SERIAL_CPU_INIT
	bool
	default y

config APIC_ID_OFFSET
	hex
	default 0x00

config RAMTOP
	hex
	default 0x1000000

config MEM_TRAIN_SEQ
	int
	default 2

config AMD_UCODE_PATCH_FILE
	string
	default "mc_patch_01000096.h"

config HT3_SUPPORT
	bool
	default y

config MCP55_PCI_E_X_0
	int
	default 1

endif # BOARD_MSI_MS9652_FAM10
```

## src/mainboard/nec/powermate2000/Kconfig
```kconfig
##
## This file is part of the coreboot project.
##
## Copyright (C) 2009 Uwe Hermann <uwe@hermann-uwe.de>
##
## This program is free software; you can redistribute it and/or modify
## it under the terms of the GNU General Public License as published by
## the Free Software Foundation; version 2 of the License.
##
## This program is distributed in the hope that it will be useful,
## but WITHOUT ANY WARRANTY; without even the implied warranty of
## MERCHANTABILITY or FITNESS FOR A PARTICULAR PURPOSE.  See the
## GNU General Public License for more details.
##
## You should have received a copy of the GNU General Public License
## along with this program; if not, write to the Free Software
## Foundation, Inc., 51 Franklin St, Fifth Floor, Boston, MA 02110-1301 USA
##
if BOARD_NEC_POWERMATE_2000

config BOARD_SPECIFIC_OPTIONS # dummy
	def_bool y
	select ARCH_X86
	select CPU_INTEL_SOCKET_PGA370
	select NORTHBRIDGE_INTEL_I82810
	select SOUTHBRIDGE_INTEL_I82801AX
	select SUPERIO_SMSC_SMSCSUPERIO
	select HAVE_PIRQ_TABLE
	select UDELAY_TSC
	select BOARD_ROMSIZE_KB_512
	select GFXUMA

config MAINBOARD_DIR
	string
	default nec/powermate2000

config MAINBOARD_PART_NUMBER
	string
	default "PowerMate 2000"

config IRQ_SLOT_COUNT
	int
	default 5

endif # BOARD_NEC_POWERMATE_2000
```

## src/mainboard/newisys/Kconfig
```kconfig
if VENDOR_NEWISYS

choice
	prompt "Mainboard model"

source "src/mainboard/newisys/*/Kconfig.name"

endchoice

source "src/mainboard/newisys/*/Kconfig"

config MAINBOARD_VENDOR
	string
	default "Newisys"

endif # VENDOR_NEWISYS
```

## src/mainboard/newisys/khepri/Kconfig
```kconfig
if BOARD_NEWISYS_KHEPRI

config BOARD_SPECIFIC_OPTIONS # dummy
	def_bool y
	select ARCH_X86
	select CPU_AMD_SOCKET_940
	select NORTHBRIDGE_AMD_AMDK8
	select SOUTHBRIDGE_AMD_AMD8111
	select SOUTHBRIDGE_AMD_AMD8131
	select SUPERIO_WINBOND_W83627HF
	select HAVE_OPTION_TABLE
	select HAVE_PIRQ_TABLE
	select HAVE_MP_TABLE
	select BOARD_ROMSIZE_KB_512
	select SB_HT_CHAIN_UNITID_OFFSET_ONLY
	select QRANK_DIMM_SUPPORT

config MAINBOARD_DIR
	string
	default newisys/khepri

config DCACHE_RAM_BASE
	hex
	default 0xcf000

config DCACHE_RAM_SIZE
	hex
	default 0x01000

config APIC_ID_OFFSET
	hex
	default 0x0

config K8_REV_F_SUPPORT
	bool
	default n

config SB_HT_CHAIN_ON_BUS0
	int
	default 0

config MAINBOARD_PART_NUMBER
	string
	default "Khepri"

config MAX_CPUS
	int
	default 4

config MAX_PHYSICAL_CPUS
	int
	default 2

config HT_CHAIN_END_UNITID_BASE
	hex
	default 0x20

config HT_CHAIN_UNITID_BASE
	hex
	default 0x1

config SB_HT_CHAIN_ON_BUS0
	int
	default 2

config IRQ_SLOT_COUNT
	int
	default 9

endif # BOARD_NEWISYS_KHEPRI
```

## src/mainboard/nokia/Kconfig
```kconfig
##
## This file is part of the coreboot project.
##
## Copyright (C) 2010 Marc Bertens <mbertens@xs4all.nl>
##
## This program is free software; you can redistribute it and/or modify
## it under the terms of the GNU General Public License as published by
## the Free Software Foundation; version 2 of the License.
##
## This program is distributed in the hope that it will be useful,
## but WITHOUT ANY WARRANTY; without even the implied warranty of
## MERCHANTABILITY or FITNESS FOR A PARTICULAR PURPOSE.  See the
## GNU General Public License for more details.
##
if VENDOR_NOKIA

choice
	prompt "Mainboard model"

source "src/mainboard/nokia/*/Kconfig.name"

endchoice

source "src/mainboard/nokia/*/Kconfig"

config MAINBOARD_VENDOR
	string
	default "Nokia"

endif # VENDOR_NOKIA
```

## src/mainboard/nokia/ip530/Kconfig
```kconfig
##
## This file is part of the coreboot project.
##
## Copyright (C) 2010 Marc Bertens <mbertens@xs4all.nl>
##
## This program is free software; you can redistribute it and/or modify
## it under the terms of the GNU General Public License as published by
## the Free Software Foundation; version 2 of the License.
##
## This program is distributed in the hope that it will be useful,
## but WITHOUT ANY WARRANTY; without even the implied warranty of
## MERCHANTABILITY or FITNESS FOR A PARTICULAR PURPOSE.  See the
## GNU General Public License for more details.
##
## You should have received a copy of the GNU General Public License
## along with this program; if not, write to the Free Software
## Foundation, Inc., 51 Franklin St, Fifth Floor, Boston, MA 02110-1301 USA
##
if BOARD_NOKIA_IP530

config BOARD_SPECIFIC_OPTIONS # dummy
	def_bool y
	select ARCH_X86
	select CPU_INTEL_SOCKET_PGA370
	select NORTHBRIDGE_INTEL_I440BX
	select SOUTHBRIDGE_INTEL_I82371EB
	select SUPERIO_SMSC_SMSCSUPERIO
	select SOUTHBRIDGE_TI_PCI1X2X
	select DRIVERS_DEC_21143
	select BOARD_ROMSIZE_KB_512
	select PIRQ_ROUTE
	select HAVE_PIRQ_TABLE
	select UDELAY_TSC
	select SDRAMPWR_4DIMM

config MAINBOARD_DIR
	string
	default nokia/ip530

config MAINBOARD_PART_NUMBER
	string
	default "IP530"

config IRQ_SLOT_COUNT
	int
	default 22

endif # BOARD_NOKIA_IP530
```

## src/mainboard/novacustom/Kconfig
```kconfig
## SPDX-License-Identifier: GPL-2.0-only

if VENDOR_NOVACUSTOM

choice
	prompt "Mainboard model"

source "src/mainboard/novacustom/*/Kconfig.name"

endchoice

source "src/mainboard/novacustom/*/Kconfig"

config MAINBOARD_VENDOR
	default "NovaCustom"

endif # VENDOR_NOVACUSTOM
```

## src/mainboard/novacustom/mtl-h/Kconfig
```kconfig
config BOARD_NOVACUSTOM_MTLH_COMMON
	def_bool n
	select AZALIA_USE_LEGACY_VERB_TABLE
	select BOARD_ROMSIZE_KB_32768
	select DRIVERS_GENERIC_BAYHUB_LV2
	select DRIVERS_GFX_GENERIC
	select DRIVERS_I2C_HID
	select DRIVERS_INTEL_PMC
	select DRIVERS_INTEL_USB4_RETIMER
	select DRIVERS_WIFI_GENERIC
	select EC_DASHARO_EC
	select HAVE_ACPI_TABLES
	select HAVE_CMOS_DEFAULT
	select HAVE_OPTION_TABLE
	select INTEL_GMA_HAVE_VBT
	select MAINBOARD_HAS_TPM2
	select MEMORY_MAPPED_TPM
	select NO_UART_ON_SUPERIO
	select PMC_IPC_ACPI_INTERFACE
	select SOC_INTEL_COMMON_BLOCK_HDA_VERB
	select SOC_INTEL_CRASHLOG
	select SOC_INTEL_ENABLE_USB4_PCIE_RESOURCES
	select SOC_INTEL_METEORLAKE_U_H
	select SPD_READ_BY_WORD
	select SYSTEM_TYPE_LAPTOP

config BOARD_NOVACUSTOM_V5X0TNX_BASE
	bool
	select EC_DASHARO_EC_DGPU
	select BOARD_NOVACUSTOM_MTLH_COMMON
	select DRIVERS_I2C_TAS5825M

config BOARD_NOVACUSTOM_V540TNX
	bool
	select BOARD_NOVACUSTOM_V5X0TNX_BASE

config BOARD_NOVACUSTOM_V560TNX
	bool
	select BOARD_NOVACUSTOM_V5X0TNX_BASE

config BOARD_NOVACUSTOM_V5X0TU_BASE
	bool
	select BOARD_NOVACUSTOM_MTLH_COMMON
	select MAINBOARD_USES_IFD_GBE_REGION

config BOARD_NOVACUSTOM_V540TU
	bool
	select BOARD_NOVACUSTOM_V5X0TU_BASE

config BOARD_NOVACUSTOM_V560TU
	bool
	select BOARD_NOVACUSTOM_V5X0TU_BASE

if BOARD_NOVACUSTOM_MTLH_COMMON

config MAINBOARD_DIR
	default "novacustom/mtl-h"

config VARIANT_DIR
	default "igpu" if BOARD_NOVACUSTOM_V5X0TU_BASE
	default "dgpu" if BOARD_NOVACUSTOM_V5X0TNX_BASE

config OVERRIDE_DEVICETREE
	default "variants/\$(CONFIG_VARIANT_DIR)/overridetree.cb"

config MAINBOARD_PART_NUMBER
	default "V54x_6x_TU" if BOARD_NOVACUSTOM_V5X0TU_BASE
	default "V5xTNC_TND_TNE" if BOARD_NOVACUSTOM_V5X0TNX_BASE

config MAINBOARD_SMBIOS_PRODUCT_NAME
	default "V54x_6x_TU" if BOARD_NOVACUSTOM_V5X0TU_BASE
	default "V5xTNC_TND_TNE" if BOARD_NOVACUSTOM_V5X0TNX_BASE

config MAINBOARD_SMBIOS_MANUFACTURER
	default "Notebook"

config MAINBOARD_VERSION
	default "V540TU" if BOARD_NOVACUSTOM_V540TU
	default "V560TU" if BOARD_NOVACUSTOM_V560TU
	default "V540TNx" if BOARD_NOVACUSTOM_V540TNX
	default "V560TNx" if BOARD_NOVACUSTOM_V560TNX

config MAINBOARD_FAMILY
	string
	default "Not Applicable" # Match Insyde firmware, for Windows Update

config CBFS_SIZE
	default 0xA00000

config CONSOLE_POST
	default y

config DIMM_SPD_SIZE
	default 1024

config POST_DEVICE
	default n

config USE_PM_ACPI_TIMER
	default n

config VBOOT
	select GBB_FLAG_DISABLE_EC_SOFTWARE_SYNC
	select GBB_FLAG_DISABLE_FWMP
	select GBB_FLAG_DISABLE_LID_SHUTDOWN
	select GBB_FLAG_DISABLE_PD_SOFTWARE_SYNC
	select HAS_RECOVERY_MRC_CACHE
	select VBOOT_ALWAYS_ENABLE_DISPLAY
	select VBOOT_CLEAR_RECOVERY_IN_RAMSTAGE
	select VBOOT_MOCK_SECDATA
	select VBOOT_NO_BOARD_SUPPORT

config VBOOT_SLOTS_RW_AB
	default y if VBOOT

config VBOOT_VBNV_OFFSET
	default 0x28

config TPM_PIRQ
	default 0x61 # GPP_E01

config FMDFILE
	default "src/mainboard/\$(CONFIG_MAINBOARD_DIR)/vboot-rwab.fmd" if VBOOT && VBOOT_SLOTS_RW_AB

config SOC_INTEL_CSE_SEND_EOP_EARLY
	default n

config EC_DASHARO_EC_FLASH_SIZE
	default 0x40000

endif
```

## src/mainboard/novacustom/mtl-h/Kconfig.name
```kconfig
comment "Meteor Lake H"

config BOARD_NOVACUSTOM_V540TNX
	bool "V540TNx (14\", discrete graphics)"

config BOARD_NOVACUSTOM_V560TNX
	bool "V560TNx (16\", discrete graphics)"

config BOARD_NOVACUSTOM_V540TU
	bool "V540TU (14\", integrated graphics)"

config BOARD_NOVACUSTOM_V560TU
	bool "V560TU (16\", integrated graphics)"
```

## src/mainboard/nvidia/Kconfig
```kconfig
if VENDOR_NVIDIA

choice
	prompt "Mainboard model"

source "src/mainboard/nvidia/*/Kconfig.name"

endchoice

source "src/mainboard/nvidia/*/Kconfig"

config MAINBOARD_VENDOR
	string
	default "NVIDIA"

endif # VENDOR_NVIDIA
```

## src/mainboard/nvidia/l1_2pvv/Kconfig
```kconfig
config BOARD_NVIDIA_L1_2PVV
	bool "l1_2pvv"
	select ARCH_X86
	select CPU_AMD_SOCKET_F
	select NORTHBRIDGE_AMD_AMDK8
	select NORTHBRIDGE_AMD_AMDK8_ROOT_COMPLEX
	select SOUTHBRIDGE_NVIDIA_MCP55
	select SUPERIO_WINBOND_W83627EHG
	select HAVE_BUS_CONFIG
	select HAVE_PIRQ_TABLE
	select HAVE_MP_TABLE
	select USE_PRINTK_IN_CAR
	select USE_DCACHE_RAM
	select HAVE_HARD_RESET
	select LIFT_BSP_APIC_ID
	select K8_REV_F_SUPPORT
	select BOARD_ROMSIZE_KB_512
 
config MAINBOARD_DIR
	string
	default nvidia/l1_2pvv
	depends on BOARD_NVIDIA_L1_2PVV

config DCACHE_RAM_BASE
	hex
	default 0xc8000
	depends on BOARD_NVIDIA_L1_2PVV
	
config DCACHE_RAM_SIZE
	hex
	default 0x08000
	depends on BOARD_NVIDIA_L1_2PVV

config DCACHE_RAM_GLOBAL_VAR_SIZE
	hex
	default 0x01000
	depends on BOARD_NVIDIA_L1_2PVV

config APIC_ID_OFFSET
	hex	
	default 0x10
	depends on BOARD_NVIDIA_L1_2PVV

config MEM_TRAIN_SEQ
	int
	default 1
	depends on BOARD_NVIDIA_L1_2PVV

config SB_HT_CHAIN_ON_BUS0
	int
	default 2
	depends on BOARD_NVIDIA_L1_2PVV

config MAINBOARD_PART_NUMBER
	string
	default "l1_2pvv"
	depends on BOARD_NVIDIA_L1_2PVV

config PCI_64BIT_PREF_MEM
	bool
        default n
	depends on BOARD_NVIDIA_L1_2PVV

config HW_MEM_HOLE_SIZEK
	hex
	default 0x100000
	depends on BOARD_NVIDIA_L1_2PVV

config MAX_CPUS
	int
	default 4
	depends on BOARD_NVIDIA_L1_2PVV

config MAX_PHYSICAL_CPUS
	int
	default 2
	depends on BOARD_NVIDIA_L1_2PVV

config HW_MEM_HOLE_SIZE_AUTO_INC
	bool	
	default n
	depends on BOARD_NVIDIA_L1_2PVV

config HT_CHAIN_UNITID_BASE
	hex
	default 0x0
	depends on BOARD_NVIDIA_L1_2PVV

config HT_CHAIN_END_UNITID_BASE
	hex	
	default 0x20
	depends on BOARD_NVIDIA_L1_2PVV

config SERIAL_CPU_INIT
	bool	
	default n
	depends on BOARD_NVIDIA_L1_2PVV

config MAINBOARD_PCI_SUBSYSTEM_VENDOR_ID
	hex
	default 0x1022
	depends on BOARD_NVIDIA_L1_2PVV

config MAINBOARD_PCI_SUBSYSTEM_DEVICE_ID
	hex
	default 0x2b80
	depends on BOARD_NVIDIA_L1_2PVV

config IRQ_SLOT_COUNT
	int
	default 11
	depends on BOARD_NVIDIA_L1_2PVV
```

## src/mainboard/ocp/Kconfig
```kconfig
if VENDOR_OCP

choice
	prompt "Mainboard model"

source "src/mainboard/ocp/*/Kconfig.name"

endchoice

source "src/mainboard/ocp/*/Kconfig"

config MAINBOARD_VENDOR
	string
	default "Open Compute Project"

endif # VENDOR_OCP
```

## src/mainboard/ocp/Kconfig.name
```kconfig
## SPDX-License-Identifier: GPL-2.0-only

config VENDOR_OCP
	bool "Open Compute Project"
```

## src/mainboard/ocp/deltalake/Kconfig
```kconfig
if BOARD_OCP_DELTALAKE

config BOARD_SPECIFIC_OPTIONS
	def_bool y
	select BOARD_ROMSIZE_KB_65536
	select CONSOLE_OVERRIDE_LOGLEVEL
	select HAVE_ACPI_TABLES
	select MAINBOARD_USES_FSP2_0
	select SOC_INTEL_COOPERLAKE_SP
	select SUPERIO_ASPEED_AST2400
	select IPMI_KCS
	select IPMI_KCS_ROMSTAGE
	select OCP_DMI
	select VPD
	select VPD_SMBIOS_VERSION
	select IPMI_OCP
	select MEMORY_MAPPED_TPM
	select MAINBOARD_HAS_TPM2

config UART_FOR_CONSOLE
	int
	default 1

config POWER_STATE_DEFAULT_ON_AFTER_FAILURE
	default n

config IPMI_KCS_REGISTER_SPACING
	int
	default 4

config MAINBOARD_DIR
	default "ocp/deltalake"

config MAINBOARD_PART_NUMBER
	default "DeltaLake"

config MAINBOARD_FAMILY
	string
	default "DeltaLake"

config MAX_SOCKET
	int
	default 1

config FMDFILE
	default "src/mainboard/\$(CONFIG_MAINBOARD_DIR)/board.fmd"

# Deltalake is single socket server, the platform design has 1 DIMM per channel
config DIMM_MAX
	default 6

config CONSOLE_POST
	bool
	default y

endif # BOARD_OCP_DELTALAKE
```

## src/mainboard/ocp/deltalake/Kconfig.name
```kconfig
## SPDX-License-Identifier: GPL-2.0-only

config BOARD_OCP_DELTALAKE
	bool "DeltaLake"
```
