## src/mainboard/ocp/monolake/Kconfig
```kconfig
if BOARD_OCP_MONOLAKE

config BOARD_SPECIFIC_OPTIONS
	def_bool y
	select SOC_INTEL_FSP_BROADWELL_DE
	select BOARD_ROMSIZE_KB_16384
	select HAVE_ACPI_TABLES
	select HAVE_OPTION_TABLE
	select INTEGRATED_UART if FSP_PACKAGE_DEFAULT
	select HAVE_FSP_BIN if FSP_PACKAGE_DEFAULT
	select SERIRQ_CONTINUOUS_MODE
	select MAINBOARD_USES_IFD_GBE_REGION
	select MAINBOARD_HAS_LPC_TPM
	select MAINBOARD_HAS_TPM1
	select IPMI_KCS
	select VPD

config VBOOT
	select VBOOT_VBNV_CMOS
	select VBOOT_NO_BOARD_SUPPORT
	select GBB_FLAG_DISABLE_LID_SHUTDOWN
	select GBB_FLAG_DISABLE_PD_SOFTWARE_SYNC
	select GBB_FLAG_DISABLE_EC_SOFTWARE_SYNC
	select GBB_FLAG_DISABLE_FWMP

config INTEGRATED_UART
	def_bool n

config MAINBOARD_DIR
	string
	default "ocp/monolake"

config MAINBOARD_PART_NUMBER
	string
	default "Mono Lake"

config IRQ_SLOT_COUNT
	int
	default 18

config CBFS_SIZE
	hex
	default 0x00200000

config VIRTUAL_ROM_SIZE
	hex
	default 0x1000000

config DRIVERS_UART_8250IO
	def_bool n

config FSP_PACKAGE_DEFAULT
	bool "Configure defaults for the Intel FSP package"
	default n

config FMDFILE
	string
	default "src/mainboard/$(CONFIG_MAINBOARD_DIR)/board.fmd"

config IPMI_KCS_REGISTER_SPACING
	default 4

config IPMI_FRU_SINGLE_RW_SZ
	default 16
endif # BOARD_OCP_MONOLAKE
```
