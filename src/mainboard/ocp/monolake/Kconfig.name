## src/mainboard/ocp/sonorapass/Kconfig
```kconfig
# SPDX-License-Identifier: GPL-2.0-only

if BOARD_OCP_SONORAPASS

config BOARD_SPECIFIC_OPTIONS
	def_bool y
	select BOARD_ROMSIZE_KB_65536
	select MAINBOARD_USES_FSP2_0
	select IPMI_KCS
	select SOC_INTEL_COOPERLAKE_SP
	select SUPERIO_ASPEED_AST2400
	select HAVE_ACPI_TABLES

config MAINBOARD_DIR
	string
	default "ocp/sonorapass"

config MAINBOARD_PART_NUMBER
	string
	default "SonoraPass"

config MAINBOARD_FAMILY
	string
	default "SonoraPass"

config FMDFILE
	string
	default "src/mainboard/\$(CONFIG_MAINBOARD_DIR)/board.fmd"

endif
```

## src/mainboard/ocp/tiogapass/Kconfig
```kconfig
## SPDX-License-Identifier: GPL-2.0-or-later

if BOARD_OCP_TIOGAPASS

config BOARD_SPECIFIC_OPTIONS
	def_bool y
	select BOARD_ROMSIZE_KB_32768
	select HAVE_ACPI_TABLES
	select IPMI_KCS
	select IPMI_KCS_ROMSTAGE
	select IPMI_OCP
	select MAINBOARD_USES_FSP2_0
	select OCP_DMI
	select SOC_INTEL_SKYLAKE_SP
	select SUPERIO_ASPEED_AST2400
	select UART_OVERRIDE_BAUDRATE
	select VPD

config MAINBOARD_DIR
	default "ocp/tiogapass"

config MAINBOARD_PART_NUMBER
	default "TiogaPass"

config MAINBOARD_FAMILY
	string
	default "TiogaPass"

config FMDFILE
	default "src/mainboard/\$(CONFIG_MAINBOARD_DIR)/board.fmd"

config UART_FOR_CONSOLE
	int
	default 1

config TTYS0_BAUD
	default 57600

endif # BOARD_OCP_TIOGAPASS
```

## src/mainboard/ocp/tiogapass/Kconfig.name
```kconfig
## SPDX-License-Identifier: GPL-2.0-only

config BOARD_OCP_TIOGAPASS
	bool "TiogaPass"
```

## src/mainboard/ocp/wedge100s/Kconfig
```kconfig
if BOARD_OCP_WEDGE100S

config BOARD_SPECIFIC_OPTIONS
	def_bool y
	select SOC_INTEL_FSP_BROADWELL_DE
	select BOARD_ROMSIZE_KB_16384
	select HAVE_ACPI_TABLES
	select HAVE_OPTION_TABLE
	select HAVE_FSP_BIN if FSP_PACKAGE_DEFAULT
	select SERIRQ_CONTINUOUS_MODE
	select FSP_EHCI1_ENABLE
	select MRC_CACHE_FMAP
	select ENABLE_FSP_FAST_BOOT
	select MAINBOARD_HAS_LPC_TPM
	select MAINBOARD_HAS_TPM1
	select DRIVERS_UART_8250IO
	select SUPERIO_ITE_IT8528E
	select IPMI_KCS

config VBOOT
	select VBOOT_VBNV_CMOS
	select VBOOT_NO_BOARD_SUPPORT
	select GBB_FLAG_DISABLE_LID_SHUTDOWN
	select GBB_FLAG_DISABLE_PD_SOFTWARE_SYNC
	select GBB_FLAG_DISABLE_EC_SOFTWARE_SYNC
	select GBB_FLAG_DISABLE_FWMP

config MAINBOARD_DIR
	string
	default "ocp/wedge100s"

config MAINBOARD_PART_NUMBER
	string
	default "Wedge 100S"

config IRQ_SLOT_COUNT
	int
	default 18

config CBFS_SIZE
	hex
	default 0x006fa000 if VBOOT
	default 0x00200000

config VIRTUAL_ROM_SIZE
	hex
	default 0x1000000

config FSP_PACKAGE_DEFAULT
	bool "Configure defaults for the Intel FSP package"
	default n

config FMDFILE
	string
	default "src/mainboard/$(CONFIG_MAINBOARD_DIR)/vboot-ro.fmd" if VBOOT
	default "src/mainboard/$(CONFIG_MAINBOARD_DIR)/board.fmd"

config INTEGRATED_UART
	def_bool n

endif # BOARD_OCP_WEDGE100S
```

## src/mainboard/olpc/Kconfig
```kconfig
if VENDOR_OLPC

choice
	prompt "Mainboard model"

config BOARD_OLPC_BTEST
	bool "btest"
config BOARD_OLPC_REV_A
	bool "rev_a"

endchoice

source "src/mainboard/olpc/btest/Kconfig"
source "src/mainboard/olpc/rev_a/Kconfig"

config MAINBOARD_VENDOR
	string
	default "OLPC"

endif # VENDOR_OLPC
```

## src/mainboard/olpc/btest/Kconfig
```kconfig
if BOARD_OLPC_BTEST

config BOARD_SPECIFIC_OPTIONS # dummy
	def_bool y
	select ARCH_X86
	select CPU_AMD_GX2
	select NORTHBRIDGE_AMD_GX2
	select SOUTHBRIDGE_AMD_CS5536
	select UDELAY_TSC
	select CACHE_AS_RAM
	select HAVE_PIRQ_TABLE
	select BOARD_ROMSIZE_KB_256

config MAINBOARD_DIR
	string
	default olpc/btest

config MAINBOARD_PART_NUMBER
	string
	default "btest"

config IRQ_SLOT_COUNT
	int
	default 2

endif # BOARD_OLPC_BTEST
```

## src/mainboard/olpc/rev_a/Kconfig
```kconfig
if BOARD_OLPC_REV_A

config BOARD_SPECIFIC_OPTIONS # dummy
	def_bool y
	select ARCH_X86
	select CPU_AMD_GX2
	select NORTHBRIDGE_AMD_GX2
	select SOUTHBRIDGE_AMD_CS5536
	select UDELAY_TSC
	select CACHE_AS_RAM
	select HAVE_PIRQ_TABLE
	select BOARD_ROMSIZE_KB_256

config MAINBOARD_DIR
	string
	default olpc/rev_a

config MAINBOARD_PART_NUMBER
	string
	default "rev_a"

config IRQ_SLOT_COUNT
	int
	default 2

endif # BOARD_OLPC_REV_A
```

## src/mainboard/opencellular/Kconfig
```kconfig
## SPDX-License-Identifier: GPL-2.0-only

if VENDOR_OPENCELLULAR

choice
	prompt "Mainboard model"

source "src/mainboard/opencellular/*/Kconfig.name"

endchoice

source "src/mainboard/opencellular/*/Kconfig"

config MAINBOARD_VENDOR
	default "OpenCellular"

endif # VENDOR_OPENCELLULAR
```

## src/mainboard/opencellular/elgon/Kconfig
```kconfig
## SPDX-License-Identifier: GPL-2.0-only

if BOARD_OPENCELLULAR_ELGON

config BOARD_SPECIFIC_OPTIONS
	def_bool y
	select BOARD_ROMSIZE_KB_16384
	select COMMON_CBFS_SPI_WRAPPER
	select I2C_TPM
	select RTC
	select SOC_CAVIUM_CN81XX
	select SPI_FLASH
	select SPI_FLASH_WINBOND
	select MAINBOARD_HAS_TPM1
	select MISSING_BOARD_RESET

config VBOOT
	select VBOOT_NO_BOARD_SUPPORT
	select GBB_FLAG_DISABLE_LID_SHUTDOWN
	select GBB_FLAG_DISABLE_PD_SOFTWARE_SYNC
	select GBB_FLAG_DISABLE_EC_SOFTWARE_SYNC
	select GBB_FLAG_DISABLE_FWMP

config GBB_HWID
	string
	depends on VBOOT
	default "ELGON"

config MAINBOARD_DIR
	default "opencellular/elgon"

config DRIVER_TPM_I2C_BUS
	hex
	default 0x1

config DRIVER_TPM_I2C_ADDR
	hex
	default 0x20

config DRAM_SIZE_MB
	int
	default 4096

config BOOT_DEVICE_SPI_FLASH_BUS
	int
	default 0

config CONSOLE_SERIAL_UART_ADDRESS
	hex
	depends on DRIVERS_UART
	default 0x87E028000000

config UART_FOR_CONSOLE
	int
	depends on DRIVERS_UART
	default 0

config FMDFILE
	default "src/mainboard/\$(CONFIG_MAINBOARD_DIR)/board.fmd"
	default "src/mainboard/\$(CONFIG_MAINBOARD_DIR)/vboot.fmd" if VBOOT

config MAX_CPUS
	default 4

##########################################################
#### Update below when adding a new derivative board. ####
##########################################################

config MAINBOARD_PART_NUMBER
	default "Elgon"

endif
```

## src/mainboard/opencellular/elgon/Kconfig.name
```kconfig
## SPDX-License-Identifier: GPL-2.0-only

config BOARD_OPENCELLULAR_ELGON
	bool "Elgon (GBCv2)"
```

## src/mainboard/opencellular/rotundu/Kconfig
```kconfig
##
## This file is part of the coreboot project.
##
## Copyright (C) 2013-2014 Sage Electronic Engineering, LLC.
## Copyright (C) 2014 Intel Corporation
## Copyright (C) 2017-present Facebook, Inc.
##
## This program is free software; you can redistribute it and/or modify
## it under the terms of the GNU General Public License as published by
## the Free Software Foundation; version 2 of the License.
##
## This program is distributed in the hope that it will be useful,
## but WITHOUT ANY WARRANTY; without even the implied warranty of
## MERCHANTABILITY or FITNESS FOR A PARTICULAR PURPOSE.  See the
## GNU General Public License for more details.
##

config BOARD_OPENCELLULAR_BASEBOARD_ROTUNDU
	def_bool n
	select SOC_INTEL_FSP_BAYTRAIL
	select BOARD_ROMSIZE_KB_8192
	select HAVE_ACPI_TABLES
	select HAVE_OPTION_TABLE
	select ENABLE_BUILTIN_COM1
	select TSC_MONOTONIC_TIMER
	select ENABLE_FSP_FAST_BOOT
	select HAVE_ACPI_RESUME
	select USE_BLOBS
	select HAVE_FSP_BIN if FSP_PACKAGE_DEFAULT
	select MAINBOARD_HAS_LPC_TPM
	select MAINBOARD_HAS_TPM1

if BOARD_OPENCELLULAR_BASEBOARD_ROTUNDU

config VBOOT
	select MRC_CACHE_FMAP
	select VBOOT_VBNV_CMOS
	select VBOOT_NO_BOARD_SUPPORT
	select GBB_FLAG_DISABLE_LID_SHUTDOWN
	select GBB_FLAG_DISABLE_PD_SOFTWARE_SYNC
	select GBB_FLAG_DISABLE_EC_SOFTWARE_SYNC
	select GBB_FLAG_DISABLE_FWMP

config GBB_HWID
	string
	depends on VBOOT
	default "ROTUNDU" if BOARD_OPENCELLULAR_ROTUNDU
	default "SUPABRCKV1" if BOARD_OPENCELLULAR_SUPABRCKV1

config VARIANT_DIR
	string
	default "rotundu" if BOARD_OPENCELLULAR_ROTUNDU
	default "supabrckv1" if BOARD_OPENCELLULAR_SUPABRCKV1

config MAINBOARD_PART_NUMBER
	string
	default "Rotundu" if BOARD_OPENCELLULAR_ROTUNDU
	default "Supabrck v1" if BOARD_OPENCELLULAR_SUPABRCKV1

config DEVICETREE
	string
	default "variants/rotundu/devicetree.cb" if BOARD_OPENCELLULAR_ROTUNDU
	default "variants/supabrckv1/devicetree.cb" if BOARD_OPENCELLULAR_SUPABRCKV1

config MAINBOARD_DIR
	string
	default "opencellular/rotundu"

config MAINBOARD_VENDOR
	string
	default "OpenCellular"

config MAX_CPUS
	int
	default 16

config CACHE_ROM_SIZE_OVERRIDE
	hex
	default 0x800000

config FSP_LOC
	hex
	default 0xfffb0000

config FMDFILE
	string
	depends on VBOOT
	default "src/mainboard/$(CONFIG_MAINBOARD_DIR)/vboot-8M.fmd" if BOARD_ROMSIZE_KB_8192
	default "src/mainboard/$(CONFIG_MAINBOARD_DIR)/vboot-16M.fmd" if BOARD_ROMSIZE_KB_16384

config CBFS_SIZE
	hex
	default 0x00140000 if BOARD_ROMSIZE_KB_8192
	default 0x003effc0 if BOARD_ROMSIZE_KB_16384

config VIRTUAL_ROM_SIZE
	hex
	depends on ENABLE_FSP_FAST_BOOT
	default 0x800000

config FSP_PACKAGE_DEFAULT
	bool "Configure defaults for the Intel FSP package"
	default n

config VGA_BIOS
	bool
	default y if FSP_PACKAGE_DEFAULT

config VGA_BIOS_ID
	string
	default "8086,0f31"

endif # BOARD_OPENCELLULAR_ROTUNDU
```

## src/mainboard/opencellular/rotundu/Kconfig.name
```kconfig
config BOARD_OPENCELLULAR_ROTUNDU
	bool "OpenCellular Rotundu (GBCv1)"
	select BOARD_OPENCELLULAR_BASEBOARD_ROTUNDU

config BOARD_OPENCELLULAR_SUPABRCKV1
	bool "OpenCellular Supabrck V1 (BRCK)"
	select BOARD_OPENCELLULAR_BASEBOARD_ROTUNDU
```

## src/mainboard/packardbell/Kconfig
```kconfig
if VENDOR_PACKARDBELL

choice
	prompt "Mainboard model"

source "src/mainboard/packardbell/*/Kconfig.name"

endchoice

source "src/mainboard/packardbell/*/Kconfig"

config MAINBOARD_VENDOR
	default "Packard Bell"

endif # VENDOR_PACKARDBELL
```

## src/mainboard/packardbell/Kconfig.name
```kconfig
## SPDX-License-Identifier: GPL-2.0-only

config VENDOR_PACKARDBELL
	bool "Packard Bell"
```

## src/mainboard/packardbell/ms2290/Kconfig
```kconfig
## SPDX-License-Identifier: GPL-2.0-only

if BOARD_PACKARDBELL_MS2290

config BOARD_SPECIFIC_OPTIONS
	def_bool y
	select AZALIA_USE_LEGACY_VERB_TABLE
	select SYSTEM_TYPE_LAPTOP
	select NORTHBRIDGE_INTEL_IRONLAKE
	select SOUTHBRIDGE_INTEL_IBEXPEAK
	select HAVE_OPTION_TABLE
	select HAVE_CMOS_DEFAULT
	select BOARD_ROMSIZE_KB_4096
	select HAVE_ACPI_TABLES
	select HAVE_ACPI_RESUME
	select MAINBOARD_HAS_LIBGFXINIT
	select INTEL_INT15
	select EC_ACPI

config MAINBOARD_DIR
	default "packardbell/ms2290"

config MAINBOARD_PART_NUMBER
	default "EasyNote LM85"

config MAINBOARD_VERSION
	string
	default "V1.20"

config USBDEBUG_HCD_INDEX
	int
	default 2

config DRAM_RESET_GATE_GPIO
	int
	default 60

endif
```

## src/mainboard/packardbell/ms2290/Kconfig.name
```kconfig
## SPDX-License-Identifier: GPL-2.0-only

config BOARD_PACKARDBELL_MS2290
	bool "EasyNote LM85 (MS2290)"
```

## src/mainboard/pcengines/Kconfig
```kconfig
## SPDX-License-Identifier: GPL-2.0-only

if VENDOR_PCENGINES

choice
	prompt "Mainboard model"

source "src/mainboard/pcengines/*/Kconfig.name"

endchoice

source "src/mainboard/pcengines/*/Kconfig"

config MAINBOARD_VENDOR
	default "PC Engines"

endif # VENDOR_PCENGINES
```

## src/mainboard/pcengines/Kconfig.name
```kconfig
## SPDX-License-Identifier: GPL-2.0-only

config VENDOR_PCENGINES
	bool "PC Engines"
```

## src/mainboard/pcengines/alix1c/Kconfig
```kconfig
if BOARD_PCENGINES_ALIX1C

config BOARD_SPECIFIC_OPTIONS # dummy
	def_bool y
	select CPU_AMD_GEODE_LX
	select NORTHBRIDGE_AMD_LX
	select SOUTHBRIDGE_AMD_CS5536
	select SUPERIO_WINBOND_W83627HF
	select HAVE_PIRQ_TABLE
	select PIRQ_ROUTE
	select UDELAY_TSC
	select BOARD_ROMSIZE_KB_512
	select POWER_BUTTON_DEFAULT_DISABLE
	select HAVE_OPTION_TABLE
	select HAVE_CMOS_DEFAULT
	select NO_EARLY_SMBUS
	select SEABIOS_ADD_SERCON_PORT_FILE if PAYLOAD_SEABIOS

config MAINBOARD_DIR
	string
	default pcengines/alix1c

config MAINBOARD_PART_NUMBER
	string
	default "ALIX.1C"

config IRQ_SLOT_COUNT
	int
	default 5

endif # BOARD_PCENGINES_ALIX1C
```

## src/mainboard/pcengines/alix2c/Kconfig
```kconfig
if BOARD_PCENGINES_ALIX2C

# Dummy for abuild

config MAINBOARD_PART_NUMBER
	string
	default "ALIX.2C"

endif
```
