## src/mainboard/pcengines/alix2d/Kconfig
```kconfig
if BOARD_PCENGINES_ALIX2C || BOARD_PCENGINES_ALIX2D || BOARD_PCENGINES_ALIX6

config BOARD_SPECIFIC_OPTIONS # dummy
	def_bool y
	select CPU_AMD_GEODE_LX
	select NORTHBRIDGE_AMD_LX
	select SOUTHBRIDGE_AMD_CS5536
	select HAVE_PIRQ_TABLE
	select PIRQ_ROUTE
	select UDELAY_TSC
	select BOARD_ROMSIZE_KB_512
	select POWER_BUTTON_FORCE_DISABLE
	select NO_EARLY_SMBUS
	select SEABIOS_ADD_SERCON_PORT_FILE if PAYLOAD_SEABIOS

config MAINBOARD_DIR
	string
	default pcengines/alix2d

if BOARD_PCENGINES_ALIX2D

config MAINBOARD_PART_NUMBER
	string
	default "ALIX.2D"

endif

config IRQ_SLOT_COUNT
	int
	default 7

endif # BOARD_PCENGINES_ALIX2C || BOARD_PCENGINES_ALIX2D || BOARD_PCENGINES_ALIX6
```

## src/mainboard/pcengines/alix2d3/Kconfig
```kconfig
if BOARD_PCENGINES_ALIX2D3

config BOARD_SPECIFIC_OPTIONS # dummy
	def_bool y
	select ARCH_X86
	select CPU_AMD_LX
	select NORTHBRIDGE_AMD_LX
	select SOUTHBRIDGE_AMD_CS5536
	select HAVE_PIRQ_TABLE
	select PIRQ_ROUTE
	select UDELAY_TSC
	select CACHE_AS_RAM
	select BOARD_ROMSIZE_KB_512

config MAINBOARD_DIR
	string
	default pcengines/alix2d3

config MAINBOARD_PART_NUMBER
	string
	default "ALIX.2D3"

config IRQ_SLOT_COUNT
	int
	default 6

config RAMBASE
	hex
	default 0x4000

endif # BOARD_PCENGINES_ALIX2D3
```

## src/mainboard/pcengines/alix6/Kconfig
```kconfig
if BOARD_PCENGINES_ALIX6

# Dummy for abuild

config MAINBOARD_PART_NUMBER
	string
	default "ALIX.6"

endif
```

## src/mainboard/pcengines/apu1/Kconfig
```kconfig
# SPDX-License-Identifier: GPL-2.0-only

if BOARD_PCENGINES_APU1

config BOARD_SPECIFIC_OPTIONS
	def_bool y
	select CPU_AMD_AGESA_FAMILY14
	select NORTHBRIDGE_AMD_AGESA_FAMILY14
	select SOUTHBRIDGE_AMD_CIMX_SB800
	select SUPERIO_NUVOTON_NCT5104D
	select HAVE_PIRQ_TABLE
	select HAVE_ACPI_RESUME
	select HAVE_ACPI_TABLES
	select HAVE_OPTION_TABLE
	select HAVE_CMOS_DEFAULT
	select BOARD_ROMSIZE_KB_2048
	select HAVE_SPD_IN_CBFS
	select SEABIOS_ADD_SERCON_PORT_FILE if PAYLOAD_SEABIOS
	select MEMORY_MAPPED_TPM

config MAINBOARD_DIR
	default "pcengines/apu1"

config MAINBOARD_PART_NUMBER
	default "apu1"

config HW_MEM_HOLE_SIZEK
	hex
	default 0x200000

config MAX_CPUS
	int
	default 2

config IRQ_SLOT_COUNT
	int
	default 11

config ONBOARD_VGA_IS_PRIMARY
	bool
	default y

config VGA_BIOS_ID
	string
	default "1002,9802"

config SB800_AHCI_ROM
	bool
	default n

choice
	prompt "J19 pins 1-10"
	default APU1_PINMUX_OFF_C

config APU1_PINMUX_OFF_C
	bool "disable"

config APU1_PINMUX_GPIO0
	bool "GPIO"

config APU1_PINMUX_UART_C
	bool "UART 0x3e8"

endchoice

config UART_C_RS485
	bool "UART C drives RTS# in RS485 mode" if APU1_PINMUX_UART_C

choice
	prompt "J19 pins 11-20"
	default APU1_PINMUX_OFF_D

config APU1_PINMUX_OFF_D
	bool "disable"

config APU1_PINMUX_GPIO1
	bool "GPIO"

config APU1_PINMUX_UART_D
	bool "UART 0x2e8"

endchoice

config UART_D_RS485
	bool "UART D drives RTS# in RS485 mode" if APU1_PINMUX_UART_D

config DIMM_SPD_SIZE
	default 128

endif # BOARD_PCENGINES_APU1
```

## src/mainboard/pcengines/apu2/Kconfig
```kconfig
# SPDX-License-Identifier: GPL-2.0-only

if BOARD_PCENGINES_APU2 || BOARD_PCENGINES_APU3 || BOARD_PCENGINES_APU4 || \
	BOARD_PCENGINES_APU5

config BOARD_SPECIFIC_OPTIONS
	def_bool y
	select CPU_AMD_PI_00730F01
	select NORTHBRIDGE_AMD_PI_00730F01
	select SOUTHBRIDGE_AMD_PI_AVALON
	select DEFAULT_POST_ON_LPC
	select SUPERIO_NUVOTON_NCT5104D
	select HAVE_PIRQ_TABLE
	select HAVE_ACPI_TABLES
	select BOARD_ROMSIZE_KB_8192
	select HAVE_SPD_IN_CBFS
	select MEMORY_MAPPED_TPM
	select SEABIOS_ADD_SERCON_PORT_FILE if PAYLOAD_SEABIOS
	select PCIEXP_ASPM
	select PCIEXP_CLK_PM
	select PCIEXP_COMMON_CLOCK
	select PCIEXP_L1_SUB_STATE

config MAINBOARD_DIR
	default "pcengines/apu2"

config VARIANT_DIR
	default "apu2" if BOARD_PCENGINES_APU2
	default "apu3" if BOARD_PCENGINES_APU3
	default "apu4" if BOARD_PCENGINES_APU4
	default "apu5" if BOARD_PCENGINES_APU5

config DEVICETREE
	default "variants/\$(CONFIG_VARIANT_DIR)/devicetree.cb"

config MAINBOARD_PART_NUMBER
	default "apu2" if BOARD_PCENGINES_APU2
	default "apu3" if BOARD_PCENGINES_APU3
	default "apu4" if BOARD_PCENGINES_APU4
	default "apu5" if BOARD_PCENGINES_APU5

config MAX_CPUS
	int
	default 4

config IRQ_SLOT_COUNT
	int
	default 11

config ONBOARD_VGA_IS_PRIMARY
	bool
	default y

config HUDSON_LEGACY_FREE
	bool
	default y

config AGESA_BINARY_PI_FILE
	string
	default "3rdparty/blobs/mainboard/pcengines/apu2/AGESA.bin"

choice
	prompt "J19 pins 1-10"
	default APU2_PINMUX_UART_C

config APU2_PINMUX_OFF_C
	bool "disable"

config APU2_PINMUX_GPIO0
	bool "GPIO"
	depends on BOARD_PCENGINES_APU2 || BOARD_PCENGINES_APU3 || \
		BOARD_PCENGINES_APU4

config APU2_PINMUX_UART_C
	bool "UART 0x3e8"

endchoice

choice
	prompt "J19 pins 11-20"
	default APU2_PINMUX_UART_D

config APU2_PINMUX_OFF_D
	bool "disable"

config APU2_PINMUX_GPIO1
	bool "GPIO"
	depends on BOARD_PCENGINES_APU2 || BOARD_PCENGINES_APU3 || \
		BOARD_PCENGINES_APU4

config APU2_PINMUX_UART_D
	bool "UART 0x2e8"

endchoice

config DIMM_SPD_SIZE
	default 128

config AGESA_USE_1_0_0_4_HEADER
	bool
	default y
	help
	  Due to a bug in AGESA 1.0.0.A affecting boards without UMA, it is
	  impossible to use the newest blob. Using an older 1.0.0.4 blob
	  workarounds the problem, however some headers changes between blob
	  revisions. This option removes the changes in headers introduced
	  with AGESA 1.0.0.A to fit the 1.0.0.4 revision.

endif # BOARD_PCENGINES_APU2
```

## src/mainboard/pcengines/apu2/Kconfig.name
```kconfig
config BOARD_PCENGINES_APU2
	bool "APU2"

config BOARD_PCENGINES_APU3
	bool "APU3"

config BOARD_PCENGINES_APU4
	bool "APU4"

config BOARD_PCENGINES_APU5
	bool "APU5"
```

## src/mainboard/pine64/Kconfig
```kconfig
## SPDX-License-Identifier: GPL-2.0-only

if VENDOR_PINE64

choice
	prompt "Mainboard model"

source "src/mainboard/pine64/*/Kconfig.name"

endchoice

source "src/mainboard/pine64/*/Kconfig"

config MAINBOARD_VENDOR
	default "Pine64"

endif # VENDOR_PINE64
```

## src/mainboard/pine64/rockpro64/Kconfig
```kconfig
## SPDX-License-Identifier: GPL-2.0-only

if BOARD_PINE64_ROCKPRO64

config BOARD_SPECIFIC_OPTIONS
	def_bool y
	select BOARD_ROMSIZE_KB_16384
	select COMMON_CBFS_SPI_WRAPPER
	select SOC_ROCKCHIP_RK3399
	select SPI_FLASH
	select SPI_FLASH_GIGADEVICE

config MAINBOARD_DIR
	string
	default "pine64/rockpro64"

config BOOT_DEVICE_SPI_FLASH_BUS
	int
	default 1

config CONSOLE_SERIAL_UART_ADDRESS
	hex
	depends on DRIVERS_UART
	default 0xFF1A0000

##########################################################
#### Update below when adding a new derivative board. ####
##########################################################
config DEVICETREE
	string
	default "devicetree.cb" if BOARD_PINE64_ROCKPRO64

config MAINBOARD_PART_NUMBER
	string
	default "ROCKPro64" if BOARD_PINE64_ROCKPRO64
endif # BOARD_PINE64_ROCKPRO64
```

## src/mainboard/pine64/rockpro64/Kconfig.name
```kconfig
## SPDX-License-Identifier: GPL-2.0-only

config BOARD_PINE64_ROCKPRO64
	bool "ROCKPro64"
```

## src/mainboard/portwell/Kconfig
```kconfig
## SPDX-License-Identifier: GPL-2.0-only

if VENDOR_PORTWELL

choice
	prompt "Mainboard model"

source "src/mainboard/portwell/*/Kconfig.name"

endchoice

source "src/mainboard/portwell/*/Kconfig"

config MAINBOARD_VENDOR
	default "Portwell"

endif # VENDOR_PORTWELL
```

## src/mainboard/portwell/m107/Kconfig
```kconfig
## SPDX-License-Identifier: GPL-2.0-only

if BOARD_PORTWELL_M107

config BOARD_SPECIFIC_OPTIONS
	def_bool y
	select BOARD_ROMSIZE_KB_8192
	select HAVE_ACPI_TABLES
	select HAVE_OPTION_TABLE
	select SOC_INTEL_BRASWELL
	select PCIEXP_L1_SUB_STATE
	select DISABLE_HPET
	select HAVE_SPD_IN_CBFS

choice
	prompt "Onboard memory manufacturer"
	default ONBOARD_MEM_MICRON

config ONBOARD_MEM_SAMSUNG
	bool "Samsung"
	help
	  Samsung K4B8G1646D memory

config ONBOARD_MEM_MICRON
	bool "Micron"
	help
	  Micron MT41K512M16HA memory

config ONBOARD_MEM_KINGSTON
	bool "Kingston"
	help
	  Kingston B5116ECMDXGGB memory

endchoice

config MAINBOARD_DIR
	default "portwell/m107"

config MAINBOARD_PART_NUMBER
	default "PQ7-M107"

config CBFS_SIZE
	default 0x00600000

config MRC_SETTINGS_CACHE_SIZE
	hex
	default 0x08000

config FSP_LOC
	hex
	default 0xfff9c000

config SPI_FLASH_INCLUDE_ALL_DRIVERS
	bool
	default n

config SPI_FLASH_WINBOND
	bool
	default y

endif # BOARD_PORTWELL_M107
```

## src/mainboard/portwell/m107/Kconfig.name
```kconfig
## SPDX-License-Identifier: GPL-2.0-only

config BOARD_PORTWELL_M107
	bool "PQ7-M107"
```

## src/mainboard/prodrive/Kconfig
```kconfig
if VENDOR_PRODRIVE

choice
	prompt "Mainboard model"

source "src/mainboard/prodrive/*/Kconfig.name"

endchoice

source "src/mainboard/prodrive/*/Kconfig"

config MAINBOARD_VENDOR
	string
	default "Prodrive"

endif # VENDOR_PRODRIVE
```

## src/mainboard/prodrive/atlas/Kconfig
```kconfig
config BOARD_PRODRIVE_ATLAS_BASEBOARD
	def_bool n
	select BOARD_ROMSIZE_KB_32768
	select INTEL_LPSS_UART_FOR_CONSOLE
	select EC_ACPI
	select FSP_TYPE_IOT
	select HAVE_ACPI_RESUME
	select HAVE_ACPI_TABLES
	select INTEL_GMA_HAVE_VBT
	select MAINBOARD_HAS_TPM2
	select MAINBOARD_USES_IFD_EC_REGION
	select MEMORY_MAPPED_TPM
	select PCIEXP_SUPPORT_RESIZABLE_BARS
	select SOC_INTEL_ALDERLAKE_PCH_P
	select SOC_INTEL_ALDERLAKE_S3

if BOARD_PRODRIVE_ATLAS_BASEBOARD

config ATLAS_ENABLE_SAGV
	bool "Enable SaGv"
	default y

config MAINBOARD_FAMILY
	string
	default "PRODRIVE_ATLAS_SERIES"

config MAINBOARD_PART_NUMBER
	default "Atlas ADL-P"

config MAINBOARD_DIR
	default "prodrive/atlas"

config MAINBOARD_SMBIOS_MANUFACTURER
	string
	default "Prodrive Technologies B.V."

config DIMM_SPD_SIZE
	default 512

config UART_FOR_CONSOLE
	int
	default 0

config CBFS_SIZE
	default 0x800000

# This platform has limited means to display POST codes
config NO_POST
	default y

config PCIEXP_DEFAULT_MAX_RESIZABLE_BAR_BITS
	int
	default 32

endif #BOARD_PRODRIVE_ATLAS_BASEBOARD
```

## src/mainboard/prodrive/atlas/Kconfig.name
```kconfig
## SPDX-License-Identifier: GPL-2.0-only

config BOARD_PRODRIVE_ATLAS
	bool "Atlas"
```

## src/mainboard/prodrive/hermes/Kconfig
```kconfig
config BOARD_PRODRIVE_HERMES_BASEBOARD
	def_bool n
	select SOC_INTEL_COFFEELAKE
	select BOARD_ROMSIZE_KB_32768
	select HAVE_ACPI_TABLES
	select SOC_INTEL_CANNONLAKE_PCH_H
	select SUPERIO_ASPEED_COMMON_PRE_RAM
	select SUPERIO_ASPEED_AST2400
	select DRIVERS_ASPEED_AST_COMMON
	select DRIVERS_ASPEED_AST2050
	select INTEL_LPSS_UART_FOR_CONSOLE
	select MAINBOARD_HAS_TPM2
	select MEMORY_MAPPED_TPM
	select INTEL_GMA_HAVE_VBT
	select SOC_INTEL_COMMON_BLOCK_HDA_VERB
	select ONBOARD_VGA_IS_PRIMARY
	select SMBIOS_TYPE41_PROVIDED_BY_DEVTREE
	select HAVE_ACPI_RESUME if !HERMES_USES_SPS_FIRMWARE
	select DISABLE_ACPI_HIBERNATE if HERMES_USES_SPS_FIRMWARE

if BOARD_PRODRIVE_HERMES_BASEBOARD

config HERMES_USES_SPS_FIRMWARE
	bool "Build for use with SPS (Server Platform Services) firmware"
	help
	  Depending on the intended use case, the Hermes mainboard can use either
	  CSME or SPS firmware SKUs. Choose this option if using SPS firmware, as
	  SPS doesn't support ACPI S3 and S4 sleep states.

config MAINBOARD_FAMILY
	string
	default "PRODRIVE_HERMES_SERIES"

config MAINBOARD_PART_NUMBER
	default "Hermes CFL"

config MAINBOARD_DIR
	default "prodrive/hermes"

config PCIEXP_L1_SUB_STATE
	bool
	default n

config PCIEXP_CLK_PM
	bool
	default n

config CONSOLE_POST
	bool
	default y

config POST_IO
	bool
	default n

config CBFS_SIZE
	default 0x900000

endif # BOARD_PRODRIVE_HERMES_BASEBOARD
```
