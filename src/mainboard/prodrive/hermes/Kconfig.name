## src/mainboard/protectli/Kconfig
```kconfig
if VENDOR_PROTECTLI

choice
	prompt "Mainboard model"

source "src/mainboard/protectli/*/Kconfig.name"

endchoice

source "src/mainboard/protectli/*/Kconfig"

config MAINBOARD_VENDOR
	default "Protectli"

endif # VENDOR_PROTECTLI
```

## src/mainboard/protectli/Kconfig.name
```kconfig
## SPDX-License-Identifier: GPL-2.0-only

config VENDOR_PROTECTLI
	bool "Protectli"
```

## src/mainboard/protectli/vault_adl_p/Kconfig
```kconfig
if BOARD_PROTECTLI_VP66XX

config BOARD_SPECIFIC_OPTIONS
	def_bool y
	select BOARD_ROMSIZE_KB_16384
	select SOC_INTEL_ALDERLAKE_PCH_P
	select SOC_INTEL_COMMON_BLOCK_HDA_VERB
	select SOC_INTEL_ENABLE_USB4_PCIE_RESOURCES
	select SUPERIO_ITE_IT8659E
	select DRIVERS_UART_8250IO
	select DRIVERS_I2C_GENERIC
	select DRIVERS_INTEL_PMC
	select FSP_TYPE_IOT	# Needed for PchPcieClockGating W/A
	select HAVE_ACPI_RESUME
	select HAVE_ACPI_TABLES
	select INTEL_GMA_HAVE_VBT
	select MEMORY_MAPPED_TPM

config MAINBOARD_DIR
	default "protectli/vault_adl_p"

config MAINBOARD_PART_NUMBER
	default "VP66XX"

config MAINBOARD_FAMILY
	default "Vault Pro"

config DIMM_SPD_SIZE
	default 1024

config DIMM_MAX
	default 2

config USE_PM_ACPI_TIMER
	default n

config CBFS_SIZE
	default 0xa80000

config TPM_PIRQ
	default 0x39	# GPP_E13_IRQ

# CLKREQ pins not connected, so disable L1 and CPM
config PCIEXP_L1_SUB_STATE
	default n

config PCIEXP_CLK_PM
	default n

config VBOOT
	select GBB_FLAG_DISABLE_EC_SOFTWARE_SYNC
	select GBB_FLAG_DISABLE_FWMP
	select GBB_FLAG_DISABLE_LID_SHUTDOWN
	select GBB_FLAG_DISABLE_PD_SOFTWARE_SYNC
	select VBOOT_ALWAYS_ENABLE_DISPLAY
	select VBOOT_NO_BOARD_SUPPORT
	select HAS_RECOVERY_MRC_CACHE
	select VBOOT_CLEAR_RECOVERY_IN_RAMSTAGE

config VBOOT_SLOTS_RW_A
	default y if VBOOT

config SOC_INTEL_CSE_SEND_EOP_EARLY
	default n

config FMDFILE
	default "src/mainboard/\$(CONFIG_MAINBOARD_DIR)/vboot-rwa.fmd" if VBOOT && VBOOT_SLOTS_RW_A

config BEEP_ON_BOOT
	bool "Beep on successful boot"
	default y
	help
	  Make the platform beep using the PC speaker in final coreboot phase.
	  May serve as a useful indicator in headless mode that platform is
	  properly booting.

endif
```

## src/mainboard/protectli/vault_bsw/Kconfig
```kconfig
if BOARD_PROTECTLI_FW2B || BOARD_PROTECTLI_FW4B

config BOARD_SPECIFIC_OPTIONS
	def_bool y
	select BOARD_ROMSIZE_KB_8192
	select CACHE_MRC_SETTINGS
	select DISABLE_HPET
	select HAVE_ACPI_RESUME
	select HAVE_ACPI_TABLES
	select PCIEXP_L1_SUB_STATE
	select SEABIOS_ADD_SERCON_PORT_FILE if PAYLOAD_SEABIOS
	select SOC_INTEL_BRASWELL
	select SPI_FLASH_MACRONIX
	select SUPERIO_ITE_IT8613E

config MAINBOARD_DIR
	default "protectli/vault_bsw"

config VARIANT_DIR
	default "fw2b" if BOARD_PROTECTLI_FW2B
	default "fw4b" if BOARD_PROTECTLI_FW4B

config OVERRIDE_DEVICETREE
	default "variants/\$(CONFIG_VARIANT_DIR)/overridetree.cb"

config MAINBOARD_PART_NUMBER
	default "FW2B" if BOARD_PROTECTLI_FW2B
	default "FW4B" if BOARD_PROTECTLI_FW4B

config MAINBOARD_VENDOR
	string
	default "Protectli"

config DIMM_MAX
	default 1

config DIMM_SPD_SIZE
	default 256

config MAX_CPUS
	int
	default 2 if BOARD_PROTECTLI_FW2B
	default 4 if BOARD_PROTECTLI_FW4B

config CBFS_SIZE
	default 0x500000

config PXE_ROM_ID
	string
	default "8086,1539" if BOARD_PROTECTLI_FW2B
	default "8086,157b" if BOARD_PROTECTLI_FW4B

if !RUN_FSP_GOP

config VGA_BIOS_ID
	string
	default "8086,22b0"
	help
	  The VGA_BIOS_ID for the C0 version of the video bios is hardcoded
	  in soc/intel/braswell/Makefile.inc as 8086,22b1

endif #RUN_FSP_GOP

endif # BOARD_PROTECTLI_FW2B
```

## src/mainboard/protectli/vault_bsw/Kconfig.name
```kconfig
config BOARD_PROTECTLI_FW2B
	bool "FW2B"

config BOARD_PROTECTLI_FW4B
	bool "FW4B"
```

## src/mainboard/protectli/vault_cml/Kconfig
```kconfig
## SPDX-License-Identifier: GPL-2.0-only

if BOARD_PROTECTLI_VP46XX

config BOARD_SPECIFIC_OPTIONS
	def_bool y
	select BOARD_ROMSIZE_KB_16384
	select GFX_GMA_IGNORE_PRESENCE_STRAPS
	select SOC_INTEL_COMETLAKE_1_2
	select HAVE_ACPI_RESUME
	select HAVE_ACPI_TABLES
	select HAVE_CMOS_DEFAULT
	select HAVE_INTEL_PTT
	select HAVE_OPTION_TABLE
	select INTEL_GMA_HAVE_VBT
	select MAINBOARD_HAS_LIBGFXINIT
	select MEMORY_MAPPED_TPM
	select SEABIOS_ADD_SERCON_PORT_FILE if PAYLOAD_SEABIOS
	select SOC_INTEL_COMMON_BLOCK_HDA_VERB
	select SPI_FLASH_MACRONIX
	select SUPERIO_ITE_IT8784E

config MAINBOARD_DIR
	default "protectli/vault_cml"

config MAINBOARD_PART_NUMBER
	default "VP46XX"

config MAINBOARD_FAMILY
	default "Vault Pro"

config DIMM_MAX
	default 2

config DIMM_SPD_SIZE
	default 512

config CBFS_SIZE
	default 0xa00000

config GFX_GMA_PANEL_1_ON_EDP
	default n

config VBOOT
	select GBB_FLAG_DISABLE_EC_SOFTWARE_SYNC
	select GBB_FLAG_DISABLE_FWMP
	select GBB_FLAG_DISABLE_LID_SHUTDOWN
	select GBB_FLAG_DISABLE_PD_SOFTWARE_SYNC
	select VBOOT_ALWAYS_ENABLE_DISPLAY
	select VBOOT_NO_BOARD_SUPPORT

config VBOOT_SLOTS_RW_A
	default y if VBOOT

config FMDFILE
	default "src/mainboard/\$(CONFIG_MAINBOARD_DIR)/vboot-rwa.fmd" if VBOOT && VBOOT_SLOTS_RW_A
	default "src/mainboard/\$(CONFIG_MAINBOARD_DIR)/board.fmd"

config BEEP_ON_BOOT
	bool "Beep on successful boot"
	default y
	help
	  Make the platform beep using the PC speaker in final coreboot phase.
	  May serve as a useful indicator in headless mode that platform is
	  properly booting.

endif
```

## src/mainboard/protectli/vault_cml/Kconfig.name
```kconfig
## SPDX-License-Identifier: GPL-2.0-only

config BOARD_PROTECTLI_VP46XX
	bool "VP4630/VP4650/VP4670"
```

## src/mainboard/protectli/vault_ehl/Kconfig
```kconfig
## SPDX-License-Identifier: GPL-2.0-only

if BOARD_PROTECTLI_VP2420

config BOARD_SPECIFIC_OPTIONS
	def_bool y
	select SOC_INTEL_ELKHARTLAKE
	select BOARD_ROMSIZE_KB_16384
	select HAVE_ACPI_RESUME
	select HAVE_ACPI_TABLES
	select SUPERIO_ITE_IT8613E
	select SPI_FLASH_MACRONIX
	select INTEL_GMA_HAVE_VBT
	select SEABIOS_ADD_SERCON_PORT_FILE if PAYLOAD_SEABIOS
	select MEMORY_MAPPED_TPM

config MAINBOARD_DIR
	default "protectli/vault_ehl"

config MAINBOARD_PART_NUMBER
	default "VP2420"

config MAINBOARD_FAMILY
	default "Vault Pro"

config MAX_CPUS
	default 4

config CBFS_SIZE
	default 0x900000

config DIMM_MAX
	default 1

config VBOOT
	select GBB_FLAG_DISABLE_EC_SOFTWARE_SYNC
	select GBB_FLAG_DISABLE_FWMP
	select GBB_FLAG_DISABLE_LID_SHUTDOWN
	select GBB_FLAG_DISABLE_PD_SOFTWARE_SYNC
	select VBOOT_ALWAYS_ENABLE_DISPLAY
	select VBOOT_NO_BOARD_SUPPORT
	select VBOOT_VBNV_CMOS
	select VBOOT_VBNV_CMOS_BACKUP_TO_FLASH
	select VBOOT_SEPARATE_VERSTAGE

config VBOOT_SLOTS_RW_A
	default y if VBOOT

config FMDFILE
	default "src/mainboard/\$(CONFIG_MAINBOARD_DIR)/vboot-rwa.fmd" if VBOOT && VBOOT_SLOTS_RW_A

config TPM_PIRQ
	default 0x6B # GPP_G19_IRQ

endif # BOARD_PROTECTLI_VP2420
```

## src/mainboard/protectli/vault_ehl/Kconfig.name
```kconfig
## SPDX-License-Identifier: GPL-2.0-only

config BOARD_PROTECTLI_VP2420
	bool "VP2420"
```

## src/mainboard/protectli/vault_kbl/Kconfig
```kconfig
## SPDX-License-Identifier: GPL-2.0-only

if BOARD_PROTECTLI_FW6

config BOARD_SPECIFIC_OPTIONS
	def_bool y
	select BOARD_ROMSIZE_KB_8192
	select HAVE_ACPI_RESUME
	select HAVE_ACPI_TABLES
	select INTEL_GMA_HAVE_VBT
	select MAINBOARD_HAS_LIBGFXINIT
	select SEABIOS_ADD_SERCON_PORT_FILE if PAYLOAD_SEABIOS
	select SOC_INTEL_KABYLAKE
	select SPI_FLASH_MACRONIX
	select SUPERIO_ITE_IT8772F
	select CRB_TPM
	select HAVE_INTEL_PTT
	select MAINBOARD_HAS_TPM2

config MAINBOARD_DIR
	default "protectli/vault_kbl"

config MAINBOARD_PART_NUMBER
	default "FW6"

config DIMM_MAX
	default 2

config DIMM_SPD_SIZE
	default 512

config MAX_CPUS
	int
	default 4

config VGA_BIOS_ID
	string
	default "8086,5916" # 8086,5906 for FW6A

config PXE_ROM_ID
	string
	default "8086,150c"

config CBFS_SIZE
	default 0x600000

config USE_PM_ACPI_TIMER
	default n

config BEEP_ON_BOOT
	bool "Beep on successful boot"
	default y
	help
	  Make the platform beep using the PC speaker in final coreboot phase.
	  May serve as a useful indicator in headless mode that platform is
	  properly booting.

endif
```

## src/mainboard/protectli/vault_kbl/Kconfig.name
```kconfig
## SPDX-License-Identifier: GPL-2.0-only

config BOARD_PROTECTLI_FW6
	bool "FW6"
```

## src/mainboard/purism/Kconfig
```kconfig
## SPDX-License-Identifier: GPL-2.0-only

if VENDOR_PURISM

choice
	prompt "Mainboard model"

source "src/mainboard/purism/*/Kconfig.name"

endchoice

source "src/mainboard/purism/*/Kconfig"

config MAINBOARD_VENDOR
	default "Purism"

endif # VENDOR_PURISM
```

## src/mainboard/purism/librem13v1/Kconfig
```kconfig
if BOARD_PURISM_LIBREM13_V1

config BOARD_SPECIFIC_OPTIONS # dummy
	def_bool y
	select SYSTEM_TYPE_LAPTOP
	select BOARD_ROMSIZE_KB_8192
	select EC_PURISM_LIBREM
	select HAVE_ACPI_RESUME
	select HAVE_ACPI_TABLES
	select INTEL_INT15
	select SOC_INTEL_BROADWELL

config DRIVERS_PS2_KEYBOARD
	def_bool y
	help
	  Default PS/2 Keyboard to enabled on this board.

config DRIVERS_UART_8250IO
	def_bool n
	help
	  This platform does not have any way to get standard
	  serial output so disable it by default.

config PCIEXP_L1_SUB_STATE
	def_bool n

config PCIEXP_AER
	def_bool n

config HAVE_IFD_BIN
	bool
	default n

config HAVE_ME_BIN
	bool
	default n

config MAINBOARD_DIR
	string
	default purism/librem13v1

config MAINBOARD_PART_NUMBER
	string
	default "Librem 13 v1"

config MAX_CPUS
	int
	default 8

config NO_POST
	def_bool y
	help
	  This platform does not have any way to see POST codes
	  so disable them by default.

config PRE_GRAPHICS_DELAY
	int
	default 50

config VGA_BIOS_ID
	string
	default "8086,1616"

endif
```

## src/mainboard/purism/librem13v2/Kconfig
```kconfig
if BOARD_PURISM_LIBREM13_V2

config BOARD_SPECIFIC_OPTIONS # dummy
	def_bool y
	select SYSTEM_TYPE_LAPTOP
	select BOARD_ROMSIZE_KB_16384
	select DRIVERS_I2C_GENERIC
	select DRIVERS_I2C_NAU8825
	select HAVE_ACPI_RESUME
	select HAVE_ACPI_TABLES
	select SOC_INTEL_SKYLAKE
	# Workaround for EC/KBC IRQ1
	select SERIRQ_CONTINUOUS_MODE

config IRQ_SLOT_COUNT
	int
	default 18

config MAINBOARD_VENDOR
	string
	default "Purism"

config MAINBOARD_FAMILY
	string
	default "Librem 13"

config MAINBOARD_PART_NUMBER
	string
	default "Librem 13 v2"

config MAINBOARD_DIR
	string
	default "purism/librem13v2"

config MAX_CPUS
	int
	default 8

config NO_POST
	def_bool y
	help
	  This platform does not have any way to see POST codes
	  so disable them by default.

config VGA_BIOS_ID
	string
	default "8086,1916"

endif
```

## src/mainboard/purism/librem_bdl/Kconfig
```kconfig
config BOARD_PURISM_BASEBOARD_LIBREM_BDL
	def_bool n
	select SYSTEM_TYPE_LAPTOP
	select BOARD_ROMSIZE_KB_8192
	select EC_PURISM_LIBREM
	select HAVE_ACPI_RESUME
	select HAVE_ACPI_TABLES
	select INTEL_INT15
	select SOC_INTEL_BROADWELL

if BOARD_PURISM_BASEBOARD_LIBREM_BDL

config VARIANT_DIR
	string
	default "librem13v1" if BOARD_PURISM_LIBREM13_V1

config DEVICETREE
	string
	default "variants/librem13v1/devicetree.cb" if BOARD_PURISM_LIBREM13_V1

config DRIVERS_PS2_KEYBOARD
	def_bool y
	help
	  Default PS/2 Keyboard to enabled on this board.

config DRIVERS_UART_8250IO
	def_bool n
	help
	  This platform does not have any way to get standard
	  serial output so disable it by default.

config PCIEXP_L1_SUB_STATE
	def_bool n

config PCIEXP_AER
	def_bool n

config HAVE_IFD_BIN
	bool
	default n

config HAVE_ME_BIN
	bool
	default n

config MAINBOARD_DIR
	string
	default purism/librem_bdl

config MAINBOARD_VENDOR
	string
	default "Purism"

config MAINBOARD_PART_NUMBER
	string
	default "Librem 13 v1" if BOARD_PURISM_LIBREM13_V1

config MAINBOARD_FAMILY
	string
	default "Librem 13" if BOARD_PURISM_LIBREM13_V1

config MAINBOARD_VERSION
	string
	default "1.0" if BOARD_PURISM_LIBREM13_V1

config MAX_CPUS
	int
	default 8

config NO_POST
	def_bool y
	help
	  This platform does not have any way to see POST codes
	  so disable them by default.

config PRE_GRAPHICS_DELAY
	int
	default 50

config VGA_BIOS_ID
	string
	default "8086,1616"

endif
```

## src/mainboard/purism/librem_bdl/Kconfig.name
```kconfig
config BOARD_PURISM_LIBREM13_V1
	bool "Librem 13 v1"
	select BOARD_PURISM_BASEBOARD_LIBREM_BDL

config BOARD_PURISM_LIBREM15_V2
	bool "Librem 15 v2"
	select BOARD_PURISM_BASEBOARD_LIBREM_BDL
```

## src/mainboard/purism/librem_bdw/Kconfig
```kconfig
## SPDX-License-Identifier: GPL-2.0-only

config BOARD_PURISM_BASEBOARD_LIBREM_BDW
	def_bool n
	select AZALIA_USE_LEGACY_VERB_TABLE
	select SYSTEM_TYPE_LAPTOP
	select BOARD_ROMSIZE_KB_8192
	select HAVE_ACPI_RESUME
	select HAVE_ACPI_TABLES
	select INTEL_GMA_HAVE_VBT
	select INTEL_INT15
	select MAINBOARD_HAS_LIBGFXINIT
	select MAINBOARD_HAS_TPM1
	select SOC_INTEL_BROADWELL

config BOARD_PURISM_LIBREM13_V1
	select BOARD_PURISM_BASEBOARD_LIBREM_BDW

config BOARD_PURISM_LIBREM15_V2
	select BOARD_PURISM_BASEBOARD_LIBREM_BDW

if BOARD_PURISM_BASEBOARD_LIBREM_BDW

config VARIANT_DIR
	default "librem13v1" if BOARD_PURISM_LIBREM13_V1
	default "librem15v2" if BOARD_PURISM_LIBREM15_V2

config OVERRIDE_DEVICETREE
	default "variants/\$(CONFIG_VARIANT_DIR)/overridetree.cb"

config DRIVERS_UART_8250IO
	def_bool n
	help
	  This platform does not have any way to get standard
	  serial output so disable it by default.

config PCIEXP_L1_SUB_STATE
	def_bool n

config PCIEXP_AER
	def_bool n

config MAINBOARD_DIR
	default "purism/librem_bdw"

config MAINBOARD_PART_NUMBER
	default "Librem 13 v1" if BOARD_PURISM_LIBREM13_V1
	default "Librem 15 v2" if BOARD_PURISM_LIBREM15_V2

config MAINBOARD_FAMILY
	string
	default "Librem 13" if BOARD_PURISM_LIBREM13_V1
	default "Librem 15" if BOARD_PURISM_LIBREM15_V2

config MAINBOARD_VERSION
	string
	default "1.0" if BOARD_PURISM_LIBREM13_V1
	default "2.0" if BOARD_PURISM_LIBREM15_V2

config PRE_GRAPHICS_DELAY_MS
	int
	default 50

config VGA_BIOS_ID
	string
	default "8086,1616" if BOARD_PURISM_LIBREM13_V1
	default "8086,162b" if BOARD_PURISM_LIBREM15_V2

# Override the default variant behavior, since the data.vbt is the same
# for both variants.
config INTEL_GMA_VBT_FILE
	default "src/mainboard/\$(MAINBOARDDIR)/data.vbt"

# This platform has limited means to display POST codes
config NO_POST
	default y

endif
```

## src/mainboard/purism/librem_bdw/Kconfig.name
```kconfig
## SPDX-License-Identifier: GPL-2.0-only

config BOARD_PURISM_LIBREM13_V1
	bool "Librem 13 v1"

config BOARD_PURISM_LIBREM15_V2
	bool "Librem 15 v2"
```
