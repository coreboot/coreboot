## src/mainboard/purism/librem_cnl/Kconfig.name
```kconfig
config BOARD_PURISM_LIBREM_MINI
	bool "Librem Mini"

config BOARD_PURISM_LIBREM_MINI_V2
	bool "Librem Mini v2"

config BOARD_PURISM_LIBREM_14
	bool "Librem 14"
```

## src/mainboard/purism/librem_jsl/Kconfig
```kconfig
## SPDX-License-Identifier: GPL-2.0-only

config BOARD_PURISM_BASEBOARD_LIBREM_JSL
	def_bool n
	select BOARD_ROMSIZE_KB_16384
	select DRIVERS_GENERIC_CBFS_SERIAL
	select DRIVERS_USB_ACPI
	select DRIVERS_I2C_GENERIC
	select DRIVERS_I2C_HID
	select EC_ACPI
	select HAVE_ACPI_RESUME
	select HAVE_ACPI_TABLES
	select HAVE_SPD_IN_CBFS
	select INTEL_GMA_HAVE_VBT
	select NO_UART_ON_SUPERIO
	select SOC_INTEL_COMMON_BLOCK_HDA_VERB
	select SOC_INTEL_JASPERLAKE
	select SYSTEM_TYPE_DETACHABLE
	select USE_LEGACY_8254_TIMER

config BOARD_PURISM_LIBREM_11
	select BOARD_PURISM_BASEBOARD_LIBREM_JSL

if BOARD_PURISM_BASEBOARD_LIBREM_JSL

config MAINBOARD_DIR
	default "purism/librem_jsl"

config MAINBOARD_FAMILY
	string
	default "Librem 11" if BOARD_PURISM_BASEBOARD_LIBREM_JSL

config MAINBOARD_PART_NUMBER
	default "Librem 11" if BOARD_PURISM_BASEBOARD_LIBREM_JSL

config MAX_CPUS
	int
	default 4

config CBFS_SIZE
	default 0x700000 if BOARD_PURISM_BASEBOARD_LIBREM_JSL

config DIMM_MAX
	default 2

config DIMM_SPD_SIZE
	default 512

config VGA_BIOS_ID
	string
	default "8086,4e61" if BOARD_PURISM_BASEBOARD_LIBREM_JSL

config NO_POST
	default y

config INTEL_GMA_VBT_FILE
	default "src/mainboard/purism/librem_jsl/data.vbt"

config ENABLE_UART2
	bool "Enable UART2 debug output"
	default n
	select INTEL_LPSS_UART_FOR_CONSOLE
	help
	  Enable UART2 for debug output.

	  This UART can be used for boot logging by coreboot and payloads.

	  For Linux, boot with `console=uart,mmio32,0xfe032000,115200n8`.
	  (0xfe032000 is CONSOLE_UART_BASE_ADDRESS for Jasper Lake.)  Blacklist
	  intel_lpss_pci so it does not reconfigure the UART.

	  Soldering is required to access these signals.  On the reverse side of
	  the board, there are two test points directly underneath the SoC (the
	  only two test points between the heatsink screw holes).  The pad
	  nearest the M.2 socket is TX, the other is RX.  The signals are 3.3V
	  (do NOT connect directly to an RS-232 serial port).

config UART_FOR_CONSOLE
	default 2 if ENABLE_UART2

config FSP_TEMP_RAM_SIZE
	default 0x28000

endif
```

## src/mainboard/purism/librem_jsl/Kconfig.name
```kconfig
## SPDX-License-Identifier: GPL-2.0-only

config BOARD_PURISM_LIBREM_11
	bool "Librem 11"
```

## src/mainboard/purism/librem_l1um_v2/Kconfig
```kconfig
## SPDX-License-Identifier: GPL-2.0-only

config BOARD_PURISM_BASEBOARD_LIBREM_L1UM_V2
	def_bool n
	select BOARD_ROMSIZE_KB_32768
	select DRIVERS_ASPEED_AST2050
	select DRIVERS_ASPEED_AST_COMMON
	select DRIVERS_GENERIC_CBFS_SERIAL
	select DRIVERS_OPTION_CFR_ENABLED if PAYLOAD_EDK2 && SMMSTORE
	select DRIVERS_UART_8250IO
	select DRIVERS_USB_ACPI
	select GENERATE_SMBIOS_TABLES
	select HAVE_ACPI_TABLES
	select IPMI_KCS
	select MAINBOARD_HAS_TPM2
	select MEMORY_MAPPED_TPM
	select SMBIOS_TYPE41_PROVIDED_BY_DEVTREE
	select SOC_INTEL_CANNONLAKE_PCH_H
	select SOC_INTEL_COFFEELAKE
	select SUPERIO_ASPEED_AST2400
	select SUPERIO_ASPEED_COMMON_PRE_RAM
	select SUPERIO_NUVOTON_NCT6791D # This board has two SuperIOs

config BOARD_PURISM_LIBREM_L1UM_V2
	select BOARD_PURISM_BASEBOARD_LIBREM_L1UM_V2

if BOARD_PURISM_BASEBOARD_LIBREM_L1UM_V2

config MAINBOARD_DIR
	default "purism/librem_l1um_v2"

config MAINBOARD_FAMILY
	string
	default "Librem L1UM v2"

config MAINBOARD_PART_NUMBER
	default "Librem L1UM v2"

config CBFS_SIZE
	default 0x1000000

endif
```

## src/mainboard/purism/librem_l1um_v2/Kconfig.name
```kconfig
## SPDX-License-Identifier: GPL-2.0-only

config BOARD_PURISM_LIBREM_L1UM_V2
	bool "Librem L1UM v2"
```

## src/mainboard/purism/librem_skl/Kconfig
```kconfig
config BOARD_PURISM_BASEBOARD_LIBREM_SKL
	def_bool n
	select BOARD_ROMSIZE_KB_16384
	select DRIVERS_GENERIC_CBFS_SERIAL
	select GFX_GMA_IGNORE_PRESENCE_STRAPS
	select HAVE_ACPI_RESUME
	select HAVE_ACPI_TABLES
	select INTEL_GMA_HAVE_VBT
	select MAINBOARD_HAS_LIBGFXINIT
	select MEMORY_MAPPED_TPM
	select MAINBOARD_HAS_TPM1
	select NO_UART_ON_SUPERIO
	select SOC_INTEL_COMMON_BLOCK_HDA_VERB
	select SOC_INTEL_KABYLAKE if BOARD_PURISM_LIBREM13_V4 || BOARD_PURISM_LIBREM15_V4
	select SOC_INTEL_SKYLAKE if BOARD_PURISM_LIBREM13_V2 || BOARD_PURISM_LIBREM15_V3
	select SPD_READ_BY_WORD
	select SYSTEM_TYPE_LAPTOP

if BOARD_PURISM_BASEBOARD_LIBREM_SKL

config DISABLE_HECI1_AT_PRE_BOOT
	default y

config VARIANT_DIR
	default "librem13" if BOARD_PURISM_LIBREM13_V2 || BOARD_PURISM_LIBREM13_V4
	default "librem15" if BOARD_PURISM_LIBREM15_V3 || BOARD_PURISM_LIBREM15_V4

config MAINBOARD_FAMILY
	string
	default "Librem 13" if BOARD_PURISM_LIBREM13_V2 || BOARD_PURISM_LIBREM13_V4
	default "Librem 15" if BOARD_PURISM_LIBREM15_V3 || BOARD_PURISM_LIBREM15_V4

config MAINBOARD_PART_NUMBER
	default "Librem 13 v2" if BOARD_PURISM_LIBREM13_V2
	default "Librem 15 v3" if BOARD_PURISM_LIBREM15_V3
	default "Librem 13 v4" if BOARD_PURISM_LIBREM13_V4
	default "Librem 15 v4" if BOARD_PURISM_LIBREM15_V4

config MAINBOARD_DIR
	default "purism/librem_skl"

config OVERRIDE_DEVICETREE
	default "variants/\$(CONFIG_VARIANT_DIR)/overridetree.cb"

config VGA_BIOS_ID
	string
	default "8086,1916" if BOARD_PURISM_LIBREM13_V2 || BOARD_PURISM_LIBREM15_V3
	default "8086,5916" if BOARD_PURISM_LIBREM13_V4 || BOARD_PURISM_LIBREM15_V4

# Override the default variant behavior, since same VBT
# is used for all variants.
config INTEL_GMA_VBT_FILE
	default "src/mainboard/\$(MAINBOARDDIR)/data.vbt"

config DIMM_MAX
	default 1

config DIMM_SPD_SIZE
	default 512

config CBFS_SIZE
	default 0xe00000

# This platform has limited means to display POST codes
config NO_POST
	default y

endif
```

## src/mainboard/purism/librem_skl/Kconfig.name
```kconfig
config BOARD_PURISM_LIBREM13_V2
	bool "Librem 13 v2/v3"
	select BOARD_PURISM_BASEBOARD_LIBREM_SKL

config BOARD_PURISM_LIBREM15_V3
	bool "Librem 15 v3"
	select BOARD_PURISM_BASEBOARD_LIBREM_SKL

config BOARD_PURISM_LIBREM13_V4
	bool "Librem 13 v4"
	select BOARD_PURISM_BASEBOARD_LIBREM_SKL

config BOARD_PURISM_LIBREM15_V4
	bool "Librem 15 v4"
	select BOARD_PURISM_BASEBOARD_LIBREM_SKL
```

## src/mainboard/qotom/Kconfig
```kconfig
## SPDX-License-Identifier: GPL-2.0-only

if VENDOR_QOTOM

choice
	prompt "Mainboard model"

source "src/mainboard/qotom/*/Kconfig.name"

endchoice

source "src/mainboard/qotom/*/Kconfig"

config MAINBOARD_VENDOR
	default "Qotom"

endif # VENDOR_QOTOM
```

## src/mainboard/qotom/q535g6/Kconfig
```kconfig
## SPDX-License-Identifier: GPL-2.0-only

if BOARD_QOTOM_Q535G6

config BOARD_SPECIFIC_OPTIONS
	def_bool y
	select BOARD_ROMSIZE_KB_16384
	select HAVE_ACPI_RESUME
	select HAVE_ACPI_TABLES
	select INTEL_GMA_HAVE_VBT
	select MAINBOARD_HAS_LIBGFXINIT
	select SEABIOS_ADD_SERCON_PORT_FILE if PAYLOAD_SEABIOS
	select SOC_INTEL_KABYLAKE
	select SUPERIO_ITE_IT8786E

config MAINBOARD_DIR
	default "qotom/q535g6"

config MAINBOARD_PART_NUMBER
	default "Q535G6"

config DIMM_MAX
	default 1

config DIMM_SPD_SIZE
	default 512

config CBFS_SIZE
	default 0x600000

config USE_PM_ACPI_TIMER
	default n

endif
```

## src/mainboard/qotom/q535g6/Kconfig.name
```kconfig
## SPDX-License-Identifier: GPL-2.0-only

config BOARD_QOTOM_Q535G6
	bool "Q535G6"
```

## src/mainboard/qotom/qdnv01/Kconfig
```kconfig
## SPDX-License-Identifier: GPL-2.0-only

if BOARD_QOTOM_QDNV01

config BOARD_SPECIFIC_OPTIONS
	def_bool y
	select SOC_INTEL_DENVERTON_NS
	select BOARD_ROMSIZE_KB_16384
	select HAVE_ACPI_TABLES
	select DRIVERS_ASPEED_AST2050
	select MAINBOARD_USES_IFD_10GBE_0_REGION
	select MAINBOARD_USES_IFD_10GBE_1_REGION

config MAINBOARD_DIR
	default "qotom/qdnv01"

config MAINBOARD_PART_NUMBER
	default "QDNV01"

config CBFS_SIZE
	default 0x800000

endif # BOARD_QOTOM_QDNV01
```

## src/mainboard/qotom/qdnv01/Kconfig.name
```kconfig
## SPDX-License-Identifier: GPL-2.0-only

config BOARD_QOTOM_QDNV01
	bool "QDNV01"
```

## src/mainboard/raptor-cs/Kconfig
```kconfig
## SPDX-License-Identifier: GPL-2.0-only

if VENDOR_RAPTOR_CS

choice
	prompt "Mainboard model"

source "src/mainboard/raptor-cs/*/Kconfig.name"

endchoice

source "src/mainboard/raptor-cs/*/Kconfig"

config MAINBOARD_VENDOR
	default "Raptor Computing Systems"

endif # VENDOR_RAPTOR_CS
```

## src/mainboard/raptor-cs/Kconfig.name
```kconfig
## SPDX-License-Identifier: GPL-2.0-only

config VENDOR_RAPTOR_CS
	bool "Raptor Computing Systems"
```

## src/mainboard/raptor-cs/talos-2/Kconfig
```kconfig
## SPDX-License-Identifier: GPL-2.0-only

if BOARD_RAPTOR_CS_TALOS_2

config BOOTBLOCK_IN_SEEPROM
	bool "Bootblock in SEEPROM"
	default n
	help
	  Enable this option if coreboot shall build image with separate
	  bootblock (i.e. not in coreboot.rom) to be put into SEEPROM
	  directly.

config BOARD_SPECIFIC_OPTIONS
	def_bool y
	select CPU_POWER9
	select SOC_IBM_POWER9
	select BOARD_ROMSIZE_KB_512
	select SUPERIO_ASPEED_AST2400
	select BOOT_DEVICE_NOT_SPI_FLASH
	select MISSING_BOARD_RESET
	select HAVE_DEBUG_RAM_SETUP

config MEMLAYOUT_LD_FILE
	default "src/mainboard/\$(CONFIG_MAINBOARD_DIR)/memlayout.ld"

config FMDFILE
	string
	default "src/mainboard/\$(CONFIG_MAINBOARD_DIR)/board-bootblock-in-seeprom.fmd"	if BOOTBLOCK_IN_SEEPROM
	default "src/mainboard/\$(CONFIG_MAINBOARD_DIR)/board.fmd"			if !BOOTBLOCK_IN_SEEPROM

config MAINBOARD_DIR
	default "raptor-cs/talos-2"

config MAINBOARD_PART_NUMBER
	default "Talos II"

config DIMM_MAX
	default 8

config DIMM_SPD_SIZE
	default 512

config MAX_CPUS
	default 1

config DRAM_SIZE_MB
	int
	default 32768

endif #  BOARD_RAPTOR_CS_TALOS_2
```

## src/mainboard/raptor-cs/talos-2/Kconfig.name
```kconfig
## SPDX-License-Identifier: GPL-2.0-only

config BOARD_RAPTOR_CS_TALOS_2
	bool "Talos II"
```

## src/mainboard/razer/Kconfig
```kconfig
if VENDOR_RAZER

choice
	prompt "Mainboard model"

source "src/mainboard/razer/*/Kconfig.name"

endchoice

source "src/mainboard/razer/*/Kconfig"

config MAINBOARD_VENDOR
	default "RAZER"

endif # VENDOR_RAZER
```

## src/mainboard/razer/blade_stealth_kbl/Kconfig
```kconfig
## SPDX-License-Identifier: GPL-2.0-only

config BOARD_RAZER_BLADE_STEALTH_KBL
	bool
	select SYSTEM_TYPE_LAPTOP
	select BOARD_ROMSIZE_KB_8192
	select SUPERIO_ITE_IT8528E
	select SOC_INTEL_KABYLAKE
	select SOC_INTEL_COMMON_BLOCK_HDA_VERB
	select MAINBOARD_HAS_LIBGFXINIT
	select HAVE_SPD_IN_CBFS
	select DRIVERS_I2C_HID
	select HAVE_ACPI_RESUME
	select HAVE_ACPI_TABLES
	select DRIVERS_GENERIC_CBFS_SERIAL

config BOARD_RAZER_BLADE_H2U
	select BOARD_RAZER_BLADE_STEALTH_KBL
	select MEMORY_MAPPED_TPM
	select MAINBOARD_HAS_TPM2

config BOARD_RAZER_BLADE_H3Q
	select INTEL_GMA_HAVE_VBT
	select BOARD_RAZER_BLADE_STEALTH_KBL

if BOARD_RAZER_BLADE_STEALTH_KBL

config VARIANT_DIR
	default "h2u" if BOARD_RAZER_BLADE_H2U
	default "h3q" if BOARD_RAZER_BLADE_H3Q

config OVERRIDE_DEVICETREE
	default "variants/\$(CONFIG_VARIANT_DIR)/overridetree.cb"

config MAINBOARD_FAMILY
	string
	default "BLADE_STEALTH"

config MAINBOARD_PART_NUMBER
	default "H2U: RZ09-01962" if BOARD_RAZER_BLADE_H2U
	default "H3Q: RZ09-01963/RZ09-01964" if BOARD_RAZER_BLADE_H3Q

# For now no way to choose the correct the available RAM
config BOARD_RAZER_BLADE_STEALTH_KBL_16GB
	bool "16GB RAM (4x MT52L1G32D4PG)"
	default n

config VGA_BIOS_ID
	string
	default "8086,5916"

config MAINBOARD_VERSION
	string
	default "1.0"

config MAINBOARD_DIR
	default "razer/blade_stealth_kbl"

config MAX_CPUS
	int
	default 4

config NO_POST
	default y

endif
```

## src/mainboard/razer/blade_stealth_kbl/Kconfig.name
```kconfig
## SPDX-License-Identifier: GPL-2.0-only

config BOARD_RAZER_BLADE_H2U
	bool "Razer Blade Stealth KabyLake (2016, RZ09-01962, 12.5\")"

config BOARD_RAZER_BLADE_H3Q
	bool "Razer Blade Stealth KabyLake (Mid 2017, RZ09-01963/RZ09-10964, 13.3\")"
```

## src/mainboard/rca/Kconfig
```kconfig
if VENDOR_RCA

choice
	prompt "Mainboard model"

source "src/mainboard/rca/*/Kconfig.name"

endchoice

source "src/mainboard/rca/*/Kconfig"

config MAINBOARD_VENDOR
	string
	default "RCA"

endif # VENDOR_RCA
```

## src/mainboard/rca/rm4100/Kconfig
```kconfig
if BOARD_RCA_RM4100

config BOARD_SPECIFIC_OPTIONS # dummy
	def_bool y
	select ARCH_X86
	select CPU_INTEL_SOCKET_MFCBGA479
	select NORTHBRIDGE_INTEL_I82830
	select SOUTHBRIDGE_INTEL_I82801DX
	select SUPERIO_SMSC_SMSCSUPERIO
	select HAVE_PIRQ_TABLE
	select UDELAY_TSC
	select BOARD_ROMSIZE_KB_1024
	select GFXUMA

config MAINBOARD_DIR
	string
	default rca/rm4100

config MAINBOARD_PART_NUMBER
	string
	default "RM4100"

config DCACHE_RAM_BASE
	hex
	default 0xffdf8000

config DCACHE_RAM_SIZE
	hex
	default 0x8000

config IRQ_SLOT_COUNT
	int
	default 7

endif # BOARD_RCA_RM4100
```

## src/mainboard/roda/Kconfig
```kconfig
## SPDX-License-Identifier: GPL-2.0-only

if VENDOR_RODA

choice
	prompt "Mainboard model"

source "src/mainboard/roda/*/Kconfig.name"

endchoice

source "src/mainboard/roda/*/Kconfig"

config MAINBOARD_VENDOR
	default "Roda"

endif # VENDOR_RODA
```
