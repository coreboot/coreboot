## src/mainboard/roda/rk886ex/Kconfig
```kconfig
## SPDX-License-Identifier: GPL-2.0-only

if BOARD_RODA_RK886EX

config BOARD_SPECIFIC_OPTIONS
	def_bool y
	select AZALIA_USE_LEGACY_VERB_TABLE
	select SYSTEM_TYPE_LAPTOP
	select CPU_INTEL_SOCKET_M
	select NORTHBRIDGE_INTEL_I945
	select NORTHBRIDGE_INTEL_SUBTYPE_I945GM
	select SOUTHBRIDGE_INTEL_I82801GX
	select SOUTHBRIDGE_TI_PCI7420
	select SUPERIO_SMSC_LPC47N227
	select SUPERIO_RENESAS_M3885X
	select EC_ACPI
	select HAVE_OPTION_TABLE
	select HAVE_PIRQ_TABLE
	select HAVE_MP_TABLE
	select HAVE_ACPI_TABLES
	select HAVE_ACPI_RESUME
	select BOARD_ROMSIZE_KB_1024
	select INTEL_INT15
	select BOOT_DEVICE_NOT_SPI_FLASH

config MAINBOARD_DIR
	default "roda/rk886ex"

config MAINBOARD_PART_NUMBER
	default "RK886EX"

config IRQ_SLOT_COUNT
	int
	default 18

config MAXIMUM_SUPPORTED_FREQUENCY
	int
	default 400

endif # BOARD_RODA_RK886EX
```

## src/mainboard/roda/rk886ex/Kconfig.name
```kconfig
## SPDX-License-Identifier: GPL-2.0-only

config BOARD_RODA_RK886EX
	bool "RK886EX"
```

## src/mainboard/roda/rk9/Kconfig
```kconfig
if BOARD_RODA_RK9

config BOARD_SPECIFIC_OPTIONS
	def_bool y
	select SYSTEM_TYPE_LAPTOP
	select CPU_INTEL_SOCKET_BGA956
	select NORTHBRIDGE_INTEL_GM45
	select SOUTHBRIDGE_INTEL_I82801IX
	select SUPERIO_SMSC_LPC47N227
	select BOARD_ROMSIZE_KB_4096
	select CARDBUS_PLUGIN_SUPPORT
	select HAVE_ACPI_TABLES
	select HAVE_ACPI_RESUME
	select EC_ACPI
	select HAVE_OPTION_TABLE
	select INTEL_INT15

config MAINBOARD_DIR
	default "roda/rk9"

config MAINBOARD_PART_NUMBER
	default "RK9"

config CBFS_SIZE
	default ROM_SIZE

endif # BOARD_RODA_RK9
```

## src/mainboard/roda/rv11/Kconfig
```kconfig
## SPDX-License-Identifier: GPL-2.0-only

if BOARD_RODA_RV11 || BOARD_RODA_RW11

config BOARD_SPECIFIC_OPTIONS
	def_bool y
	select AZALIA_USE_LEGACY_VERB_TABLE
	select SYSTEM_TYPE_LAPTOP
	select NORTHBRIDGE_INTEL_SANDYBRIDGE
	select SOUTHBRIDGE_INTEL_C216
	select BOARD_ROMSIZE_KB_16384
	select HAVE_ACPI_TABLES
	select HAVE_OPTION_TABLE
	select HAVE_ACPI_RESUME
	select EC_RODA_IT8518
	select SERIRQ_CONTINUOUS_MODE
	select MAINBOARD_HAS_LIBGFXINIT
	select SUPERIO_ITE_IT8783EF if BOARD_RODA_RW11
	select MAINBOARD_USES_IFD_GBE_REGION

config MAINBOARD_DIR
	default "roda/rv11"

config VARIANT_DIR
	default "rv11" if BOARD_RODA_RV11
	default "rw11" if BOARD_RODA_RW11

config DEVICETREE
	default "variants/\$(CONFIG_VARIANT_DIR)/devicetree.cb"

config MAINBOARD_PART_NUMBER
	default "Lizard RW11" if BOARD_RODA_RW11
	default "Lizard RV11"

endif # BOARD_RODA_RV11 || BOARD_RODA_RW11
```

## src/mainboard/roda/rv11/Kconfig.name
```kconfig
config BOARD_RODA_RV11
	bool "Lizard RV11"

config BOARD_RODA_RW11
	bool "Lizard RW11"
```

## src/mainboard/samsung/Kconfig
```kconfig
## SPDX-License-Identifier: GPL-2.0-only

if VENDOR_SAMSUNG

choice
	prompt "Mainboard model"

source "src/mainboard/samsung/*/Kconfig.name"

endchoice

source "src/mainboard/samsung/*/Kconfig"

config MAINBOARD_VENDOR
	default "SAMSUNG"

endif # VENDOR_SAMSUNG
```

## src/mainboard/samsung/lumpy/Kconfig
```kconfig
if BOARD_SAMSUNG_LUMPY

config BOARD_SPECIFIC_OPTIONS
	def_bool y
	select SYSTEM_TYPE_LAPTOP
	select BOARD_ROMSIZE_KB_8192
	select MAINBOARD_HAS_CHROMEOS
	select MEMORY_MAPPED_TPM
	select MAINBOARD_HAS_TPM1
	select EC_SMSC_MEC1308
	select HAVE_ACPI_RESUME
	select HAVE_ACPI_TABLES
	select HAVE_OPTION_TABLE
	select NORTHBRIDGE_INTEL_SANDYBRIDGE
	select MAINBOARD_HAS_LIBGFXINIT
	select GFX_GMA_PANEL_1_ON_LVDS
	select SOUTHBRIDGE_INTEL_BD82X6X
	select SUPERIO_SMSC_MEC1308
	select HAVE_IFD_BIN
	select HAVE_ME_BIN
# LPC47N207 selected for external LPC card
# not on board, should be made selectable.
	select SUPERIO_SMSC_LPC47N207
	select INTEL_INT15
	select SANDYBRIDGE_VBOOT_IN_ROMSTAGE
	select HAVE_SPD_IN_CBFS

config VBOOT
	select VBOOT_VBNV_FLASH

config MAINBOARD_DIR
	default "samsung/lumpy"

config MAINBOARD_PART_NUMBER
	default "Lumpy"

if EARLY_PCI_BRIDGE

config EARLY_PCI_BRIDGE_DEVICE
	hex
	default 0x1c

config EARLY_PCI_BRIDGE_FUNCTION
	hex
	default 0x0

config EARLY_PCI_MMIO_BASE
	hex
	default 0xe0400000

endif

endif # BOARD_SAMSUNG_LUMPY
```

## src/mainboard/samsung/lumpy/Kconfig.name
```kconfig
## SPDX-License-Identifier: GPL-2.0-only

config BOARD_SAMSUNG_LUMPY
	bool "Lumpy"
```

## src/mainboard/samsung/stumpy/Kconfig.name
```kconfig
## SPDX-License-Identifier: GPL-2.0-only

config BOARD_SAMSUNG_STUMPY
	bool "Stumpy"
```

## src/mainboard/sapphire/Kconfig
```kconfig
if VENDOR_SAPPHIRE

choice
	prompt "Mainboard model"

source "src/mainboard/sapphire/*/Kconfig.name"

endchoice

source "src/mainboard/sapphire/*/Kconfig"

config MAINBOARD_VENDOR
	default "Sapphire"

endif # VENDOR_SAPPHIRE
```

## src/mainboard/sapphire/pureplatinumh61/Kconfig
```kconfig
## SPDX-License-Identifier: GPL-2.0-only

if BOARD_SAPPHIRE_PUREPLATINUMH61

config BOARD_SPECIFIC_OPTIONS
	def_bool y
	select AZALIA_USE_LEGACY_VERB_TABLE
	select NORTHBRIDGE_INTEL_SANDYBRIDGE
	select USE_NATIVE_RAMINIT
	select SOUTHBRIDGE_INTEL_BD82X6X
	select SUPERIO_FINTEK_F71808A
	select BOARD_ROMSIZE_KB_4096
	select HAVE_ACPI_TABLES
	select HAVE_OPTION_TABLE
	select HAVE_CMOS_DEFAULT
	select HAVE_ACPI_RESUME
	select MAINBOARD_HAS_LIBGFXINIT
	select INTEL_INT15
	select NO_UART_ON_SUPERIO

config MAINBOARD_DIR
	default "sapphire/pureplatinumh61"

config MAINBOARD_PART_NUMBER
	default "Pure Platinum H61"

config DRAM_RESET_GATE_GPIO
	int
	default 60

endif
```

## src/mainboard/sapphire/pureplatinumh61/Kconfig.name
```kconfig
## SPDX-License-Identifier: GPL-2.0-only

config BOARD_SAPPHIRE_PUREPLATINUMH61
	bool "Pure Platinum H61"
```

## src/mainboard/scaleway/Kconfig
```kconfig
if VENDOR_SCALEWAY

choice
	prompt "Mainboard model"

source "src/mainboard/scaleway/*/Kconfig.name"

endchoice

source "src/mainboard/scaleway/*/Kconfig"

config MAINBOARD_VENDOR
	default "Scaleway"

endif # VENDOR_SCALEWAY
```

## src/mainboard/scaleway/tagada/Kconfig
```kconfig
## SPDX-License-Identifier: GPL-2.0-only

if BOARD_SCALEWAY_TAGADA

config BOARD_SPECIFIC_OPTIONS
	def_bool y
	select SOC_INTEL_DENVERTON_NS
	select BOARD_ROMSIZE_KB_16384
	select HAVE_ACPI_TABLES
	select CONSOLE_OVERRIDE_LOGLEVEL
	select UART_OVERRIDE_BAUDRATE

config MAINBOARD_DIR
	string
	default "scaleway/tagada"

config MAINBOARD_PART_NUMBER
	string
	default "TAGADA"

config BMC_INFO_LOC
	hex "BMC information location in flash"
	default 0xff802000
	help
	  Location of BMC SERIAL information.

endif # BOARD_SCALEWAY_TAGADA
```

## src/mainboard/siemens/Kconfig
```kconfig
if VENDOR_SIEMENS

choice
	prompt "Mainboard model"

source "src/mainboard/siemens/*/Kconfig.name"

endchoice

source "src/mainboard/siemens/*/Kconfig"

config MAINBOARD_VENDOR
	default "Siemens"

endif # VENDOR_SIEMENS
```

## src/mainboard/siemens/chili/Kconfig
```kconfig
# SPDX-License-Identifier: GPL-2.0-only

config BOARD_SIEMENS_CHILI_COMMON
	def_bool n
	select BOARD_ROMSIZE_KB_32768
	select DRIVERS_I2C_GENERIC
	select DRIVERS_I2C_HID
	select EC_ACPI
	select HAVE_ACPI_RESUME
	select HAVE_ACPI_TABLES
	select HAVE_OPTION_TABLE
	select INTEL_GMA_HAVE_VBT
	select MAINBOARD_HAS_LIBGFXINIT
	select MEMORY_MAPPED_TPM
	select MAINBOARD_HAS_TPM2
	select MAINBOARD_USES_IFD_GBE_REGION
	select SOC_INTEL_CANNONLAKE_PCH_H
	select SOC_INTEL_COFFEELAKE

config BOARD_SIEMENS_CHILI_BASE
	select BOARD_SIEMENS_CHILI_COMMON
	select DRIVERS_UART_8250IO

config BOARD_SIEMENS_CHILI_CHILI
	select BOARD_SIEMENS_CHILI_COMMON
	select DRIVERS_I2C_LM96000
	select INTEL_LPSS_UART_FOR_CONSOLE
	select SECUNET_DMI
	select SOC_INTEL_COMMON_BLOCK_HDA_VERB

if BOARD_SIEMENS_CHILI_COMMON

config MAINBOARD_DIR
	default "siemens/chili"

config MAINBOARD_FAMILY
	string
	default "Chili"

config MAINBOARD_PART_NUMBER
	default "Chili base board" if BOARD_SIEMENS_CHILI_BASE
	default "Chili" if BOARD_SIEMENS_CHILI_CHILI

config VARIANT_DIR
	default "base" if BOARD_SIEMENS_CHILI_BASE
	default "chili" if BOARD_SIEMENS_CHILI_CHILI

config DEVICETREE
	default "variants/\$(CONFIG_VARIANT_DIR)/devicetree.cb"

config INTEL_GMA_VBT_FILE
	string
	default "src/mainboard/\$(MAINBOARDDIR)/variants/\$(CONFIG_VARIANT_DIR)/data.vbt"

config CBFS_SIZE
	default 0xb00000

config POST_DEVICE
	bool
	default n

config SIEMENS_CHILI_DEBUG_USB
	bool "Enable debug USB port"
	depends on BOARD_SIEMENS_CHILI_CHILI

config DRIVERS_INTEL_WIFI
	bool
	default n if BOARD_SIEMENS_CHILI_CHILI

endif
```

## src/mainboard/siemens/chili/Kconfig.name
```kconfig
# SPDX-License-Identifier: GPL-2.0-only

comment "CHILI"

config BOARD_SIEMENS_CHILI_BASE
	bool "-> Base board"

config BOARD_SIEMENS_CHILI_CHILI
	bool "-> Chili (AiO)"
```

## src/mainboard/siemens/fa_ehl/Kconfig
```kconfig
## SPDX-License-Identifier: GPL-2.0-only

config BOARD_SIEMENS_BASEBOARD_FA_EHL
	def_bool n
	select SOC_INTEL_ELKHARTLAKE
	select BOARD_ROMSIZE_KB_16384
	select DRIVERS_I2C_GENERIC
	select HAVE_ACPI_TABLES
	select HAVE_SPD_IN_CBFS
	select SOC_INTEL_DISABLE_POWER_LIMITS
	select USE_SIEMENS_HWILIB

config BOARD_SIEMENS_FA_EHL
	select BOARD_SIEMENS_BASEBOARD_FA_EHL

source "src/mainboard/siemens/fa_ehl/variants/*/Kconfig"

if BOARD_SIEMENS_BASEBOARD_FA_EHL

config MAINBOARD_DIR
	default "siemens/fa_ehl"

config VARIANT_DIR
	default "fa_ehl" if BOARD_SIEMENS_FA_EHL

config MAINBOARD_PART_NUMBER
	default "FA EHL" if BOARD_SIEMENS_FA_EHL

config DEVICETREE
	default "variants/\$(CONFIG_VARIANT_DIR)/devicetree.cb"

config SOC_INTEL_ELKHARTLAKE_TCO_NO_REBOOT_EN
	default y

endif # BOARD_SIEMENS_BASEBOARD_FA_EHL
```
