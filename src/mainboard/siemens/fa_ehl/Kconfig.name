## src/mainboard/siemens/fa_ehl/Kconfig.name
```kconfig
## SPDX-License-Identifier: GPL-2.0-only

comment "FA EHL"

config BOARD_SIEMENS_FA_EHL
	bool "-> FA EHL"
```

## src/mainboard/siemens/fa_ehl/variants/fa_ehl/Kconfig
```kconfig
## SPDX-License-Identifier: GPL-2.0-only

if BOARD_SIEMENS_FA_EHL

config BOARD_SPECIFIC_OPTIONS
	def_bool y
	select EHL_TSN_DRIVER
	select DRIVERS_ETH_PHY_M88E1512

config FMDFILE
	default "src/mainboard/\$(CONFIG_MAINBOARD_DIR)/fa_ehl.fmd"

config UART_FOR_CONSOLE
	int
	default 0

endif # BOARD_SIEMENS_FA_EHL
```

## src/mainboard/siemens/mc_apl1/Kconfig
```kconfig
config BOARD_SIEMENS_BASEBOARD_MC_APL1
	def_bool n
	select SOC_INTEL_APOLLOLAKE
	select BOARD_ROMSIZE_KB_16384
	select HAVE_ACPI_TABLES
	select USE_SIEMENS_HWILIB
	select INTEL_LPSS_UART_FOR_CONSOLE

source "src/mainboard/siemens/mc_apl1/variants/*/Kconfig"

if BOARD_SIEMENS_BASEBOARD_MC_APL1

config MAINBOARD_DIR
	default "siemens/mc_apl1"

config VARIANT_DIR
	default "mc_apl1" if BOARD_SIEMENS_MC_APL1
	default "mc_apl2" if BOARD_SIEMENS_MC_APL2
	default "mc_apl3" if BOARD_SIEMENS_MC_APL3
	default "mc_apl4" if BOARD_SIEMENS_MC_APL4
	default "mc_apl5" if BOARD_SIEMENS_MC_APL5
	default "mc_apl6" if BOARD_SIEMENS_MC_APL6
	default "mc_apl7" if BOARD_SIEMENS_MC_APL7

config DEVICETREE
	default "variants/\$(CONFIG_VARIANT_DIR)/devicetree.cb"

config MAINBOARD_PART_NUMBER
	default "MC APL1" if BOARD_SIEMENS_MC_APL1
	default "MC APL2" if BOARD_SIEMENS_MC_APL2
	default "MC APL3" if BOARD_SIEMENS_MC_APL3
	default "MC APL4" if BOARD_SIEMENS_MC_APL4
	default "MC APL5" if BOARD_SIEMENS_MC_APL5
	default "MC APL6" if BOARD_SIEMENS_MC_APL6
	default "MC APL7" if BOARD_SIEMENS_MC_APL7

config UART_FOR_CONSOLE
	default 2

endif # BOARD_SIEMENS_BASEBOARD_MC_APL1
```

## src/mainboard/siemens/mc_apl1/Kconfig.name
```kconfig
## SPDX-License-Identifier: GPL-2.0-only

comment "MC APLx"

config BOARD_SIEMENS_MC_APL1
	bool "-> MC APL1"

config BOARD_SIEMENS_MC_APL2
	bool "-> MC APL2"

config BOARD_SIEMENS_MC_APL3
	bool "-> MC APL3"

config BOARD_SIEMENS_MC_APL4
	bool "-> MC APL4"

config BOARD_SIEMENS_MC_APL5
	bool "-> MC APL5"

config BOARD_SIEMENS_MC_APL6
	bool "-> MC APL6"

config BOARD_SIEMENS_MC_APL7
	bool "-> MC APL7"
```

## src/mainboard/siemens/mc_apl1/variants/mc_apl1/Kconfig
```kconfig
if BOARD_SIEMENS_MC_APL1

config BOARD_SPECIFIC_OPTIONS
	def_bool y
	select DRIVER_INTEL_I210
	select DRIVERS_I2C_RX6110SA
	select RX6110SA_DISABLE_ACPI
	select DRIVER_SIEMENS_NC_FPGA
	select NC_FPGA_NOTIFY_CB_READY
	select SOC_INTEL_DISABLE_POWER_LIMITS
	select DRIVERS_I2C_PTN3460

endif # BOARD_SIEMENS_MC_APL1
```

## src/mainboard/siemens/mc_apl1/variants/mc_apl2/Kconfig
```kconfig
if BOARD_SIEMENS_MC_APL2

config BOARD_SPECIFIC_OPTIONS
	def_bool y
	select DRIVER_INTEL_I210
	select DRIVERS_I2C_RX6110SA
	select DRIVER_SIEMENS_NC_FPGA
	select MAINBOARD_HAS_TPM2
	select MAINBOARD_HAS_LPC_TPM
	select TPM_ON_FAST_SPI
	select TPM_MEASURED_BOOT

config CBFS_SIZE
	default 0xb4e000

config VBOOT
	select VBOOT_VBNV_FLASH
	select VBOOT_NO_BOARD_SUPPORT
	select GBB_FLAG_DISABLE_LID_SHUTDOWN
	select GBB_FLAG_DISABLE_PD_SOFTWARE_SYNC
	select GBB_FLAG_DISABLE_EC_SOFTWARE_SYNC
	select GBB_FLAG_DISABLE_FWMP

config FMDFILE
	string
	default "src/mainboard/\$(CONFIG_MAINBOARD_DIR)/mc_apl_vboot.fmd"

endif # BOARD_SIEMENS_MC_APL2
```

## src/mainboard/siemens/mc_apl1/variants/mc_apl4/Kconfig
```kconfig
if BOARD_SIEMENS_MC_APL4

config BOARD_SPECIFIC_OPTIONS
	def_bool y
	select DRIVERS_I2C_GENERIC
	select DRIVER_INTEL_I210
	select SOC_INTEL_SET_MIN_CLOCK_RATIO
	select MAINBOARD_HAS_TPM2
	select MEMORY_MAPPED_TPM
	select TPM_ON_FAST_SPI
	select DRIVERS_I2C_PTN3460
	select TPM_MEASURED_BOOT
	select HAS_RECOVERY_MRC_CACHE

config UART_FOR_CONSOLE
	default 1

config CBFS_SIZE
	default 0xb4e000

config VBOOT
	select VBOOT_VBNV_FLASH
	select VBOOT_NO_BOARD_SUPPORT
	select GBB_FLAG_DISABLE_LID_SHUTDOWN
	select GBB_FLAG_DISABLE_PD_SOFTWARE_SYNC
	select GBB_FLAG_DISABLE_EC_SOFTWARE_SYNC
	select GBB_FLAG_DISABLE_FWMP

config FMDFILE
	default "src/mainboard/\$(CONFIG_MAINBOARD_DIR)/mc_apl_vboot.fmd"

endif # BOARD_SIEMENS_MC_APL4
```

## src/mainboard/siemens/mc_apl1/variants/mc_apl5/Kconfig
```kconfig
if BOARD_SIEMENS_MC_APL5

config BOARD_SPECIFIC_OPTIONS
	def_bool y
	select DRIVER_INTEL_I210
	select DRIVERS_I2C_RX6110SA
	select DRIVER_SIEMENS_NC_FPGA
	select NC_FPGA_NOTIFY_CB_READY
	select APL_SKIP_SET_POWER_LIMITS
	select MAINBOARD_HAS_TPM2
	select MAINBOARD_HAS_LPC_TPM
	select TPM_ON_FAST_SPI

endif # BOARD_SIEMENS_MC_APL5
```

## src/mainboard/siemens/mc_apl1/variants/mc_apl6/Kconfig
```kconfig
if BOARD_SIEMENS_MC_APL6

config BOARD_SPECIFIC_OPTIONS
	def_bool y
	select DRIVER_INTEL_I210
	select DRIVERS_I2C_RX6110SA
	select RX6110SA_DISABLE_ACPI
	select DRIVER_SIEMENS_NC_FPGA
	select NC_FPGA_NOTIFY_CB_READY
	select APL_SKIP_SET_POWER_LIMITS
	select MAINBOARD_HAS_TPM2
	select MEMORY_MAPPED_TPM
	select TPM_ON_FAST_SPI
	select TPM_MEASURED_BOOT
	select HAS_RECOVERY_MRC_CACHE

config VBOOT
	select VBOOT_VBNV_FLASH
	select VBOOT_NO_BOARD_SUPPORT
	select GBB_FLAG_DISABLE_LID_SHUTDOWN
	select GBB_FLAG_DISABLE_PD_SOFTWARE_SYNC
	select GBB_FLAG_DISABLE_EC_SOFTWARE_SYNC
	select GBB_FLAG_DISABLE_FWMP

config FMDFILE
	default "src/mainboard/\$(CONFIG_MAINBOARD_DIR)/mc_apl_vboot.fmd"

endif # BOARD_SIEMENS_MC_APL6
```

## src/mainboard/siemens/mc_apl1/variants/mc_apl7/Kconfig
```kconfig
if BOARD_SIEMENS_MC_APL7

config BOARD_SPECIFIC_OPTIONS
	def_bool y
	select DRIVER_INTEL_I210
	select SOC_INTEL_SET_MIN_CLOCK_RATIO
	select DRIVERS_I2C_PTN3460

config UART_FOR_CONSOLE
	default 1

config FMDFILE
	default "src/mainboard/\$(CONFIG_MAINBOARD_DIR)/mc_apl1.fmd"

endif # BOARD_SIEMENS_MC_APL7
```

## src/mainboard/siemens/mc_bdx1/Kconfig
```kconfig
if BOARD_SIEMENS_MC_BDX1

config BOARD_SPECIFIC_OPTIONS
	def_bool y
	select SOC_INTEL_FSP_BROADWELL_DE
	select BOARD_ROMSIZE_KB_16384
	select HAVE_ACPI_TABLES
	select HAVE_OPTION_TABLE
	select HAVE_FSP_BIN if FSP_PACKAGE_DEFAULT
	select CBFS_AUTOGEN_ATTRIBUTES
	select USE_SIEMENS_HWILIB
	select DRIVER_INTEL_I210
	select DRIVER_SIEMENS_NC_FPGA
	select DRIVERS_I2C_RX6110SA
	select DRIVERS_I2C_PCA9538
	select MAINBOARD_HAS_TPM2
	select MAINBOARD_HAS_LPC_TPM

config VBOOT
	select VBOOT_MEASURED_BOOT
	select VBOOT_VBNV_FLASH
	select VBOOT_NO_BOARD_SUPPORT
	select GBB_FLAG_DISABLE_LID_SHUTDOWN
	select GBB_FLAG_DISABLE_PD_SOFTWARE_SYNC
	select GBB_FLAG_DISABLE_EC_SOFTWARE_SYNC
	select GBB_FLAG_DISABLE_FWMP

config FMDFILE
	string
	default "src/mainboard/$(CONFIG_MAINBOARD_DIR)/mc_bdx1.fmd" if VBOOT

config MAINBOARD_DIR
	string
	default "siemens/mc_bdx1"

config MAINBOARD_PART_NUMBER
	string
	default "MC BDX1"

config IRQ_SLOT_COUNT
	int
	default 18

config CBFS_SIZE
	hex
	default 0x00D00000 if !VBOOT

config VIRTUAL_ROM_SIZE
	hex
	default 0x1000000

config INTEGRATED_UART
	bool
	default n

config DRIVERS_UART_8250IO
	def_bool y

config FSP_PACKAGE_DEFAULT
	bool "Configure defaults for the Intel FSP package"
	default n

endif # BOARD_SIEMENS_MC_BDX1
```

## src/mainboard/siemens/mc_ehl/Kconfig
```kconfig
config BOARD_SIEMENS_BASEBOARD_MC_EHL
	def_bool n
	select SOC_INTEL_ELKHARTLAKE
	select BOARD_ROMSIZE_KB_16384
	select DRIVERS_I2C_GENERIC
	select HAVE_ACPI_TABLES
	select DRIVER_SIEMENS_NC_FPGA
	select NC_FPGA_NOTIFY_CB_READY
	select USE_SIEMENS_HWILIB
	select SOC_INTEL_DISABLE_POWER_LIMITS

source "src/mainboard/siemens/mc_ehl/variants/*/Kconfig"

if BOARD_SIEMENS_BASEBOARD_MC_EHL

config MAINBOARD_DIR
	default "siemens/mc_ehl"

config VARIANT_DIR
	default "mc_ehl1" if BOARD_SIEMENS_MC_EHL1
	default "mc_ehl2" if BOARD_SIEMENS_MC_EHL2
	default "mc_ehl3" if BOARD_SIEMENS_MC_EHL3
	default "mc_ehl4" if BOARD_SIEMENS_MC_EHL4
	default "mc_ehl5" if BOARD_SIEMENS_MC_EHL5

config MAINBOARD_PART_NUMBER
	default "MC EHL1" if BOARD_SIEMENS_MC_EHL1
	default "MC EHL2" if BOARD_SIEMENS_MC_EHL2
	default "MC EHL3" if BOARD_SIEMENS_MC_EHL3
	default "MC EHL4" if BOARD_SIEMENS_MC_EHL4
	default "MC EHL5" if BOARD_SIEMENS_MC_EHL5

config DEVICETREE
	default "variants/\$(CONFIG_VARIANT_DIR)/devicetree.cb"

config SOC_INTEL_ELKHARTLAKE_TCO_NO_REBOOT_EN
	default y

endif # BOARD_SIEMENS_BASEBOARD_MC_EHL
```

## src/mainboard/siemens/mc_ehl/Kconfig.name
```kconfig
## SPDX-License-Identifier: GPL-2.0-only

comment "MC EHLx"

config BOARD_SIEMENS_MC_EHL1
	bool "-> MC EHL1"

config BOARD_SIEMENS_MC_EHL2
	bool "-> MC EHL2"

config BOARD_SIEMENS_MC_EHL3
	bool "-> MC EHL3"

config BOARD_SIEMENS_MC_EHL4
	bool "-> MC EHL4"

config BOARD_SIEMENS_MC_EHL5
	bool "-> MC EHL5"

config BOARD_SIEMENS_MC_EHL6
	bool "-> MC EHL6"

config BOARD_SIEMENS_MC_EHL7
	bool "-> MC EHL7"

config BOARD_SIEMENS_MC_EHL8
	bool "-> MC EHL8"
```

## src/mainboard/siemens/mc_ehl/variants/mc_ehl1/Kconfig
```kconfig
if BOARD_SIEMENS_MC_EHL1

config BOARD_SPECIFIC_OPTIONS
	def_bool y
	select DRIVERS_I2C_RX6110SA
	select DRIVER_INTEL_I210
	select INTEL_LPSS_UART_FOR_CONSOLE
	select NC_FPGA_POST_CODE

config FMDFILE
	default "src/mainboard/\$(CONFIG_MAINBOARD_DIR)/mc_ehl.fmd"

config UART_FOR_CONSOLE
	int
	default 2

config EARLY_PCI_BRIDGE_DEVICE
	hex
	depends on NC_FPGA_POST_CODE
	default 0x1c

config EARLY_PCI_BRIDGE_FUNCTION
	hex
	depends on NC_FPGA_POST_CODE
	default 0x2

config EARLY_PCI_MMIO_BASE
	hex
	depends on NC_FPGA_POST_CODE
	default 0xfe800000

endif # BOARD_SIEMENS_MC_EHL1
```

## src/mainboard/siemens/mc_ehl/variants/mc_ehl2/Kconfig
```kconfig
if BOARD_SIEMENS_MC_EHL2

config BOARD_SPECIFIC_OPTIONS
	def_bool y
	select DRIVERS_I2C_RX6110SA
	select DRIVER_INTEL_I210
	select SOC_INTEL_COMMON_BLOCK_LPC_COMB_ENABLE
	select EHL_TSN_DRIVER

config FMDFILE
	default "src/mainboard/\$(CONFIG_MAINBOARD_DIR)/mc_ehl.fmd"

config UART_FOR_CONSOLE
	int
	default 0

endif # BOARD_SIEMENS_MC_EHL2
```

## src/mainboard/siemens/mc_ehl/variants/mc_ehl3/Kconfig
```kconfig
if BOARD_SIEMENS_MC_EHL3

config BOARD_SPECIFIC_OPTIONS
	def_bool y
	select DRIVERS_I2C_RV3028C7
	select DRIVER_INTEL_I210
	select SOC_INTEL_COMMON_BLOCK_LPC_COMB_ENABLE
	select EHL_TSN_DRIVER
	select DRIVERS_ETH_PHY_M88E1512

config FMDFILE
	default "src/mainboard/\$(CONFIG_MAINBOARD_DIR)/mc_ehl.fmd"

config UART_FOR_CONSOLE
	int
	default 0

endif # BOARD_SIEMENS_MC_EHL3
```

## src/mainboard/siemens/mc_ehl/variants/mc_ehl6/Kconfig
```kconfig
## SPDX-License-Identifier: GPL-2.0-only

if BOARD_SIEMENS_MC_EHL6

config BOARD_SPECIFIC_OPTIONS
	def_bool y
	select DRIVER_INTEL_I210
	select DRIVERS_ETH_PHY_M88E1512
	select DRIVERS_I2C_RV3028C7
	select EHL_TSN_DRIVER
	select MAINBOARD_HAS_TPM2
	select MEMORY_MAPPED_TPM
	select NC_FPGA_POST_CODE
	select SOC_INTEL_COMMON_BLOCK_LPC_COMB_ENABLE
	select TPM_MEASURED_BOOT
	select TPM_MEASURED_BOOT_INIT_BOOTBLOCK

config FMDFILE
	default "src/mainboard/\$(CONFIG_MAINBOARD_DIR)/mc_ehl.fmd"

config UART_FOR_CONSOLE
	int
	default 0

config EARLY_PCI_BRIDGE_DEVICE
	hex
	depends on NC_FPGA_POST_CODE
	default 0x1c

config EARLY_PCI_BRIDGE_FUNCTION
	hex
	depends on NC_FPGA_POST_CODE
	default 0x0

config EARLY_PCI_MMIO_BASE
	hex
	depends on NC_FPGA_POST_CODE
	default 0xfe800000

config SOC_INTEL_ELKHARTLAKE_TCO_NO_REBOOT_EN
	default y

endif # BOARD_SIEMENS_MC_EHL6
```

## src/mainboard/siemens/mc_ehl/variants/mc_ehl7/Kconfig
```kconfig
## SPDX-License-Identifier: GPL-2.0-only

if BOARD_SIEMENS_MC_EHL7

config BOARD_SPECIFIC_OPTIONS
	def_bool y
	select DRIVER_INTEL_I210
	select MAINBOARD_HAS_TPM2
	select MEMORY_MAPPED_TPM
	select NC_FPGA_POST_CODE
	select SOC_INTEL_COMMON_BLOCK_LPC_COMB_ENABLE
	select TPM_MEASURED_BOOT
	select TPM_MEASURED_BOOT_INIT_BOOTBLOCK

config FMDFILE
	default "src/mainboard/\$(CONFIG_MAINBOARD_DIR)/mc_ehl.fmd"

config UART_FOR_CONSOLE
	int
	default 0

config EARLY_PCI_BRIDGE_DEVICE
	hex
	depends on NC_FPGA_POST_CODE
	default 0x1c

config EARLY_PCI_BRIDGE_FUNCTION
	hex
	depends on NC_FPGA_POST_CODE
	default 0x0

config EARLY_PCI_MMIO_BASE
	hex
	depends on NC_FPGA_POST_CODE
	default 0xfe800000

endif # BOARD_SIEMENS_MC_EHL7
```

## src/mainboard/siemens/mc_rpl/Kconfig
```kconfig
## SPDX-License-Identifier: GPL-2.0-only

config BOARD_SIEMENS_BASEBOARD_MC_RPL
	def_bool n
	select BOARD_ROMSIZE_KB_16384
	select CPU_INTEL_SOCKET_LGA1700
	select DRIVERS_I2C_GENERIC
	select DRIVERS_INTEL_DPTF
	select DRIVERS_SPI_ACPI
	select DRIVERS_USB_ACPI
	select HAVE_ACPI_RESUME
	select HAVE_ACPI_TABLES
	select USE_SIEMENS_HWILIB
	select SOC_INTEL_ALDERLAKE_PCH_P
	select SOC_INTEL_RAPTORLAKE
	select DRIVER_SIEMENS_NC_FPGA
	select FSP_TYPE_IOT

config BOARD_SIEMENS_MC_RPL1
	select BOARD_SIEMENS_BASEBOARD_MC_RPL

source "src/mainboard/siemens/mc_rpl/variants/*/Kconfig"

if BOARD_SIEMENS_BASEBOARD_MC_RPL

config MAINBOARD_DIR
	default "siemens/mc_rpl"

config VARIANT_DIR
	default "mc_rpl1" if BOARD_SIEMENS_MC_RPL1

config MAINBOARD_PART_NUMBER
	default "MC RPL1" if BOARD_SIEMENS_MC_RPL1

config MAINBOARD_VENDOR
	string
	default "Siemens"

config MAINBOARD_FAMILY
	string
	default "MC RPL"

config DEVICETREE
	default "devicetree.cb"

config OVERRIDE_DEVICETREE
	default "variants/\$(CONFIG_VARIANT_DIR)/overridetree.cb"

config FMDFILE
	default "src/mainboard/\$(CONFIG_MAINBOARD_DIR)/mc_rpl.fmd"

config DIMM_SPD_SIZE
	int
	default 256

config USE_PM_ACPI_TIMER
	default n if BOARD_SIEMENS_MC_RPL1
endif
```

## src/mainboard/siemens/mc_rpl/Kconfig.name
```kconfig
## SPDX-License-Identifier: GPL-2.0-only

comment "MC RPLx"

config BOARD_SIEMENS_MC_RPL1
	bool "-> MC RPL1"
```

## src/mainboard/siemens/mc_rpl/variants/mc_rpl1/Kconfig
```kconfig
## SPDX-License-Identifier: GPL-2.0-only

if BOARD_SIEMENS_MC_RPL1

config BOARD_SPECIFIC_OPTIONS
	def_bool y
	select DRIVER_INTEL_I210
	select DRIVERS_UART_8250IO
	select MAINBOARD_HAS_TPM2
	select MEMORY_MAPPED_TPM
	select NC_FPGA_POST_CODE
	select SOC_INTEL_COMMON_BLOCK_LPC_COMB_ENABLE
	select TPM_MEASURED_BOOT
	select TPM_MEASURED_BOOT_INIT_BOOTBLOCK

config UART_FOR_CONSOLE
	int
	default 0

config EARLY_PCI_BRIDGE_DEVICE
	hex
	depends on NC_FPGA_POST_CODE
	default 0x1c

config EARLY_PCI_BRIDGE_FUNCTION
	hex
	depends on NC_FPGA_POST_CODE
	default 0x2

config EARLY_PCI_MMIO_BASE
	hex
	depends on NC_FPGA_POST_CODE
	default 0xfe400000

endif # BOARD_SIEMENS_MC_RPL1
```

## src/mainboard/siemens/mc_tcu3/Kconfig
```kconfig
##
## This file is part of the coreboot project.
##
## Copyright (C) 2013-2014 Sage Electronic Engineering, LLC.
##
## This program is free software; you can redistribute it and/or modify
## it under the terms of the GNU General Public License as published by
## the Free Software Foundation; version 2 of the License.
##
## This program is distributed in the hope that it will be useful,
## but WITHOUT ANY WARRANTY; without even the implied warranty of
## MERCHANTABILITY or FITNESS FOR A PARTICULAR PURPOSE.  See the
## GNU General Public License for more details.
##

if BOARD_SIEMENS_MC_TCU3

config BOARD_SPECIFIC_OPTIONS # dummy
	def_bool y
	select SOC_INTEL_FSP_BAYTRAIL
	select BOARD_ROMSIZE_KB_16384
	select HAVE_ACPI_TABLES
	select HAVE_OPTION_TABLE
	select ENABLE_BUILTIN_COM1
	select HAVE_FSP_BIN if FSP_PACKAGE_DEFAULT
	select ENABLE_FSP_FAST_BOOT
	select TSC_MONOTONIC_TIMER
	select DRIVER_INTEL_I210
	select SOC_INTEL_FSP_BAYTRAIL_MD
	select USE_BLOBS
	select CBFS_AUTOGEN_ATTRIBUTES
	select USE_SIEMENS_HWILIB

config MAINBOARD_DIR
	string
	default "siemens/mc_tcu3"

config MAINBOARD_PART_NUMBER
	string
	default "MC_TCU3 (FSP)"


config MAX_CPUS
	int
	default 16

config CBFS_SIZE
	hex
	default 0x00e00000

config FSP_PACKAGE_DEFAULT
	bool "Configure defaults for the Intel FSP package"
	default n

config VGA_BIOS
	bool
	default y if FSP_PACKAGE_DEFAULT

endif # BOARD_SIEMENS_MC_TCU3
```
