## src/mainboard/siemens/sitemp_g1p1/Kconfig
```kconfig
if BOARD_SIEMENS_SITEMP_G1P1

config BOARD_SPECIFIC_OPTIONS # dummy
	def_bool y
	select ARCH_X86
	select CPU_AMD_SOCKET_S1G1
	select NORTHBRIDGE_AMD_AMDK8
	select SOUTHBRIDGE_AMD_RS690
	select SOUTHBRIDGE_AMD_SB600
	select SUPERIO_ITE_IT8712F
	select HAVE_ACPI_TABLES
	select HAVE_MP_TABLE
	select HAVE_PIRQ_TABLE
	select HAVE_OPTION_TABLE
	select SB_HT_CHAIN_UNITID_OFFSET_ONLY
	select BOARD_ROMSIZE_KB_1024
	select RAMINIT_SYSINFO
	select QRANK_DIMM_SUPPORT
	select SET_FIDVID
	select GFXUMA
	select EXT_CONF_SUPPORT

config MAINBOARD_DIR
	string
	default siemens/sitemp_g1p1

config LINT01_CONVERSION
	bool
	default y

config APIC_ID_OFFSET
	hex
	default 0x0

config MAINBOARD_PART_NUMBER
	string
	default "MB SITEMP-G1 (U1P0/U1P1)"

config MAX_CPUS
	int
	default 2

config MAX_PHYSICAL_CPUS
	int
	default 1

config SB_HT_CHAIN_ON_BUS0
	int
	default 1

config HT_CHAIN_END_UNITID_BASE
	hex
	default 0x1

config HT_CHAIN_UNITID_BASE
	hex
	default 0x0

config IRQ_SLOT_COUNT
	int
	default 11

config IOMMU
	bool
	default n

config HW_SCRUBBER
	bool
	default n

config ECC_MEMORY
	bool
	default n

endif # BOARD_SIEMENS_SITEMP_G1P1
```
