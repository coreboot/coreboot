## src/mainboard/starlabs/starbook/Kconfig
```kconfig
## SPDX-License-Identifier: GPL-2.0-only

config BOARD_STARLABS_STARBOOK_SERIES
	def_bool n
	select DRIVERS_EFI_VARIABLE_STORE
	select DRIVERS_OPTION_CFR_ENABLED
	select DRIVERS_I2C_HID
	select EC_STARLABS_ITE
	select EC_STARLABS_FAN
	select HAVE_ACPI_RESUME
	select HAVE_ACPI_TABLES
	select HAVE_CMOS_DEFAULT
	select HAVE_OPTION_TABLE
	select INTEL_GMA_HAVE_VBT
	select INTEL_LPSS_UART_FOR_CONSOLE
	select NO_UART_ON_SUPERIO
	select SOC_INTEL_COMMON_BLOCK_HDA_VERB
	select SYSTEM_TYPE_LAPTOP
	select VALIDATE_INTEL_DESCRIPTOR

config BOARD_STARLABS_LABTOP_KBL
	select BOARD_ROMSIZE_KB_8192
	select BOARD_STARLABS_STARBOOK_SERIES
	select CRB_TPM
	select HAVE_INTEL_PTT
	select HAVE_SPD_IN_CBFS
	select SOC_INTEL_KABYLAKE
	select SPI_FLASH_GIGADEVICE
	select TPM2

config BOARD_STARLABS_LABTOP_CML
	select BOARD_ROMSIZE_KB_16384
	select BOARD_STARLABS_STARBOOK_SERIES
	select EC_STARLABS_CHARGING_SPEED
	select EC_STARLABS_KBL_LEVELS
	select EC_STARLABS_LID_SWITCH
	select EC_STARLABS_MAX_CHARGE
	select EC_STARLABS_MERLIN
	select EC_STARLABS_NEED_ITE_BIN
	select HAVE_INTEL_PTT
	select HAVE_SPD_IN_CBFS
	select CRB_TPM
	select SOC_INTEL_COMETLAKE_1
	select SPI_FLASH_WINBOND
	select TPM2

config BOARD_STARLABS_STARBOOK_TGL
	select BOARD_ROMSIZE_KB_16384
	select BOARD_STARLABS_STARBOOK_SERIES
	select DRIVERS_INTEL_PMC
	select DRIVERS_INTEL_USB4_RETIMER
	select EC_STARLABS_CHARGING_SPEED
	select EC_STARLABS_KBL_LEVELS
	select EC_STARLABS_LID_SWITCH
	select EC_STARLABS_MAX_CHARGE
	select EC_STARLABS_MERLIN
	select EC_STARLABS_NEED_ITE_BIN
	select MAINBOARD_HAS_TPM2
	select MEMORY_MAPPED_TPM
	select SOC_INTEL_COMMON_BLOCK_TCSS
	select SOC_INTEL_ENABLE_USB4_PCIE_RESOURCES
	select SOC_INTEL_TIGERLAKE
	select SPI_FLASH_WINBOND
	select TPM_MEASURED_BOOT

config BOARD_STARLABS_STARBOOK_ADL_COMMON
	def_bool n
	select BOARD_STARLABS_STARBOOK_SERIES
	select DRIVERS_INTEL_PMC
	select EC_STARLABS_CHARGING_SPEED
	select EC_STARLABS_KBL_LEVELS
	select EC_STARLABS_LID_SWITCH
	select EC_STARLABS_MAX_CHARGE
	select EC_STARLABS_MERLIN
	select EC_STARLABS_NEED_ITE_BIN
	select MAINBOARD_HAS_TPM2
	select MEMORY_MAPPED_TPM
	select PMC_IPC_ACPI_INTERFACE
	select SOC_INTEL_ALDERLAKE
	select SOC_INTEL_COMMON_BLOCK_TCSS
	select SOC_INTEL_CRASHLOG
	select SPI_FLASH_WINBOND
	select TPM_MEASURED_BOOT

config BOARD_STARLABS_STARBOOK_ADL
	select BOARD_ROMSIZE_KB_32768
	select BOARD_STARLABS_STARBOOK_ADL_COMMON
	select SOC_INTEL_ALDERLAKE_PCH_P

config BOARD_STARLABS_STARBOOK_ADL_N
	select BOARD_ROMSIZE_KB_16384
	select BOARD_STARLABS_STARBOOK_ADL_COMMON
	select DRIVERS_GFX_GENERIC
	select FSP_TYPE_IOT
	select SOC_INTEL_ALDERLAKE_PCH_N

config BOARD_STARLABS_STARBOOK_RPL
	select BOARD_ROMSIZE_KB_32768
	select BOARD_STARLABS_STARBOOK_ADL_COMMON
	select DRIVERS_INTEL_USB4_RETIMER
	select SOC_INTEL_ALDERLAKE_PCH_P
	select SOC_INTEL_ENABLE_USB4_PCIE_RESOURCES
	select SOC_INTEL_RAPTORLAKE

config BOARD_STARLABS_STARBOOK_MTL
	select BOARD_ROMSIZE_KB_32768
	select BOARD_STARLABS_STARBOOK_SERIES
	select DRIVERS_GFX_GENERIC
	select DRIVERS_INTEL_PMC
	select EC_STARLABS_CHARGING_SPEED
	select EC_STARLABS_KBL_LEVELS
	select EC_STARLABS_LID_SWITCH
	select EC_STARLABS_MAX_CHARGE
	select EC_STARLABS_MERLIN
	select EC_STARLABS_NEED_ITE_BIN
	select MAINBOARD_HAS_TPM2
	select MEMORY_MAPPED_TPM
	select PMC_IPC_ACPI_INTERFACE
	select SOC_INTEL_COMMON_BLOCK_VTD
	select SOC_INTEL_METEORLAKE
	select SOC_INTEL_METEORLAKE_U_H
	select SOC_INTEL_COMMON_BLOCK_TCSS
	select SOC_INTEL_CRASHLOG
	select SPI_FLASH_WINBOND
	select TPM_MEASURED_BOOT

if BOARD_STARLABS_STARBOOK_SERIES

config CCD_PORT
	int
	default 6 if BOARD_STARLABS_LABTOP_CML
	default 3 if BOARD_STARLABS_LABTOP_KBL || BOARD_STARLABS_STARBOOK_TGL
	default 4

config CONSOLE_SERIAL
	default n if !EDK2_DEBUG

config D3COLD_SUPPORT
	default n

config DEVICETREE
	default "variants/\$(CONFIG_VARIANT_DIR)/devicetree.cb"

config DIMM_SPD_SIZE
	default 1024 if BOARD_STARLABS_STARBOOK_MTL
	default 512

config DRIVER_TPM_SPI_CHIP
	default 2

config EC_GPE_SCI
	default 0x50 if BOARD_STARLABS_LABTOP_KBL || BOARD_STARLABS_LABTOP_CML
	default 0x6e

config EC_STARLABS_BATTERY_MODEL
	default "AEC3987118-2S1P" if BOARD_STARLABS_LABTOP_KBL || BOARD_STARLABS_LABTOP_CML
	default "597077-3S"

config EC_STARLABS_BATTERY_TYPE
	default "LION"

config EC_STARLABS_BATTERY_OEM
	default "Apower Electronics" if BOARD_STARLABS_LABTOP_KBL || BOARD_STARLABS_LABTOP_CML
	default "GanfengLiEnergy"

config EC_STARLABS_ITE_BIN_PATH
	string
	depends on EC_STARLABS_NEED_ITE_BIN
	default "3rdparty/blobs/mainboard/\$(MAINBOARDDIR)/\$(CONFIG_VARIANT_DIR)/ec.bin"

config EC_VARIANT_DIR
	default "kbl" if !EC_STARLABS_MERLIN && BOARD_STARLABS_LABTOP_KBL
	default "cml" if !EC_STARLABS_MERLIN && BOARD_STARLABS_LABTOP_CML
	default "merlin"

config EDK2_BOOTSPLASH_FILE
	string
	default "3rdparty/blobs/mainboard/starlabs/Logo.bmp"

config FMDFILE
	default "src/mainboard/\$(CONFIG_MAINBOARD_DIR)/variants/\$(CONFIG_VARIANT_DIR)/vboot.fmd" if VBOOT
	default "src/mainboard/\$(CONFIG_MAINBOARD_DIR)/variants/\$(CONFIG_VARIANT_DIR)/board.fmd"

config IFD_BIN_PATH
	string
	default "3rdparty/blobs/mainboard/\$(MAINBOARDDIR)/\$(CONFIG_VARIANT_DIR)/flashdescriptor.bin"

config MAINBOARD_DIR
	default "starlabs/starbook"

config MAINBOARD_FAMILY
	string
	default "L3" if BOARD_STARLABS_LABTOP_KBL
	default "L4" if BOARD_STARLABS_LABTOP_CML
	default "B5" if BOARD_STARLABS_STARBOOK_TGL
	default "B6-I" if BOARD_STARLABS_STARBOOK_ADL
	default "B62-I" if BOARD_STARLABS_STARBOOK_RPL
	default "B7-N" if BOARD_STARLABS_STARBOOK_ADL_N
	default "B7-U" if BOARD_STARLABS_STARBOOK_MTL

config MAINBOARD_PART_NUMBER
	default "LabTop Mk III" if BOARD_STARLABS_LABTOP_KBL
	default "LabTop Mk IV" if BOARD_STARLABS_LABTOP_CML
	default "StarBook Mk V" if BOARD_STARLABS_STARBOOK_TGL
	default "StarBook Mk VI" if BOARD_STARLABS_STARBOOK_ADL || BOARD_STARLABS_STARBOOK_RPL
	default "StarBook Mk VII" if BOARD_STARLABS_STARBOOK_ADL_N || BOARD_STARLABS_STARBOOK_MTL

config MAINBOARD_SMBIOS_PRODUCT_NAME
	default "LabTop" if BOARD_STARLABS_LABTOP_KBL || BOARD_STARLABS_LABTOP_CML
	default "StarBook"

config ME_BIN_PATH
	string
	default "3rdparty/blobs/mainboard/\$(MAINBOARDDIR)/\$(CONFIG_VARIANT_DIR)/intel_me.bin"

config POWER_STATE_DEFAULT_ON_AFTER_FAILURE
	default n

config SOC_INTEL_CSE_SEND_EOP_EARLY
	default n

config TPM_PIRQ
	depends on MAINBOARD_HAS_TPM2
	default 0x56 if BOARD_STARLABS_STARBOOK_TGL
	default 0x3d if BOARD_STARLABS_STARBOOK_MTL
	default 0x37

config UART_FOR_CONSOLE
	default 2 if BOARD_STARLABS_LABTOP_KBL || BOARD_STARLABS_LABTOP_CML || BOARD_STARLABS_STARBOOK_TGL
	default 0

config USE_PM_ACPI_TIMER
	default n

config VBOOT
	select VBOOT_VBNV_FLASH

config VARIANT_DIR
	default "kbl" if BOARD_STARLABS_LABTOP_KBL
	default "cml" if BOARD_STARLABS_LABTOP_CML
	default "tgl" if BOARD_STARLABS_STARBOOK_TGL
	default "adl" if BOARD_STARLABS_STARBOOK_ADL
	default "rpl" if BOARD_STARLABS_STARBOOK_RPL
	default "adl_n" if BOARD_STARLABS_STARBOOK_ADL_N
	default "mtl" if BOARD_STARLABS_STARBOOK_MTL

config BOARD_HAS_FPR
	bool
	default y if BOARD_STARLABS_STARBOOK_ADL || BOARD_STARLABS_STARBOOK_RPL
	default n

config BOARD_HAS_GNA
	bool
	default y if SOC_INTEL_TIGERLAKE || SOC_INTEL_ALDERLAKE || SOC_INTEL_RAPTORLAKE || SOC_INTEL_METEORLAKE
	default n

config BOARD_SUPPORTS_HT
	bool
	default n if SOC_INTEL_ALDERLAKE_PCH_N
	default y

config BOARD_SUPPORTS_HOTPLUG
	bool
	default y if BOARD_STARLABS_STARBOOK_ADL
	default n

config BOARD_USES_FIXED_MODE_VBT
	bool
	default y if BOARD_STARLABS_STARBOOK_ADL_N || BOARD_STARLABS_STARBOOK_MTL
	default n

endif
```

## src/mainboard/starlabs/starbook/Kconfig.name
```kconfig
## SPDX-License-Identifier: GPL-2.0-only

comment "Star Labs StarBook Series"

config BOARD_STARLABS_LABTOP_KBL
	bool "Star Labs LabTop Mk III (i7-8550u)"

config BOARD_STARLABS_LABTOP_CML
	bool "Star Labs LabTop Mk IV (i3-10110U and i7-10710U)"

config BOARD_STARLABS_STARBOOK_TGL
	bool "Star Labs StarBook Mk V (i3-1115G4 and i7-1165G7)"

config BOARD_STARLABS_STARBOOK_ADL
	bool "Star Labs StarBook Mk VI (i3-1220P and i7-1260P)"

config BOARD_STARLABS_STARBOOK_RPL
	bool "Star Labs StarBook Mk VI (i3-1315U and i7-1360P)"

config BOARD_STARLABS_STARBOOK_ADL_N
	bool "Star Labs StarBook Mk VII (N200)"

config BOARD_STARLABS_STARBOOK_MTL
	bool "Star Labs StarBook Mk VII (165H)"
```
