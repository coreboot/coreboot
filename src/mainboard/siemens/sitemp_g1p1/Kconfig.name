## src/mainboard/starlabs/common/Kconfig
```kconfig
## SPDX-License-Identifier: GPL-2.0-only

if VENDOR_STARLABS

config EDK2_BOOTSPLASH_FILE
	string
	default "3rdparty/blobs/mainboard/starlabs/Logo.bmp"

config CONSOLE_SERIAL
	default n if !EDK2_DEBUG

config DEVICETREE
	default "variants/\$(CONFIG_VARIANT_DIR)/devicetree.cb"

config EC_STARLABS_ITE_BIN_PATH
	string
	default "3rdparty/blobs/mainboard/\$(MAINBOARDDIR)/\$(CONFIG_VARIANT_DIR)/ec.bin" if \
		BOARD_STARLABS_ADL_SERIES || BOARD_STARLABS_CEZANNE_SERIES || \
		BOARD_STARLABS_STARBOOK_SERIES || BOARD_STARLABS_STARFIGHTER_SERIES

if BOARD_STARLABS_ADL_SERIES || BOARD_STARLABS_STARBOOK_SERIES || \
	BOARD_STARLABS_STARFIGHTER_SERIES

config D3COLD_SUPPORT
	default n

config DIMM_SPD_SIZE
	default 512

config FMDFILE
	default "src/mainboard/\$(CONFIG_MAINBOARD_DIR)/variants/\$(CONFIG_VARIANT_DIR)/vboot.fmd" if VBOOT
	default "src/mainboard/\$(CONFIG_MAINBOARD_DIR)/variants/\$(CONFIG_VARIANT_DIR)/board.fmd"

config IFD_BIN_PATH
	string
	default "3rdparty/blobs/mainboard/\$(MAINBOARDDIR)/\$(CONFIG_VARIANT_DIR)/flashdescriptor.bin"

config ME_BIN_PATH
	string
	default "3rdparty/blobs/mainboard/\$(MAINBOARDDIR)/\$(CONFIG_VARIANT_DIR)/intel_me.bin"

config POWER_STATE_DEFAULT_ON_AFTER_FAILURE
	default n

config SOC_INTEL_CSE_SEND_EOP_EARLY
	default n

config USE_PM_ACPI_TIMER
	default n

endif

config STARLABS_MEMORY_SETTINGS_VERSION
	bool
	default y if PLATFORM_USES_FSP2_0 && CACHE_MRC_SETTINGS
	select FSP_PLATFORM_MEMORY_SETTINGS_VERSIONS

menu "Star Labs Settings"

config BOOTMEDIA_SMM_BWP
	bool
	default y if SOC_INTEL_COMMON_BLOCK_SMM

config BOOTMEDIA_SMM_BWP_RUNTIME_OPTION
	bool
	depends on BOOTMEDIA_SMM_BWP
	default y if SOC_INTEL_COMMON_BLOCK_SMM

config USE_LEGACY_8254_TIMER
	default n if VENDOR_STARLABS

config USE_PC_CMOS_ALTCENTURY
	default n if VENDOR_STARLABS

config DRIVERS_EFI_FW_INFO
	def_bool y

config STARLABS_COMMON_POWERCAP
	bool
	default y if SOC_INTEL_COMMON_BLOCK_POWER_LIMIT

config STARLABS_COMMON_CFR
	bool
	default y if CPU_INTEL_COMMON

config STARLABS_LEGACY_PL4
	bool

config STARLABS_NVME_POWER_SEQUENCE
	bool "Enable NVMe/M.2 slot power sequence"
	depends on SOC_INTEL_COMMON_BLOCK_GPIO
	default n
	help
	  Enable Fatcat-style 3-stage NVMe/M.2 slot sequencing using PWREN, PERST#
	  and CLKREQ# pads.

	  The sequencing is:
	    1) pre-mem: PERST# asserted; PWREN=0; CLKREQ# disabled
	    2) BS_PRE_DEVICE exit: PERST# still asserted; PWREN=1; CLKREQ# native
	    3) BS_DEV_INIT_CHIPS entry: PERST# deasserted

	  Boards selecting this option must provide their own pad configs and
	  implement stage 1 (pre-mem) in their early pad configuration.

	  For stage 2 and stage 3, boards must either implement the
	  `variant_nvme_power_sequence_*()` helpers or provide pad tables via
	  `variant_nvme_power_sequence_pads()` and
	  `variant_nvme_power_sequence_post_pads()`.

config TCG_OPAL_S3_UNLOCK
	default y

config MB_COMMON_DIR
	string
	default "starlabs/common"

config STARLABS_ACPI_EFI_OPTION_SMI
	bool "Expose coreboot options to ACPI via SMI (UEFI var store)"
	depends on USE_UEFI_VARIABLE_STORE
	depends on HAVE_ACPI_TABLES
	default y
	help
	  Provide ACPI methods that proxy a restricted set of coreboot options
	  (e.g. keyboard backlight and trackpad state) to the UEFI variable
	  store via an SMM APMC SMI handler.

config SOC_INTEL_COMMON_BLOCK_SMM_TCO_INTRUDER_SMI_ENABLE
	default n

source "src/mainboard/starlabs/common/hda/Kconfig"

endmenu

endif
```

## src/mainboard/starlabs/labtop/Kconfig
```kconfig
config BOARD_STARLABS_LABTOP_SERIES
	def_bool n
	select DRIVERS_I2C_HID
	select EC_STARLABS_ITE
	select EC_STARLABS_FAN
	select HAVE_ACPI_RESUME
	select HAVE_ACPI_TABLES
	select HAVE_CMOS_DEFAULT
	select HAVE_OPTION_TABLE
	select INTEL_GMA_HAVE_VBT
	select INTEL_LPSS_UART_FOR_CONSOLE
	select NO_UART_ON_SUPERIO
	select SOC_INTEL_COMMON_BLOCK_HDA_VERB
	select SYSTEM_TYPE_LAPTOP

config BOARD_STARLABS_LABTOP_KBL
	select BOARD_ROMSIZE_KB_8192
	select BOARD_STARLABS_LABTOP_SERIES
	select HAVE_INTEL_PTT
	select HAVE_SPD_IN_CBFS
	select MAINBOARD_HAS_LIBGFXINIT
	select SOC_INTEL_KABYLAKE
	select SPI_FLASH_GIGADEVICE

config BOARD_STARLABS_LABTOP_CML
	select BOARD_ROMSIZE_KB_16384
	select BOARD_STARLABS_LABTOP_SERIES
	select EC_STARLABS_MAX_CHARGE
	select EC_STARLABS_NEED_ITE_BIN
	select HAVE_INTEL_PTT
	select HAVE_SPD_IN_CBFS
	select CRB_TPM
	select MAINBOARD_HAS_LIBGFXINIT
	select MAINBOARD_HAS_TPM2
	select SOC_INTEL_COMETLAKE_1
	select SPI_FLASH_WINBOND

config BOARD_STARLABS_STARBOOK_TGL
	select BOARD_ROMSIZE_KB_16384
	select BOARD_STARLABS_LABTOP_SERIES
	select DRIVERS_INTEL_USB4_RETIMER
	select EC_STARLABS_KBL_LEVELS
	select EC_STARLABS_MAX_CHARGE
	select EC_STARLABS_NEED_ITE_BIN
	select MEMORY_MAPPED_TPM
	select MAINBOARD_HAS_TPM2
	select PCIEXP_HOTPLUG_PREFETCH_MEM_BELOW_4G
	select SOC_INTEL_COMMON_BLOCK_TCSS
	select SOC_INTEL_ENABLE_USB4_PCIE_RESOURCES
	select SOC_INTEL_TIGERLAKE
	select SOC_INTEL_TIGERLAKE_S3
	select SPI_FLASH_WINBOND

if BOARD_STARLABS_LABTOP_SERIES

config CCD_PORT
	int
	default 6 if BOARD_STARLABS_LABTOP_CML
	default 3

config DEVICETREE
	default "variants/\$(CONFIG_VARIANT_DIR)/devicetree.cb"

config DIMM_SPD_SIZE
	default 512 if BOARD_STARLABS_LABTOP_KBL

config DRIVER_TPM_SPI_CHIP
	default 2

config EC_GPE_SCI
	default 0x6e if BOARD_STARLABS_STARBOOK_TGL
	default 0x50

config EC_STARLABS_ADD_ITE_BIN
	default y

config EC_STARLABS_ITE_BIN_PATH
	string
	depends on EC_STARLABS_NEED_ITE_BIN
	default "3rdparty/blobs/mainboard/starlabs/starbook/\$(CONFIG_VARIANT_DIR)/ec.bin"

config EC_VARIANT_DIR
	default "kbl" if !EC_STARLABS_MERLIN && BOARD_STARLABS_LABTOP_KBL
	default "cml" if !EC_STARLABS_MERLIN && BOARD_STARLABS_LABTOP_CML
	default "tgl" if !EC_STARLABS_MERLIN && BOARD_STARLABS_STARBOOK_TGL

config FMDFILE
	default "src/mainboard/\$(CONFIG_MAINBOARD_DIR)/variants/\$(CONFIG_VARIANT_DIR)/board.fmd"

config IFD_BIN_PATH
	string
	default "3rdparty/blobs/mainboard/\$(MAINBOARDDIR)/\$(CONFIG_VARIANT_DIR)/flashdescriptor.bin"

config MAINBOARD_DIR
	default "starlabs/labtop"

config MAINBOARD_FAMILY
	string
	default "L3" if BOARD_STARLABS_LABTOP_KBL
	default "L4" if BOARD_STARLABS_LABTOP_CML
	default "B5" if BOARD_STARLABS_STARBOOK_TGL

config MAINBOARD_PART_NUMBER
	default "LabTop Mk III" if BOARD_STARLABS_LABTOP_KBL
	default "LabTop Mk IV" if BOARD_STARLABS_LABTOP_CML
	default "StarBook Mk V" if BOARD_STARLABS_STARBOOK_TGL

config MAINBOARD_SMBIOS_PRODUCT_NAME
	default "StarBook" if BOARD_STARLABS_STARBOOK_TGL
	default "LabTop"

config ME_BIN_PATH
	string
	default "3rdparty/blobs/mainboard/\$(MAINBOARDDIR)/\$(CONFIG_VARIANT_DIR)/intel_me.bin"

config TIANOCORE_BOOTSPLASH_FILE
	string
	default "3rdparty/blobs/mainboard/starlabs/Logo.bmp"

config UART_FOR_CONSOLE
	default 2

config USE_PM_ACPI_TIMER
	default n if BOARD_STARLABS_STARBOOK_TGL

config VARIANT_DIR
	default "kbl" if BOARD_STARLABS_LABTOP_KBL
	default "cml" if BOARD_STARLABS_LABTOP_CML
	default "tgl" if BOARD_STARLABS_STARBOOK_TGL

endif
```

## src/mainboard/starlabs/labtop/Kconfig.name
```kconfig
comment "Star Labs LabTop Series"

config BOARD_STARLABS_LABTOP_KBL
	bool "Star Labs LabTop Mk III (i7-8550u)"

config BOARD_STARLABS_LABTOP_CML
	bool "Star Labs LabTop Mk IV (i3-10110U and i7-10710U)"

config BOARD_STARLABS_STARBOOK_TGL
	bool "Star Labs StarBook Mk V (i3-1115G4 and i7-1165G7)"
```

## src/mainboard/starlabs/lite/Kconfig
```kconfig
config BOARD_STARLABS_LITE_SERIES
	def_bool n
	select BOARD_ROMSIZE_KB_8192
	select DRIVERS_I2C_HID
	select HAVE_ACPI_RESUME
	select HAVE_ACPI_TABLES
	select HAVE_CMOS_DEFAULT
	select HAVE_OPTION_TABLE
	select HAVE_INTEL_PTT
	select INTEL_GMA_HAVE_VBT
	select CRB_TPM
	select MAINBOARD_HAS_TPM2
	select ONBOARD_VGA_IS_PRIMARY
	select SOC_INTEL_COMMON_BLOCK_HDA
	select SOC_INTEL_COMMON_BLOCK_HDA_VERB
	select SPI_FLASH_GIGADEVICE
	select SYSTEM_TYPE_LAPTOP

config BOARD_STARLABS_LITE_GLK
	select BOARD_STARLABS_LITE_SERIES
	select EC_STARLABS_ITE
	select EC_STARLABS_KBL_LEVELS
	select SOC_INTEL_GEMINILAKE

config BOARD_STARLABS_LITE_GLKR
	select BOARD_STARLABS_LITE_SERIES
	select EC_STARLABS_FAST_CHARGE
	select EC_STARLABS_NUVOTON
	select EC_STARLABS_KBL_LEVELS
	select SOC_INTEL_GEMINILAKE

if BOARD_STARLABS_LITE_SERIES

config CMOS_DEFAULT_FILE
	default "src/mainboard/\$(CONFIG_MAINBOARD_DIR)/variants/\$(CONFIG_VARIANT_DIR)/cmos.default" if BOARD_STARLABS_LITE_GLKR

config CMOS_LAYOUT_FILE
	default "src/mainboard/\$(CONFIG_MAINBOARD_DIR)/variants/\$(CONFIG_VARIANT_DIR)/cmos.layout" if BOARD_STARLABS_LITE_GLKR

config DEVICETREE
	default "variants/\$(CONFIG_VARIANT_DIR)/devicetree.cb"

config EC_GPE_SCI
	default 0x26

config EC_VARIANT_DIR
	default "glk"  if BOARD_STARLABS_LITE_GLK
	default "glkr" if BOARD_STARLABS_LITE_GLKR

config FMDFILE
	default "src/mainboard/starlabs/lite/vboot.fmd" if VBOOT
	default "src/mainboard/starlabs/lite/board.fmd"

config MAINBOARD_DIR
	default "starlabs/lite"

config MAINBOARD_FAMILY
	string
	default "I3" if BOARD_STARLABS_LITE_GLK
	default "I4" if BOARD_STARLABS_LITE_GLKR

config MAINBOARD_PART_NUMBER
	default "Lite Mk III" if BOARD_STARLABS_LITE_GLK
	default "Lite Mk IV"  if BOARD_STARLABS_LITE_GLKR

config MAINBOARD_SMBIOS_PRODUCT_NAME
	string
	default "Lite"

config TRACKPAD_INTERRUPT
	hex
	default 0x1 if BOARD_STARLABS_LITE_GLK
	default 0x0 if BOARD_STARLABS_LITE_GLKR

config EDK2_BOOTSPLASH_FILE
	string
	default "3rdparty/blobs/mainboard/starlabs/Logo.bmp"

config UART_FOR_CONSOLE
	default 2

config VARIANT_DIR
	default "glk"  if BOARD_STARLABS_LITE_GLK
	default "glkr" if BOARD_STARLABS_LITE_GLKR

config VBOOT
	select VBOOT_VBNV_FLASH

config WEBCAM_USB_PORT
	int
	default 4 if BOARD_STARLABS_LITE_GLK
	default 7 if BOARD_STARLABS_LITE_GLKR
endif
```

## src/mainboard/starlabs/lite/Kconfig.name
```kconfig
comment "Star Labs Lite Series"

config BOARD_STARLABS_LITE_GLK
	bool "Star Labs Lite Mk III (N5000)"

config BOARD_STARLABS_LITE_GLKR
	bool "Star Labs Lite Mk IV (N5030)"
```
