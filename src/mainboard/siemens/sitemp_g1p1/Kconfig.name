## src/mainboard/sifive/Kconfig
```kconfig
## SPDX-License-Identifier: GPL-2.0-only

if VENDOR_SIFIVE

choice
	prompt "Mainboard model"

source "src/mainboard/sifive/*/Kconfig.name"

endchoice

source "src/mainboard/sifive/*/Kconfig"

config MAINBOARD_VENDOR
	default "SiFive"

endif # VENDOR_SIFIVE
```

## src/mainboard/sifive/hifive-unleashed/Kconfig
```kconfig
# SPDX-License-Identifier: GPL-2.0-only

if BOARD_SIFIVE_HIFIVE_UNLEASHED

config BOARD_SPECIFIC_OPTIONS
	def_bool y
	select SOC_SIFIVE_FU540
	select BOARD_ROMSIZE_KB_32768
	select MISSING_BOARD_RESET
	select FLATTENED_DEVICE_TREE
	select SPI_SDCARD

config HEAP_SIZE
	default 0x10000

config MAINBOARD_DIR
	string
	default "sifive/hifive-unleashed"

config MAINBOARD_PART_NUMBER
	string
	default "HiFive Unleashed"

endif
```

## src/mainboard/sifive/hifive-unleashed/Kconfig.name
```kconfig
## SPDX-License-Identifier: GPL-2.0-only

config BOARD_SIFIVE_HIFIVE_UNLEASHED
	bool "HiFive Unleashed"
```

## src/mainboard/sifive/hifive-unmatched/Kconfig
```kconfig
# SPDX-License-Identifier: GPL-2.0-only

if BOARD_SIFIVE_HIFIVE_UNMATCHED

config BOARD_SPECIFIC_OPTIONS
	def_bool y
	select SOC_SIFIVE_FU740
	select BOARD_ROMSIZE_KB_32768
	select MISSING_BOARD_RESET
	select FLATTENED_DEVICE_TREE
	select SPI_FLASH
	select SPI_FLASH_ISSI
	select SPI_SDCARD

config HEAP_SIZE
	default 0x10000 #TODO

config MAINBOARD_DIR
	default "sifive/hifive-unmatched"

config MAINBOARD_PART_NUMBER
	default "HiFive Unmatched"

endif
```

## src/mainboard/soyo/Kconfig
```kconfig
##
## This file is part of the coreboot project.
##
## Copyright (C) 2009 Uwe Hermann <uwe@hermann-uwe.de>
##
## This program is free software; you can redistribute it and/or modify
## it under the terms of the GNU General Public License as published by
## the Free Software Foundation; version 2 of the License.
##
## This program is distributed in the hope that it will be useful,
## but WITHOUT ANY WARRANTY; without even the implied warranty of
## MERCHANTABILITY or FITNESS FOR A PARTICULAR PURPOSE.  See the
## GNU General Public License for more details.
##
## You should have received a copy of the GNU General Public License
## along with this program; if not, write to the Free Software
## Foundation, Inc., 51 Franklin St, Fifth Floor, Boston, MA 02110-1301 USA
##
if VENDOR_SOYO

choice
	prompt "Mainboard model"

config BOARD_SOYO_SY_6BA_PLUS_III
	bool "SY-6BA+ III"

endchoice

source "src/mainboard/soyo/sy-6ba-plus-iii/Kconfig"

config MAINBOARD_VENDOR
	string
	default "Soyo"

endif # VENDOR_SOYO
```

## src/mainboard/starlabs/Kconfig
```kconfig
if VENDOR_STARLABS

choice
	prompt "Mainboard model"

source "src/mainboard/starlabs/*/Kconfig.name"

endchoice

source "src/mainboard/starlabs/*/Kconfig"

config MAINBOARD_VENDOR
	default "Star Labs"

config LOCAL_VERSION
	string
	default "8.18"

endif # VENDOR_STARLABS
```

## src/mainboard/starlabs/adl/Kconfig
```kconfig
config BOARD_STARLABS_ADL_SERIES
	def_bool n
	select AZALIA_USE_LEGACY_VERB_TABLE
	select BOARD_ROMSIZE_KB_16384
	select CSE_DEFAULT_CFR_OPTION_STATE_DISABLED
	select DRIVERS_EFI_VARIABLE_STORE
	select DRIVERS_INTEL_PMC
	select DRIVERS_OPTION_CFR_ENABLED
	select EC_STARLABS_MERLIN
	select HAVE_ACPI_RESUME
	select HAVE_ACPI_TABLES
	select HAVE_OPTION_TABLE
	select INTEL_GMA_HAVE_VBT
	select INTEL_LPSS_UART_FOR_CONSOLE
	select NO_UART_ON_SUPERIO
	select PMC_IPC_ACPI_INTERFACE
	select SOC_INTEL_ALDERLAKE
	select SOC_INTEL_COMMON_BLOCK_HDA_VERB
	select SOC_INTEL_COMMON_BLOCK_TCSS
	select SOC_INTEL_CRASHLOG
	select SPD_READ_BY_WORD
	select SPI_FLASH_WINBOND
	select TPM2
	select VALIDATE_INTEL_DESCRIPTOR

config BOARD_STARLABS_ADL_HORIZON
	select BOARD_STARLABS_ADL_SERIES
	select DRIVERS_GFX_GENERIC
	select DRIVERS_I2C_HID
	select HAVE_CMOS_DEFAULT
	select HAVE_HDA_DMIC
	select HAVE_SPD_IN_CBFS
	select MAINBOARD_HAS_TPM2
	select MEMORY_MAPPED_TPM
	select SOC_INTEL_ALDERLAKE_PCH_N
	select SYSTEM_TYPE_LAPTOP
	select TPM_MEASURED_BOOT

config BOARD_STARLABS_BYTE_ADL
	select BOARD_STARLABS_ADL_SERIES
	select CRB_TPM
	select DRIVERS_PCIE_GENERIC
	select EC_STARLABS_FAN
	select HAVE_INTEL_PTT
	select SOC_INTEL_ALDERLAKE_PCH_N
	select SOC_INTEL_ENABLE_USB4_PCIE_RESOURCES
	select SYSTEM_TYPE_MINIPC

config BOARD_STARLABS_BYTE_TWL
	select BOARD_STARLABS_ADL_SERIES
	select CRB_TPM
	select DRIVERS_PCIE_GENERIC
	select EC_STARLABS_FAN
	select HAVE_INTEL_PTT
	select SOC_INTEL_ENABLE_USB4_PCIE_RESOURCES
	select SOC_INTEL_TWINLAKE
	select SYSTEM_TYPE_MINIPC

if BOARD_STARLABS_ADL_SERIES

config CONSOLE_SERIAL
	default n if !EDK2_DEBUG

config D3COLD_SUPPORT
	default n

config DEVICETREE
	default "variants/\$(CONFIG_VARIANT_DIR)/devicetree.cb"

config DIMM_SPD_SIZE
	default 512

config EDK2_BOOTSPLASH_FILE
	string
	default "3rdparty/blobs/mainboard/starlabs/Logo.bmp"

config EC_STARLABS_ITE_BIN_PATH
	string
	default "3rdparty/blobs/mainboard/\$(MAINBOARDDIR)/\$(CONFIG_VARIANT_DIR)/ec.bin"

config FMDFILE
	default "src/mainboard/\$(CONFIG_MAINBOARD_DIR)/variants/\$(CONFIG_VARIANT_DIR)/vboot.fmd" if VBOOT
	default "src/mainboard/\$(CONFIG_MAINBOARD_DIR)/variants/\$(CONFIG_VARIANT_DIR)/board.fmd"

config IFD_BIN_PATH
	string
	default "3rdparty/blobs/mainboard/\$(MAINBOARDDIR)/\$(CONFIG_VARIANT_DIR)/flashdescriptor.bin"

config MAINBOARD_DIR
	default "starlabs/adl"

config MAINBOARD_FAMILY
	string
	default "HZ" if BOARD_STARLABS_ADL_HORIZON
	default "Y3" if BOARD_STARLABS_BYTE_TWL
	default "Y2" if BOARD_STARLABS_BYTE_ADL

config MAINBOARD_PART_NUMBER
	default "StarBook Horizon" if BOARD_STARLABS_ADL_HORIZON
	default "Byte Mk III" if BOARD_STARLABS_BYTE_TWL
	default "Byte Mk II" if BOARD_STARLABS_BYTE_ADL

config MAINBOARD_SMBIOS_PRODUCT_NAME
	default "StarBook Horizon" if BOARD_STARLABS_ADL_HORIZON
	default "Byte" if BOARD_STARLABS_BYTE_ADL || BOARD_STARLABS_BYTE_TWL

config ME_BIN_PATH
	string
	default "3rdparty/blobs/mainboard/\$(MAINBOARDDIR)/\$(CONFIG_VARIANT_DIR)/intel_me.bin"

config POWER_STATE_DEFAULT_ON_AFTER_FAILURE
	default n

config SOC_INTEL_CSE_SEND_EOP_EARLY
	default n

config UART_FOR_CONSOLE
	default 0

config USE_PM_ACPI_TIMER
	default n

config VARIANT_DIR
	default "hz" if BOARD_STARLABS_ADL_HORIZON
	default "y2" if BOARD_STARLABS_BYTE_ADL || BOARD_STARLABS_BYTE_TWL

config CMOS_LAYOUT_FILE
	default "src/mainboard/\$(MAINBOARDDIR)/variants/\$(CONFIG_VARIANT_DIR)/cmos.layout"

if BOARD_STARLABS_ADL_HORIZON

config CCD_PORT
	int
	default 4

config EC_STARLABS_BATTERY_MODEL
	default "U5266122PV-2S1P"

config EC_STARLABS_BATTERY_TYPE
	default "LION"

config EC_STARLABS_BATTERY_OEM
	default "Shenzhen Utility Energy Co., Ltd"

config TPM_PIRQ
	depends on MAINBOARD_HAS_TPM2
	default 0x28

endif # BOARD_STARLABS_ADL_HORIZON

if BOARD_STARLABS_BYTE_ADL || BOARD_STARLABS_BYTE_TWL

config PL4_WATTS
	int
	default 65

config VBOOT
	select VBOOT_VBNV_FLASH

endif # BOARD_STARLABS_BYTE_ADL || BOARD_STARLABS_BYTE_TWL

endif # BOARD_STARLABS_ADL_SERIES
```

## src/mainboard/starlabs/adl/Kconfig.name
```kconfig
comment "Star Labs ADL Series"

config BOARD_STARLABS_ADL_HORIZON
	bool "Star Labs StarBook Horizon (N305)"

config BOARD_STARLABS_BYTE_ADL
	bool "Star Labs Byte Mk II (N200)"

config BOARD_STARLABS_BYTE_TWL
	bool "Star Labs Byte Mk III (N355)"

config BOARD_STARLABS_LITE_ADL
	bool "Star Labs Lite Mk V (N200/N350)"
```

## src/mainboard/starlabs/byte_adl/Kconfig
```kconfig
config BOARD_STARLABS_BYTE_SERIES
	def_bool n
	select BOARD_ROMSIZE_KB_16384
	select CRB_TPM
	select CSE_DEFAULT_CFR_OPTION_STATE_DISABLED
	select DRIVERS_EFI_VARIABLE_STORE
	select DRIVERS_INTEL_PMC
	select DRIVERS_OPTION_CFR_ENABLED
	select EC_STARLABS_ITE
	select EC_STARLABS_MERLIN
	select EC_STARLABS_NEED_ITE_BIN
	select HAVE_ACPI_RESUME
	select HAVE_ACPI_TABLES
	select HAVE_INTEL_PTT
	select HAVE_OPTION_TABLE
	select INTEL_GMA_HAVE_VBT
	select INTEL_LPSS_UART_FOR_CONSOLE
	select NO_UART_ON_SUPERIO
	select PMC_IPC_ACPI_INTERFACE
	select SOC_INTEL_COMMON_BLOCK_HDA_VERB
	select SOC_INTEL_COMMON_BLOCK_TCSS
	select SOC_INTEL_CRASHLOG
	select SPI_FLASH_WINBOND
	select SYSTEM_TYPE_MINIPC
	select TPM2
	select VALIDATE_INTEL_DESCRIPTOR

config BOARD_STARLABS_BYTE_ADL
	select BOARD_STARLABS_BYTE_SERIES
	select SOC_INTEL_ALDERLAKE
	select SOC_INTEL_ALDERLAKE_PCH_N

config BOARD_STARLABS_BYTE_TWL
	select BOARD_STARLABS_BYTE_SERIES
	select SOC_INTEL_ALDERLAKE
	select SOC_INTEL_TWINLAKE

if BOARD_STARLABS_BYTE_SERIES

config CONSOLE_SERIAL
	default n if !EDK2_DEBUG

config D3COLD_SUPPORT
	default n

config DEVICETREE
	default "variants/\$(CONFIG_VARIANT_DIR)/devicetree.cb"

config DIMM_SPD_SIZE
	default 512

config EC_GPE_SCI
	default 0x6e

config EC_STARLABS_ITE_BIN_PATH
	string
	depends on EC_STARLABS_NEED_ITE_BIN
	default "3rdparty/blobs/mainboard/\$(MAINBOARDDIR)/\$(CONFIG_VARIANT_DIR)/ec.bin"

config EC_VARIANT_DIR
	default "merlin"

config FMDFILE
	default "src/mainboard/\$(CONFIG_MAINBOARD_DIR)/variants/\$(CONFIG_VARIANT_DIR)/vboot.fmd" if VBOOT
	default "src/mainboard/\$(CONFIG_MAINBOARD_DIR)/variants/\$(CONFIG_VARIANT_DIR)/board.fmd"

config IFD_BIN_PATH
	string
	default "3rdparty/blobs/mainboard/\$(MAINBOARDDIR)/\$(CONFIG_VARIANT_DIR)/flashdescriptor.bin"

config MAINBOARD_DIR
	default "starlabs/byte_adl"

config MAINBOARD_FAMILY
	string
	default "Y3" if BOARD_STARLABS_BYTE_TWL
	default "Y2"

config MAINBOARD_PART_NUMBER
	default "Byte Mk III" if BOARD_STARLABS_BYTE_TWL
	default "Byte Mk II"

config MAINBOARD_SMBIOS_PRODUCT_NAME
	default "Byte"

config ME_BIN_PATH
	string
	default "3rdparty/blobs/mainboard/\$(MAINBOARDDIR)/\$(CONFIG_VARIANT_DIR)/intel_me.bin"

config PL4_WATTS
	int
	default 84 if BOARD_STARLABS_BYTE_TWL
	default 36

config POWER_STATE_DEFAULT_ON_AFTER_FAILURE
	default n

config EDK2_BOOTSPLASH_FILE
	string
	default "3rdparty/blobs/mainboard/starlabs/Logo.bmp"

config SOC_INTEL_CSE_SEND_EOP_EARLY
	default n

config UART_FOR_CONSOLE
	default 0

config USE_PM_ACPI_TIMER
	default n

config VBOOT
	select VBOOT_VBNV_FLASH

config VARIANT_DIR
	default "mk_ii"

endif
```

## src/mainboard/starlabs/byte_adl/Kconfig.name
```kconfig
comment "Star Labs Byte Series"

config BOARD_STARLABS_BYTE_ADL
	bool "Star Labs Byte Mk II (N200)"

config BOARD_STARLABS_BYTE_TWL
	bool "Star Labs Byte Mk III (N355)"
```

## src/mainboard/starlabs/cezanne/Kconfig
```kconfig
## SPDX-License-Identifier: GPL-2.0-only

config BOARD_STARLABS_CEZANNE_SERIES
	def_bool n
	select AMD_FWM_POSITION_820000_DEFAULT
	select AMD_SOC_CONSOLE_UART
	select AZALIA_HDA_CODEC_SUPPORT
	select AZALIA_USE_LEGACY_VERB_TABLE
	select BOARD_ROMSIZE_KB_16384
	select DISABLE_KEYBOARD_RESET_PIN
	select DRIVERS_EFI_VARIABLE_STORE
	select DRIVERS_I2C_HID
	select DRIVERS_OPTION_CFR_ENABLED
	select DRIVERS_PCIE_RTD3_DEVICE
	select EC_STARLABS_ITE
	select EC_STARLABS_KBL_LEVELS
	select EC_STARLABS_MERLIN
	select HAVE_ACPI_RESUME
	select HAVE_ACPI_TABLES
	select HAVE_HDA_DMIC
	select PCIEXP_ASPM
	select PCIEXP_CLK_PM
	select PCIEXP_COMMON_CLOCK
	select PCIEXP_L1_SUB_STATE
	select SERIRQ_CONTINUOUS_MODE
	select SOC_AMD_CEZANNE
	select SOC_AMD_COMMON_BLOCK_GRAPHICS_ATIF
	select SPI_FLASH_WINBOND
	select VGA_BIOS

config BOARD_STARLABS_BYTE_CEZANNE
	select BOARD_STARLABS_CEZANNE_SERIES
	select SYSTEM_TYPE_MINIPC

config BOARD_STARLABS_STARBOOK_CEZANNE
	select BOARD_STARLABS_CEZANNE_SERIES
	select SYSTEM_TYPE_LAPTOP

if BOARD_STARLABS_CEZANNE_SERIES

config ADD_APCB_SOURCES
	bool "Add PSP customisation files"

config APCB_SOURCES_PATH
	string "Path to APCB files"

config CONSOLE_SERIAL
	default n if !EDK2_DEBUG

config DEVICETREE
	default "variants/\$(CONFIG_VARIANT_DIR)/devicetree.cb"

config EC_GPE_SCI
	default 0x17

config EC_STARLABS_ADD_ITE_BIN
	default y if BOARD_STARLABS_STARBOOK_CEZANNE

config EC_STARLABS_ITE_BIN_PATH
	default "3rdparty/blobs/mainboard/\$(MAINBOARDDIR)/\$(CONFIG_VARIANT_DIR)/ec.bin"

config EDK2_BOOTSPLASH_FILE
	default "3rdparty/blobs/mainboard/starlabs/Logo.bmp"

config FMDFILE
	default "src/mainboard/\$(CONFIG_MAINBOARD_DIR)/board.fmd"

config MAINBOARD_DIR
	default "starlabs/cezanne"

config MAINBOARD_FAMILY
	default "B6-A"			if BOARD_STARLABS_STARBOOK_CEZANNE
	default "Y1"			if BOARD_STARLABS_BYTE_CEZANNE

config MAINBOARD_PART_NUMBER
	default "StarBook Mk VI"	if BOARD_STARLABS_STARBOOK_CEZANNE
	default "Byte Mk I"		if BOARD_STARLABS_BYTE_CEZANNE

config MAINBOARD_SMBIOS_PRODUCT_NAME
	default "StarBook"		if BOARD_STARLABS_STARBOOK_CEZANNE
	default "Byte"			if BOARD_STARLABS_BYTE_CEZANNE

config POST_IO
	default y			if BOARD_STARLABS_STARBOOK_CEZANNE
	default n			if BOARD_STARLABS_BYTE_CEZANNE

config PSP_LOAD_MP2_FW
	default y

config PSP_POSTCODES_ON_ESPI
	default n

config S3_VGA_ROM_RUN
	default n

config VARIANT_DIR
	default "starbook"		if BOARD_STARLABS_STARBOOK_CEZANNE
	default "byte"			if BOARD_STARLABS_BYTE_CEZANNE

config EFS_SPI_SPEED
	default 3	# 66MHz

config NORMAL_READ_SPI_SPEED
	default 1	# 33MHz

config ALT_SPI_SPEED
	default 0	# 66MHz

endif
```

## src/mainboard/starlabs/cezanne/Kconfig.name
```kconfig
## SPDX-License-Identifier: GPL-2.0-only

comment "Star Labs Cezanne Series"

config BOARD_STARLABS_BYTE_CEZANNE
	bool "Star Labs Byte Mk I (Ryzen 7 5800U)"

config BOARD_STARLABS_STARBOOK_CEZANNE
	bool "Star Labs StarBook Mk VI (Ryzen 7 5800U)"
```
