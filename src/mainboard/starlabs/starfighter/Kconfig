## src/mainboard/starlabs/starfighter/Kconfig
```kconfig
## SPDX-License-Identifier: GPL-2.0-only

config BOARD_STARLABS_STARFIGHTER_SERIES
	def_bool n
	select AZALIA_USE_LEGACY_VERB_TABLE
	select BOARD_ROMSIZE_KB_32768
	select CSE_DEFAULT_CFR_OPTION_STATE_DISABLED
	select DRIVERS_EFI_VARIABLE_STORE
	select DRIVERS_OPTION_CFR_ENABLED
	select DRIVERS_GFX_GENERIC
	select DRIVERS_INTEL_PMC
	select DRIVERS_INTEL_USB4_RETIMER
	select DRIVERS_I2C_HID
	select EC_STARLABS_FAN
	select EC_STARLABS_MERLIN
	select HAVE_ACPI_RESUME
	select HAVE_ACPI_TABLES
	select HAVE_CMOS_DEFAULT
	select HAVE_HDA_DMIC
	select HAVE_OPTION_TABLE
	select HAVE_SPD_IN_CBFS
	select INTEL_GMA_HAVE_VBT
	select INTEL_LPSS_UART_FOR_CONSOLE
	select MAINBOARD_HAS_TPM2
	select MEMORY_MAPPED_TPM
	select NO_UART_ON_SUPERIO
	select PMC_IPC_ACPI_INTERFACE
	select SOC_INTEL_COMMON_BLOCK_HDA_VERB
	select SOC_INTEL_COMMON_BLOCK_TCSS
	select SOC_INTEL_CRASHLOG
	select SOC_INTEL_ENABLE_USB4_PCIE_RESOURCES
	select SPD_READ_BY_WORD
	select SPI_FLASH_WINBOND
	select SYSTEM_TYPE_LAPTOP
	select TPM_MEASURED_BOOT
	select VALIDATE_INTEL_DESCRIPTOR

config BOARD_STARLABS_STARFIGHTER_RPL
	select BOARD_STARLABS_STARFIGHTER_SERIES
	select SOC_INTEL_ALDERLAKE
	select SOC_INTEL_ALDERLAKE_PCH_P
	select SOC_INTEL_RAPTORLAKE

config BOARD_STARLABS_STARFIGHTER_MTL
	select BOARD_STARLABS_STARFIGHTER_SERIES
	select SOC_INTEL_COMMON_BLOCK_VTD
	select SOC_INTEL_METEORLAKE
	select SOC_INTEL_METEORLAKE_U_H

if BOARD_STARLABS_STARFIGHTER_SERIES

config BOARD_USES_FIXED_MODE_VBT
	bool
	default y

config CCD_PORT
	int
	default 4

config CONSOLE_SERIAL
	default n if !EDK2_DEBUG

config D3COLD_SUPPORT
	default n

config DEVICETREE
	default "variants/\$(CONFIG_VARIANT_DIR)/devicetree.cb"

config DIMM_SPD_SIZE
	default 512

config EC_STARLABS_BATTERY_MODEL
	default "AEC617573-4S1P"

config EC_STARLABS_BATTERY_TYPE
	default "LION"

config EC_STARLABS_BATTERY_OEM
	default "Apower Electronics"

config EC_STARLABS_ITE_BIN_PATH
	string
	default "3rdparty/blobs/mainboard/\$(MAINBOARDDIR)/\$(CONFIG_VARIANT_DIR)/ec.bin"

config EDK2_BOOTSPLASH_FILE
	string
	default "3rdparty/blobs/mainboard/starlabs/Logo.bmp"

config FMDFILE
	default "src/mainboard/\$(CONFIG_MAINBOARD_DIR)/variants/\$(CONFIG_VARIANT_DIR)/vboot.fmd" if VBOOT
	default "src/mainboard/\$(CONFIG_MAINBOARD_DIR)/variants/\$(CONFIG_VARIANT_DIR)/board.fmd"

config IFD_BIN_PATH
	string
	default "3rdparty/blobs/mainboard/\$(MAINBOARDDIR)/\$(CONFIG_VARIANT_DIR)/flashdescriptor.bin"

config MAINBOARD_DIR
	default "starlabs/starfighter"

config MAINBOARD_FAMILY
	string
	default "F2" if BOARD_STARLABS_STARFIGHTER_MTL
	default "F1"

config MAINBOARD_PART_NUMBER
	default "StarFighter Mk II" if BOARD_STARLABS_STARFIGHTER_MTL
	default "StarFighter Mk I"

config MAINBOARD_SMBIOS_PRODUCT_NAME
	default "StarFighter"

config ME_BIN_PATH
	string
	default "3rdparty/blobs/mainboard/\$(MAINBOARDDIR)/\$(CONFIG_VARIANT_DIR)/intel_me.bin"

config POWER_STATE_DEFAULT_ON_AFTER_FAILURE
	default n

config SOC_INTEL_CSE_SEND_EOP_EARLY
	default n

config TME_KEY_REGENERATION_ON_WARM_BOOT
	default n

config TPM_PIRQ
	depends on MAINBOARD_HAS_TPM2
	default 0x3d if BOARD_STARLABS_STARFIGHTER_MTL
	default 0x37

config UART_FOR_CONSOLE
	default 0

config USE_PM_ACPI_TIMER
	default n

config VBOOT
	select VBOOT_VBNV_FLASH

config VARIANT_DIR
	default "mtl" if BOARD_STARLABS_STARFIGHTER_MTL
	default "rpl"

endif
```

## src/mainboard/starlabs/starfighter/Kconfig.name
```kconfig
## SPDX-License-Identifier: GPL-2.0-only

comment "Star Labs StarFighter Series"

config BOARD_STARLABS_STARFIGHTER_RPL
	bool "Star Labs StarFighter Mk I (i3-1315U, i7-13700H and i9-13900H)"
```

## src/mainboard/starlabs/starlite_adl/Kconfig
```kconfig
config BOARD_STARLABS_STARLITE_SERIES
	def_bool n
	select BOARD_ROMSIZE_KB_16384
	select DRIVERS_EFI_VARIABLE_STORE
	select DRIVERS_OPTION_CFR
	select DRIVERS_I2C_HID
	select EC_STARLABS_CHARGING_SPEED
	select EC_STARLABS_LID_SWITCH
	select EC_STARLABS_ITE
	select EC_STARLABS_MAX_CHARGE
	select EC_STARLABS_MERLIN
	select EC_STARLABS_NEED_ITE_BIN
	select EC_STARLABS_POWER_LED
	select HAVE_ACPI_RESUME
	select HAVE_ACPI_TABLES
	select HAVE_OPTION_TABLE
	select HAVE_SPD_IN_CBFS
	select INTEL_GMA_HAVE_VBT
	select INTEL_LPSS_UART_FOR_CONSOLE
	select NO_UART_ON_SUPERIO
	select SOC_INTEL_COMMON_BLOCK_HDA_VERB
	select SYSTEM_TYPE_DETACHABLE
	select VALIDATE_INTEL_DESCRIPTOR

config BOARD_STARLABS_LITE_ADL
	select BOARD_ROMSIZE_KB_16384
	select BOARD_STARLABS_STARLITE_SERIES
	select CRB_TPM
	select DRIVERS_INTEL_PMC
	select HAVE_INTEL_PTT
	select SOC_INTEL_ALDERLAKE
	select SOC_INTEL_ALDERLAKE_PCH_N
	select SOC_INTEL_COMMON_BLOCK_TCSS
	select SOC_INTEL_CRASHLOG
	select SPI_FLASH_WINBOND
	select TPM2

if BOARD_STARLABS_STARLITE_SERIES

config CCD_PORT
	int
	default 4

config CONSOLE_SERIAL
	default n if !EDK2_DEBUG

config D3COLD_SUPPORT
	default n

config DEVICETREE
	default "variants/\$(CONFIG_VARIANT_DIR)/devicetree.cb"

config DIMM_SPD_SIZE
	default 512

config EC_GPE_SCI
	default 0x6e

config EC_STARLABS_ADD_ITE_BIN
	default n

config EC_STARLABS_BATTERY_MODEL
	default "AEC3756153-2S1P-N"

config EC_STARLABS_BATTERY_TYPE
	default "LION"

config EC_STARLABS_BATTERY_OEM
	default "Apower Electronics"

config EC_STARLABS_ITE_BIN_PATH
	string
	depends on EC_STARLABS_NEED_ITE_BIN
	default "3rdparty/blobs/mainboard/\$(MAINBOARDDIR)/\$(CONFIG_VARIANT_DIR)/ec.bin"

config EC_VARIANT_DIR
	default "merlin"

config FMDFILE
	default "src/mainboard/\$(CONFIG_MAINBOARD_DIR)/variants/\$(CONFIG_VARIANT_DIR)/vboot.fmd" if VBOOT
	default "src/mainboard/\$(CONFIG_MAINBOARD_DIR)/variants/\$(CONFIG_VARIANT_DIR)/board.fmd"

config IFD_BIN_PATH
	string
	default "3rdparty/blobs/mainboard/\$(MAINBOARDDIR)/\$(CONFIG_VARIANT_DIR)/flashdescriptor.bin"

config MAINBOARD_DIR
	default "starlabs/starlite_adl"

config MAINBOARD_FAMILY
	string
	default "I5"

config MAINBOARD_PART_NUMBER
	default "StarLite Mk V"

config MAINBOARD_SMBIOS_PRODUCT_NAME
	default "StarLite"

config ME_BIN_PATH
	string
	default "3rdparty/blobs/mainboard/\$(MAINBOARDDIR)/\$(CONFIG_VARIANT_DIR)/intel_me.bin"

config POWER_STATE_DEFAULT_ON_AFTER_FAILURE
	default n

config EDK2_BOOTSPLASH_FILE
	string
	default "3rdparty/blobs/mainboard/starlabs/Logo.bmp"

config SOC_INTEL_CSE_SEND_EOP_EARLY
	default n

config UART_FOR_CONSOLE
	default 0

config USE_PM_ACPI_TIMER
	default n

config VBOOT
	select VBOOT_VBNV_FLASH

config VARIANT_DIR
	default "mk_v"

endif
```

## src/mainboard/starlabs/starlite_adl/Kconfig.name
```kconfig
comment "Star Labs StarLite Series"

config BOARD_STARLABS_LITE_ADL
	bool "Star Labs Lite Mk V (N200)"

config BOARD_STARLABS_LITE_ADL_SB
	bool "Star Labs Lite Mk V Smart Battery (N200)"
```

## src/mainboard/sunw/Kconfig
```kconfig
if VENDOR_SUNW

choice
	prompt "Mainboard model"

source "src/mainboard/sunw/*/Kconfig.name"

endchoice

source "src/mainboard/sunw/*/Kconfig"

config MAINBOARD_VENDOR
	string
	default "Sun"

endif # VENDOR_SUNW
```

## src/mainboard/sunw/ultra40/Kconfig
```kconfig
if BOARD_SUNW_ULTRA40

config BOARD_SPECIFIC_OPTIONS # dummy
	def_bool y
	select ARCH_X86
	select CPU_AMD_SOCKET_940
	select NORTHBRIDGE_AMD_AMDK8
	select SOUTHBRIDGE_NVIDIA_CK804
	select SUPERIO_SMSC_LPC47M10X
	select HAVE_OPTION_TABLE
	select HAVE_PIRQ_TABLE
	select HAVE_MP_TABLE
	select BOARD_ROMSIZE_KB_1024
	select CK804_USE_NIC
	select CK804_USE_ACI
	select QRANK_DIMM_SUPPORT
	select K8_ALLOCATE_IO_RANGE

config MAINBOARD_DIR
	string
	default sunw/ultra40

config DCACHE_RAM_BASE
	hex
	default 0xcf000

config DCACHE_RAM_SIZE
	hex
	default 0x01000

config APIC_ID_OFFSET
	hex
	default 0x10

config K8_REV_F_SUPPORT
	bool
	default n

config CK804_NUM
	int
	default 2

config SB_HT_CHAIN_ON_BUS0
	int
	default 2

config MAINBOARD_PART_NUMBER
	string
	default "Ultra 40"

config MAX_CPUS
	int
	default 4

config MAX_PHYSICAL_CPUS
	int
	default 2

config HT_CHAIN_END_UNITID_BASE
	hex
	default 0x20

config HT_CHAIN_UNITID_BASE
	hex
	default 0x0

config SB_HT_CHAIN_ON_BUS0
	int
	default 2

config IRQ_SLOT_COUNT
	int
	default 11

endif # BOARD_SUNW_ULTRA40
```

## src/mainboard/sunw/ultra40m2/Kconfig
```kconfig
if BOARD_SUNW_ULTRA40M2

config BOARD_SPECIFIC_OPTIONS # dummy
	def_bool y
	select CPU_AMD_SOCKET_F
	select DIMM_DDR2
	select DIMM_REGISTERED
	select NORTHBRIDGE_AMD_AMDK8
	select SOUTHBRIDGE_NVIDIA_MCP55
	select HT_CHAIN_DISTRIBUTE
	select MCP55_USE_NIC
	select MCP55_USE_AZA
	select SUPERIO_SMSC_DME1737
	select PARALLEL_CPU_INIT
	select HAVE_OPTION_TABLE
	select HAVE_PIRQ_TABLE
	select HAVE_MP_TABLE
	select LIFT_BSP_APIC_ID
	select BOARD_ROMSIZE_KB_1024
	select QRANK_DIMM_SUPPORT
	select K8_ALLOCATE_IO_RANGE

config MAINBOARD_DIR
	string
	default sunw/ultra40m2

config DCACHE_RAM_BASE
	hex
	default 0xc8000

config DCACHE_RAM_SIZE
	hex
	default 0x08000

config APIC_ID_OFFSET
	hex
	default 0x10

config MEM_TRAIN_SEQ
	int
	default 1

config MCP55_NUM
	int
	default 2

config MAINBOARD_PART_NUMBER
	string
	default "Ultra 40 M2"

config MAX_CPUS
	int
	default 4

config MAX_PHYSICAL_CPUS
	int
	default 2

config HT_CHAIN_UNITID_BASE
	hex
	default 0x0

config HT_CHAIN_END_UNITID_BASE
	hex
	default 0x20

config IRQ_SLOT_COUNT
	int
	default 11

config MCP55_PCI_E_X_0
	int
	default 1

config MCP55_PCI_E_X_1
	int
	default 1

endif # BOARD_SUNW_ULTRA40M2
```

## src/mainboard/supermicro/Kconfig
```kconfig
## SPDX-License-Identifier: GPL-2.0-only

if VENDOR_SUPERMICRO

choice
	prompt "Mainboard model"

source "src/mainboard/supermicro/*/Kconfig.name"

endchoice

source "src/mainboard/supermicro/*/Kconfig"

config MAINBOARD_VENDOR
	default "Supermicro"

endif # VENDOR_SUPERMICRO
```

## src/mainboard/supermicro/Kconfig.name
```kconfig
## SPDX-License-Identifier: GPL-2.0-only

config VENDOR_SUPERMICRO
	bool "Supermicro"
```

## src/mainboard/supermicro/h8dme/Kconfig
```kconfig
config BOARD_SUPERMICRO_H8DME
	bool "H8DME-2"
	select ARCH_X86
	select CPU_AMD_SOCKET_F
	select NORTHBRIDGE_AMD_AMDK8
	select NORTHBRIDGE_AMD_AMDK8_ROOT_COMPLEX
	select SOUTHBRIDGE_NVIDIA_MCP55
	select SUPERIO_WINBOND_W83627HF
	select HAVE_PIRQ_TABLE
	select HAVE_MP_TABLE
	select USE_PRINTK_IN_CAR
	select USE_DCACHE_RAM
	select HAVE_HARD_RESET
	select AP_CODE_IN_CAR
	select IOAPIC
	select LIFT_BSP_APIC_ID
	select BOARD_ROMSIZE_KB_1024

config MAINBOARD_DIR
	string
	default supermicro/h8dme
	depends on BOARD_SUPERMICRO_H8DME

config DCACHE_RAM_BASE
	hex
	default 0xc8000
	depends on BOARD_SUPERMICRO_H8DME

config DCACHE_RAM_SIZE
	hex
	default 0x08000
	depends on BOARD_SUPERMICRO_H8DME

config DCACHE_RAM_GLOBAL_VAR_SIZE
	hex
	default 0x01000
	depends on BOARD_SUPERMICRO_H8DME

config APIC_ID_OFFSET
	hex
	default 0x10
	depends on BOARD_SUPERMICRO_H8DME

config MEM_TRAIN_SEQ
	int
	default 1
	depends on BOARD_SUPERMICRO_H8DME

config SB_HT_CHAIN_ON_BUS0
	int
	default 2
	depends on BOARD_SUPERMICRO_H8DME

config SB_HT_CHAIN_UNITID_OFFSET_ONLY
	bool
	default n
	depends on BOARD_SUPERMICRO_H8DME

config LB_CKS_RANGE_END
	int
	default 122
	depends on BOARD_SUPERMICRO_H8DME

config LB_CKS_LOC
	int
	default 123
	depends on BOARD_SUPERMICRO_H8DME

config MAINBOARD_PART_NUMBER
	string
	default "H8DME-2"
	depends on BOARD_SUPERMICRO_H8DME

config HW_MEM_HOLE_SIZEK
	hex
	default 0x100000
	depends on BOARD_SUPERMICRO_H8DME

config MAX_CPUS
	int
	default 4
	depends on BOARD_SUPERMICRO_H8DME

config MAX_PHYSICAL_CPUS
	int
	default 2
	depends on BOARD_SUPERMICRO_H8DME

config HT_CHAIN_END_UNITID_BASE
	hex
	default 0x0
	depends on BOARD_SUPERMICRO_H8DME

config HT_CHAIN_UNITID_BASE
	hex
	default 0x0
	depends on BOARD_SUPERMICRO_H8DME

config USE_INIT
	bool
	default n
	depends on BOARD_SUPERMICRO_H8DME

config SB_HT_CHAIN_ON_BUS0
	int
	default 2
	depends on BOARD_SUPERMICRO_H8DME

config IRQ_SLOT_COUNT
	int
	default 11
	depends on BOARD_SUPERMICRO_H8DME

config MAINBOARD_PCI_SUBSYSTEM_VENDOR_ID
	hex
	default 0x15d9
	depends on BOARD_SUPERMICRO_H8DME

config MAINBOARD_PCI_SUBSYSTEM_DEVICE_ID
	hex
	default 0x1511
	depends on BOARD_SUPERMICRO_H8DME
```

## src/mainboard/supermicro/h8dmr_fam10/Kconfig
```kconfig
config BOARD_SUPERMICRO_H8DMR_FAM10
	bool "H8DMR-i2 (Fam10)"
	select ARCH_X86
	select CPU_AMD_SOCKET_F_1207
	select NORTHBRIDGE_AMD_AMDFAM10
	select NORTHBRIDGE_AMD_AMDFAM10_ROOT_COMPLEX
	select SOUTHBRIDGE_NVIDIA_MCP55
	select SUPERIO_WINBOND_W83627HF
	select HAVE_BUS_CONFIG
	select HAVE_PIRQ_TABLE
	select HAVE_MP_TABLE
	select USE_PRINTK_IN_CAR
	select USE_DCACHE_RAM
	select HAVE_HARD_RESET
	select LIFT_BSP_APIC_ID
	select AMDMCT
	select BOARD_ROMSIZE_KB_1024
	select TINY_BOOTBLOCK
	select ENABLE_APIC_EXT_ID

config MAINBOARD_DIR
	string
	default supermicro/h8dmr_fam10
	depends on BOARD_SUPERMICRO_H8DMR_FAM10

config DCACHE_RAM_BASE
	hex
	default 0xc4000
	depends on BOARD_SUPERMICRO_H8DMR_FAM10

config DCACHE_RAM_SIZE
	hex
	default 0x0c000
	depends on BOARD_SUPERMICRO_H8DMR_FAM10

config DCACHE_RAM_GLOBAL_VAR_SIZE
	hex
	default 0x04000
	depends on BOARD_SUPERMICRO_H8DMR_FAM10

config RAMBASE
	hex
	default 0x200000
	depends on BOARD_SUPERMICRO_H8DMR_FAM10

config RAMTOP
	hex
	default 0x1000000
	depends on BOARD_SUPERMICRO_H8DMR_FAM10

config HEAP_SIZE
	hex
	default 0xc0000
	depends on BOARD_SUPERMICRO_H8DMR_FAM10

config APIC_ID_OFFSET
	hex
	default 0x0
	depends on BOARD_SUPERMICRO_H8DMR_FAM10

config MEM_TRAIN_SEQ
	int
	default 2
	depends on BOARD_SUPERMICRO_H8DMR_FAM10

config SB_HT_CHAIN_ON_BUS0
	int
	default 2
	depends on BOARD_SUPERMICRO_H8DMR_FAM10

config SB_HT_CHAIN_UNITID_OFFSET_ONLY
	bool
	default n
	depends on BOARD_SUPERMICRO_H8DMR_FAM10

config MAINBOARD_PART_NUMBER
	string
	default "H8DMR-i2 (Fam10)"
	depends on BOARD_SUPERMICRO_H8DMR_FAM10

config HW_MEM_HOLE_SIZEK
	hex
	default 0x100000
	depends on BOARD_SUPERMICRO_H8DMR_FAM10

config MAX_CPUS
	int
	default 8
	depends on BOARD_SUPERMICRO_H8DMR_FAM10

config MAX_PHYSICAL_CPUS
	int
	default 2
	depends on BOARD_SUPERMICRO_H8DMR_FAM10

config HT_CHAIN_END_UNITID_BASE
	hex
	default 0x20
	depends on BOARD_SUPERMICRO_H8DMR_FAM10

config HT_CHAIN_UNITID_BASE
	hex
	default 0x1
	depends on BOARD_SUPERMICRO_H8DMR_FAM10

config SB_HT_CHAIN_ON_BUS0
	int
	default 2
	depends on BOARD_SUPERMICRO_H8DMR_FAM10

config IRQ_SLOT_COUNT
	int
	default 11
	depends on BOARD_SUPERMICRO_H8DMR_FAM10

config AMD_UCODE_PATCH_FILE
	string
	default "mc_patch_0100009f.h"
	depends on BOARD_SUPERMICRO_H8DMR_FAM10

config SERIAL_CPU_INIT
	bool
	default n
	depends on BOARD_SUPERMICRO_H8DMR_FAM10

config MAINBOARD_PCI_SUBSYSTEM_DEVICE_ID
	hex
	default 0x1511
	depends on BOARD_SUPERMICRO_H8DMR_FAM10
```
