## src/mainboard/supermicro/x10slm-f/Kconfig
```kconfig
## SPDX-License-Identifier: GPL-2.0-or-later

if BOARD_SUPERMICRO_X10SLM_PLUS_F

config BOARD_SPECIFIC_OPTIONS
	def_bool y
	select BOARD_ROMSIZE_KB_16384
	select DRIVERS_ASPEED_AST2050 # Supports AST2400 too.
	select HAVE_ACPI_RESUME
	select HAVE_ACPI_TABLES
	select HAVE_OPTION_TABLE
	select HAVE_CMOS_DEFAULT
	select NORTHBRIDGE_INTEL_HASWELL
	select SERIRQ_CONTINUOUS_MODE
	select SOUTHBRIDGE_INTEL_LYNXPOINT
	select SUPERIO_NUVOTON_COMMON_COM_A
	select SUPERIO_NUVOTON_NCT6776

config CBFS_SIZE
	default 0xb00000

config MAINBOARD_DIR
	default "supermicro/x10slm-f"

config MAINBOARD_PART_NUMBER
	default "X10SLM+-F"

config ENABLE_DDR_2X_REFRESH
	default y

endif
```

## src/mainboard/supermicro/x10slm-f/Kconfig.name
```kconfig
## SPDX-License-Identifier: GPL-2.0-only

config BOARD_SUPERMICRO_X10SLM_PLUS_F
	bool "X10SLM+-F"
```

## src/mainboard/supermicro/x11-lga1151-series/Kconfig
```kconfig
config BOARD_SUPERMICRO_BASEBOARD_X11_LGA1151_SERIES
	def_bool n
	select BOARD_ROMSIZE_KB_16384
	select HAVE_ACPI_TABLES
	select HAVE_OPTION_TABLE
	select HAVE_CMOS_DEFAULT
	select SOC_INTEL_KABYLAKE
	select SKYLAKE_SOC_PCH_H
	select MEMORY_MAPPED_TPM
	select DRIVERS_ASPEED_AST2050
	select SUPERIO_ASPEED_AST2400
	select IPMI_KCS
	select MAINBOARD_NO_FSP_GOP
	select SUPERIO_ASPEED_HAS_UART_DELAY_WORKAROUND
	select NO_FADT_8042
	select DRIVERS_UART_8250IO
	select SOC_INTEL_COMMON_BLOCK_LPC_COMB_ENABLE

if BOARD_SUPERMICRO_BASEBOARD_X11_LGA1151_SERIES

config DISABLE_HECI1_AT_PRE_BOOT
	default y

config MAINBOARD_FAMILY
	string
	default "Supermicro_X11_LGA1151_SERIES"

config MAINBOARD_PART_NUMBER
	default "X11SSH-TF"	if BOARD_SUPERMICRO_X11SSH_TF
	default "X11SSM-F"	if BOARD_SUPERMICRO_X11SSM_F
	default "X11SSH-F/LN4F"	if BOARD_SUPERMICRO_X11SSH_F

config MAINBOARD_DIR
	default "supermicro/x11-lga1151-series"

config VARIANT_DIR
	default "x11ssh-tf"	if BOARD_SUPERMICRO_X11SSH_TF
	default "x11ssm-f"	if BOARD_SUPERMICRO_X11SSM_F
	default "x11ssh-f"	if BOARD_SUPERMICRO_X11SSH_F

config OVERRIDE_DEVICETREE
	default "variants/\$(CONFIG_VARIANT_DIR)/overridetree.cb"

config VBOOT
	select VBOOT_NO_BOARD_SUPPORT
	select GBB_FLAG_DISABLE_LID_SHUTDOWN
	select GBB_FLAG_DISABLE_PD_SOFTWARE_SYNC
	select GBB_FLAG_DISABLE_EC_SOFTWARE_SYNC
	select GBB_FLAG_DISABLE_FWMP

if VBOOT

config VBOOT_SLOTS_RW_AB
	default y

endif

config VBOOT_VBNV_OFFSET
	hex
	default 0x2a

config FMDFILE
	default "src/mainboard/\$(CONFIG_MAINBOARD_DIR)/vboot-ro-rwab.fmd" if VBOOT_SLOTS_RW_AB

config DRIVERS_IPMI_SUPERMICRO_OEM
	bool
	default y

config CBFS_SIZE
	default 0xb00000

config CONSOLE_POST
	bool
	default y

config POST_DEVICE
	bool
	default n

config DIMM_SPD_SIZE
	default 512

config SUPERMICRO_BOARDID
	string
	default "0896"	if BOARD_SUPERMICRO_X11SSM_F
	default "089C"	if BOARD_SUPERMICRO_X11SSH_TF
	default "0884"	if BOARD_SUPERMICRO_X11SSH_F

endif  # BOARD_SUPERMICRO_BASEBOARD_X11_LGA1151_SERIES
```

## src/mainboard/supermicro/x11-lga1151-series/Kconfig.name
```kconfig
## SPDX-License-Identifier: GPL-2.0-only

config BOARD_SUPERMICRO_X11SSH_TF
	bool "X11SSH-TF"

config BOARD_SUPERMICRO_X11SSM_F
	bool "X11SSM-F"

config BOARD_SUPERMICRO_X11SSH_F
	bool "X11SSH-F/LN4F"

config BOARD_SUPERMICRO_X11SSW_F
	bool "X11SSW-F"
```

## src/mainboard/supermicro/x11ssh/Kconfig
```kconfig
config BOARD_SUPERMICRO_BASEBOARD_X11SSH
	def_bool n
	select BOARD_ROMSIZE_KB_16384
	select HAVE_ACPI_RESUME
	select HAVE_ACPI_TABLES
	select HAVE_OPTION_TABLE
	select SOC_INTEL_KABYLAKE
	select SKYLAKE_SOC_PCH_H
	select MAINBOARD_HAS_LPC_TPM
	select DRIVERS_ASPEED_AST2050
	select SUPERIO_ASPEED_AST2400
	select GENERATE_SMBIOS_TABLES
	select IPMI_KCS

if BOARD_SUPERMICRO_BASEBOARD_X11SSH

config VBOOT
	select VBOOT_NO_BOARD_SUPPORT
	select GBB_FLAG_DISABLE_LID_SHUTDOWN
	select GBB_FLAG_DISABLE_PD_SOFTWARE_SYNC
	select GBB_FLAG_DISABLE_EC_SOFTWARE_SYNC
	select GBB_FLAG_DISABLE_FWMP

config VBOOT_SLOTS_RW_AB
	default y

config VBOOT_VBNV_OFFSET
	hex
	default 0x2a

config FMDFILE
	string
	default "src/mainboard/$(CONFIG_MAINBOARD_DIR)/vboot-ro-rwab.fmd" if VBOOT_SLOTS_RW_AB

config CBFS_SIZE
	hex
	default 0x009aa000 if !VBOOT

config IRQ_SLOT_COUNT
	int
	default 18

config MAINBOARD_DIR
	string
	default "supermicro/x11ssh"

config VARIANT_DIR
	string
	default "tf" if BOARD_SUPERMICRO_X11SSH_PLUS_TF

config DEVICETREE
	string
	default "variants/$(CONFIG_VARIANT_DIR)/devicetree.cb"

config MAINBOARD_PART_NUMBER
	string
	default "X11SSH-TF" if BOARD_SUPERMICRO_X11SSH_PLUS_TF

config MAX_CPUS
	int
	default 8

config SUBSYSTEM_VENDOR_ID
	hex
	default 0x8086

config CONSOLE_POST
	bool
	default y

config POST_DEVICE
	bool
	default n

config DIMM_SPD_SIZE
	int
	default 512

endif # BOARD_SUPERMICRO_BASEBOARD_X11SSH
```

## src/mainboard/supermicro/x11ssh/Kconfig.name
```kconfig
config BOARD_SUPERMICRO_X11SSH_TF
	bool "X11SSH-TF"
	select BOARD_SUPERMICRO_BASEBOARD_X11SSH
```

## src/mainboard/supermicro/x6dai_g/Kconfig
```kconfig
if BOARD_SUPERMICRO_X6DAI_G

config BOARD_SPECIFIC_OPTIONS # dummy
	def_bool y
	select ARCH_X86
	select CPU_INTEL_SOCKET_MPGA604
	select NORTHBRIDGE_INTEL_E7525
	select SOUTHBRIDGE_INTEL_ESB6300
	select SUPERIO_WINBOND_W83627HF
	select ROMCC
	select HAVE_HARD_RESET
	select HAVE_OPTION_TABLE
	select HAVE_PIRQ_TABLE
	select HAVE_MP_TABLE
	select BOARD_ROMSIZE_KB_1024

config MAINBOARD_DIR
	string
	default supermicro/x6dai_g

config MAINBOARD_PART_NUMBER
	string
	default "X6DAi-G"

config MAX_CPUS
	int
	default 4

config IRQ_SLOT_COUNT
	int
	default 15

endif # BOARD_SUPERMICRO_X6DAI_G
```

## src/mainboard/supermicro/x6dhe_g/Kconfig
```kconfig
if BOARD_SUPERMICRO_X6DHE_G

config BOARD_SPECIFIC_OPTIONS # dummy
	def_bool y
	select ARCH_X86
	select CPU_INTEL_SOCKET_MPGA604
	select NORTHBRIDGE_INTEL_E7520
	select SOUTHBRIDGE_INTEL_ESB6300
	select SOUTHBRIDGE_INTEL_PXHD
	select SUPERIO_WINBOND_W83627HF
	select ROMCC
	select HAVE_HARD_RESET
	select HAVE_OPTION_TABLE
	select HAVE_PIRQ_TABLE
	select HAVE_MP_TABLE
	select BOARD_ROMSIZE_KB_1024
	select DRIVERS_GENERIC_DEBUG

config MAINBOARD_DIR
	string
	default supermicro/x6dhe_g

config MAINBOARD_PART_NUMBER
	string
	default "X6DHE-G"

config MAX_CPUS
	int
	default 4

config IRQ_SLOT_COUNT
	int
	default 15

endif # BOARD_SUPERMICRO_X6DHE_G
```

## src/mainboard/supermicro/x6dhe_g2/Kconfig
```kconfig
if BOARD_SUPERMICRO_X6DHE_G2

config BOARD_SPECIFIC_OPTIONS # dummy
	def_bool y
	select ARCH_X86
	select CPU_INTEL_SOCKET_MPGA604
	select NORTHBRIDGE_INTEL_E7520
	select SOUTHBRIDGE_INTEL_I82801EX
	select SOUTHBRIDGE_INTEL_PXHD
	select SUPERIO_NSC_PC87427
	select ROMCC
	select HAVE_OPTION_TABLE
	select HAVE_PIRQ_TABLE
	select HAVE_MP_TABLE
	select BOARD_ROMSIZE_KB_1024
	select USE_WATCHDOG_ON_BOOT
	select DRIVERS_GENERIC_DEBUG

config MAINBOARD_DIR
	string
	default supermicro/x6dhe_g2

config MAINBOARD_PART_NUMBER
	string
	default "X6DHE-G2"

config MAX_CPUS
	int
	default 4

config IRQ_SLOT_COUNT
	int
	default 15

endif # BOARD_SUPERMICRO_X6DHE_G2
```

## src/mainboard/supermicro/x6dhr_ig2/Kconfig
```kconfig
if BOARD_SUPERMICRO_X6DHR_IG2

config BOARD_SPECIFIC_OPTIONS # dummy
	def_bool y
	select ARCH_X86
	select CPU_INTEL_SOCKET_MPGA604
	select NORTHBRIDGE_INTEL_E7520
	select SOUTHBRIDGE_INTEL_I82801EX
	select SOUTHBRIDGE_INTEL_PXHD
	select SUPERIO_WINBOND_W83627HF
	select ROMCC
	select HAVE_OPTION_TABLE
	select HAVE_PIRQ_TABLE
	select HAVE_MP_TABLE
	select USE_WATCHDOG_ON_BOOT
	select BOARD_ROMSIZE_KB_1024

config MAINBOARD_DIR
	string
	default supermicro/x6dhr_ig2

config MAINBOARD_PART_NUMBER
	string
	default "X6DHR-iG2"

config MAX_CPUS
	int
	default 4

config IRQ_SLOT_COUNT
	int
	default 15

endif # BOARD_SUPERMICRO_X6DHR_IG2
```

## src/mainboard/supermicro/x7db8/Kconfig
```kconfig
if BOARD_SUPERMICRO_X7DB8

config BOARD_SPECIFIC_OPTIONS # dummy
	def_bool y
	select ARCH_X86
	select CPU_INTEL_SOCKET_LGA771
	select SOUTHBRIDGE_INTEL_I3100
	select NORTHBRIDGE_INTEL_I5000
	select SUPERIO_WINBOND_W83627HF
	select BOARD_ROMSIZE_KB_512
	select HAVE_PIRQ_TABLE
	select DRIVERS_I2C_W83793
	select DRIVERS_GENERIC_IOAPIC

config MAINBOARD_DIR
	string
	default supermicro/x7db8

config DCACHE_RAM_BASE
	hex
	default 0xffdf8000

config DCACHE_RAM_SIZE
	hex
	default 0x8000

config MAINBOARD_PART_NUMBER
	string
	default "X7DB8 / X7DB8+"

config MMCONF_BASE_ADDRESS
	hex
	default 0xe0000000

config IRQ_SLOT_COUNT
	int
	default 48

config MAX_CPUS
	int
	default 8

endif
```

## src/mainboard/supermicro/x9sae/Kconfig
```kconfig
## SPDX-License-Identifier: GPL-2.0-only

if BOARD_SUPERMICRO_X9SAE

config BOARD_SPECIFIC_OPTIONS
	def_bool y
	select BOARD_ROMSIZE_KB_16384
	select HAVE_ACPI_RESUME
	select HAVE_ACPI_TABLES
	select HAVE_CMOS_DEFAULT
	select HAVE_OPTION_TABLE
	select INTEL_GMA_HAVE_VBT
	select INTEL_INT15
	select MAINBOARD_HAS_LIBGFXINIT
	select MEMORY_MAPPED_TPM
	select MAINBOARD_USES_IFD_GBE_REGION
	select NORTHBRIDGE_INTEL_SANDYBRIDGE
	select SERIRQ_CONTINUOUS_MODE
	select SOUTHBRIDGE_INTEL_C216
	select SUPERIO_NUVOTON_NCT6776
	select USE_NATIVE_RAMINIT

config MAINBOARD_DIR
	string
	default "supermicro/x9sae"

config MAINBOARD_PART_NUMBER
	string
	default "X9SAE"

endif
```

## src/mainboard/supermicro/x9sae/Kconfig.name
```kconfig
## SPDX-License-Identifier: GPL-2.0-only

config BOARD_SUPERMICRO_X9SAE
	bool "X9SAE"
```

## src/mainboard/supermicro/x9scl/Kconfig
```kconfig
if BOARD_SUPERMICRO_X9SCL

config BOARD_SPECIFIC_OPTIONS
	def_bool y
	select BOARD_ROMSIZE_KB_8192
	select HAVE_ACPI_TABLES
	select NORTHBRIDGE_INTEL_SANDYBRIDGE
	select USE_NATIVE_RAMINIT
	select RAMINIT_ENABLE_ECC
	select SERIRQ_CONTINUOUS_MODE
	select SOUTHBRIDGE_INTEL_BD82X6X
	select SUPERIO_NUVOTON_COMMON_COM_A
	select SUPERIO_NUVOTON_NCT6776
	select SUPERIO_NUVOTON_WPCM450
	select MAINBOARD_USES_IFD_GBE_REGION
	select IPMI_KCS

config MAINBOARD_DIR
	default "supermicro/x9scl"

config MAINBOARD_PART_NUMBER
	default "X9SCL/X9SCM"

config USBDEBUG_HCD_INDEX
	int
	default 1

config VGA_BIOS_ID
	string
	depends on VGA_BIOS
	default "102b,0532"

config PXE_ROM_ID
	string
	depends on PXE
	default "8086:10d3"

config CBFS_SIZE
	default 0x400000

#config SUPERMICRO_BOARDID
#	string
#	default "0624"
#
endif
```

## src/mainboard/supermicro/x9scl/Kconfig.name
```kconfig
## SPDX-License-Identifier: GPL-2.0-only

config BOARD_SUPERMICRO_X9SCL
	bool "X9SCL/X9SCM"
```

## src/mainboard/system76/Kconfig
```kconfig
if VENDOR_SYSTEM76

choice
	prompt "Mainboard model"

source "src/mainboard/system76/*/Kconfig.name"

endchoice

source "src/mainboard/system76/*/Kconfig"

config MAINBOARD_VENDOR
	default "System76"

endif # VENDOR_SYSTEM76
```

## src/mainboard/system76/Kconfig.name
```kconfig
## SPDX-License-Identifier: GPL-2.0-only

config VENDOR_SYSTEM76
	bool "System76"
```

## src/mainboard/system76/addw1/Kconfig
```kconfig
## SPDX-License-Identifier: GPL-2.0-only

if BOARD_SYSTEM76_ADDW1 || BOARD_SYSTEM76_ADDW2

config BOARD_SPECIFIC_OPTIONS
	def_bool y
	select BOARD_ROMSIZE_KB_16384
	select DRIVERS_GENERIC_CBFS_SERIAL
	select DRIVERS_GENERIC_CBFS_UUID
	select DRIVERS_I2C_HID
	select DRIVERS_I2C_TAS5825M
	select EC_SYSTEM76_EC
	select EC_SYSTEM76_EC_DGPU
	select EC_SYSTEM76_EC_OLED
	select HAVE_ACPI_RESUME
	select HAVE_ACPI_TABLES
	select HAVE_CMOS_DEFAULT
	select HAVE_OPTION_TABLE
	select INTEL_GMA_HAVE_VBT
	select INTEL_LPSS_UART_FOR_CONSOLE
	select MEMORY_MAPPED_TPM
	select MAINBOARD_HAS_TPM2
	select NO_UART_ON_SUPERIO
	select PCIEXP_HOTPLUG
	select SOC_INTEL_CANNONLAKE_PCH_H
	select SOC_INTEL_COFFEELAKE if BOARD_SYSTEM76_ADDW1
	select SOC_INTEL_COMETLAKE_1 if BOARD_SYSTEM76_ADDW2
	select SOC_INTEL_COMMON_BLOCK_HDA_VERB
	select SPD_READ_BY_WORD
	select SYSTEM_TYPE_LAPTOP
	select TPM_MEASURED_BOOT

config MAINBOARD_DIR
	default "system76/addw1"

config VARIANT_DIR
	default "addw1" if BOARD_SYSTEM76_ADDW1
	default "addw2" if BOARD_SYSTEM76_ADDW2

config OVERRIDE_DEVICETREE
	default "variants/\$(CONFIG_VARIANT_DIR)/overridetree.cb"

config MAINBOARD_PART_NUMBER
	default "addw1" if BOARD_SYSTEM76_ADDW1
	default "addw2" if BOARD_SYSTEM76_ADDW2

config MAINBOARD_SMBIOS_PRODUCT_NAME
	default "Adder WS"

config MAINBOARD_VERSION
	default "addw1" if BOARD_SYSTEM76_ADDW1
	default "addw2" if BOARD_SYSTEM76_ADDW2

config CBFS_SIZE
	default 0xa00000 if BOARD_SYSTEM76_ADDW1
	default 0xc00000

config CONSOLE_POST
	default y

config ONBOARD_VGA_IS_PRIMARY
	default y

config UART_FOR_CONSOLE
	default 2

config DIMM_MAX
	default 2

config POST_DEVICE
	default n

endif
```

## src/mainboard/system76/addw1/Kconfig.name
```kconfig
## SPDX-License-Identifier: GPL-2.0-only

config BOARD_SYSTEM76_ADDW1
	bool "addw1"

config BOARD_SYSTEM76_ADDW2
	bool "addw2"
```

## src/mainboard/system76/adl-p/Kconfig
```kconfig
if BOARD_SYSTEM76_DARP8 || BOARD_SYSTEM76_GALP6

config BOARD_SPECIFIC_OPTIONS
	def_bool y
	select BOARD_ROMSIZE_KB_32768
	select DRIVERS_I2C_HID
	select DRIVERS_INTEL_PMC
	select DRIVERS_INTEL_USB4_RETIMER
	select EC_SYSTEM76_EC
	select EC_SYSTEM76_EC_COLOR_KEYBOARD if BOARD_SYSTEM76_DARP8
	select HAVE_ACPI_TABLES
	select HAVE_CMOS_DEFAULT
	select HAVE_OPTION_TABLE
	select INTEL_GMA_HAVE_VBT
	select INTEL_LPSS_UART_FOR_CONSOLE
	select MAINBOARD_HAS_TPM2
	select MEMORY_MAPPED_TPM
	select NO_UART_ON_SUPERIO
	select SOC_INTEL_ALDERLAKE_PCH_P
	select SOC_INTEL_COMMON_BLOCK_HDA_VERB
	select SOC_INTEL_CRASHLOG
	select SOC_INTEL_ENABLE_USB4_PCIE_RESOURCES
	select SPD_READ_BY_WORD
	select SYSTEM_TYPE_LAPTOP

config MAINBOARD_DIR
	default "system76/adl-p"

config VARIANT_DIR
	default "darp8" if BOARD_SYSTEM76_DARP8
	default "galp6" if BOARD_SYSTEM76_GALP6

config OVERRIDE_DEVICETREE
	default "variants/\$(CONFIG_VARIANT_DIR)/overridetree.cb"

config MAINBOARD_PART_NUMBER
	default "darp8" if BOARD_SYSTEM76_DARP8
	default "galp6" if BOARD_SYSTEM76_GALP6

config MAINBOARD_SMBIOS_PRODUCT_NAME
	default "Darter Pro" if BOARD_SYSTEM76_DARP8
	default "Galago Pro" if BOARD_SYSTEM76_GALP6

config MAINBOARD_VERSION
	default "darp8" if BOARD_SYSTEM76_DARP8
	default "galp6" if BOARD_SYSTEM76_GALP6

config CBFS_SIZE
	default 0xA00000

config CONSOLE_POST
	default y

config DIMM_SPD_SIZE
	default 512

config POST_DEVICE
	default n

config TPM_MEASURED_BOOT
	default y

config UART_FOR_CONSOLE
	default 0

# PM Timer Disabled, saves power
config USE_PM_ACPI_TIMER
	default n

endif
```

## src/mainboard/system76/adl-p/Kconfig.name
```kconfig
config BOARD_SYSTEM76_DARP8
	bool "darp8"

config BOARD_SYSTEM76_GALP6
	bool "galp6"
```
