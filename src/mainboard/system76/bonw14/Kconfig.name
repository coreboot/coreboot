## src/mainboard/system76/bonw14/Kconfig.name
```kconfig
## SPDX-License-Identifier: GPL-2.0-only

config BOARD_SYSTEM76_BONW14
	bool "bonw14"
```

## src/mainboard/system76/cml-u/Kconfig
```kconfig
if BOARD_SYSTEM76_GALP4 || BOARD_SYSTEM76_DARP6

config BOARD_SPECIFIC_OPTIONS
	def_bool y
	select BOARD_ROMSIZE_KB_16384
	select DRIVERS_I2C_HID
	select EC_SYSTEM76_EC
	select EC_SYSTEM76_EC_COLOR_KEYBOARD if BOARD_SYSTEM76_DARP6
	select HAVE_ACPI_RESUME
	select HAVE_ACPI_TABLES
	select HAVE_CMOS_DEFAULT
	select HAVE_OPTION_TABLE
	select INTEL_GMA_HAVE_VBT
	select INTEL_LPSS_UART_FOR_CONSOLE
	select MEMORY_MAPPED_TPM
	select MAINBOARD_HAS_TPM2
	select NO_UART_ON_SUPERIO
	select PCIEXP_HOTPLUG
	select PCIEXP_HOTPLUG_PREFETCH_MEM_BELOW_4G # Fix running out of MTRRs
	select SOC_INTEL_COMETLAKE_1
	select SOC_INTEL_COMMON_BLOCK_HDA_VERB
	select SPD_READ_BY_WORD
	select SYSTEM_TYPE_LAPTOP
	select TPM_MEASURED_BOOT

config MAINBOARD_DIR
	default "system76/cml-u"

config VARIANT_DIR
	default "galp4" if BOARD_SYSTEM76_GALP4
	default "darp6" if BOARD_SYSTEM76_DARP6

config OVERRIDE_DEVICETREE
	default "variants/\$(CONFIG_VARIANT_DIR)/overridetree.cb"

config MAINBOARD_PART_NUMBER
	default "galp4" if BOARD_SYSTEM76_GALP4
	default "darp6" if BOARD_SYSTEM76_DARP6

config MAINBOARD_SMBIOS_PRODUCT_NAME
	default "Galago Pro" if BOARD_SYSTEM76_GALP4
	default "Darter Pro" if BOARD_SYSTEM76_DARP6

config MAINBOARD_VERSION
	default "galp4" if BOARD_SYSTEM76_GALP4
	default "darp6" if BOARD_SYSTEM76_DARP6

config CBFS_SIZE
	default 0xA00000

config CONSOLE_POST
	default y

config ONBOARD_VGA_IS_PRIMARY
	default y

config UART_FOR_CONSOLE
	default 2

config DIMM_MAX
	default 2

config VGA_BIOS_ID
	default "8086,9b41"

config POST_DEVICE
	default n

endif
```

## src/mainboard/system76/cml-u/Kconfig.name
```kconfig
config BOARD_SYSTEM76_GALP4
	bool "galp4"

config BOARD_SYSTEM76_DARP6
	bool "darp6"

config BOARD_SYSTEM76_LEMP9
	bool "lemp9"
```

## src/mainboard/system76/gaze15/Kconfig
```kconfig
if BOARD_SYSTEM76_GAZE14 || BOARD_SYSTEM76_GAZE15

config BOARD_SPECIFIC_OPTIONS
	def_bool y
	select BOARD_ROMSIZE_KB_16384
	select DRIVERS_I2C_HID
	select EC_SYSTEM76_EC
	select EC_SYSTEM76_EC_COLOR_KEYBOARD
	select EC_SYSTEM76_EC_DGPU
	select HAVE_ACPI_RESUME
	select HAVE_ACPI_TABLES
	select HAVE_CMOS_DEFAULT
	select HAVE_OPTION_TABLE
	select INTEL_GMA_HAVE_VBT
	select INTEL_LPSS_UART_FOR_CONSOLE
	select MEMORY_MAPPED_TPM
	select MAINBOARD_HAS_TPM2
	select NO_UART_ON_SUPERIO
	select SOC_INTEL_CANNONLAKE_PCH_H
	select SOC_INTEL_COFFEELAKE if BOARD_SYSTEM76_GAZE14
	select SOC_INTEL_COMETLAKE_1 if BOARD_SYSTEM76_GAZE15
	select SOC_INTEL_COMMON_BLOCK_HDA_VERB
	select SPD_READ_BY_WORD
	select SYSTEM_TYPE_LAPTOP
	select TPM_MEASURED_BOOT
	select TPM_RDRESP_NEED_DELAY

config MAINBOARD_DIR
	default "system76/gaze15"

config VARIANT_DIR
	default "gaze14" if BOARD_SYSTEM76_GAZE14
	default "gaze15" if BOARD_SYSTEM76_GAZE15

config OVERRIDE_DEVICETREE
	default "variants/\$(CONFIG_VARIANT_DIR)/overridetree.cb"

config MAINBOARD_PART_NUMBER
	default "gaze14" if BOARD_SYSTEM76_GAZE14
	default "gaze15" if BOARD_SYSTEM76_GAZE15

config MAINBOARD_SMBIOS_PRODUCT_NAME
	default "Gazelle"

config MAINBOARD_VERSION
	default "gaze14" if BOARD_SYSTEM76_GAZE14
	default "gaze15" if BOARD_SYSTEM76_GAZE15

config CBFS_SIZE
	default 0xA00000

config CONSOLE_POST
	default y

config ONBOARD_VGA_IS_PRIMARY
	default y

config UART_FOR_CONSOLE
	default 2

config MAX_CPUS
	default 16

config DIMM_MAX
	default 2

config VGA_BIOS_ID
	default "8086,9bc4"

config POST_DEVICE
	default n

endif
```

## src/mainboard/system76/gaze15/Kconfig.name
```kconfig
## SPDX-License-Identifier: GPL-2.0-only

config BOARD_SYSTEM76_GAZE14
	bool "gaze14"

config BOARD_SYSTEM76_GAZE15
	bool "gaze15"
```

## src/mainboard/system76/gaze16/Kconfig.name
```kconfig
config BOARD_SYSTEM76_GAZE16_3050
	bool "gaze16 3050"

config BOARD_SYSTEM76_GAZE16_3060
	bool "gaze16 3060"

config BOARD_SYSTEM76_GAZE16_3060_B
	bool "gaze16 3060-b"
```

## src/mainboard/system76/kbl-u/Kconfig
```kconfig
if BOARD_SYSTEM76_GALP2 || BOARD_SYSTEM76_GALP3 || BOARD_SYSTEM76_GALP3_B

config BOARD_SPECIFIC_OPTIONS
	def_bool y
	select BOARD_ROMSIZE_KB_8192
	select HAVE_ACPI_RESUME
	select HAVE_ACPI_TABLES
	select HAVE_CMOS_DEFAULT
	select HAVE_OPTION_TABLE
	select INTEL_GMA_HAVE_VBT
	select INTEL_LPSS_UART_FOR_CONSOLE
	select MEMORY_MAPPED_TPM
	select MAINBOARD_HAS_TPM2
	select NO_UART_ON_SUPERIO
	select PCIEXP_HOTPLUG
	select SOC_INTEL_COMMON_BLOCK_HDA_VERB
	select SOC_INTEL_KABYLAKE
	select SPD_READ_BY_WORD
	select SYSTEM_TYPE_LAPTOP
	select TPM_MEASURED_BOOT

config DISABLE_HECI1_AT_PRE_BOOT
	default y

config MAINBOARD_DIR
	default "system76/kbl-u"

config VARIANT_DIR
	default "galp2" if BOARD_SYSTEM76_GALP2
	default "galp3" if BOARD_SYSTEM76_GALP3
	default "galp3-b" if BOARD_SYSTEM76_GALP3_B

config MAINBOARD_PART_NUMBER
	default "galp2" if BOARD_SYSTEM76_GALP2
	default "galp3" if BOARD_SYSTEM76_GALP3
	default "galp3-b" if BOARD_SYSTEM76_GALP3_B

config MAINBOARD_SMBIOS_PRODUCT_NAME
	default "Galago Pro"

config MAINBOARD_VERSION
	default "galp2" if BOARD_SYSTEM76_GALP2
	default "galp3" if BOARD_SYSTEM76_GALP3
	default "galp3-b" if BOARD_SYSTEM76_GALP3_B

config CBFS_SIZE
	default 0x600000

config CONSOLE_POST
	default y

config ONBOARD_VGA_IS_PRIMARY
	default y

config UART_FOR_CONSOLE
	default 2

config DIMM_MAX
	default 2

config DIMM_SPD_SIZE
	default 512

config VGA_BIOS_ID
	default "8086,5916" if BOARD_SYSTEM76_GALP2
	default "8086,5917" if BOARD_SYSTEM76_GALP3 || BOARD_SYSTEM76_GALP3_B

config POST_DEVICE
	default n

endif
```

## src/mainboard/system76/kbl-u/Kconfig.name
```kconfig
config BOARD_SYSTEM76_GALP2
	bool "galp2"

config BOARD_SYSTEM76_GALP3
	bool "galp3"

config BOARD_SYSTEM76_GALP3_B
	bool "galp3-b"
```

## src/mainboard/system76/lemp10/Kconfig
```kconfig
if BOARD_SYSTEM76_LEMP10

config BOARD_SPECIFIC_OPTIONS
	def_bool y
	select BOARD_ROMSIZE_KB_16384
	select DRIVERS_I2C_HID
	select DRIVERS_INTEL_PMC
	select DRIVERS_INTEL_USB4_RETIMER
	select EC_SYSTEM76_EC
	select EC_SYSTEM76_EC_BAT_THRESHOLDS
	select HAVE_ACPI_TABLES
	select HAVE_CMOS_DEFAULT
	select HAVE_OPTION_TABLE
	select HAVE_SPD_IN_CBFS
	select INTEL_GMA_HAVE_VBT
	select INTEL_LPSS_UART_FOR_CONSOLE
	select MEMORY_MAPPED_TPM
	select MAINBOARD_HAS_TPM2
	select NO_UART_ON_SUPERIO
	select PCIEXP_HOTPLUG
	select PCIEXP_HOTPLUG_PREFETCH_MEM_BELOW_4G
	select SOC_INTEL_TIGERLAKE
	select SOC_INTEL_COMMON_BLOCK_HDA_VERB
	select SPD_READ_BY_WORD
	select SYSTEM_TYPE_LAPTOP
	select TPM_MEASURED_BOOT
	select TPM_RDRESP_NEED_DELAY

config MAINBOARD_DIR
	default "system76/lemp10"

config MAINBOARD_PART_NUMBER
	default "lemp10"

config MAINBOARD_SMBIOS_PRODUCT_NAME
	default "Lemur Pro"

config MAINBOARD_VERSION
	default "lemp10"

config CBFS_SIZE
	default 0xA00000

config CONSOLE_POST
	default y

config POST_DEVICE
	default n

config UART_FOR_CONSOLE
	default 2

# PM Timer Disabled, saves power
config USE_PM_ACPI_TIMER
	default n

endif
```

## src/mainboard/system76/lemp9/Kconfig
```kconfig
if BOARD_SYSTEM76_LEMP9

config BOARD_SPECIFIC_OPTIONS
	def_bool y
	select BOARD_ROMSIZE_KB_16384
	select DRIVERS_I2C_HID
	select EC_SYSTEM76_EC
	select EC_SYSTEM76_EC_BAT_THRESHOLDS
	select HAVE_ACPI_RESUME
	select HAVE_ACPI_TABLES
	select HAVE_CMOS_DEFAULT
	select HAVE_OPTION_TABLE
	select HAVE_SMI_HANDLER
	select HAVE_SPD_IN_CBFS
	select INTEL_GMA_HAVE_VBT
	select INTEL_LPSS_UART_FOR_CONSOLE
	select MEMORY_MAPPED_TPM
	select MAINBOARD_HAS_TPM2
	select NO_UART_ON_SUPERIO
	select SOC_INTEL_COMETLAKE_1
	select SOC_INTEL_COMMON_BLOCK_HDA_VERB
	select SPD_READ_BY_WORD
	select SYSTEM_TYPE_LAPTOP
	select TPM_MEASURED_BOOT
	select USE_LEGACY_8254_TIMER # Fix failure to boot GRUB

config MAINBOARD_DIR
	default "system76/lemp9"

config MAINBOARD_PART_NUMBER
	default "lemp9"

config MAINBOARD_SMBIOS_PRODUCT_NAME
	string
	default "Lemur Pro"

config MAINBOARD_VERSION
	string
	default "lemp9"

config CBFS_SIZE
	default 0xc00000

config CONSOLE_POST
	bool
	default y

config UART_FOR_CONSOLE
	int
	default 2

config MAX_CPUS
	int
	default 8

config DIMM_MAX
	default 2

config VGA_BIOS_ID
	string
	default "8086,9b41"

config TPM_PIRQ
	hex
	default 0x10 # GPP_A7/PIRQA#

config POST_DEVICE
	bool
	default n

endif
```

## src/mainboard/system76/mtl/Kconfig
```kconfig
## SPDX-License-Identifier: GPL-2.0-only

config BOARD_SYSTEM76_MTL_COMMON
	def_bool n
	select BOARD_ROMSIZE_KB_32768
	select DRIVERS_GENERIC_BAYHUB_LV2
	select DRIVERS_GENERIC_CBFS_SERIAL
	select DRIVERS_GENERIC_CBFS_UUID
	select DRIVERS_I2C_HID
	select EC_SYSTEM76_EC
	select HAVE_ACPI_RESUME
	select HAVE_ACPI_TABLES
	select HAVE_CMOS_DEFAULT
	select HAVE_OPTION_TABLE
	select INTEL_GMA_HAVE_VBT
	select INTEL_LPSS_UART_FOR_CONSOLE
	select MAINBOARD_HAS_TPM2
	select MEMORY_MAPPED_TPM
	select NO_UART_ON_SUPERIO
	select PCIEXP_SUPPORT_RESIZABLE_BARS
	select SOC_INTEL_COMMON_BLOCK_HDA_VERB
	select SOC_INTEL_CRASHLOG
	select SOC_INTEL_METEORLAKE
	select SPD_READ_BY_WORD
	select SYSTEM_TYPE_LAPTOP

config BOARD_SYSTEM76_DARP10
	select BOARD_SYSTEM76_MTL_COMMON
	select MAINBOARD_USES_IFD_GBE_REGION
	select SOC_INTEL_ENABLE_USB4_PCIE_RESOURCES
	select SOC_INTEL_METEORLAKE_U_H

config BOARD_SYSTEM76_DARP10_B
	select BOARD_SYSTEM76_MTL_COMMON
	select MAINBOARD_USES_IFD_GBE_REGION
	select SOC_INTEL_ENABLE_USB4_PCIE_RESOURCES
	select SOC_INTEL_METEORLAKE_U_H

if BOARD_SYSTEM76_MTL_COMMON

config MAINBOARD_DIR
	default "system76/mtl"

config VARIANT_DIR
	default "darp10" if BOARD_SYSTEM76_DARP10 || BOARD_SYSTEM76_DARP10_B

config OVERRIDE_DEVICETREE
	default "variants/\$(CONFIG_VARIANT_DIR)/overridetree.cb"

config MAINBOARD_PART_NUMBER
	default "darp10" if BOARD_SYSTEM76_DARP10
	default "darp10-b" if BOARD_SYSTEM76_DARP10_B

config MAINBOARD_SMBIOS_PRODUCT_NAME
	default "Darter Pro" if BOARD_SYSTEM76_DARP10 || BOARD_SYSTEM76_DARP10_B

config MAINBOARD_VERSION
	default "darp10" if BOARD_SYSTEM76_DARP10
	default "darp10-b" if BOARD_SYSTEM76_DARP10_B

config CMOS_DEFAULT_FILE
	default "src/mainboard/\$(MAINBOARDDIR)/cmos.default"

config CONSOLE_POST
	default y

config D3COLD_SUPPORT
	default n

config DIMM_SPD_SIZE
	default 1024

config FMDFILE
	default "src/mainboard/\$(CONFIG_MAINBOARD_DIR)/variants/\$(CONFIG_VARIANT_DIR)/board.fmd"

config ONBOARD_VGA_IS_PRIMARY
	default y

config PCIEXP_DEFAULT_MAX_RESIZABLE_BAR_BITS
	default 36

config POST_DEVICE
	default n

config TPM_MEASURED_BOOT
	default y

config UART_FOR_CONSOLE
	default 0

# PM Timer Disabled, saves power
config USE_PM_ACPI_TIMER
	default n

endif
```

## src/mainboard/system76/mtl/Kconfig.name
```kconfig
## SPDX-License-Identifier: GPL-2.0-only

config BOARD_SYSTEM76_DARP10
	bool "darp10"

config BOARD_SYSTEM76_DARP10_B
	bool "darp10-b"

config BOARD_SYSTEM76_DARP11
	bool "darp11"

config BOARD_SYSTEM76_DARP11_B
	bool "darp11-b"

config BOARD_SYSTEM76_LEMP13
	bool "lemp13"

config BOARD_SYSTEM76_LEMP13_B
	bool "lemp13-b"
```

## src/mainboard/system76/oryp5/Kconfig
```kconfig
if BOARD_SYSTEM76_ORYP5

config BOARD_SPECIFIC_OPTIONS
	def_bool y
	select BOARD_ROMSIZE_KB_16384
	select DRIVERS_I2C_HID
	select DRIVERS_I2C_TAS5825M
	select EC_SYSTEM76_EC
	select EC_SYSTEM76_EC_COLOR_KEYBOARD
	select EC_SYSTEM76_EC_DGPU
	select HAVE_ACPI_RESUME
	select HAVE_ACPI_TABLES
	select HAVE_CMOS_DEFAULT
	select HAVE_OPTION_TABLE
	select INTEL_GMA_HAVE_VBT
	select INTEL_LPSS_UART_FOR_CONSOLE
	select MEMORY_MAPPED_TPM
	select MAINBOARD_HAS_TPM2
	select NO_UART_ON_SUPERIO
	select SOC_INTEL_CANNONLAKE_PCH_H
	select SOC_INTEL_COFFEELAKE
	select SOC_INTEL_COMMON_BLOCK_HDA_VERB
	select SPD_READ_BY_WORD
	select SYSTEM_TYPE_LAPTOP
	select TPM_MEASURED_BOOT

config MAINBOARD_DIR
	default "system76/oryp5"

config MAINBOARD_PART_NUMBER
	default "oryp5"

config MAINBOARD_SMBIOS_PRODUCT_NAME
	string
	default "Oryx Pro"

config MAINBOARD_VERSION
	string
	default "oryp5"

config CBFS_SIZE
	default 0xA00000

config CONSOLE_POST
	bool
	default y

config ONBOARD_VGA_IS_PRIMARY
	bool
	default y

config UART_FOR_CONSOLE
	int
	default 2

config DIMM_MAX
	default 2

config POST_DEVICE
	bool
	default n

endif
```

## src/mainboard/system76/oryp5/Kconfig.name
```kconfig
## SPDX-License-Identifier: GPL-2.0-only

config BOARD_SYSTEM76_ORYP5
	bool "oryp5"
```

## src/mainboard/system76/oryp6/Kconfig
```kconfig
if BOARD_SYSTEM76_ORYP6 || BOARD_SYSTEM76_ORYP7

config BOARD_SPECIFIC_OPTIONS
	def_bool y
	select BOARD_ROMSIZE_KB_16384
	select DRIVERS_I2C_HID
	select DRIVERS_I2C_TAS5825M
	select EC_SYSTEM76_EC
	select EC_SYSTEM76_EC_COLOR_KEYBOARD
	select EC_SYSTEM76_EC_DGPU
	select HAVE_ACPI_RESUME
	select HAVE_ACPI_TABLES
	select HAVE_CMOS_DEFAULT
	select HAVE_OPTION_TABLE
	select INTEL_GMA_HAVE_VBT
	select MEMORY_MAPPED_TPM
	select MAINBOARD_HAS_TPM2
	select NO_UART_ON_SUPERIO
	select PCIEXP_HOTPLUG
	select PCIEXP_HOTPLUG_PREFETCH_MEM_BELOW_4G # Fix running out of MTRRs
	select SOC_INTEL_CANNONLAKE_PCH_H
	select SOC_INTEL_COMETLAKE_1
	select SOC_INTEL_COMMON_BLOCK_HDA_VERB
	select SPD_READ_BY_WORD
	select SYSTEM_TYPE_LAPTOP
	select TPM_MEASURED_BOOT
	select TPM_RDRESP_NEED_DELAY

config MAINBOARD_DIR
	default "system76/oryp6"

config VARIANT_DIR
	default "oryp6" if BOARD_SYSTEM76_ORYP6
	default "oryp7" if BOARD_SYSTEM76_ORYP7

config OVERRIDE_DEVICETREE
	default "variants/\$(CONFIG_VARIANT_DIR)/overridetree.cb"

config MAINBOARD_PART_NUMBER
	default "oryp6" if BOARD_SYSTEM76_ORYP6
	default "oryp7" if BOARD_SYSTEM76_ORYP7

config MAINBOARD_SMBIOS_PRODUCT_NAME
	default "Oryx Pro"

config MAINBOARD_VERSION
	default "oryp6" if BOARD_SYSTEM76_ORYP6
	default "oryp7" if BOARD_SYSTEM76_ORYP7

config CBFS_SIZE
	default 0xA00000

config CONSOLE_POST
	default y

config ONBOARD_VGA_IS_PRIMARY
	default y

config MAX_CPUS
	default 16

config DIMM_MAX
	default 2

config VGA_BIOS_ID
	default "8086,9bc4"

config POST_DEVICE
	default n

endif
```

## src/mainboard/system76/oryp6/Kconfig.name
```kconfig
## SPDX-License-Identifier: GPL-2.0-only

config BOARD_SYSTEM76_ORYP6
	bool "oryp6"

config BOARD_SYSTEM76_ORYP7
	bool "oryp7"
```
