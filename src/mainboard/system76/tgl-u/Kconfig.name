## src/mainboard/system76/tgl-u/Kconfig.name
```kconfig
## SPDX-License-Identifier: GPL-2.0-only

config BOARD_SYSTEM76_DARP7
	bool "darp7"

config BOARD_SYSTEM76_GALP5
	bool "galp5"

config BOARD_SYSTEM76_LEMP10
	bool "lemp10"
```

## src/mainboard/system76/whl-u/Kconfig
```kconfig
if BOARD_SYSTEM76_GALP3_C || BOARD_SYSTEM76_DARP5

config BOARD_SPECIFIC_OPTIONS
	def_bool y
	select BOARD_ROMSIZE_KB_16384
	select DRIVERS_I2C_HID
	select EC_SYSTEM76_EC
	select EC_SYSTEM76_EC_COLOR_KEYBOARD if BOARD_SYSTEM76_DARP5
	select HAVE_ACPI_RESUME
	select HAVE_ACPI_TABLES
	select HAVE_CMOS_DEFAULT
	select HAVE_OPTION_TABLE
	select INTEL_GMA_HAVE_VBT
	select INTEL_LPSS_UART_FOR_CONSOLE
	select MEMORY_MAPPED_TPM
	select MAINBOARD_HAS_TPM2
	select NO_UART_ON_SUPERIO
	select PCIEXP_HOTPLUG
	select PCIEXP_HOTPLUG_PREFETCH_MEM_BELOW_4G # Fix running out of MTRRs
	select SOC_INTEL_COMMON_BLOCK_HDA_VERB
	select SOC_INTEL_WHISKEYLAKE
	select SPD_READ_BY_WORD
	select SYSTEM_TYPE_LAPTOP
	select TPM_MEASURED_BOOT

config MAINBOARD_DIR
	default "system76/whl-u"

config VARIANT_DIR
	default "galp3-c" if BOARD_SYSTEM76_GALP3_C
	default "darp5" if BOARD_SYSTEM76_DARP5

config OVERRIDE_DEVICETREE
	default "variants/\$(CONFIG_VARIANT_DIR)/overridetree.cb"

config MAINBOARD_PART_NUMBER
	default "galp3-c" if BOARD_SYSTEM76_GALP3_C
	default "darp5" if BOARD_SYSTEM76_DARP5

config MAINBOARD_SMBIOS_PRODUCT_NAME
	string
	default "Galago Pro" if BOARD_SYSTEM76_GALP3_C
	default "Darter Pro" if BOARD_SYSTEM76_DARP5

config MAINBOARD_VERSION
	string
	default "galp3-c" if BOARD_SYSTEM76_GALP3_C
	default "darp5" if BOARD_SYSTEM76_DARP5

config CBFS_SIZE
	default 0xA00000

config CONSOLE_POST
	bool
	default y

config ONBOARD_VGA_IS_PRIMARY
	bool
	default y

config UART_FOR_CONSOLE
	int
	default 2

config MAX_CPUS
	int
	default 8

config DIMM_MAX
	default 2

config POST_DEVICE
	bool
	default n

endif
```

## src/mainboard/system76/whl-u/Kconfig.name
```kconfig
## SPDX-License-Identifier: GPL-2.0-only

config BOARD_SYSTEM76_GALP3_C
	bool "galp3-c"

config BOARD_SYSTEM76_DARP5
	bool "darp5"
```

## src/mainboard/technexion/Kconfig
```kconfig
if VENDOR_TECHNEXION

choice
	prompt "Mainboard model"

source "src/mainboard/technexion/*/Kconfig.name"

endchoice

source "src/mainboard/technexion/*/Kconfig"

config MAINBOARD_VENDOR
	string
	default "Technexion"

endif # VENDOR_TECHNEXION
```

## src/mainboard/technexion/tim5690/Kconfig
```kconfig
if BOARD_TECHNEXION_TIM5690

config BOARD_SPECIFIC_OPTIONS # dummy
	def_bool y
	select ARCH_X86
	select CPU_AMD_SOCKET_S1G1
	select NORTHBRIDGE_AMD_AMDK8
	select SOUTHBRIDGE_AMD_RS690
	select SOUTHBRIDGE_AMD_SB600
	select SUPERIO_ITE_IT8712F
	select HAVE_OPTION_TABLE
	select HAVE_PIRQ_TABLE
	select HAVE_MP_TABLE
	select SB_HT_CHAIN_UNITID_OFFSET_ONLY
	select HAVE_ACPI_TABLES
	select GFXUMA
	select BOARD_ROMSIZE_KB_512
	select RAMINIT_SYSINFO
	select QRANK_DIMM_SUPPORT
	select SET_FIDVID

config MAINBOARD_DIR
	string
	default technexion/tim5690

config APIC_ID_OFFSET
	hex
	default 0x0

config MAINBOARD_PART_NUMBER
	string
	default "TIM-5690"

config MAX_CPUS
	int
	default 2

config MAX_PHYSICAL_CPUS
	int
	default 1

config SB_HT_CHAIN_ON_BUS0
	int
	default 1

config HT_CHAIN_END_UNITID_BASE
	hex
	default 0x1

config HT_CHAIN_UNITID_BASE
	hex
	default 0x0

config IRQ_SLOT_COUNT
	int
	default 11

config HEAP_SIZE
	hex
	default 0x4000

endif # BOARD_TECHNEXION_TIM5690
```

## src/mainboard/technexion/tim8690/Kconfig
```kconfig
if BOARD_TECHNEXION_TIM8690

config BOARD_SPECIFIC_OPTIONS # dummy
	def_bool y
	select ARCH_X86
	select CPU_AMD_SOCKET_S1G1
	select NORTHBRIDGE_AMD_AMDK8
	select NORTHBRIDGE_AMD_AMDK8_ROOT_COMPLEX
	select SOUTHBRIDGE_AMD_RS690
	select SOUTHBRIDGE_AMD_SB600
	select SUPERIO_ITE_IT8712F
	select BOARD_HAS_FADT
	select HAVE_BUS_CONFIG
	select HAVE_OPTION_TABLE
	select HAVE_PIRQ_TABLE
	select HAVE_MP_TABLE
	select USE_DCACHE_RAM
	select HAVE_HARD_RESET
	select SB_HT_CHAIN_UNITID_OFFSET_ONLY
	select WAIT_BEFORE_CPUS_INIT
	select HAVE_ACPI_TABLES
	select BOARD_ROMSIZE_KB_512

config MAINBOARD_DIR
	string
	default technexion/tim8690

config DCACHE_RAM_BASE
	hex
	default 0xc8000

config DCACHE_RAM_SIZE
	hex
	default 0x08000

config DCACHE_RAM_GLOBAL_VAR_SIZE
	hex
	default 0x01000

config APIC_ID_OFFSET
	hex
	default 0x0

config MAINBOARD_PART_NUMBER
	string
	default "TIM-8690"

config HW_MEM_HOLE_SIZEK
	hex
	default 0x100000

config MAX_CPUS
	int
	default 2

config MAX_PHYSICAL_CPUS
	int
	default 1

config HW_MEM_HOLE_SIZE_AUTO_INC
	bool
	default n

config SB_HT_CHAIN_ON_BUS0
	int
	default 1

config HT_CHAIN_END_UNITID_BASE
	hex
	default 0x1

config HT_CHAIN_UNITID_BASE
	hex
	default 0x0

config IRQ_SLOT_COUNT
	int
	default 11

config MAINBOARD_PCI_SUBSYSTEM_VENDOR_ID
	hex
	default 0x1022

config MAINBOARD_PCI_SUBSYSTEM_DEVICE_ID
	hex
	default 0x3050

endif # BOARD_TECHNEXION_TIM8690
```

## src/mainboard/technologic/Kconfig
```kconfig
if VENDOR_TECHNOLOGIC

choice
	prompt "Mainboard model"

config BOARD_TECHNOLOGIC_TS5300
	bool "TS-5300"

endchoice

source "src/mainboard/technologic/ts5300/Kconfig"

config MAINBOARD_VENDOR
	string
	default "Technologic"

endif # VENDOR_TECHNOLOGIC
```

## src/mainboard/technologic/ts5300/Kconfig
```kconfig
if BOARD_TECHNOLOGIC_TS5300

config BOARD_SPECIFIC_OPTIONS # dummy
	def_bool y
	select ARCH_X86
	select CPU_AMD_SC520
	select ROMCC
	select HAVE_OPTION_TABLE
	select HAVE_PIRQ_TABLE
	select BOARD_ROMSIZE_KB_1024

config MAINBOARD_DIR
	string
	default technologic/ts5300

config MAINBOARD_PART_NUMBER
	string
	default "TS-5300"

config IRQ_SLOT_COUNT
	int
	default 2

endif # BOARD_TECHNOLOGIC_TS5300
```

## src/mainboard/thomson/Kconfig
```kconfig
if VENDOR_THOMSON

choice
	prompt "Mainboard model"

source "src/mainboard/thomson/*/Kconfig.name"

endchoice

source "src/mainboard/thomson/*/Kconfig"

config MAINBOARD_VENDOR
	string
	default "Thomson"

endif # VENDOR_THOMSON
```

## src/mainboard/thomson/ip1000/Kconfig
```kconfig
if BOARD_THOMSON_IP1000

config BOARD_SPECIFIC_OPTIONS # dummy
	def_bool y
	select ARCH_X86
	select CPU_INTEL_SOCKET_MFCBGA479
	select NORTHBRIDGE_INTEL_I82830
	select SOUTHBRIDGE_INTEL_I82801DX
	select SUPERIO_SMSC_SMSCSUPERIO
	select HAVE_PIRQ_TABLE
	select UDELAY_TSC
	select BOARD_ROMSIZE_KB_512
	select GFXUMA

config MAINBOARD_DIR
	string
	default thomson/ip1000

config MAINBOARD_PART_NUMBER
	string
	default "IP1000"

config DCACHE_RAM_BASE
	hex
	default 0xffdf8000

config DCACHE_RAM_SIZE
	hex
	default 0x8000

config IRQ_SLOT_COUNT
	int
	default 7

choice
	prompt "IP1000 Onboard Memory"
	default ONBOARD_MEMORY_64MB

config ONBOARD_MEMORY_64MB
	bool "IP1000-64MB"
config ONBOARD_MEMORY_128MB
	bool "IP1000T-128MB"

endchoice

endif # BOARD_THOMSON_IP1000
```

## src/mainboard/ti/Kconfig
```kconfig
## SPDX-License-Identifier: GPL-2.0-only

if VENDOR_TI

# Auto select common options
choice
	prompt "Mainboard model"

source "src/mainboard/ti/*/Kconfig.name"

endchoice

source "src/mainboard/ti/*/Kconfig"

config MAINBOARD_VENDOR
	default "TI"

endif # VENDOR_TI
```

## src/mainboard/ti/beaglebone/Kconfig
```kconfig
## SPDX-License-Identifier: GPL-2.0-only

if BOARD_TI_BEAGLEBONE

config BOARD_SPECIFIC_OPTIONS
	def_bool y
	select SOC_TI_AM335X
	select BOARD_ROMSIZE_KB_32768
	select MISSING_BOARD_RESET
	select COMMONLIB_STORAGE
	select COMMONLIB_STORAGE_SD

config MAINBOARD_DIR
	string
	default "ti/beaglebone"

config MAINBOARD_PART_NUMBER
	string
	default "Beaglebone"

config MAX_CPUS
	int
	default 1

config DRAM_SIZE_MB
	int
	default 256

config UART_FOR_CONSOLE
	int
	default 0

config FMDFILE
	string
	default "src/mainboard/$(CONFIG_MAINBOARD_DIR)/board.fmd"

endif # BOARD_TI_BEAGLEBONE
```

## src/mainboard/topton/Kconfig
```kconfig
## SPDX-License-Identifier: GPL-2.0-or-later

if VENDOR_TOPTON

choice
	prompt "Mainboard model"

source "src/mainboard/topton/*/Kconfig.name"

endchoice

source "src/mainboard/topton/*/Kconfig"

config MAINBOARD_VENDOR
	default "TOPTON"

endif # VENDOR_TOPTON
```

## src/mainboard/topton/Kconfig.name
```kconfig
## SPDX-License-Identifier: GPL-2.0-or-later

config VENDOR_TOPTON
	bool "Topton"
```

## src/mainboard/topton/adl/Kconfig
```kconfig
## SPDX-License-Identifier: GPL-2.0-or-later

if BOARD_TOPTON_X2F_N100

config BOARD_SPECIFIC_OPTIONS
	def_bool y
	select BOARD_ROMSIZE_KB_16384
	select FSP_TYPE_IOT
	select HAVE_ACPI_TABLES
	select HAVE_ACPI_RESUME
	select SUPERIO_ITE_IT8625E
	select DRIVERS_UART_8250IO
	select SOC_INTEL_ALDERLAKE_PCH_N
	select INTEL_GMA_HAVE_VBT
	select SOC_INTEL_COMMON_BLOCK_HDA_VERB

config MAINBOARD_DIR
	default "topton/adl"

config MAINBOARD_PART_NUMBER
	default "X2F_N100"

endif # BOARD_TOPTON_X2F_N100
```

## src/mainboard/topton/adl/Kconfig.name
```kconfig
## SPDX-License-Identifier: GPL-2.0-or-later

config BOARD_TOPTON_X2F_N100
	bool "X2F_N100"
```

## src/mainboard/traverse/Kconfig
```kconfig
if VENDOR_TRAVERSE

choice
	prompt "Mainboard model"

source "src/mainboard/traverse/*/Kconfig.name"

endchoice

source "src/mainboard/traverse/*/Kconfig"

config MAINBOARD_VENDOR
	string
	default "Traverse Technologies"

endif # VENDOR_TRAVERSE
```
