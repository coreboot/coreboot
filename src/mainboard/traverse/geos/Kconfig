## src/mainboard/traverse/geos/Kconfig
```kconfig
if BOARD_TRAVERSE_GEOS

config BOARD_SPECIFIC_OPTIONS # dummy
	def_bool y
	select ARCH_X86
	select CPU_AMD_GEODE_LX
	select NORTHBRIDGE_AMD_LX
	select SOUTHBRIDGE_AMD_CS5536
	select HAVE_PIRQ_TABLE
	select PIRQ_ROUTE
	select UDELAY_TSC
	select BOARD_ROMSIZE_KB_1024
	select POWER_BUTTON_DEFAULT_DISABLE
	select PLL_MANUAL_CONFIG
	select CORE_GLIU_500_400

config MAINBOARD_DIR
	string
	default traverse/geos

config MAINBOARD_PART_NUMBER
	string
	default "Geos"

config IRQ_SLOT_COUNT
	int
	default 6

config PLLMSRlo
        hex
        default 0x00de602e

endif # BOARD_TRAVERSE_GEOS
```

## src/mainboard/tyan/Kconfig
```kconfig
##
## This file is part of the coreboot project.
##
## Copyright (C) 2009 Uwe Hermann <uwe@hermann-uwe.de>
##
## This program is free software; you can redistribute it and/or modify
## it under the terms of the GNU General Public License as published by
## the Free Software Foundation; version 2 of the License.
##
## This program is distributed in the hope that it will be useful,
## but WITHOUT ANY WARRANTY; without even the implied warranty of
## MERCHANTABILITY or FITNESS FOR A PARTICULAR PURPOSE.  See the
## GNU General Public License for more details.
##
## You should have received a copy of the GNU General Public License
## along with this program; if not, write to the Free Software
## Foundation, Inc., 51 Franklin St, Fifth Floor, Boston, MA 02110-1301 USA
##
if VENDOR_TYAN

choice
	prompt "Mainboard model"

config BOARD_TYAN_S1846
	bool "S1846 (Tsunami ATX)"
config BOARD_TYAN_S2735
	bool "S2735 (Tiger i7501R)"
config BOARD_TYAN_S2850
	bool "S2850 (Tomcat K8S)"
config BOARD_TYAN_S2875
	bool "S2875 (Tiger K8W)"
config BOARD_TYAN_S2880
	bool "S2880 (Thunder K8S)"
config BOARD_TYAN_S2881
	bool "S2881 (Thunder K8SR)"
config BOARD_TYAN_S2882
	bool "S2882 (Thunder K8S Pro)"
config BOARD_TYAN_S2885
	bool "S2885 (Thunder K8W)"
config BOARD_TYAN_S2891
	bool "S2891 (Thunder K8SRE)"
config BOARD_TYAN_S2892
	bool "S2892 (Thunder K8SE)"
config BOARD_TYAN_S2895
	bool "S2895 (Thunder K8WE)"
config BOARD_TYAN_S2912
	bool "S2912 (Thunder n3600R)"
config BOARD_TYAN_S2912_FAM10
	bool "S2912 Fam10 (Thunder n3600R)"
config BOARD_TYAN_S4880
	bool "S4880 (Thunder K8QS)"
config BOARD_TYAN_S4882
	bool "S4882 (Thunder K8QS Pro)"
config BOARD_TYAN_S8226
        bool "S8226"
endchoice

source "src/mainboard/tyan/s1846/Kconfig"
source "src/mainboard/tyan/s2735/Kconfig"
source "src/mainboard/tyan/s2850/Kconfig"
source "src/mainboard/tyan/s2875/Kconfig"
source "src/mainboard/tyan/s2880/Kconfig"
source "src/mainboard/tyan/s2881/Kconfig"
source "src/mainboard/tyan/s2882/Kconfig"
source "src/mainboard/tyan/s2885/Kconfig"
source "src/mainboard/tyan/s2891/Kconfig"
source "src/mainboard/tyan/s2892/Kconfig"
source "src/mainboard/tyan/s2895/Kconfig"
source "src/mainboard/tyan/s2912/Kconfig"
source "src/mainboard/tyan/s2912_fam10/Kconfig"
source "src/mainboard/tyan/s4880/Kconfig"
source "src/mainboard/tyan/s4882/Kconfig"
source "src/mainboard/tyan/s8226/Kconfig"

config MAINBOARD_VENDOR
	string
	default "Tyan"

endif # VENDOR_TYAN
```

## src/mainboard/tyan/s1846/Kconfig
```kconfig
##
## This file is part of the coreboot project.
##
## Copyright (C) 2009 Uwe Hermann <uwe@hermann-uwe.de>
##
## This program is free software; you can redistribute it and/or modify
## it under the terms of the GNU General Public License as published by
## the Free Software Foundation; version 2 of the License.
##
## This program is distributed in the hope that it will be useful,
## but WITHOUT ANY WARRANTY; without even the implied warranty of
## MERCHANTABILITY or FITNESS FOR A PARTICULAR PURPOSE.  See the
## GNU General Public License for more details.
##
## You should have received a copy of the GNU General Public License
## along with this program; if not, write to the Free Software
## Foundation, Inc., 51 Franklin St, Fifth Floor, Boston, MA 02110-1301 USA
##
if BOARD_TYAN_S1846

config BOARD_SPECIFIC_OPTIONS # dummy
	def_bool y
	select ARCH_X86
	select CPU_INTEL_SLOT_1
	select NORTHBRIDGE_INTEL_I440BX
	select SOUTHBRIDGE_INTEL_I82371EB
	select SUPERIO_NSC_PC87309
	select UDELAY_TSC
	select BOARD_ROMSIZE_KB_256

config MAINBOARD_DIR
	string
	default tyan/s1846

config MAINBOARD_PART_NUMBER
	string
	default "S1846"

endif # BOARD_TYAN_S1846
```

## src/mainboard/tyan/s2735/Kconfig
```kconfig
if BOARD_TYAN_S2735

config BOARD_SPECIFIC_OPTIONS # dummy
	def_bool y
	select ARCH_X86
	select CPU_INTEL_SOCKET_MPGA604
	select NORTHBRIDGE_INTEL_E7501
	select SOUTHBRIDGE_INTEL_I82870
	select SOUTHBRIDGE_INTEL_I82801EX
	select SUPERIO_WINBOND_W83627HF
	select HAVE_PIRQ_TABLE
	select HAVE_MP_TABLE
	select UDELAY_TSC
	select HAVE_OPTION_TABLE
	select CACHE_AS_RAM
	select USE_WATCHDOG_ON_BOOT
	select BOARD_ROMSIZE_KB_512

config MAINBOARD_DIR
	string
	default tyan/s2735

config DCACHE_RAM_BASE
	hex
	default 0xcf000

config DCACHE_RAM_SIZE
	hex
	default 0x1000

config MAINBOARD_PART_NUMBER
	string
	default "S2735"

config IRQ_SLOT_COUNT
	int
	default 15

config MAX_CPUS
	int
	default 4

endif # BOARD_TYAN_S2735
```

## src/mainboard/tyan/s2850/Kconfig
```kconfig
config BOARD_TYAN_S2850
	bool "S2850 (Tomcat K8S)"
	select ARCH_X86
	select CPU_AMD_SOCKET_940
	select NORTHBRIDGE_AMD_AMDK8
	select NORTHBRIDGE_AMD_AMDK8_ROOT_COMPLEX
	select SOUTHBRIDGE_AMD_AMD8111
	select SUPERIO_WINBOND_W83627HF
	select HAVE_HARD_RESET
	select HAVE_PIRQ_TABLE
	select HAVE_MP_TABLE
	select BOARD_ROMSIZE_KB_512

config MAINBOARD_DIR
	string
	default tyan/s2850
	depends on BOARD_TYAN_S2850

config MAINBOARD_PART_NUMBER
	string
	default "S2850"
	depends on BOARD_TYAN_S2850

config MAINBOARD_PCI_SUBSYSTEM_DEVICE_ID
	hex
	default 0x2850
	depends on BOARD_TYAN_S2850

config HW_MEM_HOLE_SIZEK
	hex
	default 0x100000
	depends on BOARD_TYAN_S2850

config MAX_CPUS
	int
	default 2
	depends on BOARD_TYAN_S2850

config MAX_PHYSICAL_CPUS
	int
	default 1
	depends on BOARD_TYAN_S2850

config USE_INIT
	bool
	default n
	depends on BOARD_TYAN_S2850

config IRQ_SLOT_COUNT
	int
	default 12
	depends on BOARD_TYAN_S2850

config HT_CHAIN_UNITID_BASE
	hex
	default 1
	depends on BOARD_TYAN_S2850

config HT_CHAIN_END_UNITID_BASE
	hex
	default 0x20
	depends on BOARD_TYAN_S2850

config SB_HT_CHAIN_UNITID_OFFSET_ONLY
	bool
	default y
	depends on BOARD_TYAN_S2850

config SB_HT_CHAIN_ON_BUS0
	int
	default 0
	depends on BOARD_TYAN_S2850

config APIC_ID_OFFSET
	hex
	default 0x0
	depends on BOARD_TYAN_S2850
```

## src/mainboard/tyan/s2875/Kconfig
```kconfig
if BOARD_TYAN_S2875

config BOARD_SPECIFIC_OPTIONS # dummy
	def_bool y
	select ARCH_X86
	select CPU_AMD_SOCKET_940
	select NORTHBRIDGE_AMD_AMDK8
	select SOUTHBRIDGE_AMD_AMD8151
	select SOUTHBRIDGE_AMD_AMD8111
	select SUPERIO_WINBOND_W83627HF
	select HAVE_OPTION_TABLE
	select HAVE_PIRQ_TABLE
	select HAVE_MP_TABLE
	select BOARD_ROMSIZE_KB_512
	select SB_HT_CHAIN_UNITID_OFFSET_ONLY
	select QRANK_DIMM_SUPPORT

config MAINBOARD_DIR
	string
	default tyan/s2875

config MAINBOARD_PART_NUMBER
	string
	default "S2875"

config MAX_CPUS
	int
	default 4

config MAX_PHYSICAL_CPUS
	int
	default 2

config IRQ_SLOT_COUNT
	int
	default 13

config HT_CHAIN_UNITID_BASE
	hex
	default 1

config HT_CHAIN_END_UNITID_BASE
	hex
	default 0x20

config SB_HT_CHAIN_ON_BUS0
	int
	default 0

config APIC_ID_OFFSET
	hex
	default 0x0

endif # BOARD_TYAN_S2875
```

## src/mainboard/tyan/s2880/Kconfig
```kconfig
config BOARD_TYAN_S2880
	bool "S2880 (Thunder K8S)"
	select ARCH_X86
	select CPU_AMD_SOCKET_940
	select NORTHBRIDGE_AMD_AMDK8
	select NORTHBRIDGE_AMD_AMDK8_ROOT_COMPLEX
	select SOUTHBRIDGE_AMD_AMD8131
	select SOUTHBRIDGE_AMD_AMD8111
	select SUPERIO_WINBOND_W83627HF
	select HAVE_PIRQ_TABLE
	select HAVE_MP_TABLE
	select BOARD_ROMSIZE_KB_512
	select SB_HT_CHAIN_UNITID_OFFSET_ONLY

config MAINBOARD_DIR
	string
	default tyan/s2880
	depends on BOARD_TYAN_S2880

config APIC_ID_OFFSET
	hex
	default 0x0
	depends on BOARD_TYAN_S2880

config SB_HT_CHAIN_ON_BUS0
	int
	default 0
	depends on BOARD_TYAN_S2880

config LB_CKS_RANGE_END
	int
	default 122
	depends on BOARD_TYAN_S2880

config LB_CKS_LOC
	int
        default 123
	depends on BOARD_TYAN_S2880

config MAINBOARD_PART_NUMBER
	string
	default "S2880"
	depends on BOARD_TYAN_S2880

config MAINBOARD_PCI_SUBSYSTEM_DEVICE_ID
	hex
	default 0x2880
	depends on BOARD_TYAN_S2880

config HW_MEM_HOLE_SIZEK
	hex
	default 0x100000
	depends on BOARD_TYAN_S2880

config MAX_CPUS
	int
	default 2
	depends on BOARD_TYAN_S2880

config MAX_PHYSICAL_CPUS
	int
	default 2
	depends on BOARD_TYAN_S2880

config HW_MEM_HOLE_SIZE_AUTO_INC
	bool
	default n
	depends on BOARD_TYAN_S2880

config HT_CHAIN_UNITID_BASE
	hex
	default 0x1
	depends on BOARD_TYAN_S2880

config HT_CHAIN_END_UNITID_BASE
	hex
	default 0x20
	depends on BOARD_TYAN_S2880

config USE_INIT
	bool
	default n
	depends on BOARD_TYAN_S2880

config WAIT_BEFORE_CPUS_INIT
	bool
	default n
	depends on BOARD_TYAN_S2880

config IRQ_SLOT_COUNT
	int
	default 13
	depends on BOARD_TYAN_S2880
```

## src/mainboard/tyan/s2881/Kconfig
```kconfig
config BOARD_TYAN_S2881
	bool "S2881 (Thunder K8SR)"
	select ARCH_X86
	select CPU_AMD_SOCKET_940
	select NORTHBRIDGE_AMD_AMDK8
	select NORTHBRIDGE_AMD_AMDK8_ROOT_COMPLEX
	select SOUTHBRIDGE_AMD_AMD8131
	select SOUTHBRIDGE_AMD_AMD8111
	select SUPERIO_WINBOND_W83627HF
	select HAVE_PIRQ_TABLE
	select HAVE_MP_TABLE
	select BOARD_ROMSIZE_KB_512
	select SB_HT_CHAIN_UNITID_OFFSET_ONLY

config MAINBOARD_DIR
	string
	default tyan/s2881
	depends on BOARD_TYAN_S2881

config APIC_ID_OFFSET
	hex
	default 0x0
	depends on BOARD_TYAN_S2881

config SB_HT_CHAIN_ON_BUS0
	int
	default 0
	depends on BOARD_TYAN_S2881

config LB_CKS_RANGE_END
	int
	default 122
	depends on BOARD_TYAN_S2881

config LB_CKS_LOC
	int
        default 123
	depends on BOARD_TYAN_S2881

config MAINBOARD_PART_NUMBER
	string
	default "S2881"
	depends on BOARD_TYAN_S2881

config MAINBOARD_PCI_SUBSYSTEM_DEVICE_ID
	hex
	default 0x2881
	depends on BOARD_TYAN_S2881

config HW_MEM_HOLE_SIZEK
	hex
	default 0x100000
	depends on BOARD_TYAN_S2881

config MAX_CPUS
	int
	default 4
	depends on BOARD_TYAN_S2881

config MAX_PHYSICAL_CPUS
	int
	default 2
	depends on BOARD_TYAN_S2881

config HW_MEM_HOLE_SIZE_AUTO_INC
	bool
	default n
	depends on BOARD_TYAN_S2881

config HT_CHAIN_UNITID_BASE
	hex
	default 0xa
	depends on BOARD_TYAN_S2881

config HT_CHAIN_END_UNITID_BASE
	hex
	default 0x6
	depends on BOARD_TYAN_S2881

config USE_INIT
	bool
	default n
	depends on BOARD_TYAN_S2881

config WAIT_BEFORE_CPUS_INIT
	bool
	default n
	depends on BOARD_TYAN_S2881

config IRQ_SLOT_COUNT
	int
	default 9
	depends on BOARD_TYAN_S2881
```

## src/mainboard/tyan/s2882/Kconfig
```kconfig
config BOARD_TYAN_S2882
	bool "S2882 (Thunder K8S Pro)"
	select ARCH_X86
	select CPU_AMD_SOCKET_940
	select NORTHBRIDGE_AMD_AMDK8
	select NORTHBRIDGE_AMD_AMDK8_ROOT_COMPLEX
	select SOUTHBRIDGE_AMD_AMD8131
	select SOUTHBRIDGE_AMD_AMD8111
	select SUPERIO_WINBOND_W83627HF
	select HAVE_HARD_RESET
	select HAVE_PIRQ_TABLE
	select HAVE_MP_TABLE
	select BOARD_ROMSIZE_KB_512
	select SB_HT_CHAIN_UNITID_OFFSET_ONLY
	select DRIVERS_SIL

config MAINBOARD_DIR
	string
	default tyan/s2882
	depends on BOARD_TYAN_S2882

config APIC_ID_OFFSET
	hex
	default 0x0
	depends on BOARD_TYAN_S2882

config SB_HT_CHAIN_ON_BUS0
	int
	default 0
	depends on BOARD_TYAN_S2882

config MAINBOARD_PART_NUMBER
	string
	default "S2882"
	depends on BOARD_TYAN_S2882

config MAINBOARD_PCI_SUBSYSTEM_DEVICE_ID
	hex
	default 0x2882
	depends on BOARD_TYAN_S2882

config HW_MEM_HOLE_SIZEK
	hex
	default 0x100000
	depends on BOARD_TYAN_S2882

config MAX_CPUS
	int
	default 4
	depends on BOARD_TYAN_S2882

config MAX_PHYSICAL_CPUS
	int
	default 2
	depends on BOARD_TYAN_S2882

config HW_MEM_HOLE_SIZE_AUTO_INC
	bool
	default n
	depends on BOARD_TYAN_S2882

config HT_CHAIN_UNITID_BASE
	hex
	default 0x1
	depends on BOARD_TYAN_S2882

config HT_CHAIN_END_UNITID_BASE
	hex
	default 0x20
	depends on BOARD_TYAN_S2882

config IRQ_SLOT_COUNT
	int
	default 15
	depends on BOARD_TYAN_S2882
```

## src/mainboard/tyan/s2885/Kconfig
```kconfig
config BOARD_TYAN_S2885
	bool "S2885 (Thunder K8W)"
	select ARCH_X86
	select CPU_AMD_SOCKET_940
	select NORTHBRIDGE_AMD_AMDK8
	select NORTHBRIDGE_AMD_AMDK8_ROOT_COMPLEX
	select SOUTHBRIDGE_AMD_AMD8131
	select SOUTHBRIDGE_AMD_AMD8111
	select SUPERIO_WINBOND_W83627HF
	select HAVE_BUS_CONFIG
	select HAVE_HARD_RESET
	select HAVE_PIRQ_TABLE
	select HAVE_MP_TABLE
	select BOARD_ROMSIZE_KB_512
	select SB_HT_CHAIN_UNITID_OFFSET_ONLY

config MAINBOARD_DIR
	string
	default tyan/s2885
	depends on BOARD_TYAN_S2885

config APIC_ID_OFFSET
	hex
	default 0x10
	depends on BOARD_TYAN_S2885

config SB_HT_CHAIN_ON_BUS0
	int
	default 2
	depends on BOARD_TYAN_S2885

config LB_CKS_RANGE_END
	int
	default 122
	depends on BOARD_TYAN_S2885

config LB_CKS_LOC
	int
        default 123
	depends on BOARD_TYAN_S2885

config MAINBOARD_PART_NUMBER
	string
	default "S2885"
	depends on BOARD_TYAN_S2885

config MAINBOARD_PCI_SUBSYSTEM_DEVICE_ID
	hex
	default 0x2885
	depends on BOARD_TYAN_S2885

config HW_MEM_HOLE_SIZEK
	hex
	default 0x100000
	depends on BOARD_TYAN_S2885

config MAX_CPUS
	int
	default 4
	depends on BOARD_TYAN_S2885

config MAX_PHYSICAL_CPUS
	int
	default 2
	depends on BOARD_TYAN_S2885

config HW_MEM_HOLE_SIZE_AUTO_INC
	bool
	default n
	depends on BOARD_TYAN_S2885

config HT_CHAIN_UNITID_BASE
	hex
	default 0xa
	depends on BOARD_TYAN_S2885

config HT_CHAIN_END_UNITID_BASE
	hex
	default 0x6
	depends on BOARD_TYAN_S2885

config USE_INIT
	bool
	default n
	depends on BOARD_TYAN_S2885

config IRQ_SLOT_COUNT
	int
	default 11
	depends on BOARD_TYAN_S2885
```

## src/mainboard/tyan/s2891/Kconfig
```kconfig
if BOARD_TYAN_S2891

config BOARD_SPECIFIC_OPTIONS # dummy
	def_bool y
	select ARCH_X86
	select CPU_AMD_SOCKET_940
	select NORTHBRIDGE_AMD_AMDK8
	select SOUTHBRIDGE_NVIDIA_CK804
	select SOUTHBRIDGE_AMD_AMD8131
	select SUPERIO_WINBOND_W83627HF
	select HAVE_OPTION_TABLE
	select HAVE_PIRQ_TABLE
	select HAVE_MP_TABLE
	select SERIAL_CPU_INIT
	select HAVE_ACPI_TABLES
	select BOARD_ROMSIZE_KB_512
	select SB_HT_CHAIN_UNITID_OFFSET_ONLY
	select QRANK_DIMM_SUPPORT

config MAINBOARD_DIR
	string
	default tyan/s2891

config APIC_ID_OFFSET
	hex
	default 0x10

config SB_HT_CHAIN_ON_BUS0
	int
	default 2

config MAINBOARD_PART_NUMBER
	string
	default "S2891"

config MAX_CPUS
	int
	default 4

config MAX_PHYSICAL_CPUS
	int
	default 2

config HT_CHAIN_UNITID_BASE
	hex
	default 0

config HT_CHAIN_END_UNITID_BASE
	hex
	default 0x20

config IRQ_SLOT_COUNT
	int
	default 11

endif # BOARD_TYAN_S2891
```
