## src/mainboard/tyan/s2892/Kconfig
```kconfig
config BOARD_TYAN_S2892
	bool "Tyan Thunder K8SE S2892"
	select ARCH_X86
	select CPU_AMD_K8
	select CPU_AMD_SOCKET_940
	select NORTHBRIDGE_AMD_AMDK8
	select NORTHBRIDGE_AMD_AMDK8_ROOT_COMPLEX
	select SOUTHBRIDGE_NVIDIA_CK804
	select SOUTHBRIDGE_AMD_AMD8131
	select SUPERIO_WINBOND_W83627HF
	select PIRQ_TABLE

config MAINBOARD_DIR
	string
	default tyan/s2892
	depends on BOARD_TYAN_S2892

config APIC_ID_OFFSET
	hex
	default 0x10
	depends on BOARD_TYAN_S2892

config SB_HT_CHAIN_ON_BUS0
	int
	default 2
	depends on BOARD_TYAN_S2892

config LB_CKS_RANGE_END
	int
	default 122
	depends on BOARD_TYAN_S2892

config LB_CKS_LOC
	int
        default 123
	depends on BOARD_TYAN_S2892

config MAINBOARD_PART_NUMBER
	string
	default "s2892"
	depends on BOARD_TYAN_S2892

config MAINBOARD_PCI_SUBSYSTEM_DEVICE_ID
	hex
	default 0x2892
	depends on BOARD_TYAN_S2892

config USE_FAILOVER_IMAGE
	bool
	default n
	depends on BOARD_TYAN_S2892

config HW_MEM_HOLE_SIZEK
	hex
	default 0x100000
	depends on BOARD_TYAN_S2892

config MEM_TRAIN_SEQ
	bool
	default n
	depends on BOARD_TYAN_S2892

config HAVE_FAILOVER_BOOT
	bool
	default n
	depends on BOARD_TYAN_S2892

config USE_FAILOVER_IMAGE
	bool
	default n
	depends on BOARD_TYAN_S2892

config MAX_CPUS
	int
	default 4
	depends on BOARD_TYAN_S2892

config MAX_PHYSICAL_CPUS
	int
	default 2
	depends on BOARD_TYAN_S2892

config MEM_TRAIN_SEQ
	bool
	default n
	depends on BOARD_TYAN_S2892

config AP_CODE_IN_CAR
	bool
	default n
	depends on BOARD_TYAN_S2892

config HW_MEM_HOLE_SIZE_AUTO_INC
	bool
	default n
	depends on BOARD_TYAN_S2892

config HT_CHAIN_UNITID_BASE
	hex
	default 0
	depends on BOARD_TYAN_S2892

config HT_CHAIN_END_UNITID_BASE
	hex
	default 0x20
	depends on BOARD_TYAN_S2892

config USE_INIT
	bool
	default n
	depends on BOARD_TYAN_S2892

config SERIAL_CPU_INIT
	bool
	default y
	depends on BOARD_TYAN_S2892

config AP_CODE_IN_CAR
	bool
	default y
	depends on BOARD_TYAN_S2892

config WAIT_BEFORE_CPUS_INIT
	bool
	default n
	depends on BOARD_TYAN_S2892

config SB_HT_CHAIN_ON_BUS0
	int
	default 2
	depends on BOARD_TYAN_S2892

config SB_HT_CHAIN_UNITID_OFFSET_ONLY
	bool
	default n
	depends on BOARD_TYAN_S2892

config HAVE_ACPI_TABLES
	bool "Generate ACPI tables"
	default y
	depends on BOARD_TYAN_S2892
```

## src/mainboard/tyan/s2895/Kconfig
```kconfig
if BOARD_TYAN_S2895

config BOARD_SPECIFIC_OPTIONS # dummy
	def_bool y
	select ARCH_X86
	select CPU_AMD_SOCKET_940
	select NORTHBRIDGE_AMD_AMDK8
	select SOUTHBRIDGE_NVIDIA_CK804
	select SOUTHBRIDGE_AMD_AMD8131
	select SUPERIO_SMSC_LPC47B397
	select HAVE_OPTION_TABLE
	select HAVE_PIRQ_TABLE
	select HAVE_MP_TABLE
	select SERIAL_CPU_INIT
	select HAVE_ACPI_TABLES
	select BOARD_ROMSIZE_KB_1024
	select QRANK_DIMM_SUPPORT
	select K8_ALLOCATE_IO_RANGE

config MAINBOARD_DIR
	string
	default tyan/s2895

config APIC_ID_OFFSET
	hex
	default 0x10

config CK804_NUM
	int
	default 2

config SB_HT_CHAIN_ON_BUS0
	int
	default 2

config MAINBOARD_PART_NUMBER
	string
	default "S2895"

config MAX_CPUS
	int
	default 4

config MAX_PHYSICAL_CPUS
	int
	default 2

config HT_CHAIN_UNITID_BASE
	hex
	default 0

config HT_CHAIN_END_UNITID_BASE
	hex
	default 0x20

config SB_HT_CHAIN_ON_BUS0
	int
	default 2

config IRQ_SLOT_COUNT
	int
	default 11

endif # BOARD_TYAN_S2895
```
