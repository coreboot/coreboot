## src/mainboard/tyan/s2912/Kconfig
```kconfig
if BOARD_TYAN_S2912

config BOARD_SPECIFIC_OPTIONS # dummy
	def_bool y
	select ARCH_X86
	select CPU_AMD_SOCKET_F
	select DIMM_DDR2
	select DIMM_REGISTERED
	select NORTHBRIDGE_AMD_AMDK8
	select SOUTHBRIDGE_NVIDIA_MCP55
	select MCP55_USE_NIC
	select SUPERIO_WINBOND_W83627HF
	select HAVE_OPTION_TABLE
	select HAVE_PIRQ_TABLE
	select HAVE_MP_TABLE
	select LIFT_BSP_APIC_ID
	select K8_REV_F_SUPPORT
	select BOARD_ROMSIZE_KB_512
	select RAMINIT_SYSINFO
	select QRANK_DIMM_SUPPORT
	select K8_ALLOCATE_IO_RANGE

config MAINBOARD_DIR
	string
	default tyan/s2912

config DCACHE_RAM_BASE
	hex
	default 0xc8000

config DCACHE_RAM_SIZE
	hex
	default 0x08000

config APIC_ID_OFFSET
	hex
	default 0x10

config MEM_TRAIN_SEQ
	int
	default 1

config SB_HT_CHAIN_ON_BUS0
	int
	default 2

config MAINBOARD_PART_NUMBER
	string
	default "S2912"

config PCI_64BIT_PREF_MEM
	bool
	default n

config MAX_CPUS
	int
	default 4

config MAX_PHYSICAL_CPUS
	int
	default 2

config HT_CHAIN_UNITID_BASE
	hex
	default 0x0

config HT_CHAIN_END_UNITID_BASE
	hex
	default 0x20

config SERIAL_CPU_INIT
	bool
	default n

config IRQ_SLOT_COUNT
	int
	default 11

config MCP55_PCI_E_X_0
	int
	default 1

endif # BOARD_TYAN_S2912
```

## src/mainboard/tyan/s2912_fam10/Kconfig
```kconfig
if BOARD_TYAN_S2912_FAM10

config BOARD_SPECIFIC_OPTIONS # dummy
	def_bool y
	select CPU_AMD_SOCKET_F_1207
	select DIMM_DDR2
	select DIMM_REGISTERED
	select NORTHBRIDGE_AMD_AMDFAM10
	select SOUTHBRIDGE_NVIDIA_MCP55
	select HT_CHAIN_DISTRIBUTE
	select MCP55_USE_NIC
	select SUPERIO_WINBOND_W83627HF
	select PARALLEL_CPU_INIT
	select HAVE_OPTION_TABLE
	select HAVE_PIRQ_TABLE
	select HAVE_MP_TABLE
	select LIFT_BSP_APIC_ID
	select BOARD_ROMSIZE_KB_1024
	select ENABLE_APIC_EXT_ID

config MAINBOARD_DIR
	string
	default tyan/s2912_fam10

config DCACHE_RAM_BASE
	hex
	default 0xc4000

config DCACHE_RAM_SIZE
	hex
	default 0x0c000

config APIC_ID_OFFSET
	hex
	default 0x0

config MAINBOARD_PART_NUMBER
	string
	default "S2912 (Fam10)"

config MAX_CPUS
	int
	default 12

config MAX_PHYSICAL_CPUS
	int
	default 2

config HT_CHAIN_UNITID_BASE
	hex
	default 0x1

config HT_CHAIN_END_UNITID_BASE
	hex
	default 0x20

config IRQ_SLOT_COUNT
	int
	default 11

config MCP55_PCI_E_X_0
	int
	default 1

endif # BOARD_TYAN_S2912_FAM10
```

## src/mainboard/tyan/s4882/Kconfig
```kconfig
config BOARD_TYAN_S4882
	bool "S4882 (Thunder K8QS Pro)"
	select ARCH_X86
	select CPU_AMD_SOCKET_940
	select NORTHBRIDGE_AMD_AMDK8
	select NORTHBRIDGE_AMD_AMDK8_ROOT_COMPLEX
	select SOUTHBRIDGE_AMD_AMD8111
	select SOUTHBRIDGE_AMD_AMD8131
	select SUPERIO_WINBOND_W83627HF
	select HAVE_PIRQ_TABLE
	select HAVE_MP_TABLE
	select USE_PRINTK_IN_CAR
	select USE_DCACHE_RAM
	select HAVE_HARD_RESET
	select IOAPIC
	select BOARD_ROMSIZE_KB_512

config MAINBOARD_DIR
	string
	default tyan/s4882
	depends on BOARD_TYAN_S4882

config DCACHE_RAM_BASE
	hex
	default 0xcf000
	depends on BOARD_TYAN_S4882

config DCACHE_RAM_SIZE
	hex
	default 0x01000
	depends on BOARD_TYAN_S4882

config APIC_ID_OFFSET
	hex
	default 0x10
	depends on BOARD_TYAN_S4882

config K8_REV_F_SUPPORT
	bool
	default n
	depends on BOARD_TYAN_S4882

config SB_HT_CHAIN_ON_BUS0
	int
	default 2
	depends on BOARD_TYAN_S4882

config SB_HT_CHAIN_UNITID_OFFSET_ONLY
	bool
	default n
	depends on BOARD_TYAN_S4882

config LB_CKS_RANGE_END
	int
	default 122
	depends on BOARD_TYAN_S4882

config LB_CKS_LOC
	int
	default 123
	depends on BOARD_TYAN_S4882

config MAINBOARD_PART_NUMBER
	string
	default "S4882"
	depends on BOARD_TYAN_S4882

config HW_MEM_HOLE_SIZEK
	hex
	default 0x100000
	depends on BOARD_TYAN_S4882

config MAX_CPUS
	int
	default 4
	depends on BOARD_TYAN_S4882

config MAX_PHYSICAL_CPUS
	int
	default 2
	depends on BOARD_TYAN_S4882

config HT_CHAIN_END_UNITID_BASE
	hex
	default 0x0
	depends on BOARD_TYAN_S4882

config HT_CHAIN_UNITID_BASE
	hex
	default 0x0
	depends on BOARD_TYAN_S4882

config USE_INIT
	bool
	default n
	depends on BOARD_TYAN_S4882

config SB_HT_CHAIN_ON_BUS0
	int
	default 2
	depends on BOARD_TYAN_S4882

config IRQ_SLOT_COUNT
	int
	default 11
	depends on BOARD_TYAN_S4882

config MAINBOARD_PCI_SUBSYSTEM_DEVICE_ID
	hex
	default 0x4882
	depends on BOARD_TYAN_S4882
```

## src/mainboard/tyan/s8226/Kconfig
```kconfig
#
# This file is part of the coreboot project.
#
# Copyright (C) 2011 - 2012 Advanced Micro Devices, Inc.
#
# This program is free software; you can redistribute it and/or modify
# it under the terms of the GNU General Public License as published by
# the Free Software Foundation; version 2 of the License.
#
# This program is distributed in the hope that it will be useful,
# but WITHOUT ANY WARRANTY; without even the implied warranty of
# MERCHANTABILITY or FITNESS FOR A PARTICULAR PURPOSE.  See the
# GNU General Public License for more details.
#

if BOARD_TYAN_S8226

config BOARD_SPECIFIC_OPTIONS
	def_bool y
	select CPU_AMD_AGESA_FAMILY15
	select CPU_AMD_SOCKET_C32
	select NORTHBRIDGE_AMD_AGESA_FAMILY15
	select NORTHBRIDGE_AMD_CIMX_RD890
	select SOUTHBRIDGE_AMD_CIMX_SB700
	select SUPERIO_WINBOND_W83627DHG
	select SUPERIO_NUVOTON_WPCM450
	select DRIVERS_I2C_W83795
	select HAVE_OPTION_TABLE
	select HAVE_PIRQ_TABLE
	select HAVE_MP_TABLE
	select HAVE_ACPI_TABLES
	select BOARD_ROMSIZE_KB_4096

config MAINBOARD_DIR
	string
	default tyan/s8226

config MAINBOARD_PART_NUMBER
	string
	default "S8226"

config HW_MEM_HOLE_SIZEK
	hex
	default 0x200000

config MAX_CPUS
	int
	default 64

config HW_MEM_HOLE_SIZE_AUTO_INC
	bool
	default n

config IRQ_SLOT_COUNT
	int
	default 11

config ONBOARD_VGA_IS_PRIMARY
	bool
	default y

config VGA_BIOS
	bool
	default n

config VGA_BIOS_ID
	string
	depends on VGA_BIOS
	default "1a03,2000"

endif # BOARD_TYAN_S8226
```

## src/mainboard/up/Kconfig
```kconfig
if VENDOR_UP

choice
	prompt "Mainboard model"

source "src/mainboard/up/*/Kconfig.name"

endchoice

source "src/mainboard/up/*/Kconfig"

config MAINBOARD_VENDOR
	default "UP"

endif # VENDOR_UP
```

## src/mainboard/up/squared/Kconfig
```kconfig
## SPDX-License-Identifier: GPL-2.0-only

if BOARD_UP_SQUARED

config BOARD_SPECIFIC_OPTIONS
	def_bool y
	select HAVE_ACPI_TABLES
	select HAVE_ACPI_RESUME
	select INTEL_GMA_HAVE_VBT
	select INTEL_LPSS_UART_FOR_CONSOLE
	select SOC_INTEL_APOLLOLAKE
	select BOARD_ROMSIZE_KB_16384
	select ONBOARD_VGA_IS_PRIMARY
	select MAINBOARD_HAS_LIBGFXINIT
	select CRB_TPM
	select HAVE_INTEL_PTT
	select NO_UART_ON_SUPERIO

config VBOOT
	select VBOOT_NO_BOARD_SUPPORT
	select GBB_FLAG_DISABLE_LID_SHUTDOWN
	select GBB_FLAG_DISABLE_EC_SOFTWARE_SYNC
	select GBB_FLAG_DISABLE_PD_SOFTWARE_SYNC
	select GBB_FLAG_DISABLE_FWMP

config GBB_HWID
	string
	depends on VBOOT
	default "UPSQUARED"

config MAINBOARD_DIR
	default "up/squared"

config MAINBOARD_VENDOR
	string
	default "Up"

config MAINBOARD_PART_NUMBER
	default "Squared"

config FMDFILE
	default "src/mainboard/\$(CONFIG_MAINBOARD_DIR)/upsquared.fmd"	if !VBOOT
	default "src/mainboard/\$(CONFIG_MAINBOARD_DIR)/vboot-ro.fmd"	if !VBOOT_SLOTS_RW_A
	default "src/mainboard/\$(CONFIG_MAINBOARD_DIR)/vboot-roa.fmd"	if VBOOT_SLOTS_RW_A && !VBOOT_SLOTS_RW_AB
	default "src/mainboard/\$(CONFIG_MAINBOARD_DIR)/vboot-roab.fmd"	if VBOOT_SLOTS_RW_AB

config VGA_BIOS_ID
	string
	default "8086,5a85"

config PXE_ROM_ID
	string
	default "10ec,8168"

config LINUX_COMMAND_LINE
	string
	default "console=ttyS4,115200 earlyprintk=ttyS4,115200,keep" if PAYLOAD_LINUXBOOT && UART_FOR_CONSOLE=0

config UART_FOR_CONSOLE
	int
	default 0

config IFWI_FMAP_NAME
	string
	default "IFWI"

config POST_IO
	bool
	default n

config POST_DEVICE
	bool
	default n

config CONSOLE_POST
	bool
	default y

choice
	prompt "Mini PCIe port mode"
	default MINI_PCIE_MODE_PCIE
	help
	  Choose the operating mode of the mini PCIe port.

config MINI_PCIE_MODE_PCIE
	bool "PCIe"
	help
	  Select this option to leave the mini PCIe port in PCIe mode. This is
	  also the default mode of the vendor firmware.

config MINI_PCIE_MODE_MSATA
	bool "mSATA"
	help
	  Select this option to put the mini PCIe port into mSATA mode.
endchoice

endif
```

## src/mainboard/up/squared/Kconfig.name
```kconfig
## SPDX-License-Identifier: GPL-2.0-only

config BOARD_UP_SQUARED
	bool "Squared"
```

## src/mainboard/via/Kconfig
```kconfig
## SPDX-License-Identifier: GPL-2.0-only

if VENDOR_VIA

choice
	prompt "Mainboard model"

source "src/mainboard/via/*/Kconfig.name"

endchoice

source "src/mainboard/via/*/Kconfig"

config MAINBOARD_VENDOR
	default "VIA"

endif # VENDOR_VIA
```

## src/mainboard/via/epia-cn/Kconfig
```kconfig
if BOARD_VIA_EPIA_CN

config BOARD_SPECIFIC_OPTIONS # dummy
	def_bool y
	select ARCH_X86
	select CPU_VIA_C7
	select NORTHBRIDGE_VIA_CN700
	select SOUTHBRIDGE_VIA_VT8237R
	select SUPERIO_VIA_VT1211
	select HAVE_OPTION_TABLE
	select HAVE_PIRQ_TABLE
	select BOARD_ROMSIZE_KB_512

config MAINBOARD_DIR
	string
	default via/epia-cn

config MAINBOARD_PART_NUMBER
	string
	default "EPIA-CN"

config IRQ_SLOT_COUNT
	int
	default 9

endif # BOARD_VIA_EPIA_CN
```

## src/mainboard/via/epia-ex/Kconfig
```kconfig
## SPDX-License-Identifier: GPL-2.0-only

if BOARD_VIA_EPIA_EX

config BOARD_SPECIFIC_OPTIONS
	def_bool y
	select CPU_VIA_C7
	select NORTHBRIDGE_VIA_CX700
	select BOARD_ROMSIZE_KB_512
	select NO_UART_ON_SUPERIO

config MAINBOARD_DIR
	default "via/epia-ex"

config MAINBOARD_PART_NUMBER
	default "EPIA-EX"

endif
```

## src/mainboard/via/epia-ex/Kconfig.name
```kconfig
## SPDX-License-Identifier: GPL-2.0-only

config BOARD_VIA_EPIA_EX
	bool "EPIA-EX (work in progress)"
```

## src/mainboard/via/epia-m/Kconfig
```kconfig
if BOARD_VIA_EPIA_M

config BOARD_SPECIFIC_OPTIONS # dummy
	def_bool y
	select ARCH_X86
	select CPU_VIA_C3
	select NORTHBRIDGE_VIA_VT8623
	select SOUTHBRIDGE_VIA_VT8235
	select SOUTHBRIDGE_RICOH_RL5C476
	select SUPERIO_VIA_VT1211
	select HAVE_OPTION_TABLE
	select HAVE_PIRQ_TABLE
	select HAVE_ACPI_TABLES
	select BOARD_ROMSIZE_KB_256
	select ROMCC

config MAINBOARD_DIR
	string
	default via/epia-m

config MAINBOARD_PART_NUMBER
	string
	default "EPIA-M"

config IRQ_SLOT_COUNT
	int
	default 5

endif # BOARD_VIA_EPIA_M
```

## src/mainboard/via/epia-m700/Kconfig
```kconfig
if BOARD_VIA_EPIA_M700

config BOARD_SPECIFIC_OPTIONS # dummy
	def_bool y
	select ARCH_X86
	select CPU_VIA_C7
	select NORTHBRIDGE_VIA_VX800
	select SUPERIO_WINBOND_W83697HF
	select HAVE_PIRQ_TABLE
	# Note: For ACPI, you need to use the 'get_dsdt' script and uncomment
	# the "select HAVE_ACPI_TABLES" line below.
	# select HAVE_ACPI_TABLES
	select HAVE_OPTION_TABLE
	select BOARD_ROMSIZE_KB_512
	select RAMINIT_SYSINFO

config MAINBOARD_DIR
	string
	default via/epia-m700

config MAINBOARD_PART_NUMBER
	string
	default "EPIA-M700"

config IRQ_SLOT_COUNT
	int
	default 13

endif # BOARD_VIA_EPIA_M700
```

## src/mainboard/via/epia-m850/Kconfig
```kconfig
##
## This file is part of the coreboot project.
##
## Copyright (C) 2011-2012  Alexandru Gagniuc <mr.nuke.me@gmail.com>
##
## This program is free software: you can redistribute it and/or modify
## it under the terms of the GNU General Public License as published by
## the Free Software Foundation, either version 2 of the License, or
## (at your option) any later version.
##
## This program is distributed in the hope that it will be useful,
## but WITHOUT ANY WARRANTY; without even the implied warranty of
## MERCHANTABILITY or FITNESS FOR A PARTICULAR PURPOSE.  See the
## GNU General Public License for more details.
##
## You should have received a copy of the GNU General Public License
## along with this program.  If not, see <http://www.gnu.org/licenses/>.
##

if BOARD_VIA_EPIA_M850

config BOARD_SPECIFIC_OPTIONS # dummy
	def_bool y
	select ARCH_X86
	select CPU_VIA_NANO
	select NORTHBRIDGE_VIA_VX900
	select SUPERIO_FINTEK_F81865F
	select HAVE_PIRQ_TABLE
	select PIRQ_ROUTE
	select HAVE_MP_TABLE
	#select HAVE_OPTION_TABLE
	#select HAVE_ACPI_TABLES
	#select HAVE_ACPI_RESUME
	#select BOARD_HAS_FADT
	select BOARD_ROMSIZE_KB_512

config MAINBOARD_DIR
	string
	default via/epia-m850

config MAINBOARD_PART_NUMBER
	string
	default "EPIA-M850"

config IRQ_SLOT_COUNT
	int
	default 13

endif # BOARD_VIA_EPIA_M850
```
