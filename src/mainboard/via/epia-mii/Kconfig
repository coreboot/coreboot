## src/mainboard/via/epia-mii/Kconfig
```kconfig
if BOARD_VIA_EPIA_MII

# Dummy for abuild

config MAINBOARD_PART_NUMBER
	string
	default "EPIA-MII"

endif
```

## src/mainboard/via/epia-ml/Kconfig
```kconfig
if BOARD_VIA_EPIA_ML

# Dummy for abuild

config MAINBOARD_PART_NUMBER
	string
	default "EPIA-ML"

endif
```

## src/mainboard/via/epia-n/Kconfig
```kconfig
if BOARD_VIA_EPIA_N

config BOARD_SPECIFIC_OPTIONS # dummy
	def_bool y
	select ARCH_X86
	select CPU_VIA_C3
	select NORTHBRIDGE_VIA_CN400
	select SOUTHBRIDGE_VIA_VT8237R
	select SUPERIO_WINBOND_W83697HF
	select HAVE_OPTION_TABLE
	select HAVE_PIRQ_TABLE
	select HAVE_MP_TABLE
	select EPIA_VT8237R_INIT
	select HAVE_ACPI_TABLES
	select BOARD_ROMSIZE_KB_512
	select ROMCC

config MAINBOARD_DIR
	string
	default via/epia-n

config MAINBOARD_PART_NUMBER
	string
	default "EPIA-N"

config IRQ_SLOT_COUNT
	int
	default 7

endif # BOARD_VIA_EPIA_N
```

## src/mainboard/via/epia/Kconfig
```kconfig
if BOARD_VIA_EPIA

config BOARD_SPECIFIC_OPTIONS # dummy
	def_bool y
	select ARCH_X86
	select CPU_VIA_C3
	select NORTHBRIDGE_VIA_VT8601
	select SOUTHBRIDGE_VIA_VT8231
	select SUPERIO_WINBOND_W83627HF
	select HAVE_OPTION_TABLE
	select HAVE_PIRQ_TABLE
	select BOARD_ROMSIZE_KB_256
	select ROMCC

config MAINBOARD_DIR
	string
	default via/epia

config MAINBOARD_PART_NUMBER
	string
	default "EPIA"

config IRQ_SLOT_COUNT
	int
	default 5

endif # BOARD_VIA_EPIA
```

## src/mainboard/via/pc2500e/Kconfig
```kconfig
if BOARD_VIA_PC2500E

config BOARD_SPECIFIC_OPTIONS # dummy
	def_bool y
	select ARCH_X86
	select CPU_VIA_C7
	select NORTHBRIDGE_VIA_CN700
	select SOUTHBRIDGE_VIA_VT8237R
	select SUPERIO_ITE_IT8716F
	select HAVE_OPTION_TABLE
	select HAVE_PIRQ_TABLE
	select HAVE_MP_TABLE
	select SMP
	select UDELAY_TSC
	select BOARD_ROMSIZE_KB_512

config MAINBOARD_DIR
	string
	default via/pc2500e

config MAINBOARD_PART_NUMBER
	string
	default "pc2500e"

config IRQ_SLOT_COUNT
	int
	default 10

config VGA_BIOS_FILE
	string
	default "M14CRT.ROM"

config VGA_BIOS_ID
	string
	default "1106,3344"

endif # BOARD_VIA_PC2500E
```

## src/mainboard/via/vt8454c/Kconfig
```kconfig
if BOARD_VIA_VT8454C

config BOARD_SPECIFIC_OPTIONS # dummy
	def_bool y
	select ARCH_X86
	select CPU_VIA_C7
	select NORTHBRIDGE_VIA_CX700
	select SUPERIO_VIA_VT1211
	select HAVE_OPTION_TABLE
	select HAVE_PIRQ_TABLE
	select HAVE_MP_TABLE
	select HAVE_ACPI_TABLES
	select BOARD_ROMSIZE_KB_512

config MAINBOARD_DIR
	string
	default via/vt8454c

config MAINBOARD_PART_NUMBER
	string
	default "VT8454c"

config IRQ_SLOT_COUNT
	int
	default 15

endif # BOARD_VIA_VT8454C
```

## src/mainboard/winent/Kconfig
```kconfig
##
## This file is part of the coreboot project.
##
## Copyright (C) 2009 Uwe Hermann <uwe@hermann-uwe.de>
##
## This program is free software; you can redistribute it and/or modify
## it under the terms of the GNU General Public License as published by
## the Free Software Foundation; version 2 of the License.
##
## This program is distributed in the hope that it will be useful,
## but WITHOUT ANY WARRANTY; without even the implied warranty of
## MERCHANTABILITY or FITNESS FOR A PARTICULAR PURPOSE.  See the
## GNU General Public License for more details.
##
if VENDOR_WINENT

choice
	prompt "Mainboard model"

source "src/mainboard/winent/*/Kconfig.name"

endchoice

source "src/mainboard/winent/*/Kconfig"

config MAINBOARD_VENDOR
	string
	default "Win Enterprise"

endif # VENDOR_WINENT
```

## src/mainboard/winent/mb6047/Kconfig
```kconfig
if BOARD_WINENT_MB6047

config BOARD_SPECIFIC_OPTIONS # dummy
	def_bool y
	select ARCH_X86
	select CPU_AMD_SOCKET_940
	select NORTHBRIDGE_AMD_AMDK8
	select SOUTHBRIDGE_NVIDIA_CK804
	select SUPERIO_WINBOND_W83627THG
	select HAVE_OPTION_TABLE
	select HAVE_PIRQ_TABLE
	select HAVE_MP_TABLE
	select SERIAL_CPU_INIT
	select HAVE_ACPI_TABLES
	select BOARD_ROMSIZE_KB_512
	select SB_HT_CHAIN_UNITID_OFFSET_ONLY
	select QRANK_DIMM_SUPPORT
	select CK804_USE_NIC
	select CK804_USE_ACI
	select SET_FIDVID

config MAINBOARD_DIR
	string
	default winent/mb6047

config APIC_ID_OFFSET
	hex
	default 0x10

config SB_HT_CHAIN_ON_BUS0
	int
	default 2

config MAINBOARD_PART_NUMBER
	string
	default "MB6047"

config MAX_CPUS
	int
	default 2

config MAX_PHYSICAL_CPUS
	int
	default 1

config HT_CHAIN_UNITID_BASE
	hex
	default 0

config HT_CHAIN_END_UNITID_BASE
	hex
	default 0x20

config IRQ_SLOT_COUNT
	int
	default 11

config CK804_PCI_E_X
	int
	default 0

config VGA_BIOS_ID
	string
	default "126f,0720"

config VGA_BIOS_FILE
	string
	default "DM22383.ROM"

endif # BOARD_WINENT_MB6047
```

## src/mainboard/winent/pl6064/Kconfig
```kconfig
if BOARD_WINENT_PL6064

config BOARD_SPECIFIC_OPTIONS # dummy
	def_bool y
	select ARCH_X86
	select CPU_AMD_GEODE_LX
	select NORTHBRIDGE_AMD_LX
	select SOUTHBRIDGE_AMD_CS5536
	select SUPERIO_WINBOND_W83627HF
	select HAVE_PIRQ_TABLE
	select PIRQ_ROUTE
	select UDELAY_TSC
	select BOARD_ROMSIZE_KB_512
	select POWER_BUTTON_FORCE_ENABLE

config MAINBOARD_DIR
	string
	default winent/pl6064

config MAINBOARD_PART_NUMBER
	string
	default "PL6064"

config IRQ_SLOT_COUNT
	int
	default 7

endif # BOARD_WINENT_PL6064
```

## src/mainboard/winnet/Kconfig
```kconfig
##
## This file is part of the coreboot project.
##
## Copyright (C) 2017 Lubomir Rintel <lkundrak@v3.sk>
##
## This program is free software: you can redistribute it and/or modify
## it under the terms of the GNU General Public License as published by
## the Free Software Foundation, either version 2 of the License, or
## (at your option) any later version.
##
## This program is distributed in the hope that it will be useful,
## but WITHOUT ANY WARRANTY; without even the implied warranty of
## MERCHANTABILITY or FITNESS FOR A PARTICULAR PURPOSE.  See the
## GNU General Public License for more details.
##

if VENDOR_WINNET

choice
	prompt "Mainboard model"

source "src/mainboard/winnet/*/Kconfig.name"

endchoice

source "src/mainboard/winnet/*/Kconfig"

config MAINBOARD_VENDOR
	string
	default "WinNET"

endif # VENDOR_WINNET
```

## src/mainboard/winnet/Kconfig.name
```kconfig
config VENDOR_WINNET
	bool "WinNET"
	help
	  WinNET boards. Used in various thin client appliances.
```

## src/mainboard/winnet/g170/Kconfig
```kconfig
##
## This file is part of the coreboot project.
##
## Copyright (C) 2017 Lubomir Rintel <lkundrak@v3.sk>
##
## This program is free software: you can redistribute it and/or modify
## it under the terms of the GNU General Public License as published by
## the Free Software Foundation, either version 2 of the License, or
## (at your option) any later version.
##
## This program is distributed in the hope that it will be useful,
## but WITHOUT ANY WARRANTY; without even the implied warranty of
## MERCHANTABILITY or FITNESS FOR A PARTICULAR PURPOSE.  See the
## GNU General Public License for more details.
##

if BOARD_WINNET_G170

config BOARD_SPECIFIC_OPTIONS
	def_bool y
	select CPU_VIA_C7
	select NORTHBRIDGE_VIA_CN700
	select SOUTHBRIDGE_VIA_VT8237R
	select SUPERIO_WINBOND_W83697HF
	select HAVE_PIRQ_TABLE
	select HAVE_OPTION_TABLE
	select HAVE_ACPI_TABLES
	select BOARD_ROMSIZE_KB_512

config MAINBOARD_DIR
	string
	default winnet/g170

config MAINBOARD_PART_NUMBER
	string
	default "WinNET G170"

config IRQ_SLOT_COUNT
	int
	default 10

endif # BOARD_WINNET_G170
```

## src/mainboard/winnet/g170/Kconfig.name
```kconfig
config BOARD_WINNET_G170
	bool "WinNET G170 (Neoware CA19, IGEL 2110)"
	help
	  G170 is a board manufactured by WinNET, used in thin clients including
	  HP Neoware CA19 and IGEL 2110.
```

## src/mainboard/wyse/Kconfig
```kconfig
choice
	prompt "Mainboard model"
	depends on VENDOR_WYSE

source "src/mainboard/wyse/s50/Kconfig"

endchoice
```

## src/mainboard/wyse/s50/Kconfig
```kconfig
##
## This file is part of the coreboot project.
##
## Copyright (C) 2010 Nils Jacobs
##
## This program is free software; you can redistribute it and/or modify
## it under the terms of the GNU General Public License as published by
## the Free Software Foundation; version 2 of the License.
##
## This program is distributed in the hope that it will be useful,
## but WITHOUT ANY WARRANTY; without even the implied warranty of
## MERCHANTABILITY or FITNESS FOR A PARTICULAR PURPOSE.  See the
## GNU General Public License for more details.
##
## You should have received a copy of the GNU General Public License
## along with this program; if not, write to the Free Software
## Foundation, Inc., 51 Franklin St, Fifth Floor, Boston, MA 02110-1301 USA
##
if BOARD_WYSE_S50

config BOARD_SPECIFIC_OPTIONS # dummy
	def_bool y
	select ARCH_X86
	select CPU_AMD_GEODE_GX2
	select NORTHBRIDGE_AMD_GX2
	select SOUTHBRIDGE_AMD_CS5536
	select UDELAY_TSC
	select HAVE_PIRQ_TABLE
	select PIRQ_ROUTE
	select BOARD_ROMSIZE_KB_256
	select POWER_BUTTON_FORCE_DISABLE
	select GX2_PROCESSOR_MHZ_366

config MAINBOARD_DIR
	string
	default wyse/s50

config MAINBOARD_PART_NUMBER
	string
	default "s50"

config IRQ_SLOT_COUNT
	int
	default 3

endif # BOARD_WYSE_S50
```

## src/northbridge/Kconfig
```kconfig
source src/northbridge/amd/Kconfig
source src/northbridge/dmp/Kconfig
source src/northbridge/intel/Kconfig
source src/northbridge/rdc/Kconfig
source src/northbridge/via/Kconfig
```

## src/northbridge/amd/Kconfig
```kconfig
source src/northbridge/amd/amdk8/Kconfig
source src/northbridge/amd/gx2/Kconfig
source src/northbridge/amd/amdfam10/Kconfig
source src/northbridge/amd/lx/Kconfig
source src/northbridge/amd/agesa/Kconfig
source src/northbridge/amd/cimx/Kconfig
source src/northbridge/amd/pi/Kconfig
```

## src/northbridge/amd/agesa/Kconfig
```kconfig
# SPDX-License-Identifier: GPL-2.0-only

config NORTHBRIDGE_AMD_AGESA
	bool

if NORTHBRIDGE_AMD_AGESA

config BOTTOMIO_POSITION
	hex "Bottom of 32-bit IO space"
	default 0x80000000
	help
	  If PCI peripherals with big BARs are connected to the system
	  the bottom of the IO must be decreased to allocate such devices.

	  Declare the beginning of the 128MB-aligned MMIO region.  This
	  option is useful when PCI peripherals requesting large address
	  ranges are present, for example, graphic cards.

config CONSOLE_VGA_MULTI
	bool
	default n

config S3_VGA_ROM_RUN
	bool
	default n

source "src/northbridge/amd/agesa/*/Kconfig"

# TODO: Reservation for heap seems excessive
config HEAP_SIZE
	hex
	default 0xc0000

endif # NORTHBRIDGE_AMD_AGESA
```
