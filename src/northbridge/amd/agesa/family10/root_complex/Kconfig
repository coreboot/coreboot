## src/northbridge/amd/lx/Kconfig
```kconfig
config NORTHBRIDGE_AMD_LX
	bool
	select GEODE_VSA
	select LATE_CBMEM_INIT
	select NO_RELOCATABLE_RAMSTAGE

if NORTHBRIDGE_AMD_LX

config VIDEO_MB
	int
	default 8

config PLL_MANUAL_CONFIG
	bool

if PLL_MANUAL_CONFIG

# "Core/GLIU Frequency"
config CORE_GLIU_500_266
	bool # "500MHz / 266MHz"

config CORE_GLIU_500_333
	bool # "500MHz / 333MHz"

config CORE_GLIU_500_400
	bool # "500MHz / 400MHz"

config PLLMSRhi
	hex
	default 0x39c if CORE_GLIU_500_266
	default 0x49c if CORE_GLIU_500_333
	default 0x59c if CORE_GLIU_500_400

config PLLMSRlo
	hex

endif

endif
```

## src/northbridge/amd/pi/00660F01/Kconfig
```kconfig
##
## This file is part of the coreboot project.
##
## Copyright (C) 2015 Advanced Micro Devices, Inc.
##
## This program is free software; you can redistribute it and/or modify
## it under the terms of the GNU General Public License as published by
## the Free Software Foundation; version 2 of the License.
##
## This program is distributed in the hope that it will be useful,
## but WITHOUT ANY WARRANTY; without even the implied warranty of
## MERCHANTABILITY or FITNESS FOR A PARTICULAR PURPOSE.  See the
## GNU General Public License for more details.
##
config NORTHBRIDGE_AMD_PI_00660F01
	bool

if NORTHBRIDGE_AMD_PI_00660F01

config HW_MEM_HOLE_SIZEK
	hex
	default 0x100000

config HW_MEM_HOLE_SIZE_AUTO_INC
	bool
	default n

config MMCONF_BASE_ADDRESS
	hex
	default 0xF8000000

config MMCONF_BUS_NUMBER
	int
	default 64

config VGA_BIOS_ID
	string
	default "1002,9870"
	help
	  The default VGA BIOS PCI vendor/device ID should be set to the
	  result of the map_oprom_vendev() function in northbridge.c.

config VGA_BIOS_FILE
	string
	default "3rdparty/blobs/northbridge/amd/00660F01/VBIOS.bin"

endif
```

## src/northbridge/amd/pi/00730F01/Kconfig
```kconfig
# SPDX-License-Identifier: GPL-2.0-only

config NORTHBRIDGE_AMD_PI_00730F01
	bool
	select DRAM_SUPPORT_DDR3
	select ACPI_HEST

if NORTHBRIDGE_AMD_PI_00730F01

config CHIPSET_DEVICETREE
	string
	default "northbridge/amd/pi/00730F01/chipset.cb"

config ECAM_MMCONF_BASE_ADDRESS
	default 0xF8000000

config ECAM_MMCONF_BUS_NUMBER
	default 64

config VGA_BIOS_ID
	string
	default "1002,9850"
	help
	  The default VGA BIOS PCI vendor/device ID should be set to the
	  result of the map_oprom_vendev() function in northbridge.c.

config VGA_BIOS_FILE
	string
	default "3rdparty/blobs/northbridge/amd/00730F01/VBIOS.bin"

endif
```

## src/northbridge/amd/pi/Kconfig
```kconfig
# SPDX-License-Identifier: GPL-2.0-only

config NORTHBRIDGE_AMD_PI
	bool
	default y if CPU_AMD_PI
	default n

if NORTHBRIDGE_AMD_PI

config BOTTOMIO_POSITION
	hex "Bottom of 32-bit IO space"
	default 0xD0000000
	help
	  If PCI peripherals with big BARs are connected to the system
	  the bottom of the IO must be decreased to allocate such
	  devices.

	  Declare the beginning of the 128MB-aligned MMIO region.  This
	  option is useful when PCI peripherals requesting large address
	  ranges are present.

config S3_VGA_ROM_RUN
	bool
	default n

source "src/northbridge/amd/pi/00730F01/Kconfig"

config HW_MEM_HOLE_SIZEK
	hex
	default 0x200000

config HEAP_SIZE
	hex
	default 0xc0000

endif # NORTHBRIDGE_AMD_PI
```

## src/northbridge/intel/Kconfig
```kconfig
source src/northbridge/intel/e7501/Kconfig
source src/northbridge/intel/e7505/Kconfig
source src/northbridge/intel/e7520/Kconfig
source src/northbridge/intel/e7525/Kconfig
source src/northbridge/intel/i3100/Kconfig
source src/northbridge/intel/i440bx/Kconfig
source src/northbridge/intel/i440lx/Kconfig
source src/northbridge/intel/i82810/Kconfig
source src/northbridge/intel/i82830/Kconfig
source src/northbridge/intel/i855/Kconfig
source src/northbridge/intel/i945/Kconfig
source src/northbridge/intel/gm45/Kconfig
source src/northbridge/intel/sch/Kconfig
source src/northbridge/intel/i5000/Kconfig
source src/northbridge/intel/sandybridge/Kconfig
source src/northbridge/intel/haswell/Kconfig
```

## src/northbridge/intel/common/Kconfig
```kconfig
config NORTHBRIDGE_INTEL_COMMON_MRC_CACHE
	def_bool n

config NORTHBRIDGE_INTEL_COMMON_GMA_OPREGION
	def_bool n
```

## src/northbridge/intel/common/Kconfig.common
```kconfig
# SPDX-License-Identifier: GPL-2.0-only

config NORTHBRIDGE_INTEL_COMMON
	bool

if NORTHBRIDGE_INTEL_COMMON

config FIXED_DMIBAR_MMIO_BASE
	hex

config FIXED_EPBAR_MMIO_BASE
	hex

config FIXED_MCHBAR_MMIO_BASE
	hex

endif # NORTHBRIDGE_INTEL_COMMON
```
