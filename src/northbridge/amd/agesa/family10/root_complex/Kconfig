## src/northbridge/amd/agesa/family12/Kconfig
```kconfig
##
## This file is part of the coreboot project.
##
## Copyright (C) 2007-2009 coresystems GmbH
##
## This program is free software; you can redistribute it and/or modify
## it under the terms of the GNU General Public License as published by
## the Free Software Foundation; version 2 of the License.
##
## This program is distributed in the hope that it will be useful,
## but WITHOUT ANY WARRANTY; without even the implied warranty of
## MERCHANTABILITY or FITNESS FOR A PARTICULAR PURPOSE.  See the
## GNU General Public License for more details.
##
## You should have received a copy of the GNU General Public License
## along with this program; if not, write to the Free Software
## Foundation, Inc., 51 Franklin St, Fifth Floor, Boston, MA 02110-1301 USA
##
config NORTHBRIDGE_AMD_AGESA_FAMILY12
	bool
	select HAVE_DEBUG_RAM_SETUP
	select HAVE_DEBUG_SMBUS
	select HYPERTRANSPORT_PLUGIN_SUPPORT
	select MMCONF_SUPPORT

if NORTHBRIDGE_AMD_AGESA_FAMILY12

config HT3_SUPPORT
	bool
	default y

config HW_MEM_HOLE_SIZEK
	hex
	default 0x100000

config HW_MEM_HOLE_SIZE_AUTO_INC
	bool
	default n

config MMCONF_BASE_ADDRESS
	hex
	default 0xe0000000

config MMCONF_BUS_NUMBER
	int
	default 256

config DIMM_DDR3
	bool
	default n

config DIMM_REGISTERED
	bool
	default n

if !DIMM_REGISTERED
	config DIMM_SUPPORT
		hex
		default 0x0004
endif

if DIMM_DDR3
	if DIMM_REGISTERED
	  config DIMM_SUPPORT
		  hex
		  default 0x0005
	endif
endif

endif # NORTHBRIDGE_AMD_AGESA_FAMILY_12
```

## src/northbridge/amd/agesa/family14/Kconfig
```kconfig
# SPDX-License-Identifier: GPL-2.0-only

config NORTHBRIDGE_AMD_AGESA_FAMILY14
	bool
	select LEGACY_SMP_INIT
	select RESOURCE_ALLOCATOR_V3

if NORTHBRIDGE_AMD_AGESA_FAMILY14

config HW_MEM_HOLE_SIZEK
	hex
	default 0x100000

config ECAM_MMCONF_BASE_ADDRESS
	default 0xF8000000

config ECAM_MMCONF_BUS_NUMBER
	default 64

endif # NORTHBRIDGE_AMD_AGESA_FAMILY14
```

## src/northbridge/amd/agesa/family15/Kconfig
```kconfig
##
## This file is part of the coreboot project.
##
## Copyright (C) 2007-2009 coresystems GmbH
## Copyright (C) 2012 Advanced Micro Devices, Inc.
##
## This program is free software; you can redistribute it and/or modify
## it under the terms of the GNU General Public License as published by
## the Free Software Foundation; version 2 of the License.
##
## This program is distributed in the hope that it will be useful,
## but WITHOUT ANY WARRANTY; without even the implied warranty of
## MERCHANTABILITY or FITNESS FOR A PARTICULAR PURPOSE.  See the
## GNU General Public License for more details.
##
config NORTHBRIDGE_AMD_AGESA_FAMILY15
	bool
	select HAVE_DEBUG_RAM_SETUP
	select HAVE_DEBUG_SMBUS
	select HYPERTRANSPORT_PLUGIN_SUPPORT

if NORTHBRIDGE_AMD_AGESA_FAMILY15

config HW_MEM_HOLE_SIZEK
	hex
	default 0x100000

config HW_MEM_HOLE_SIZE_AUTO_INC
	bool
	default n

config MMCONF_BASE_ADDRESS
	hex
	default 0xF8000000

config MMCONF_BUS_NUMBER
	int
	default 64

endif # NORTHBRIDGE_AMD_AGESA_FAMILY15
```

## src/northbridge/amd/agesa/family15tn/Kconfig
```kconfig
##
## This file is part of the coreboot project.
##
## Copyright (C) 2007-2009 coresystems GmbH
##
## This program is free software; you can redistribute it and/or modify
## it under the terms of the GNU General Public License as published by
## the Free Software Foundation; version 2 of the License.
##
## This program is distributed in the hope that it will be useful,
## but WITHOUT ANY WARRANTY; without even the implied warranty of
## MERCHANTABILITY or FITNESS FOR A PARTICULAR PURPOSE.  See the
## GNU General Public License for more details.
##
config NORTHBRIDGE_AMD_AGESA_FAMILY15_TN
	bool

if NORTHBRIDGE_AMD_AGESA_FAMILY15_TN

config HW_MEM_HOLE_SIZEK
	hex
	default 0x100000

config HW_MEM_HOLE_SIZE_AUTO_INC
	bool
	default n

config MMCONF_BASE_ADDRESS
	hex
	default 0xF8000000

config MMCONF_BUS_NUMBER
	int
	default 64

endif # NORTHBRIDGE_AMD_AGESA_FAMILY15_TN
```

## src/northbridge/amd/agesa/family16kb/Kconfig
```kconfig
# SPDX-License-Identifier: GPL-2.0-only

config NORTHBRIDGE_AMD_AGESA_FAMILY16_KB
	bool
	select LEGACY_SMP_INIT
	select RESOURCE_ALLOCATOR_V3

if NORTHBRIDGE_AMD_AGESA_FAMILY16_KB

config HW_MEM_HOLE_SIZEK
	hex
	default 0x100000

config ECAM_MMCONF_BASE_ADDRESS
	default 0xF8000000

config ECAM_MMCONF_BUS_NUMBER
	default 64

config VGA_BIOS_ID
	string
	default "1002,9830"
	help
	  The default VGA BIOS PCI vendor/device ID should be set to the
	  result of the map_oprom_vendev() function in northbridge.c.

config AGESA_BROKEN_DATA_SECTION
	default n

endif # NORTHBRIDGE_AMD_AGESA_FAMILY16_KB
```

## src/northbridge/amd/agesa_wrapper/family14/Kconfig
```kconfig
##
## This file is part of the coreboot project.
##
## Copyright (C) 2007-2009 coresystems GmbH
##
## This program is free software; you can redistribute it and/or modify
## it under the terms of the GNU General Public License as published by
## the Free Software Foundation; version 2 of the License.
##
## This program is distributed in the hope that it will be useful,
## but WITHOUT ANY WARRANTY; without even the implied warranty of
## MERCHANTABILITY or FITNESS FOR A PARTICULAR PURPOSE.  See the
## GNU General Public License for more details.
##
## You should have received a copy of the GNU General Public License
## along with this program; if not, write to the Free Software
## Foundation, Inc., 51 Franklin St, Fifth Floor, Boston, MA  02110-1301 USA
##
config NORTHBRIDGE_AMD_AGESA_WRAPPER_FAMILY14
	bool
	select HAVE_DEBUG_RAM_SETUP
	select HAVE_DEBUG_SMBUS
	select HYPERTRANSPORT_PLUGIN_SUPPORT
	select MMCONF_SUPPORT
	select NORTHBRIDGE_AMD_AGESA_WRAPPER_FAMILY14_ROOT_COMPLEX

config HT3_SUPPORT
	bool
	default y
	depends on NORTHBRIDGE_AMD_AGESA_WRAPPER_FAMILY14

config HW_MEM_HOLE_SIZEK
	hex
	default 0x100000
	depends on NORTHBRIDGE_AMD_AGESA_WRAPPER_FAMILY14

config HW_MEM_HOLE_SIZE_AUTO_INC
	bool
	default n
	depends on NORTHBRIDGE_AMD_AGESA_WRAPPER_FAMILY14

config MMCONF_BASE_ADDRESS
	hex
	default 0xf8000000
  depends on NORTHBRIDGE_AMD_AGESA_WRAPPER_FAMILY14

config MMCONF_BUS_NUMBER
	int
 	default 16
	depends on NORTHBRIDGE_AMD_AGESA_WRAPPER_FAMILY14

config DIMM_DDR3
	bool
	default n
	depends on NORTHBRIDGE_AMD_AGESA_WRAPPER_FAMILY14

config DIMM_REGISTERED
	bool
	default n
	depends on NORTHBRIDGE_AMD_AGESA_WRAPPER_FAMILY14

if !DIMM_REGISTERED
	config DIMM_SUPPORT
		hex
		default 0x0004
endif

if DIMM_DDR3
	if DIMM_REGISTERED
	  config DIMM_SUPPORT
		  hex
		  default 0x0005
	endif
endif

config BOOTBLOCK_NORTHBRIDGE_INIT
  string
  default "northbridge/amd/agesa_wrapper/family14/bootblock.c"
	depends on NORTHBRIDGE_AMD_AGESA_WRAPPER_FAMILY14
```

## src/northbridge/amd/amdfam10/Kconfig
```kconfig
##
## This file is part of the coreboot project.
##
## Copyright (C) 2015 Timothy Pearson <tpearson@raptorengineeringinc.com>, Raptor Engineering
## Copyright (C) 2007-2009 coresystems GmbH
##
## This program is free software; you can redistribute it and/or modify
## it under the terms of the GNU General Public License as published by
## the Free Software Foundation; version 2 of the License.
##
## This program is distributed in the hope that it will be useful,
## but WITHOUT ANY WARRANTY; without even the implied warranty of
## MERCHANTABILITY or FITNESS FOR A PARTICULAR PURPOSE.  See the
## GNU General Public License for more details.
##

config NORTHBRIDGE_AMD_AMDFAM10
	bool
	select HAVE_DEBUG_RAM_SETUP
	select HAVE_DEBUG_SMBUS
	select HAVE_DEBUG_CAR
	select HYPERTRANSPORT_PLUGIN_SUPPORT
	select PCIEXP_ASPM
	select PCIEXP_COMMON_CLOCK
	select PCIEXP_CLK_PM
	select PCIEXP_L1_SUB_STATE
	select NO_RELOCATABLE_RAMSTAGE

if NORTHBRIDGE_AMD_AMDFAM10
config AGP_APERTURE_SIZE
	hex
	default 0x4000000

config HW_MEM_HOLE_SIZEK
	hex
	default 0x100000

config HW_MEM_HOLE_SIZE_AUTO_INC
	bool
	default n

config MMCONF_BASE_ADDRESS
	hex
	default 0xc0000000

config MMCONF_BUS_NUMBER
	int
	default 256

# TODO: Reservation for heap seems excessive
config HEAP_SIZE
	hex
	default 0xc0000

config RAMTOP
	hex
	default 0x400000

config BOOTBLOCK_NORTHBRIDGE_INIT
	string
	default "northbridge/amd/amdfam10/bootblock.c"

config SB_HT_CHAIN_UNITID_OFFSET_ONLY
	bool
	default n

config HT_CHAIN_DISTRIBUTE
	def_bool n

config DIMM_FBDIMM
	bool
	default n

config DIMM_DDR2
	bool
	default n

config DIMM_DDR3
	bool
	default n

config DIMM_REGISTERED
	bool
	default n

config DIMM_VOLTAGE_SET_SUPPORT
	bool
	default n

if DIMM_FBDIMM
	config DIMM_SUPPORT
		hex
		default 0x0110
endif

config S3_DATA_SIZE
	int
	default 32768
	depends on (HAVE_ACPI_RESUME)

config S3_DATA_POS
	hex
	default 0x0
	depends on (HAVE_ACPI_RESUME)

if DIMM_DDR2
	if DIMM_REGISTERED
	config DIMM_SUPPORT
		hex
		default 0x0104
	endif

	if !DIMM_REGISTERED
	config DIMM_SUPPORT
		hex
		default 0x0004
	endif
endif

if DIMM_DDR3
	if DIMM_REGISTERED
	config DIMM_SUPPORT
		hex
		default 0x0005
	endif
endif

config SVI_HIGH_FREQ
	bool
	default n
	help
	  Select this for boards with a Voltage Regulator able to operate
	  at 3.4 MHz in SVI mode. Ignored unless the AMD CPU is rev C3.

menu "HyperTransport setup"
	#could be implemented for K8 (NORTHBRIDGE_AMD_AMDK8)
	depends on (NORTHBRIDGE_AMD_AMDFAM10)

choice
	prompt "HyperTransport downlink width"
	default LIMIT_HT_DOWN_WIDTH_16
	help
	  This option sets the maximum permissible HyperTransport
	  downlink width.

	  Use of this option will only limit the autodetected HT width.
	  It will not (and cannot) increase the width beyond the autodetected
	  limits.

	  This is primarily used to work around poorly designed or laid out HT
	  traces on certain motherboards.

config LIMIT_HT_DOWN_WIDTH_8
	bool "8 bits"
config LIMIT_HT_DOWN_WIDTH_16
	bool "16 bits"
endchoice

choice
	prompt "HyperTransport uplink width"
	default LIMIT_HT_UP_WIDTH_16
	help
	  This option sets the maximum permissible HyperTransport
	  uplink width.

	  Use of this option will only limit the autodetected HT width.
	  It will not (and cannot) increase the width beyond the autodetected
	  limits.

	  This is primarily used to work around poorly designed or laid out HT
	  traces on certain motherboards.

config LIMIT_HT_UP_WIDTH_8
	bool "8 bits"
config LIMIT_HT_UP_WIDTH_16
	bool "16 bits"
endchoice

endmenu

config MAX_REBOOT_CNT
	int
	default 6

endif # NORTHBRIDGE_AMD_AMDFAM10
```

## src/northbridge/amd/amdk8/Kconfig
```kconfig
##
## This file is part of the coreboot project.
##
## Copyright (C) 2007-2009 coresystems GmbH
##
## This program is free software; you can redistribute it and/or modify
## it under the terms of the GNU General Public License as published by
## the Free Software Foundation; version 2 of the License.
##
## This program is distributed in the hope that it will be useful,
## but WITHOUT ANY WARRANTY; without even the implied warranty of
## MERCHANTABILITY or FITNESS FOR A PARTICULAR PURPOSE.  See the
## GNU General Public License for more details.
##
## You should have received a copy of the GNU General Public License
## along with this program; if not, write to the Free Software
## Foundation, Inc., 51 Franklin St, Fifth Floor, Boston, MA 02110-1301 USA
##

config NORTHBRIDGE_AMD_AMDK8
	bool
	select HAVE_DEBUG_RAM_SETUP
	select HAVE_DEBUG_SMBUS
	select HAVE_DEBUG_CAR
	select HYPERTRANSPORT_PLUGIN_SUPPORT

if NORTHBRIDGE_AMD_AMDK8
config AGP_APERTURE_SIZE
	hex
	default 0x4000000

config K8_HT_FREQ_1G_SUPPORT
	bool
	default n

config WAIT_BEFORE_CPUS_INIT
	bool
	default n

config MEM_TRAIN_SEQ
	int
	default 0

# Force 2T DRAM timing (vendor BIOS does it even for single DIMM setups and
# single DIMM is indeed unreliable without it).
config K8_FORCE_2T_DRAM_TIMING
	bool
	default n

config HW_MEM_HOLE_SIZEK
	hex
	default 0x100000

config HW_MEM_HOLE_SIZE_AUTO_INC
	bool
	default n

config BOOTBLOCK_NORTHBRIDGE_INIT
        string
        default "northbridge/amd/amdk8/bootblock.c"

config SB_HT_CHAIN_UNITID_OFFSET_ONLY
	bool
	default n

config QRANK_DIMM_SUPPORT
	bool
	default n

config K8_ALLOCATE_IO_RANGE
	bool
	default n

if K8_REV_F_SUPPORT

config DIMM_DDR2
	bool
	default n

config DIMM_REGISTERED
	bool
	default n

if DIMM_DDR2
	if DIMM_REGISTERED
	config DIMM_SUPPORT
		hex
		default 0x0104
	endif

	if !DIMM_REGISTERED
	config DIMM_SUPPORT
		hex
		default 0x0004
	endif
endif #DIMM_DDR2

endif #K8_REV_F_SUPPORT

config IOMMU
	bool
	default y

endif #NORTHBRIDGE_AMD_K8
```

## src/northbridge/amd/cimx/rd890/Kconfig
```kconfig
#
# This file is part of the coreboot project.
#
# Copyright (C) 2012 Advanced Micro Devices, Inc.
#
# This program is free software; you can redistribute it and/or modify
# it under the terms of the GNU General Public License as published by
# the Free Software Foundation; version 2 of the License.
#
# This program is distributed in the hope that it will be useful,
# but WITHOUT ANY WARRANTY; without even the implied warranty of
# MERCHANTABILITY or FITNESS FOR A PARTICULAR PURPOSE.  See the
# GNU General Public License for more details.
#
# You should have received a copy of the GNU General Public License
# along with this program; if not, write to the Free Software
# Foundation, Inc., 51 Franklin St, Fifth Floor, Boston, MA 02110-1301 USA
#

config NORTHBRIDGE_AMD_CIMX_RD890
	bool
	default n
	select AMD_NB_CIMX

if NORTHBRIDGE_AMD_CIMX_RD890

config REDIRECT_NBCIMX_TRACE_TO_SERIAL
	bool "Redirect AMD Northbridge CIMX Trace to serial console"
	default n
	help
	  This Option allows you to redirect the AMD Northbridge CIMX
	  Trace debug information to the serial console.

          Warning: Only enable this option when debuging or tracing AMD CIMX code.

endif # NORTHBRIDGE_AMD_CIMX_RD890
```

## src/northbridge/amd/gx2/Kconfig
```kconfig
##
## This file is part of the coreboot project.
##
## Copyright (C) 2007-2009 coresystems GmbH
##
## This program is free software; you can redistribute it and/or modify
## it under the terms of the GNU General Public License as published by
## the Free Software Foundation; version 2 of the License.
##
## This program is distributed in the hope that it will be useful,
## but WITHOUT ANY WARRANTY; without even the implied warranty of
## MERCHANTABILITY or FITNESS FOR A PARTICULAR PURPOSE.  See the
## GNU General Public License for more details.
##
## You should have received a copy of the GNU General Public License
## along with this program; if not, write to the Free Software
## Foundation, Inc., 51 Franklin St, Fifth Floor, Boston, MA 02110-1301 USA
##

config NORTHBRIDGE_AMD_GX2
	bool
	select GEODE_VSA

if NORTHBRIDGE_AMD_GX2

choice
	prompt "Framebuffer size"
	default GX2_VIDEO_MB_8MB

config GX2_VIDEO_MB_4MB
	bool "4MB"
config GX2_VIDEO_MB_8MB
	bool "8MB"
config GX2_VIDEO_MB_16MB
	bool "16MB"
config GX2_VIDEO_MB_32MB
	bool "32MB"
config GX2_VIDEO_MB_64MB
	bool "64MB"
config GX2_VIDEO_MB_128MB
	bool "128MB"
config GX2_VIDEO_MB_256MB
	bool "256MB"
config GX2_VIDEO_MB_CMOS
	bool "Use CMOS option"

endchoice

config VIDEO_MB
	int
	default 4 if GX2_VIDEO_MB_4MB
	default 8 if GX2_VIDEO_MB_8MB
	default 16 if GX2_VIDEO_MB_16MB
	default 32 if GX2_VIDEO_MB_32MB
	default 64 if GX2_VIDEO_MB_64MB
	default 128 if GX2_VIDEO_MB_128MB
	default 256 if GX2_VIDEO_MB_256MB
	default -1  if GX2_VIDEO_MB_CMOS

# The GX2_PROCESSOR_MHZ options let you chose the correct GX2 processor
# speed in the mainboard's Kconfig file.
config GX2_PROCESSOR_MHZ_300
	bool
config GX2_PROCESSOR_MHZ_366
	bool
config GX2_PROCESSOR_MHZ_400
	bool

# Map the config names to an integer (MHz).
config GX2_PROCESSOR_MHZ
	int
	default 300 if GX2_PROCESSOR_MHZ_300
	default 366 if GX2_PROCESSOR_MHZ_366
	default 400 if GX2_PROCESSOR_MHZ_400

endif # NORTHBRIDGE_AMD_GX2
```
