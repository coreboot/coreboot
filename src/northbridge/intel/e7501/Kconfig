## src/northbridge/intel/e7501/Kconfig
```kconfig
config NORTHBRIDGE_INTEL_E7501
	bool
	select HAVE_DEBUG_RAM_SETUP
	select PER_DEVICE_ACPI_TABLES
	select LATE_CBMEM_INIT
```

## src/northbridge/intel/e7505/Kconfig
```kconfig
# SPDX-License-Identifier: GPL-2.0-only

config NORTHBRIDGE_INTEL_E7505
	bool
	select NO_ECAM_MMCONF_SUPPORT
	select HAVE_DEBUG_RAM_SETUP
	select NO_CBFS_MCACHE
	select SMM_TSEG
	select NEED_SMALL_2MB_PAGE_TABLES
```

## src/northbridge/intel/e7520/Kconfig
```kconfig
config NORTHBRIDGE_INTEL_E7520
	bool

if NORTHBRIDGE_INTEL_E7520
config DIMM_MAP_LOGICAL
	hex
	default 0x1248

endif
```

## src/northbridge/intel/e7525/Kconfig
```kconfig
config NORTHBRIDGE_INTEL_E7525
	bool

if NORTHBRIDGE_INTEL_E7525
config DIMM_MAP_LOGICAL
	hex
	default 0x1248

endif
```

## src/northbridge/intel/fsp_rangeley/Kconfig
```kconfig
##
## This file is part of the coreboot project.
##
## Copyright (C) 2010 Google Inc.
## Copyright (C) 2013 Sage Electronic Engineering, LLC.
##
## This program is free software; you can redistribute it and/or modify
## it under the terms of the GNU General Public License as published by
## the Free Software Foundation; version 2 of the License.
##
## This program is distributed in the hope that it will be useful,
## but WITHOUT ANY WARRANTY; without even the implied warranty of
## MERCHANTABILITY or FITNESS FOR A PARTICULAR PURPOSE.  See the
## GNU General Public License for more details.
##

config NORTHBRIDGE_INTEL_FSP_RANGELEY
	bool
	select CPU_INTEL_FSP_MODEL_406DX
	select MMCONF_SUPPORT_DEFAULT

if NORTHBRIDGE_INTEL_FSP_RANGELEY

config MMCONF_BASE_ADDRESS
	hex
	default 0xe0000000

choice
	prompt "Set TSEG Size"
	default SET_TSEG_1MB if SET_DEFAULT_TSEG_1MB
	default SET_TSEG_2MB if SET_DEFAULT_TSEG_2MB
	default SET_TSEG_4MB if SET_DEFAULT_TSEG_4MB
	default SET_TSEG_8MB if SET_DEFAULT_TSEG_8MB

config SET_TSEG_1MB
	bool "1 MB"
	help
	  Set the TSEG area to 1 MB.

config SET_TSEG_2MB
	bool "2 MB"
	help
	  Set the TSEG area to 2 MB.

config SET_TSEG_4MB
	bool "4 MB"
	help
	  Set the TSEG area to 4 MB.

config SET_TSEG_8MB
	bool "8 MB"
	help
	  Set the TSEG area to 8 MB.
endchoice

config SMM_TSEG_SIZE
	hex
	default 0x200000 if SET_TSEG_2MB
	default 0x400000 if SET_TSEG_4MB
	default 0x800000 if SET_TSEG_8MB
	default 0x100000 # SET_TSEG_1MB

config SMM_RESERVED_SIZE
	hex
	default 0x200000 if SET_TSEG_2MB
	default 0x400000 if SET_TSEG_4MB
	default 0x800000 if SET_TSEG_8MB
	default 0x100000 # SET_TSEG_1MB

config SET_DEFAULT_TSEG_1MB
	bool
	default n

config SET_DEFAULT_TSEG_2MB
	bool
	default n

config SET_DEFAULT_TSEG_4MB
	bool
	default n

config SET_DEFAULT_TSEG_8MB
	bool
	default n

# Rangeley Specific FSP Kconfig
source src/northbridge/intel/fsp_rangeley/fsp/Kconfig

endif # NORTHBRIDGE_INTEL_FSP_RANGELEY
```

## src/northbridge/intel/fsp_rangeley/fsp/Kconfig
```kconfig
##
## This file is part of the coreboot project.
##
## Copyright (C) 2014 Sage Electronic Engineering, LLC.
##
## This program is free software; you can redistribute it and/or modify
## it under the terms of the GNU General Public License as published by
## the Free Software Foundation; version 2 of the License.
##
## This program is distributed in the hope that it will be useful,
## but WITHOUT ANY WARRANTY; without even the implied warranty of
## MERCHANTABILITY or FITNESS FOR A PARTICULAR PURPOSE.  See the
## GNU General Public License for more details.
##

config RANGELEY_FSP_SPECIFIC_OPTIONS
	def_bool y
	select PLATFORM_USES_FSP1_0
	select USE_GENERIC_FSP_CAR_INC
	select FSP_USES_UPD
	select ENABLE_MRC_CACHE #rangeley FSP always needs MRC data

config FSP_FILE
	string
	default "../intel/fsp/rangeley/FvFsp.bin"
	help
	  The path and filename of the Intel FSP binary for this platform.

config FSP_LOC
	hex
	default 0xfff80000
	help
	  The location in CBFS that the FSP is located. This must match the
	  value that is set in the FSP binary.  If the FSP needs to be moved,
	  rebase the FSP with Intel's BCT (tool).

	  The Rangeley FSP is built with a preferred base address of 0xFFF80000

config DCACHE_RAM_BASE
	hex
	default 0xfef00000

config DCACHE_RAM_SIZE
	hex
	default 0x4000
```

## src/northbridge/intel/fsp_sandybridge/Kconfig
```kconfig
##
## This file is part of the coreboot project.
##
## Copyright (C) 2010 Google Inc.
## Copyright (C) 2013 Sage Electronic Engineering, LLC.
##
## This program is free software; you can redistribute it and/or modify
## it under the terms of the GNU General Public License as published by
## the Free Software Foundation; version 2 of the License.
##
## This program is distributed in the hope that it will be useful,
## but WITHOUT ANY WARRANTY; without even the implied warranty of
## MERCHANTABILITY or FITNESS FOR A PARTICULAR PURPOSE.  See the
## GNU General Public License for more details.
##

config NORTHBRIDGE_INTEL_FSP_SANDYBRIDGE
	bool
	select CPU_INTEL_FSP_MODEL_206AX
	select INTEL_GMA_ACPI
	select MMCONF_SUPPORT_DEFAULT

config NORTHBRIDGE_INTEL_FSP_IVYBRIDGE
	bool
	select CPU_INTEL_FSP_MODEL_306AX
	select INTEL_GMA_ACPI
	select MMCONF_SUPPORT_DEFAULT

if NORTHBRIDGE_INTEL_FSP_IVYBRIDGE || NORTHBRIDGE_INTEL_FSP_SANDYBRIDGE

config BOOTBLOCK_NORTHBRIDGE_INIT
	string
	default "northbridge/intel/fsp_sandybridge/bootblock.c"

config VGA_BIOS_ID
	string
	default "8086,0106"
	help
	  This is the default PCI ID for the sandybridge/ivybridge graphics
	  devices.  This string names the vbios ROM in cbfs.  The following
	  PCI IDs will be remapped to load this ROM:
	  0x80860102, 0x8086010a, 0x80860112, 0x80860116
	  0x80860122, 0x80860126, 0x80860166

# Ivybridge Specific FSP Kconfig
source src/northbridge/intel/fsp_sandybridge/fsp/Kconfig

endif # NORTHBRIDGE_INTEL_FSP_IVYBRIDGE || NORTHBRIDGE_INTEL_FSP_SANDYBRIDGE
```

## src/northbridge/intel/fsp_sandybridge/fsp/Kconfig
```kconfig
##
## This file is part of the coreboot project.
##
## Copyright (C) 2014 Sage Electronic Engineering, LLC.
##
## This program is free software; you can redistribute it and/or modify
## it under the terms of the GNU General Public License as published by
## the Free Software Foundation; version 2 of the License.
##
## This program is distributed in the hope that it will be useful,
## but WITHOUT ANY WARRANTY; without even the implied warranty of
## MERCHANTABILITY or FITNESS FOR A PARTICULAR PURPOSE.  See the
## GNU General Public License for more details.
##
## You should have received a copy of the GNU General Public License
## along with this program; if not, write to the Free Software
## Foundation, Inc.
##

config SANDYBRIDGE_FSP_SPECIFIC_OPTIONS
	def_bool y
	select PLATFORM_USES_FSP1_0
	select USE_GENERIC_FSP_CAR_INC

config FSP_FILE
	string
	default "../intel/fsp/ivybridge_bd82x6x/FvFsp.bin" if SOUTHBRIDGE_INTEL_FSP_BD82X6X
	help
	  The path and filename of the Intel FSP binary for this platform.

config FSP_LOC
	hex "Intel FSP Binary location in CBFS"
	default 0xfff80000
	help
	  The location in CBFS that the FSP is located. This must match the
	  value that is set in the FSP binary.  If the FSP needs to be moved,
	  rebase the FSP with the Intel's BCT (tool).

	  The Ivy Bridge Processor/Panther Point FSP is built with a preferred
	  base address of 0xFFF80000
```

## src/northbridge/intel/gm45/Kconfig
```kconfig
# SPDX-License-Identifier: GPL-2.0-only

config NORTHBRIDGE_INTEL_GM45
	bool

if NORTHBRIDGE_INTEL_GM45

config NORTHBRIDGE_SPECIFIC_OPTIONS
	def_bool y
	select HAVE_DEBUG_RAM_SETUP
	select VGA
	select INTEL_EDID
	select INTEL_GMA_ACPI
	select INTEL_GMA_SSC_ALTERNATE_REF
	select HAVE_EXP_X86_64_SUPPORT

config VBOOT
	select VBOOT_STARTS_IN_BOOTBLOCK

config CBFS_SIZE
	default 0x100000

config VGA_BIOS_ID
	string
	default "8086,2a42"

config ECAM_MMCONF_BASE_ADDRESS
	default 0xf0000000

config ECAM_MMCONF_BUS_NUMBER
	int
	default 64

config SMM_RESERVED_SIZE
	hex
	default 0x100000

config INTEL_GMA_BCLV_OFFSET
	default 0x61254

config INTEL_GMA_BCLM_OFFSET
	default 0x61256

config FIXED_MCHBAR_MMIO_BASE
	default 0xfed14000

config FIXED_DMIBAR_MMIO_BASE
	default 0xfed18000

config FIXED_EPBAR_MMIO_BASE
	default 0xfed19000

endif
```

## src/northbridge/intel/haswell/Kconfig
```kconfig
# SPDX-License-Identifier: GPL-2.0-only

config NORTHBRIDGE_INTEL_HASWELL
	bool
	select CPU_INTEL_HASWELL
	select CACHE_MRC_SETTINGS
	select INTEL_DDI
	select INTEL_GMA_ACPI
	select NO_DDR5
	select NO_LPDDR4
	select NO_DDR2
	select NO_DDR4
	select USE_DDR3

if NORTHBRIDGE_INTEL_HASWELL

config USE_NATIVE_RAMINIT
	bool "[NOT WORKING] Use native raminit"
	default n
	select HAVE_DEBUG_RAM_SETUP
	help
	  Select if you want to use coreboot implementation of raminit rather than
	  MRC.bin. Currently incomplete and does not boot.

config HASWELL_VBOOT_IN_BOOTBLOCK
	depends on VBOOT
	bool "Start verstage in bootblock"
	default y
	select VBOOT_STARTS_IN_BOOTBLOCK
	help
	  Haswell can either start verstage in a separate stage
	  right after the bootblock has run or it can start it
	  after romstage for compatibility reasons.
	  Haswell however uses a mrc.bin to initialize memory which
	  needs to be located at a fixed offset. Therefore even with
	  a separate verstage starting after the bootblock that same
	  binary is used meaning a jump is made from RW to the RO region
	  and back to the RW region after the binary is done.

config VBOOT
	select VBOOT_MUST_REQUEST_DISPLAY
	select VBOOT_STARTS_IN_ROMSTAGE if !HASWELL_VBOOT_IN_BOOTBLOCK

config VGA_BIOS_ID
	string
	default "8086,0166"

config ECAM_MMCONF_BASE_ADDRESS
	default 0xf0000000

config ECAM_MMCONF_BUS_NUMBER
	int
	default 64

config DCACHE_RAM_BASE
	hex
	default 0xff7c0000

config DCACHE_RAM_SIZE
	hex
	default 0x40000 if USE_NATIVE_RAMINIT
	default 0x10000
	help
	  The size of the cache-as-ram region required during bootblock
	  and/or romstage. Note DCACHE_RAM_SIZE and DCACHE_RAM_MRC_VAR_SIZE
	  must add up to a power of 2.

config DCACHE_RAM_MRC_VAR_SIZE
	hex
	default 0x0 if USE_NATIVE_RAMINIT
	default 0x30000
	help
	  The amount of cache-as-ram region required by the reference code.

config DCACHE_BSP_STACK_SIZE
	hex
	default 0x20000 if USE_NATIVE_RAMINIT
	default 0x2000
	help
	  The amount of anticipated stack usage in CAR by bootblock and
	  other stages.

config HAVE_MRC
	bool "Add a System Agent binary"
	depends on !USE_NATIVE_RAMINIT
	help
	  Select this option to add a System Agent binary to
	  the resulting coreboot image.

	  Note: Without this binary coreboot will not work

config MRC_FILE
	string "Intel System Agent path and filename"
	depends on HAVE_MRC
	default "mrc.bin"
	help
	  The path and filename of the file to use as System Agent
	  binary.

config HASWELL_HIDE_PEG_FROM_MRC
	bool "Hide PEG devices from MRC to work around hardcoded MRC behavior"
	depends on !USE_NATIVE_RAMINIT
	default y
	help
	  If set, hides all PEG devices from MRC. This allows the iGPU
	  to be used even when a dedicated graphics card is present.
	  However, it prevents MRC from programming PEG AFE registers,
	  which can make PEG devices unstable. When unsure, choose N.

# The UEFI System Agent binary needs to be at a fixed offset in the flash
# and can therefore only reside in the COREBOOT fmap region
config RO_REGION_ONLY
	string
	depends on VBOOT
	default "mrc.bin"

config INTEL_GMA_BCLV_OFFSET
	default 0x48254

config ENABLE_DDR_2X_REFRESH
	bool "Enable DRAM Refresh 2x support"
	default n
	help
	  When enabled, the memory controller will refresh the DRAM twice as often.
	  This probably only happens when the DRAM gets hot, but what MRC exactly
	  does when this setting is enabled has not been investigated.

config FIXED_MCHBAR_MMIO_BASE
	default 0xfed10000

config FIXED_DMIBAR_MMIO_BASE
	default 0xfed18000

config FIXED_EPBAR_MMIO_BASE
	default 0xfed19000

endif
```

## src/northbridge/intel/i3100/Kconfig
```kconfig
config NORTHBRIDGE_INTEL_I3100
	bool
	select NO_MMCONF_SUPPORT
	select LATE_CBMEM_INIT
	select UDELAY_IO

if NORTHBRIDGE_INTEL_I3100
config DIMM_MAP_LOGICAL
	hex
	default 0x1248

endif
```

## src/northbridge/intel/i440bx/Kconfig
```kconfig
# SPDX-License-Identifier: GPL-2.0-only

config NORTHBRIDGE_INTEL_I440BX
	bool
	select NO_ECAM_MMCONF_SUPPORT
	select HAVE_DEBUG_RAM_SETUP
	select NO_CBFS_MCACHE

config SDRAMPWR_4DIMM
	bool
	depends on NORTHBRIDGE_INTEL_I440BX
	default n
	help
	  This option affects how the SDRAMC register is programmed.
	  Memory clock signals will not be routed properly if this option
	  is set wrong.

	  If your board has 4 DIMM slots, you must use select this option, in
	  your Kconfig file of the board. On boards with 3 DIMM slots,
	  do _not_ select this option.
```

## src/northbridge/intel/i5000/Kconfig
```kconfig
##
## This file is part of the coreboot project.
##
## Copyright (C) 2011 Sven Schnelle <svens@stackframe.org>
##
## This program is free software; you can redistribute it and/or modify
## it under the terms of the GNU General Public License as published by
## the Free Software Foundation; version 2 of the License.
##
## This program is distributed in the hope that it will be useful,
## but WITHOUT ANY WARRANTY; without even the implied warranty of
## MERCHANTABILITY or FITNESS FOR A PARTICULAR PURPOSE.  See the
## GNU General Public License for more details.
##

config NORTHBRIDGE_INTEL_I5000
	bool
	select HAVE_DEBUG_RAM_SETUP
	select LATE_CBMEM_INIT

if NORTHBRIDGE_INTEL_I5000

config NORTHBRIDGE_INTEL_I5000_RAM_CHECK
	bool
	prompt "Run ramcheck after RAM initialization"

config BOOTBLOCK_NORTHBRIDGE_INIT
	string
	default "northbridge/intel/i5000/bootblock.c"

endif
```

## src/northbridge/intel/i82810/Kconfig
```kconfig
##
## This file is part of the coreboot project.
##
## Copyright (C) 2009 Uwe Hermann <uwe@hermann-uwe.de>
##
## This program is free software; you can redistribute it and/or modify
## it under the terms of the GNU General Public License as published by
## the Free Software Foundation; version 2 of the License.
##
## This program is distributed in the hope that it will be useful,
## but WITHOUT ANY WARRANTY; without even the implied warranty of
## MERCHANTABILITY or FITNESS FOR A PARTICULAR PURPOSE.  See the
## GNU General Public License for more details.
##

config NORTHBRIDGE_INTEL_I82810
	bool
	select NO_MMCONF_SUPPORT
	select HAVE_DEBUG_RAM_SETUP
	select LATE_CBMEM_INIT
	select UDELAY_IO

choice
	prompt "Onboard graphics"
	default I810_VIDEO_MB_1MB
	depends on NORTHBRIDGE_INTEL_I82810

config I810_VIDEO_MB_OFF
	bool "Disabled, 0KB"
config I810_VIDEO_MB_512KB
	bool "Enabled, 512KB"
config I810_VIDEO_MB_1MB
	bool "Enabled, 1MB"

endchoice

config VIDEO_MB
	int
	default 0   if I810_VIDEO_MB_OFF
	default 512 if I810_VIDEO_MB_512KB
	default 1   if I810_VIDEO_MB_1MB
	depends on NORTHBRIDGE_INTEL_I82810

config VGA_BIOS_ID
	string
	default "8086,7121"
	depends on NORTHBRIDGE_INTEL_I82810
```

## src/northbridge/intel/i82830/Kconfig
```kconfig
config NORTHBRIDGE_INTEL_I82830
	bool
	select NO_MMCONF_SUPPORT
	select HAVE_DEBUG_RAM_SETUP
	select LATE_CBMEM_INIT
	select UDELAY_IO

choice
	prompt "Onboard graphics"
	default I830_VIDEO_MB_8MB
	depends on NORTHBRIDGE_INTEL_I82830

config I830_VIDEO_MB_OFF
	bool "Disabled, 0KB"
config I830_VIDEO_MB_512KB
	bool "Enabled, 512KB"
config I830_VIDEO_MB_1MB
	bool "Enabled, 1MB"
config I830_VIDEO_MB_8MB
	bool "Enabled, 8MB"

endchoice

config VIDEO_MB
	int
	default 0   if I830_VIDEO_MB_OFF
	default 512 if I830_VIDEO_MB_512KB
	default 1   if I830_VIDEO_MB_1MB
	default 8   if I830_VIDEO_MB_8MB
	depends on NORTHBRIDGE_INTEL_I82830
```
