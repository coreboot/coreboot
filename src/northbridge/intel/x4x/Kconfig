## src/northbridge/intel/x4x/Kconfig
```kconfig
# SPDX-License-Identifier: GPL-2.0-only

config NORTHBRIDGE_INTEL_X4X
	bool

if NORTHBRIDGE_INTEL_X4X

config NORTHBRIDGE_SPECIFIC_OPTIONS
	def_bool y
	select HAVE_DEBUG_RAM_SETUP
	select VGA
	select INTEL_GMA_ACPI
	select CACHE_MRC_SETTINGS
	select BOOT_DEVICE_SPI_FLASH_NO_EARLY_WRITES
	select HAVE_EXP_X86_64_SUPPORT
	select NO_DDR5
	select NO_LPDDR4
	select NO_DDR4
	select USE_DDR3
	select USE_DDR2

config CBFS_SIZE
	default 0x100000 if !SOUTHBRIDGE_INTEL_I82801GX

config VGA_BIOS_ID
	string
	default "8086,2e32"

config ECAM_MMCONF_BASE_ADDRESS
	default 0xe0000000

config ECAM_MMCONF_BUS_NUMBER
	int
	default 256

config SMM_RESERVED_SIZE
	hex
	default 0x100000

config MAX_CPUS
	int
	default 4

config FIXED_MCHBAR_MMIO_BASE
	default 0xfed14000

config FIXED_DMIBAR_MMIO_BASE
	default 0xfed18000

config FIXED_EPBAR_MMIO_BASE
	default 0xfed19000

endif
```

## src/northbridge/via/Kconfig
```kconfig
source src/northbridge/via/cn700/Kconfig
source src/northbridge/via/cx700/Kconfig
source src/northbridge/via/vx800/Kconfig
source src/northbridge/via/vx900/Kconfig
```

## src/northbridge/via/cn400/Kconfig
```kconfig
config NORTHBRIDGE_VIA_CN400
	bool

# TODO: Values are from the CX700 datasheet, not sure if this matches CN400.
# TODO: What should be the per-chipset default value here?
choice
	prompt "Onboard graphics"
	default CN400_VIDEO_MB_32MB
	depends on NORTHBRIDGE_VIA_CN400

# TODO: Disabling onboard graphics is not yet supported in the source code.
config CN400_VIDEO_MB_OFF
	bool "Disabled, 0KB"
config CN400_VIDEO_MB_8MB
	bool "Enabled, 8MB"
config CN400_VIDEO_MB_16MB
	bool "Enabled, 16MB"
config CN400_VIDEO_MB_32MB
	bool "Enabled, 32MB"
config CN400_VIDEO_MB_64MB
	bool "Enabled, 64MB"
config CN400_VIDEO_MB_128MB
	bool "Enabled, 128MB"

endchoice

config VIDEO_MB
	int
	default 0   if CN400_VIDEO_MB_OFF
	default 8   if CN400_VIDEO_MB_8MB
	default 16  if CN400_VIDEO_MB_16MB
	default 32  if CN400_VIDEO_MB_32MB
	default 64  if CN400_VIDEO_MB_64MB
	default 128 if CN400_VIDEO_MB_128MB
	depends on NORTHBRIDGE_VIA_CN400
```

## src/northbridge/via/cn700/Kconfig
```kconfig
config NORTHBRIDGE_VIA_CN700
	bool
	select NO_MMCONF_SUPPORT
	select HAVE_DEBUG_RAM_SETUP
	select LATE_CBMEM_INIT

# TODO: Values are from the CX700 datasheet, not sure if this matches CN700.
# TODO: What should be the per-chipset default value here?
choice
	prompt "Onboard graphics"
	default CN700_VIDEO_MB_32MB
	depends on NORTHBRIDGE_VIA_CN700

# TODO: Disabling onboard graphics is not yet supported in the code.
config CN700_VIDEO_MB_OFF
	bool "Disabled, 0KB"
config CN700_VIDEO_MB_8MB
	bool "Enabled, 8MB"
config CN700_VIDEO_MB_16MB
	bool "Enabled, 16MB"
config CN700_VIDEO_MB_32MB
	bool "Enabled, 32MB"
config CN700_VIDEO_MB_64MB
	bool "Enabled, 64MB"
config CN700_VIDEO_MB_128MB
	bool "Enabled, 128MB"

endchoice

config VIDEO_MB
	int
	default 0   if CN700_VIDEO_MB_OFF
	default 8   if CN700_VIDEO_MB_8MB
	default 16  if CN700_VIDEO_MB_16MB
	default 32  if CN700_VIDEO_MB_32MB
	default 64  if CN700_VIDEO_MB_64MB
	default 128 if CN700_VIDEO_MB_128MB
	depends on NORTHBRIDGE_VIA_CN700
```

## src/northbridge/via/cx700/Kconfig
```kconfig
## SPDX-License-Identifier: GPL-2.0-only

config NORTHBRIDGE_VIA_CX700
	bool
	select PCI
	select NO_ECAM_MMCONF_SUPPORT
	select HAVE_CF9_RESET
	select SOUTHBRIDGE_INTEL_COMMON_SMBUS
	select HAVE_DEBUG_RAM_SETUP

if NORTHBRIDGE_VIA_CX700

config CHIPSET_DEVICETREE
	default "northbridge/via/cx700/chipset.cb"

endif
```

## src/northbridge/via/vx800/Kconfig
```kconfig
config NORTHBRIDGE_VIA_VX800
	bool
	select NO_MMCONF_SUPPORT
	select HAVE_DEBUG_RAM_SETUP
	select HAVE_DEBUG_SMBUS
	select LATE_CBMEM_INIT
```

## src/northbridge/via/vx900/Kconfig
```kconfig
##
## This file is part of the coreboot project.
##
## Copyright (C) 2011  Alexandru Gagniuc <mr.nuke.me@gmail.com>
##
## This program is free software: you can redistribute it and/or modify
## it under the terms of the GNU General Public License as published by
## the Free Software Foundation, either version 2 of the License, or
## (at your option) any later version.
##
## This program is distributed in the hope that it will be useful,
## but WITHOUT ANY WARRANTY; without even the implied warranty of
## MERCHANTABILITY or FITNESS FOR A PARTICULAR PURPOSE.  See the
## GNU General Public License for more details.
##

config NORTHBRIDGE_VIA_VX900
	bool
	select IOAPIC
	select DRIVERS_GENERIC_IOAPIC
	select HAVE_DEBUG_RAM_SETUP
	select HAVE_DEBUG_SMBUS
	select HAVE_HARD_RESET

if NORTHBRIDGE_VIA_VX900

config MAX_PIRQ_LINKS
	int
	default 8

config MMCONF_BASE_ADDRESS
	hex
	default 0xe0000000

config MMCONF_BUS_NUMBER
	int
	default 256

config VGA_BIOS_ID
	string
	default "1106,7122"

config BOOTBLOCK_NORTHBRIDGE_INIT
	string
	default "northbridge/via/vx900/bootblock.c"

endif
```

## src/sbom/Kconfig
```kconfig
## SPDX-License-Identifier: GPL-2.0-only

config SBOM
	bool "Include SBOM data for coreboot"
	default n
	help
	  Select this option if you want to include a
	  coswid (Concise Software Identification Tag) of coreboot itself
	  into the SBOM (Software Bill of Materials) File in your build

if SBOM

config SBOM_COMPILER
	bool "Include compiler metadata in SBOM"
	default n
	help
	  Select this option if you want to include a
	  coswid (Concise Software Identification Tag) of the compiler
	  used to compile coreboot into the SBOM (Software Bill of Materials)
	  File in your build
	  Note: if the system toolchain is used to build coreboot
	  one should check the final SBOM file for the expected results

config SBOM_PAYLOAD
	bool "Include payload metadata in SBOM"
	default n
	help
	  Select this option if you want to include a
	  coswid (Concise Software Identification Tag) of the payload into
	  the SBOM (Software Bill of Materials) File in your build

config SBOM_PAYLOAD_GENERATE
	bool "Auto-generate generic SBOM info for payload"
	depends on SBOM_PAYLOAD && (PAYLOAD_BOOTBOOT || PAYLOAD_DEPTHCHARGE || PAYLOAD_FILO || PAYLOAD_GRUB2 || PAYLOAD_LINUXBOOT || PAYLOAD_SEABIOS || PAYLOAD_SKIBOOT || PAYLOAD_UBOOT || PAYLOAD_YABITS)
	default y
	help
	  Select this option if you want coreboot to generate and include
	  the coswid (Concise Software Identification Tag) instead of supplying
	  it manually. Be aware that this option is only meant to be a
	  transition and suppliers of Software should always prefer to include
	  their own Software descriptions, since ours may be incomplete or
	  straight up wrong.

config SBOM_PAYLOAD_PATH
	string "SBOM file path"
	depends on SBOM_PAYLOAD && !SBOM_PAYLOAD_GENERATE
	help
	  The path of the .ini file describing the payload
	  Software included in the build

config SBOM_ME
	bool "Include ME metadata in SBOM"
	depends on HAVE_ME_BIN
	default n
	help
	  Select this option if you want to include a
	  coswid (Concise Software Identification Tag) of the
	  ME firmware into the SBOM (Software Bill of Materials)
	  File in your build

config SBOM_ME_GENERATE
	bool "Auto-generate generic SBOM info for ME firmware"
	depends on SBOM_ME
	default y
	help
	  Select this option if you want coreboot to generate and include
	  the coswid (Concise Software Identification Tag) instead of
	  supplying it manually. Be aware that this option is only meant
	  to be a transition and suppliers of Software should always prefer
	  to include their own Software descriptions, since ours may be
	  incomplete or straight up wrong.

config SBOM_ME_PATH
	string "Path to sbom.json for the ME firmware"
	depends on SBOM_ME && !SBOM_ME_GENERATE
	help
	  The path of the SBOM file (sbom.json file)
	  The path of the .json file describing the Software included in the build

config SBOM_EC
	bool "Include EC metadata in SBOM"
	depends on HAVE_EC_BIN
	default n
	help
	  Select this option if you want to include a
	  coswid (Concise Software Identification Tag) of the
	  EC (Embedded Controller) firmware into the
	  SBOM (Software Bill of Materials) File in your build

config SBOM_EC_PATH
	string "Path to SBOM file for the EC firmware"
	depends on SBOM_EC
	default "src/sbom/generic-ec.json"
	help
	  The path of the SBOM file describing the Software included in the build
	  File can be a .json, .xml, .cbor, .uswid, or .pc

config SBOM_SINIT_ACM
	bool "Include SINIT ACM metadata in SBOM"
	depends on INTEL_TXT_SINITACM_FILE != ""
	default n
	help
	  Select this option if you want to include a
	  coswid (Concise Software Identification Tag) of the
	  SINIT ACM (Authenticated Code Module) firmware into the
	  SBOM (Software Bill of Materials) File in your build

config SBOM_SINIT_ACM_PATH
	string "Path to SBOM file for the SINIT AMC firmware"
	depends on SBOM_SINIT_ACM
	default "src/sbom/intel-sinit-acm.json"
	help
	  The path of the SBOM file describing the Software included in the build
	  File can be a .json, .xml, .cbor, .uswid, or .pc

config SBOM_BIOS_ACM
	bool "Include BIOS ACM metadata in SBOM"
	depends on INTEL_TXT_BIOSACM_FILE != ""
	default n
	help
	  Select this option if you want to include a
	  coswid (Concise Software Identification Tag) of the
	  BIOS ACM (Authenticated Code Module) firmware into the
	  SBOM (Software Bill of Materials) File in your build

config SBOM_BIOS_ACM_PATH
	string "Path to SBOM file for the BIOS AMC firmware"
	depends on SBOM_SINIT_ACM
	default "src/sbom/intel-bios-acm.json"
	help
	  The path of the SBOM file describing the Software included in the build
	  File can be a .json, .xml, .cbor, .uswid, or .pc

config SBOM_MICROCODE
	bool "Include microcode metadata in SBOM"
	default n
	help
	  Select this option if you want to include a
	  coswid (Concise Software Identification Tag) of the
	  microcode firmware into the SBOM (Software Bill of Materials)
	  File in your build

config SBOM_FSP
	bool "Include Intel FSP metadata in SBOM"
	default n
	depends on (FSP_S_FILE != "" || FSP_M_FILE != "" || FSP_T_FILE != "")
	help
	  Select this option if you want to include a
	  coswid (Concise Software Identification Tag) of the
	  FSP firmware into the SBOM (Software Bill of Materials)
	  File in your build

config SBOM_FSP_PATH
	string "Path to SBOM file for the FSP firmware"
	depends on SBOM_FSP
	default "build/sbom/generic-fsp.json"
	help
	  The path of the SBOM file describing the Software included in the build
	  File can be a .json, .xml, .cbor, .uswid, or .pc

config SBOM_VBOOT
	bool "Include VBOOT metadata in SBOM"
	default n
	depends on VBOOT_LIB
	help
	  Select this option if you want to include a
	  coswid (Concise Software Identification Tag) of the
	  VBOOT Software into the SBOM (Software Bill of Materials)
	  File in your build

endif
```

## src/security/intel/Kconfig
```kconfig
## This file is part of the coreboot project.
##
## Copyright (C) 2019 9elements Agency GmbH
## Copyright (C) 2019 Facebook Inc.
##
## This program is free software; you can redistribute it and/or modify
## it under the terms of the GNU General Public License as published by
## the Free Software Foundation; version 2 of the License.
##
## This program is distributed in the hope that it will be useful,
## but WITHOUT ANY WARRANTY; without even the implied warranty of
## MERCHANTABILITY or FITNESS FOR A PARTICULAR PURPOSE.  See the
## GNU General Public License for more details.
##

source "src/security/intel/txt/Kconfig"
source "src/security/intel/stm/Kconfig"
```
