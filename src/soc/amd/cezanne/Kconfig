## src/soc/amd/cezanne/Kconfig
```kconfig
# SPDX-License-Identifier: GPL-2.0-only

config SOC_AMD_CEZANNE
	bool
	help
	  AMD Cezanne support

if SOC_AMD_CEZANNE

config SOC_SPECIFIC_OPTIONS
	def_bool y
	select ACPI_SOC_NVS
	select ARCH_BOOTBLOCK_X86_32
	select ARCH_VERSTAGE_X86_32
	select ARCH_ROMSTAGE_X86_32
	select ARCH_RAMSTAGE_X86_32
	select BOOT_DEVICE_SUPPORTS_WRITES if BOOT_DEVICE_SPI_FLASH
	select DRIVERS_USB_ACPI
	select DRIVERS_USB_PCI_XHCI
	select FSP_COMPRESS_FSP_M_LZMA
	select FSP_COMPRESS_FSP_S_LZMA
	select HAVE_ACPI_TABLES
	select HAVE_CF9_RESET
	select HAVE_FSP_GOP
	select HAVE_SMI_HANDLER
	select IDT_IN_EVERY_STAGE
	select IOAPIC
	select PARALLEL_MP
	select PARALLEL_MP_AP_WORK
	select PLATFORM_USES_FSP2_0
	select RESET_VECTOR_IN_RAM
	select RTC
	select SOC_AMD_COMMON
	select SOC_AMD_COMMON_BLOCK_ACPI
	select SOC_AMD_COMMON_BLOCK_ACPIMMIO
	select SOC_AMD_COMMON_BLOCK_AOAC
	select SOC_AMD_COMMON_BLOCK_APOB
	select SOC_AMD_COMMON_BLOCK_BANKED_GPIOS
	select SOC_AMD_COMMON_BLOCK_DATA_FABRIC
	select SOC_AMD_COMMON_BLOCK_GRAPHICS
	select SOC_AMD_COMMON_BLOCK_HAS_ESPI
	select SOC_AMD_COMMON_BLOCK_I2C
	select SOC_AMD_COMMON_BLOCK_LPC
	select SOC_AMD_COMMON_BLOCK_NONCAR
	select SOC_AMD_COMMON_BLOCK_PCI
	select SOC_AMD_COMMON_BLOCK_PCI_MMCONF
	select SOC_AMD_COMMON_BLOCK_PSP_GEN2
	select SOC_AMD_COMMON_BLOCK_SMBUS
	select SOC_AMD_COMMON_BLOCK_SMI
	select SOC_AMD_COMMON_BLOCK_SMM
	select SOC_AMD_COMMON_BLOCK_SMU
	select SOC_AMD_COMMON_BLOCK_SPI
	select SOC_AMD_COMMON_BLOCK_TSC_FAM17H_19H
	select SOC_AMD_COMMON_BLOCK_UART
	select SOC_AMD_COMMON_BLOCK_UCODE
	select SSE2
	select UDK_2017_BINDING
	select X86_AMD_FIXED_MTRRS
	select X86_AMD_INIT_SIPI

config SOC_AMD_COMMON_BLOCK_UCODE_SIZE
	default 5568

config CHIPSET_DEVICETREE
	string
	default "soc/amd/cezanne/chipset.cb"

config EARLY_RESERVED_DRAM_BASE
	hex
	default 0x2000000
	help
	  This variable defines the base address of the DRAM which is reserved
	  for usage by coreboot in early stages (i.e. before ramstage is up).
	  This memory gets reserved in BIOS tables to ensure that the OS does
	  not use it, thus preventing corruption of OS memory in case of S3
	  resume.

config EARLYRAM_BSP_STACK_SIZE
	hex
	default 0x1000

config PSP_APOB_DRAM_ADDRESS
	hex
	default 0x2001000
	help
	  Location in DRAM where the PSP will copy the AGESA PSP Output
	  Block.

config PRERAM_CBMEM_CONSOLE_SIZE
	hex
	default 0x1600
	help
	  Increase this value if preram cbmem console is getting truncated

config C_ENV_BOOTBLOCK_SIZE
	hex
	default 0x10000
	help
	  Sets the size of the bootblock stage that should be loaded in DRAM.
	  This variable controls the DRAM allocation size in linker script
	  for bootblock stage.

config ROMSTAGE_ADDR
	hex
	default 0x2040000
	help
	  Sets the address in DRAM where romstage should be loaded.

config ROMSTAGE_SIZE
	hex
	default 0x80000
	help
	  Sets the size of DRAM allocation for romstage in linker script.

config FSP_M_ADDR
	hex
	default 0x20C0000
	help
	  Sets the address in DRAM where FSP-M should be loaded. cbfstool
	  performs relocation of FSP-M to this address.

config FSP_M_SIZE
	hex
	default 0x80000
	help
	  Sets the size of DRAM allocation for FSP-M in linker script.

config FSP_TEMP_RAM_SIZE
	hex
	default 0x40000
	help
	  The amount of coreboot-allocated heap and stack usage by the FSP.

config VERSTAGE_ADDR
	hex
	depends on VBOOT_SEPARATE_VERSTAGE
	default 0x2140000
	help
	  Sets the address in DRAM where verstage should be loaded if running
	  as a separate stage on x86.

config VERSTAGE_SIZE
	hex
	depends on VBOOT_SEPARATE_VERSTAGE
	default 0x80000
	help
	  Sets the size of DRAM allocation for verstage in linker script if
	  running as a separate stage on x86.

config RAMBASE
	hex
	default 0x10000000

config RO_REGION_ONLY
	string
	depends on VBOOT_SLOTS_RW_AB || VBOOT_SLOTS_RW_A
	default "apu/amdfw"

config CPU_ADDR_BITS
	int
	default 48

config MMCONF_BASE_ADDRESS
	default 0xF8000000

config MMCONF_BUS_NUMBER
	default 64

config MAX_CPUS
	int
	default 16

config CONSOLE_UART_BASE_ADDRESS
	depends on CONSOLE_SERIAL && AMD_SOC_CONSOLE_UART
	hex
	default 0xfedc9000 if UART_FOR_CONSOLE = 0
	default 0xfedca000 if UART_FOR_CONSOLE = 1

config SMM_TSEG_SIZE
	hex
	default 0x800000 if HAVE_SMI_HANDLER
	default 0x0

config SMM_RESERVED_SIZE
	hex
	default 0x180000

config SMM_MODULE_STACK_SIZE
	hex
	default 0x800

menu "PSP Configuration Options"

config AMD_FWM_POSITION_INDEX
	int "Firmware Directory Table location (0 to 5)"
	range 0 5
	default 0 if BOARD_ROMSIZE_KB_512
	default 1 if BOARD_ROMSIZE_KB_1024
	default 2 if BOARD_ROMSIZE_KB_2048
	default 3 if BOARD_ROMSIZE_KB_4096
	default 4 if BOARD_ROMSIZE_KB_8192
	default 5 if BOARD_ROMSIZE_KB_16384
	help
	  Typically this is calculated by the ROM size, but there may
	  be situations where you want to put the firmware directory
	  table in a different location.
	    0: 512 KB - 0xFFFA0000
	    1: 1 MB   - 0xFFF20000
	    2: 2 MB   - 0xFFE20000
	    3: 4 MB   - 0xFFC20000
	    4: 8 MB   - 0xFF820000
	    5: 16 MB  - 0xFF020000

comment "AMD Firmware Directory Table set to location for 512KB ROM"
	depends on AMD_FWM_POSITION_INDEX = 0
comment "AMD Firmware Directory Table set to location for 1MB ROM"
	depends on AMD_FWM_POSITION_INDEX = 1
comment "AMD Firmware Directory Table set to location for 2MB ROM"
	depends on AMD_FWM_POSITION_INDEX = 2
comment "AMD Firmware Directory Table set to location for 4MB ROM"
	depends on AMD_FWM_POSITION_INDEX = 3
comment "AMD Firmware Directory Table set to location for 8MB ROM"
	depends on AMD_FWM_POSITION_INDEX = 4
comment "AMD Firmware Directory Table set to location for 16MB ROM"
	depends on AMD_FWM_POSITION_INDEX = 5

config AMDFW_CONFIG_FILE
	string
	default "src/soc/amd/cezanne/fw.cfg"

config PSP_LOAD_MP2_FW
	bool
	default n
	help
	  Include the MP2 firmwares and configuration into the PSP build.

	  If unsure, answer 'n'

config PSP_UNLOCK_SECURE_DEBUG
	bool "Unlock secure debug"
	default y
	help
	  Select this item to enable secure debug options in PSP.

config HAVE_PSP_WHITELIST_FILE
	bool "Include a debug whitelist file in PSP build"
	default n
	help
	  Support secured unlock prior to reset using a whitelisted
	  serial number. This feature requires a signed whitelist image
	  and bootloader from AMD.

	  If unsure, answer 'n'

config PSP_WHITELIST_FILE
	string "Debug whitelist file path"
	depends on HAVE_PSP_WHITELIST_FILE
	default "3rdparty/amd_blobs/cezanne/PSP/wtl-czn.sbin"

endmenu

endif # SOC_AMD_CEZANNE
```

## src/soc/amd/common/Kconfig
```kconfig
config SOC_AMD_COMMON
	bool
	help
	  common code blocks for AMD SOCs

if SOC_AMD_COMMON

config SOC_AMD_PI
	bool
	default n

source "src/soc/amd/common/block/*/Kconfig"

endif # SOC_AMD_COMMON
```

## src/soc/amd/common/Kconfig.common
```kconfig
config SOC_AMD_COMMON
	bool
	help
	  common code blocks for AMD SOCs

if SOC_AMD_COMMON

source "src/soc/amd/common/block/*/Kconfig"
source "src/soc/amd/common/fsp/Kconfig"
source "src/soc/amd/common/pi/Kconfig"
source "src/soc/amd/common/psp_verstage/Kconfig"

config APCB_BLOBS_DIR
	string "Mainboard blobs path"
	default "3rdparty/blobs/mainboard/\$(MAINBOARDDIR)"
	help
	  The path to the APCB mainboard blobs

endif # SOC_AMD_COMMON
```

## src/soc/amd/common/block/Kconfig
```kconfig
config SOC_AMD_COMMON_BLOCK
	bool
	help
	  SoC driver for AMD common IP code

if SOC_AMD_COMMON_BLOCK

comment "AMD SoC Common IP Code"
source "src/soc/amd/common/block/*/Kconfig"

endif
```

## src/soc/amd/common/block/acp/Kconfig
```kconfig
## SPDX-License-Identifier: GPL-2.0-only

config SOC_AMD_COMMON_BLOCK_ACP_GEN1
	bool
	help
	  Select this option to perform Audio Co-Processor(ACP) configuration.
	  Used by the ACP in AMD family 17h, 19h, and earlier (picasso, cezanne)

config SOC_AMD_COMMON_BLOCK_ACP_GEN2
	bool
	help
	  Select this option to perform Audio Co-Processor(ACP) configuration.
	  Used by the ACP in AMD mendocino (family 17h) and possibly newer CPUs.

config SOC_AMD_ACP_KEEP_RUNNING_IN_S3
	bool
	depends on SOC_AMD_COMMON_BLOCK_ACP_GEN1 || SOC_AMD_COMMON_BLOCK_ACP_GEN2
	help
	  Enables AMD Audio Co-Processor (ACP) to remain operational in ACPI
	  S3 (sleep) state for continued audio processing support.
```

## src/soc/amd/common/block/acpi/Kconfig
```kconfig
config SOC_AMD_COMMON_BLOCK_ACPI
	bool
	depends on SOC_AMD_COMMON_BLOCK_ACPIMMIO
	select ACPI_AMD_HARDWARE_SLEEP_VALUES
	select ACPI_COMMON_MADT_IOAPIC
	select ACPI_COMMON_MADT_LAPIC
	select ACPI_CUSTOM_MADT
	help
	  Select this option to use the AcpiMmio ACPI registers.

config SOC_AMD_COMMON_BLOCK_ACPI_ALIB
	bool

config SOC_AMD_COMMON_BLOCK_ACPI_DPTC
	bool
	depends on SOC_AMD_COMMON_BLOCK_ACPI_ALIB
	help
	  Selected by mainboards that implement support for ALIB
	  to enable DPTC.

config SOC_AMD_COMMON_BLOCK_ACPI_CPPC
	bool

config SOC_AMD_COMMON_BLOCK_ACPI_CPU_POWER_STATE
	bool

config SOC_AMD_COMMON_BLOCK_ACPI_GPIO
	bool

config SOC_AMD_COMMON_BLOCK_ACPI_IVRS
	bool

config ACPI_SSDT_PSD_INDEPENDENT
	bool "Allow core p-state independent transitions"
	default y
	help
	  AMD recommends the ACPI _PSD object to be configured to cause
	  cores to transition between p-states independently. A vendor may
	  choose to generate _PSD object to allow cores to transition together.
```

## src/soc/amd/common/block/acpimmio/Kconfig
```kconfig
config SOC_AMD_COMMON_BLOCK_ACPIMMIO
	bool
	help
	  Select this option to enable hardware blocks in the AcpiMmio
	  address space (0xfed8xxxx).

if SOC_AMD_COMMON_BLOCK_ACPIMMIO

config SOC_AMD_COMMON_BLOCK_ACPIMMIO_BIOSRAM
	bool
	help
	  Add functions to access settings stored in the biosram region.
	  This is only used by the SoCs using binaryPI and the old AGESA.

config SOC_AMD_COMMON_BLOCK_ACPIMMIO_PM_IO_ACCESS
	bool
	help
	  Add functions to access the PM register block via the indirect
	  IO register access interface.

endif # SOC_AMD_COMMON_BLOCK_ACPIMMIO
```

## src/soc/amd/common/block/alink/Kconfig
```kconfig
config SOC_AMD_COMMON_BLOCK_ALINK
	bool
	help
	  Select this option to access the FCH A-link configuration registers.
```

## src/soc/amd/common/block/aoac/Kconfig
```kconfig
config SOC_AMD_COMMON_BLOCK_AOAC
	bool
	help
	  Select this option to add the common functions for the AOAC (always
	  on, always connected) block to the build.
```

## src/soc/amd/common/block/apob/Kconfig
```kconfig
config SOC_AMD_COMMON_BLOCK_APOB
	bool
	help
	  Select this option to add firmware support for the non-volatile APOB
	  cache to the build.

config SOC_AMD_COMMON_BLOCK_APOB_NV_DISABLE
	bool "Disable non-volatile APOB support"
	depends on SOC_AMD_COMMON_BLOCK_APOB
	help
	  Select this to disable non-volatile APOB cache and train memory
	  on every boot.

	  If unsure, say N.

config SOC_AMD_COMMON_BLOCK_APOB_HASH
	bool
	help
	  Select this to use a hash of the APOB data to determine when to update
	  the non-volatile APOB store.
```

## src/soc/amd/common/block/data_fabric/Kconfig
```kconfig
## SPDX-License-Identifier: GPL-2.0-only

config SOC_AMD_COMMON_BLOCK_DATA_FABRIC
	bool
	help
	  Select this option to add data fabric configuration related
	  functionality to the build.

config SOC_AMD_COMMON_BLOCK_DATA_FABRIC_DOMAIN
	bool
	depends on SOC_AMD_COMMON_BLOCK_DATA_FABRIC
	select SOC_AMD_COMMON_BLOCK_ROOT_COMPLEX
	help
	  Select this option to add functionality to the build to tell the
	  resource allocator about the MMIO regions configured in the data
	  fabric registers so that it knows in which regions it can properly
	  allocate the non-fixed MMIO devices.

config SOC_AMD_COMMON_BLOCK_DATA_FABRIC_MULTI_PCI_SEGMENT
	bool
	depends on SOC_AMD_COMMON_BLOCK_DATA_FABRIC_DOMAIN
	help
	  Some AMD SoCs support more than one PCI segment with 256 buses. Those
	  SoCs however have a different data fabric register layout for the PCI
	  bus number decoding. SoCs that use a data fabric register pair for
	  the PCI bus number which includes the segment number must select this
	  option; SoCs that use one data fabric register for the PCI bus number
	  which doesn't include a segment number field mustn't select this.

config SOC_AMD_COMMON_BLOCK_DATA_FABRIC_EXTENDED_MMIO
	bool
	depends on SOC_AMD_COMMON_BLOCK_DATA_FABRIC_DOMAIN
	help
	  Some AMD SoCs support more than 48 bit MMIO addresses. In order to
	  have enough bits for this, the MMIO address extension register is
	  introduced. SoCs that have this register must select this option in
	  order for the MMIO regions to be reported correctly.
```

## src/soc/amd/common/block/emmc/Kconfig
```kconfig
config SOC_AMD_COMMON_BLOCK_EMMC
	bool
	help
	  Select this option to use AMD common EMMC driver support.

config SOC_AMD_COMMON_BLOCK_EMMC_SKIP_POWEROFF
	bool
	depends on SOC_AMD_COMMON_BLOCK_EMMC
	help
	  Select this option to try to switch off the power of the eMMC
	  controller via the AOAC registers.
```

## src/soc/amd/common/block/gpio/Kconfig
```kconfig
config SOC_AMD_COMMON_BLOCK_BANKED_GPIOS
	bool
	depends on SOC_AMD_COMMON_BLOCK_ACPIMMIO
	help
	  Select this option to use the newer style banks of GPIO signals.
	  These are at offsets +0x1500, +0x1600, and +0x1700 from the AcpiMmio
	  base.

if SOC_AMD_COMMON_BLOCK_BANKED_GPIOS

config SOC_AMD_COMMON_BLOCK_BANKED_GPIOS_NON_SOC_CODEBASE
	bool
	help
	  Select this option when selecting the GPIO bank support from AMD
	  chipsets outside the soc/ subtree that only support a subset of the
	  features available on the chipsets inside the soc/ subtree. When this
	  option is selected, no SMI or SCI event can be configured by the GPIO
	  code.

endif # SOC_AMD_COMMON_BLOCK_BANKED_GPIOS
```

## src/soc/amd/common/block/gpio_banks/Kconfig
```kconfig
config SOC_AMD_COMMON_BLOCK_BANKED_GPIOS
	bool
	depends on SOC_AMD_COMMON_BLOCK_ACPIMMIO
	help
	  Select this option to use the newer style banks of GPIO signals.
	  These are at offsets +0x1500, +0x1600, and +0x1700 from the AcpiMmio
	  base.
```

## src/soc/amd/common/block/graphics/Kconfig
```kconfig
## SPDX-License-Identifier: GPL-2.0-only

config SOC_AMD_COMMON_BLOCK_GRAPHICS
	bool
	help
	  Select this option to use AMD common graphics driver support.

config SOC_AMD_COMMON_BLOCK_GRAPHICS_ATIF
	bool
	depends on SOC_AMD_COMMON_BLOCK_GRAPHICS
	help
	  Select this option to provide ATIF method with display brightness querying.
	  Currently, the exported values only open up 0-255 as the brightness range for
	  the display.

config SOC_AMD_GFX_CACHE_VBIOS_IN_FMAP
	bool "Support for caching modified VBIOS tables in flash"
	depends on SOC_AMD_COMMON_BLOCK_GRAPHICS && CHROMEOS && RUN_FSP_GOP && TPM2
	default n
	help
	  Enable support for flash based VBIOS cache.

config USE_SELECTIVE_GOP_INIT
	bool "Run FSP GOP driver only when needed for recovery/developer modes"
	depends on SOC_AMD_GFX_CACHE_VBIOS_IN_FMAP
	default n
	help
	  Select this option to only run the FSP GOP driver when needed for pre-OS display init
	  (eg, Recovery and Developer Modes). Otherwise, use cached VBIOS/ATOMBIOS tables.
	  Selecting this option will save approx. 130ms boot time on the normal boot path.

config SOC_AMD_COMMON_BLOCK_GRAPHICS_ACP
	bool
	depends on SOC_AMD_COMMON_BLOCK_GRAPHICS
	help
	  Select this option to provide Audio CoProcessor ACPI device for pre-Ryzen APUs for
	  use by custom Windows drivers.

config SOC_AMD_COMMON_BLOCK_GRAPHICS_NO_VGA
	bool
	depends on SOC_AMD_COMMON_BLOCK_GRAPHICS
	help
	  Select this option when the IGD is not VGA compatible. On newer platforms the IGD
	  advertises itself as a Display device, but not as a VGA Display controller.
	  The IGD does not decode the legacy I/O ranges 0x3C0-0x3CF, 0x3D4.
```

## src/soc/amd/common/block/hda/Kconfig
```kconfig
config SOC_AMD_COMMON_BLOCK_HDA
	bool
	help
	  Select this option to use AMD common High Definition Audio
	  driver support.
```
