## src/soc/amd/common/block/i2c/Kconfig
```kconfig
config SOC_AMD_COMMON_BLOCK_I2C
	bool
	select DRIVERS_I2C_DESIGNWARE
	help
	  Select this option to add FCH I2C controller functions to the build.

config SOC_AMD_COMMON_BLOCK_I2C_PAD_CTRL
	bool
	help
	  Select this option to add FCH I2C pad configuration functions to the
	  build.

config SOC_AMD_COMMON_BLOCK_I23C_PAD_CTRL
	bool
	help
	  Select this option to add FCH I2C/I3C pad configuration functions to
	  the build.

config SOC_AMD_COMMON_BLOCK_I2C3_TPM_SHARED_WITH_PSP
	bool
	depends on !SOC_AMD_PICASSO && !SOC_AMD_STONEYRIDGE
	default n
	help
	  Enable PSP I2C arbitration if there is I2C3 controller with TPM device
	  connected, which is shared between x86 and PSP. This is necessary to
	  ensure proper communication with I2C peripherals connected to such
	  bus.
```

## src/soc/amd/common/block/iommu/Kconfig
```kconfig
config SOC_AMD_COMMON_BLOCK_IOMMU
	bool
	help
	  Select this option to use AMD common IOMMU support.
```

## src/soc/amd/common/block/lpc/Kconfig
```kconfig
config SOC_AMD_COMMON_BLOCK_LPC
	bool
	help
	  Select this option to use the traditional LPC-ISA bridge at D14F3.

config PROVIDES_ROM_SHARING
	bool
	help
	  Select this option if the LPC bridge supports ROM sharing.

config SOC_AMD_COMMON_BLOCK_LPC_SPI_DMA
	bool
	select X86_CUSTOM_BOOTMEDIA
	select SOC_AMD_COMMON_BLOCK_SPI_4DW_BURST
	depends on !SOC_AMD_PICASSO && !SOC_AMD_STONEYRIDGE
	help
	  Select this option to enable SPI DMA support.

# The LPC SPI DMA controller requires the source and destination to be 64 byte
# aligned.
config CBFS_CACHE_ALIGN
	int
	default 64 if SOC_AMD_COMMON_BLOCK_LPC_SPI_DMA

config FSP_ALIGNMENT_FSP_S
	int
	default 64 if SOC_AMD_COMMON_BLOCK_LPC_SPI_DMA

config FSP_ALIGNMENT_FSP_M
	int
	default 64 if SOC_AMD_COMMON_BLOCK_LPC_SPI_DMA

config SOC_AMD_COMMON_BLOCK_HAS_ESPI
	bool
	help
	  Select this option if platform supports eSPI using D14F3 configuration
	  registers.

config SOC_AMD_COMMON_BLOCK_ESPI_EXTENDED_DECODE_RANGES
	bool
	depends on SOC_AMD_COMMON_BLOCK_HAS_ESPI
	help
	  Select this if the platform supports 16 instead of 4 eSPI IO decode
	  ranges and 5 instead of 4 eSPI MMIO decode ranges.

config SOC_AMD_COMMON_BLOCK_HAS_ESPI_ALERT_ENABLE
	bool
	depends on SOC_AMD_COMMON_BLOCK_HAS_ESPI
	help
	  Selected by the SoC if it supports the ALERT_ENABLE bit.

config SOC_AMD_COMMON_BLOCK_USE_ESPI
	bool
	depends on SOC_AMD_COMMON_BLOCK_HAS_ESPI
	help
	  Select this option if mainboard uses eSPI instead of LPC (if supported
	  by platform).

config SOC_AMD_COMMON_BLOCK_ESPI_RETAIN_PORT80_EN
	bool
	depends on SOC_AMD_COMMON_BLOCK_USE_ESPI
	help
	  SMU will lock up at times if the port80h enable bit is cleared. Select
	  this option to retain the port80 enable bit while clearing other enable
	  bits in the ESPI Decode register.
```

## src/soc/amd/common/block/pci/Kconfig
```kconfig
config SOC_AMD_COMMON_BLOCK_PCI
	bool
	select SOC_AMD_COMMON_BLOCK_PCI_MMCONF
	help
	  This option builds functions used to program PCI interrupt
	  routing, both PIC and APIC modes.

config SOC_AMD_COMMON_BLOCK_PCI_MMCONF
	bool
	help
	  Selecting this option adds the AMD-common enable_pci_mmconf function
	  to the build.

config SOC_AMD_COMMON_BLOCK_PCIE_GPP_DRIVER
	bool
	depends on SOC_AMD_COMMON_BLOCK_PCI
	help
	  Select this option to use AMD common PCIe GPP driver.

config SOC_AMD_COMMON_BLOCK_PCIE_CLK_REQ
	bool
	depends on SOC_AMD_COMMON_BLOCK_PCIE_GPP_DRIVER
	help
	  This option includes code to disable PCIe clock request if the corresponding
	  PCIe device is disabled.
```

## src/soc/amd/common/block/pi/Kconfig
```kconfig
config SOC_AMD_COMMON_BLOCK_PI
	bool
	select HAVE_DEBUG_RAM_SETUP
	help
	  This option builds functions that interface AMD's AGESA reference
	  code packaged in the binaryPI form.

if SOC_AMD_COMMON_BLOCK_PI

config PI_AGESA_CAR_HEAP_BASE
	hex
	default 0x400000
	help
	  The AGESA PI blob may be built to allow an optional callout for
	  AgesaHeapRebase.  If AGESA calls AgesaHeapRebase, this option
	  determines the location of the heap prior to DRAM availability.

config PI_AGESA_TEMP_RAM_BASE
	hex
	default 0x100000
	help
	  During a boot from S5, AGESA copies its CAR-based heap to a temporary
	  location in DRAM.  Once coreboot has established cbmem, the heap
	  is moved again.  This symbol determines the temporary location for
	  the heap.

config PI_AGESA_HEAP_SIZE
	hex
	default 0x20000
	help
	  This option determines the amount of space allowed for AGESA heap
	  prior to DRAM availability.

endif
```

## src/soc/amd/common/block/pm/Kconfig
```kconfig
config SOC_AMD_COMMON_BLOCK_PM
	bool
	depends on SOC_AMD_COMMON_BLOCK_ACPIMMIO
	select HAVE_POWER_STATE_AFTER_FAILURE
	select HAVE_POWER_STATE_PREVIOUS_AFTER_FAILURE
	help
	  AMD Processor common code for Power Management (PM) subsystem.

if SOC_AMD_COMMON_BLOCK_PM

config SOC_AMD_COMMON_BLOCK_PM_CHIPSET_STATE_SAVE
	bool
	help
	  Add common functionality to write CBMEM_ID_POWER_STATE for AMD
	  platforms that use FSP for hardware initialization.

endif # SOC_AMD_COMMON_BLOCK_PM

config SOC_AMD_COMMON_BLOCK_RESET
	bool
	help
	  Select this option to use AMD common reset driver support.

config SOC_AMD_SUPPORTS_WARM_RESET
	bool
	depends on SOC_AMD_COMMON_BLOCK_RESET
	help
	  Select this option if the chip supports warm reset.
```

## src/soc/amd/common/block/psp/Kconfig
```kconfig
## SPDX-License-Identifier: GPL-2.0-only

config SOC_AMD_COMMON_BLOCK_PSP
	bool
	help
	  This option builds in the Platform Security Processor initialization
	  functions. Do not select this directly in SoC code, select
	  SOC_AMD_COMMON_BLOCK_PSP_GENx instead.

config SOC_AMD_COMMON_BLOCK_PSP_GEN1
	bool
	select SOC_AMD_COMMON_BLOCK_PSP
	help
	  Used by the PSP in AMD systems before family 17h, e.g. stoneyridge.

config SOC_AMD_COMMON_BLOCK_PSP_GEN2
	bool
	select SOC_AMD_COMMON_BLOCK_PSP
	select SOC_AMD_COMMON_BLOCK_SMN
	help
	  Used by the PSP in AMD family 17h, 19h and possibly newer CPUs.

config SOC_AMD_PSP_SELECTABLE_SMU_FW
	bool
	help
	  Some PSP implementations allow storing SMU firmware into cbfs and
	  calling the PSP to load the blobs at the proper time.

	  The soc/<codename> should select this if its PSP supports the feature
	  and each mainboard can choose to select an appropriate fanless or
	  fanned set of blobs.  Ask your AMD representative whether your APU
	  is considered fanless.

config SOC_AMD_COMMON_BLOCK_PSP_SPL
	bool
	help
	  Select this option in the SoC's Kconfig to include the Security Patch
	  Level (SPL) support code. This code will only send the actual SPL
	  fuse update command to the PSP if the PERFORM_SPL_FUSING option is
	  also selected.

config PERFORM_SPL_FUSING
	bool "Send SPL fusing command to PSP"
	default n
	depends on SOC_AMD_COMMON_BLOCK_PSP_SPL
	help
	  Send the Security Patch Level (SPL) fusing command to the PSP in
	  order to update the minimum SPL version to be written to the SoC's
	  fuse bits. This will prevent using any embedded firmware components
	  with lower SPL version.

	  If unsure, answer 'n'

config SPL_TABLE_FILE
	string "SPL table file override"
	depends on SOC_AMD_COMMON_BLOCK_PSP_SPL
	help
	  Provide a mainboard-specific Security Patch Level (SPL) table file
	  override. The SPL file is required to support PSP FW anti-rollback
	  and needs to be created by AMD. The default SPL file specified in the
	  SoC's fw.cfg is in the corresponding folder of the amd_blobs submodule
	  and applies to all boards that use the SoC without verstage on PSP.
	  In the verstage on PSP case, a different SPL file is specific as an
	  override via this Kconfig option.

config HAVE_SPL_RW_AB_FILE
	bool "Have a separate mainboard-specific SPL file in RW A/B partitions"
	default n
	depends on SOC_AMD_COMMON_BLOCK_PSP_SPL
	depends on VBOOT_SLOTS_RW_AB
	help
	  Have separate mainboard-specific Security Patch Level (SPL) table
	  file for the RW A/B FMAP partitions.

config SPL_RW_AB_TABLE_FILE
	string "Separate SPL table file override for RW A/B partitions"
	depends on HAVE_SPL_RW_AB_FILE

config PSP_PLATFORM_SECURE_BOOT
	bool "Platform secure boot enable"
	depends on SOC_AMD_COMMON_BLOCK_PSP_GEN2
	default n
	help
	  Select this config to enable PSP Platform Secure Boot.

	  Platform Secure Boot will automatically be fused on boot if the
	  coreboot ROM is properly signed and can not be disabled once fused.
	  Refer AMD PSB user guide doc# 56654, Revision# 1.00, this document is
	  only available with NDA customers.

config SOC_AMD_COMMON_BLOCK_PSP_SMI
	bool
	default n
	select SPI_FLASH_SMM if BOOT_DEVICE_SPI_FLASH_RW_NOMMAP
	help
	  Add PSP SMI handler for SPI flash access.

	  When ROM armor isn't enabled, the x86 part owns the SPI controller,
	  so when the PSP wants to access the SPI flash, it sends an SMI to the
	  x86 side and the corresponding SMI handler will do the SPI flash
	  access for the PSP.

	  WARNING: Since the flash access in the SMI handler is a blocking
	  operation during which all cores stay in SMM, an erase operation may
	  lock up the system for a long enough time to be noticeable. Reads and
	  writes with small data sizes are less problematic. This is AMD
	  specific design and should be enabled when PSP requires to access the
	  SPI flash after the BOOT_DONE PSP command.

config PSP_INCLUDES_HSP
	bool
	depends on SOC_AMD_COMMON_BLOCK_PSP
	default n
	help
	  Select this config to indicate SoC includes Hardware Security Processor(HSP).

config AMD_FWM_POSITION_20000_DEFAULT
	# This is the default if nothing else is selected
	bool

config AMD_FWM_POSITION_420000_DEFAULT
	bool

config AMD_FWM_POSITION_820000_DEFAULT
	bool

config AMD_FWM_POSITION_C20000_DEFAULT
	bool

config AMD_FWM_POSITION_E20000_DEFAULT
	bool

config AMD_FWM_POSITION_F20000_DEFAULT
	bool

config AMD_FWM_POSITION_FA0000_DEFAULT
	bool

choice
	prompt "AMD FW position"
	default AMD_FWM_POSITION_420000 if AMD_FWM_POSITION_420000_DEFAULT
	default AMD_FWM_POSITION_820000 if AMD_FWM_POSITION_820000_DEFAULT
	default AMD_FWM_POSITION_C20000 if AMD_FWM_POSITION_C20000_DEFAULT
	default AMD_FWM_POSITION_E20000 if AMD_FWM_POSITION_E20000_DEFAULT
	default AMD_FWM_POSITION_F20000 if AMD_FWM_POSITION_F20000_DEFAULT
	default AMD_FWM_POSITION_FA0000 if AMD_FWM_POSITION_FA0000_DEFAULT
	default AMD_FWM_POSITION_20000
	help
	  Set the position on flash offset where the AMD FW needs to be.
	  This position is relative to a 16MB flash window. If the flash
	  size is smaller than 16MB it gets mapped at the top of that window.

config AMD_FWM_POSITION_20000
	bool "0x20000"

config AMD_FWM_POSITION_420000
	bool "0x420000"

config AMD_FWM_POSITION_820000
	bool "0x820000"

config AMD_FWM_POSITION_C20000
	bool "0xC20000"

config AMD_FWM_POSITION_E20000
	bool "0xE20000"

config AMD_FWM_POSITION_F20000
	bool "0xF20000"

config AMD_FWM_POSITION_FA0000
	bool "0xFA0000"

endchoice

config AMD_FWM_POSITION
	hex
	default 0x20000 if AMD_FWM_POSITION_20000
	default 0x420000 if AMD_FWM_POSITION_420000
	default 0x820000 if AMD_FWM_POSITION_820000
	default 0xc20000 if AMD_FWM_POSITION_C20000
	default 0xe20000 if AMD_FWM_POSITION_E20000
	default 0xf20000 if AMD_FWM_POSITION_F20000
	default 0xfa0000 if AMD_FWM_POSITION_FA0000

config USE_AMDFWTOOL
	bool
	default y if SOC_AMD_COMMON_BLOCK_PSP
	help
	  Select this if AMDFWTOOL needs to be built
```

## src/soc/amd/common/block/root_complex/Kconfig
```kconfig
config SOC_AMD_COMMON_BLOCK_ROOT_COMPLEX
	bool
	select SOC_AMD_COMMON_BLOCK_SMN
	help
	  Select this option to add AMD common root complex support code
	  to the build.
```

## src/soc/amd/common/block/s3/Kconfig
```kconfig
config SOC_AMD_COMMON_BLOCK_S3
	bool
	depends on SOC_AMD_COMMON_BLOCK_ACPI
	select CACHE_MRC_SETTINGS
	select MRC_WRITE_NV_LATE
	help
	  Select this option to add S3 related functions to the build.
```
