## src/soc/amd/strix_halo/Kconfig
```kconfig
# SPDX-License-Identifier: GPL-2.0-only

# TODO: Evaluate what can be moved to a common directory
# TODO: Update for Strix Halo

config SOC_AMD_STRIX_HALO_BASE
	bool
	select ACPI_SOC_NVS
	select ARCH_X86
	select BOOT_DEVICE_SUPPORTS_WRITES if BOOT_DEVICE_SPI_FLASH
	select DRIVERS_USB_ACPI
	select DRIVERS_USB_PCI_XHCI
	select FSP_COMPRESS_FSP_M_LZMA
	select FSP_COMPRESS_FSP_S_LZ4
	select GENERIC_GPIO_LIB
	select HAVE_ACPI_TABLES
	select HAVE_CF9_RESET
	select HAVE_EM100_SUPPORT
	select HAVE_FSP_GOP
	select HAVE_SMI_HANDLER
	select IDT_IN_EVERY_STAGE
	select PLATFORM_USES_FSP2_0
	select PROVIDES_ROM_SHARING
	select RTC
	select SOC_AMD_COMMON
	select SOC_AMD_COMMON_BLOCK_ACP_GEN2		# TODO: Check if this is still correct
	select SOC_AMD_COMMON_BLOCK_ACPI		# TODO: Check if this is still correct
	select SOC_AMD_COMMON_BLOCK_ACPIMMIO		# TODO: Check if this is still correct
	select SOC_AMD_COMMON_BLOCK_ACPI_ALIB		# TODO: Check if this is still correct
	select SOC_AMD_COMMON_BLOCK_ACPI_CPPC		# TODO: Check if this is still correct
	select SOC_AMD_COMMON_BLOCK_ACPI_CPU_POWER_STATE
	select SOC_AMD_COMMON_BLOCK_ACPI_GPIO		# TODO: Check if this is still correct
	select SOC_AMD_COMMON_BLOCK_ACPI_IVRS		# TODO: Check if this is still correct
	select SOC_AMD_COMMON_BLOCK_ACPI_MADT
	select SOC_AMD_COMMON_BLOCK_AOAC		# TODO: Check if this is still correct
	select SOC_AMD_COMMON_BLOCK_APOB		# TODO: Check if this is still correct
	select SOC_AMD_COMMON_BLOCK_APOB_HASH		# TODO: Check if this is still correct
	select SOC_AMD_COMMON_BLOCK_BANKED_GPIOS	# TODO: Check if this is still correct
	select SOC_AMD_COMMON_BLOCK_CPUFREQ_FAM1AH      # TODO: Check if this is still correct
	select SOC_AMD_COMMON_BLOCK_DATA_FABRIC         # TODO: Check if this is still correct
	select SOC_AMD_COMMON_BLOCK_DATA_FABRIC_DOMAIN  # TODO: Check if this is still correct
	select SOC_AMD_COMMON_BLOCK_DATA_FABRIC_MULTI_PCI_SEGMENT # TODO: Check if this is still correct
	select SOC_AMD_COMMON_BLOCK_ESPI_EXTENDED_DECODE_RANGES   # TODO: Check if this is still correct
	select SOC_AMD_COMMON_BLOCK_GPP_CLK             # TODO: Check if this is still correct
	select SOC_AMD_COMMON_BLOCK_GRAPHICS            # TODO: Check if this is still correct
	select SOC_AMD_COMMON_BLOCK_GRAPHICS_NO_VGA     # TODO: Check if this is still correct
	select SOC_AMD_COMMON_BLOCK_HAS_ESPI		# TODO: Check if this is still correct
	select SOC_AMD_COMMON_BLOCK_HAS_ESPI_ALERT_ENABLE # TODO: Check if this is still correct
	select SOC_AMD_COMMON_BLOCK_I2C			# TODO: Check if this is still correct
	select SOC_AMD_COMMON_BLOCK_I23C_PAD_CTRL	# TODO: Check if this is still correct
	select SOC_AMD_COMMON_BLOCK_I3C                 # TODO: Check if this is still correct
	select SOC_AMD_COMMON_BLOCK_IOMMU		# TODO: Check if this is still correct
	select SOC_AMD_COMMON_BLOCK_LPC			# TODO: Check if this is still correct
	select SOC_AMD_COMMON_BLOCK_MCAX		# TODO: Check if this is still correct
	select SOC_AMD_COMMON_BLOCK_NONCAR		# TODO: Check if this is still correct
	select SOC_AMD_COMMON_BLOCK_PCI			# TODO: Check if this is still correct
	select SOC_AMD_COMMON_BLOCK_PCI_DOMAIN_ROOT_PRT # TODO: Check if this is still correct
	select SOC_AMD_COMMON_BLOCK_PCI_MMCONF		# TODO: Check if this is still correct
	select SOC_AMD_COMMON_BLOCK_PCIE_GPP_DRIVER	# TODO: Check if this is still correct
	select SOC_AMD_COMMON_BLOCK_PM			# TODO: Check if this is still correct
	select SOC_AMD_COMMON_BLOCK_PM_CHIPSET_STATE_SAVE # TODO: Check if this is still correct
	select SOC_AMD_COMMON_BLOCK_PSP_GEN2		# TODO: Check if this is still correct
	select SOC_AMD_COMMON_BLOCK_PSP_SPL             # TODO: Check if this is still correct
	select SOC_AMD_COMMON_BLOCK_RESET               # TODO: Check if this is still correct
	select SOC_AMD_COMMON_BLOCK_SMBUS		# TODO: Check if this is still correct
	select SOC_AMD_COMMON_BLOCK_SMI			# TODO: Check if this is still correct
	select SOC_AMD_COMMON_BLOCK_SMM			# TODO: Check if this is still correct
	select SOC_AMD_COMMON_BLOCK_SMU			# TODO: Check if this is still correct
	select SOC_AMD_COMMON_BLOCK_SMU_SX_ENTRY	# TODO: Check if this is still correct
	select SOC_AMD_COMMON_BLOCK_SPI                 # TODO: Check if this is still correct
	select SOC_AMD_COMMON_BLOCK_SPI_DWORD_ACCESS    # TODO: Check if this is still correct
	select SOC_AMD_COMMON_BLOCK_SVI3                # TODO: Check if this is still correct
	select SOC_AMD_COMMON_BLOCK_TSC                 # TODO: Check if this is still correct
	select SOC_AMD_COMMON_BLOCK_UART		# TODO: Check if this is still correct
	select SOC_AMD_COMMON_BLOCK_UCODE		# TODO: Check if this is still correct
	select SOC_AMD_COMMON_FSP_CCX_CPPC_HOB		# TODO: Check if this is still correct
	select SOC_AMD_COMMON_FSP_DMI_TABLES		# TODO: Check if this is still correct
	select SOC_AMD_COMMON_FSP_PCIE_CLK_REQ          # TODO: Check if this is still correct
	select SOC_AMD_COMMON_FSP_PCI			# TODO: Check if this is still correct
	select SOC_AMD_COMMON_FSP_PRELOAD_FSPS          # TODO: Check if this is still correct
	select SOC_AMD_COMMON_ROMSTAGE_LEGACY_DMA_FIXUP # TODO: Check if this is still correct
	select SOC_FILL_CPU_CACHE_INFO
	select SSE2
	select UDK_2017_BINDING
	select DRAM_SUPPORT_DDR5
	select USE_FSP_NOTIFY_PHASE_POST_PCI_ENUM
	select USE_FSP_NOTIFY_PHASE_READY_TO_BOOT
	select USE_FSP_NOTIFY_PHASE_END_OF_FIRMWARE
	select X86_AMD_FIXED_MTRRS
	select HAVE_X86_64_SUPPORT
	help
	  AMD Strix Halo support

config SOC_AMD_STRIX_HALO
	bool
	select SOC_AMD_STRIX_HALO_BASE
	help
	  AMD Strix Halo support

config SOC_AMD_STRIX_HALO_FAEGAN
	bool
	select SOC_AMD_STRIX_HALO_BASE
	select SOC_AMD_SUPPORTS_WARM_RESET
	help
	  AMD Strix Halo Faegan support

if SOC_AMD_STRIX_HALO_BASE

config CHIPSET_DEVICETREE
	string
	default "soc/amd/strix_halo/chipset.cb"

config VGA_BIOS_FILE
	string
	default "3rdparty/amd_blobs/strixhalo/KRK2E_GENERIC_vbios.sbin" if SOC_AMD_STRIX_HALO_FAEGAN
	default "3rdparty/amd_blobs/strixhalo/STRIX_HALO_GENERIC_vbios.sbin"

config VGA_BIOS_ID
	string
	default "1002,1902" if SOC_AMD_STRIX_HALO_FAEGAN
	default "1002,150e"
	help
	  The default VGA BIOS PCI vendor/device ID of the GPU and VBIOS.

config CPU_PT_ROM_MAP_GB
	default 1024

config EARLY_RESERVED_DRAM_BASE
	hex
	default 0x2000000
	help
	  This variable defines the base address of the DRAM which is reserved
	  for usage by coreboot in early stages (i.e. before ramstage is up).
	  This memory gets reserved in BIOS tables to ensure that the OS does
	  not use it, thus preventing corruption of OS memory in case of S3
	  resume.

config EARLYRAM_BSP_STACK_SIZE
	hex
	default 0x1000

config PSP_APOB_DRAM_ADDRESS
	hex
	default 0x2001000
	help
	  Location in DRAM where the PSP will copy the AGESA PSP Output
	  Block.

config PSP_APOB_DRAM_SIZE
	hex
	default 0x90000

config PRE_X86_CBMEM_CONSOLE_SIZE
	hex
	default 0x1600
	help
	  Size of the CBMEM console used in PSP verstage.

config PRERAM_CBMEM_CONSOLE_SIZE
	hex
	default 0x1600
	help
	  Increase this value if preram cbmem console is getting truncated

config C_ENV_BOOTBLOCK_SIZE
	hex
	default 0x20000
	help
	  Sets the size of the bootblock stage that should be loaded in DRAM.
	  This variable controls the DRAM allocation size in linker script
	  for bootblock stage.

config ROMSTAGE_ADDR
	hex
	default 0x20C0000
	help
	  Sets the address in DRAM where romstage should be loaded.

config ROMSTAGE_SIZE
	hex
	default 0x70000
	help
	  Sets the size of DRAM allocation for romstage in linker script.

config FSP_M_ADDR
	hex
	default 0x2130000
	help
	  Sets the address in DRAM where FSP-M should be loaded. cbfstool
	  performs relocation of FSP-M to this address.

config FSP_M_SIZE
	hex
	default 0xC0000
	help
	  Sets the size of DRAM allocation for FSP-M in linker script.

config FSP_TEMP_RAM_SIZE
	hex
	default 0x40000
	help
	  The amount of coreboot-allocated heap and stack usage by the FSP.

config ECAM_MMCONF_BASE_ADDRESS
	default 0xE0000000

config ECAM_MMCONF_BUS_NUMBER
	default 256

config MAX_CPUS
	int
	default 32
	help
	  Maximum number of threads the platform can have.

config CONSOLE_UART_BASE_ADDRESS
	depends on CONSOLE_SERIAL && AMD_SOC_CONSOLE_UART
	hex
	default 0xfedc9000 if UART_FOR_CONSOLE = 0
	default 0xfedca000 if UART_FOR_CONSOLE = 1
	default 0xfedce000 if UART_FOR_CONSOLE = 2
	default 0xfedcf000 if UART_FOR_CONSOLE = 3
	default 0xfedd1000 if UART_FOR_CONSOLE = 4

config SMM_TSEG_SIZE
	hex
	default 0x800000 if HAVE_SMI_HANDLER
	default 0x0

config SMM_RESERVED_SIZE
	hex
	default 0x180000

config SMM_MODULE_STACK_SIZE
	hex
	default 0x800

config ACPI_BERT
	bool "Build ACPI BERT Table"
	default y
	depends on HAVE_ACPI_TABLES
	help
	  Report Machine Check errors identified in POST to the OS in an
	  ACPI Boot Error Record Table.

config ACPI_BERT_SIZE
	hex
	default 0x4000 if ACPI_BERT
	default 0x0
	help
	  Specify the amount of DRAM reserved for gathering the data used to
	  generate the ACPI table.

config DRIVERS_I2C_DESIGNWARE_CLOCK_MHZ
	int
	default 150

config DISABLE_SPI_FLASH_ROM_SHARING
	def_bool n
	help
	  Instruct the chipset to not honor the EGPIO67_SPI_ROM_REQ pin
	  which indicates a board level ROM transaction request. This
	  removes arbitration with board and assumes the chipset controls
	  the SPI flash bus entirely.

config DISABLE_KEYBOARD_RESET_PIN
	bool
	help
	  Instruct the SoC to not to reset based on the state of GPIO_21, KBDRST_L.

menu "PSP Configuration Options"

config AMDFW_CONFIG_FILE
	string "AMD PSP Firmware config file"
	default "src/soc/amd/strix_halo/fw.cfg"
	help
	  Specify the path/location of AMD PSP Firmware config file.
	  By default build a LPDDR5 board.

config PSP_DISABLE_POSTCODES
	bool "Disable PSP post codes"
	help
	  Disables the output of port80 post codes from PSP.

config PSP_POSTCODES_ON_ESPI
	bool "Use eSPI bus for PSP post codes"
	default y
	depends on !PSP_DISABLE_POSTCODES
	help
	  Select to send PSP port80 post codes on eSPI bus.
	  If not selected, PSP port80 codes will be sent on LPC bus.

config PSP_LOAD_MP2_FW
	bool
	default n
	help
	  Include the MP2 firmwares and configuration into the PSP build.

	  If unsure, answer 'n'

config PSP_UNLOCK_SECURE_DEBUG
	bool "Unlock secure debug"
	default y
	help
	  Select this item to enable secure debug options in PSP.

config HAVE_PSP_WHITELIST_FILE
	bool "Include a debug whitelist file in PSP build"
	default n
	help
	  Support secured unlock prior to reset using a whitelisted
	  serial number. This feature requires a signed whitelist image
	  and bootloader from AMD.

	  If unsure, answer 'n'

config PSP_WHITELIST_FILE
	string "Debug whitelist file path"
	depends on HAVE_PSP_WHITELIST_FILE
	default "site-local/3rdparty/amd_blobs/strix_halo/PSP/wtl-mrg.sbin"

config PSP_SOFTFUSE_BITS
	string "PSP Soft Fuse bits to enable"
	default "6"
	help
	  Space separated list of Soft Fuse bits to enable.
	  Bit 0:  Enable secure debug (Set by PSP_UNLOCK_SECURE_DEBUG)
	  Bit 7:  Disable PSP postcodes on Renoir and newer chips only
	          (Set by PSP_DISABLE_PORT80)
	  Bit 15: PSP debug output destination:
	          0=SoC MMIO UART, 1=IO port 0x3F8
	  Bit 29: Disable MP2 firmware loading (Set by PSP_LOAD_MP2_FW)

	  See #55758 (NDA) for additional bit definitions.

config PSPV2_MBOX_CMD_OFFSET
	default 0x10970

config PSP_AB_RECOVERY
	bool "Use A/B Recovery scheme"
	depends on !VBOOT && !CHROMEOS
	select CBFS_VERIFICATION
	select SOC_AMD_COMMON_BLOCK_PSP_GEN2_EARLY_ACCESS
	default n
	help
	  Enable the PSP A/B Recovery mechanism

endmenu

menu "RAS Config Options"
choice
	prompt "PCIe AER Report Mechanism"
	depends on SOC_AMD_STRIX_HALO_FAEGAN
	default AMD_PCIE_AER_OS_FIRST_HANDLING_STXH
	help
	  Choose a PCIe AER Report Mechanism.

config AMD_PCIE_AER_PFEH_FIRMWARE_FIRST_REPORTING_STXH
	bool "PFEH-based Firmware First reporting"

config AMD_PCIE_AER_OS_FIRST_HANDLING_STXH
	bool "OS First handling"

config AMD_PCIE_AER_FIRMWARE_FIRST_HANDLING_STXH
	bool "Firmware First handling through SMI"
endchoice

choice
	prompt "AMD NBIO Ras Control V2"
	depends on SOC_AMD_STRIX_HALO_FAEGAN
	default AMD_NBIO_RAS_MCA_REPORTING_STXH if SOC_AMD_STRIX_HALO_FAEGAN
	default AMD_NBIO_RAS_DISABLE_STXH
	help
	  Choose an AMD NBIO RAS control option.

config AMD_NBIO_RAS_DISABLE_STXH
	bool "Disable NBIO Ras Control"

config AMD_NBIO_RAS_MCA_REPORTING_STXH
	bool "MCA reporting"

config AMD_NBIO_RAS_LEGACY_MODE_STXH
	bool "Legacy Mode"
endchoice

config AMD_PCIE_ECRC_ENABLEMENT
	bool "PCIe ECRC Enablement"
	depends on SOC_AMD_STRIX_HALO_FAEGAN
	default y if SOC_AMD_STRIX_HALO_FAEGAN
	default n
	help
	  Enable/Disable PCIe ECRC support.
endmenu

endif # SOC_AMD_STRIX_HALO_BASE
```
