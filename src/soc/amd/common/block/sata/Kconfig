## src/soc/amd/common/block/sata/Kconfig
```kconfig
## SPDX-License-Identifier: GPL-2.0-only

config SOC_AMD_COMMON_BLOCK_SATA
	bool
	help
	  Select this option to use AMD common SATA driver support.
```

## src/soc/amd/common/block/simnow/Kconfig
```kconfig
# SPDX-License-Identifier: GPL-2.0-only

config SOC_AMD_COMMON_BLOCK_SIMNOW_SUPPORTED
	bool
	help
	  Select this for mainboards that are supported by SimNow

config SOC_AMD_COMMON_BLOCK_SIMNOW_BUILD
	bool "Build for SimNow"
	default n
	depends on SOC_AMD_COMMON_BLOCK_SIMNOW_SUPPORTED
	select CONSOLE_AMD_SIMNOW
	help
	  Select this option when building for SimNow

if SOC_AMD_COMMON_BLOCK_SIMNOW_BUILD

config POST_IO
	default n

config CONSOLE_SERIAL
	default n

endif
```

## src/soc/amd/common/block/smbus/Kconfig
```kconfig
config SOC_AMD_COMMON_BLOCK_SMBUS
	bool
	help
	  Select this option to add FCH SMBus controller functions to the build.
```

## src/soc/amd/common/block/smi/Kconfig
```kconfig
## SPDX-License-Identifier: GPL-2.0-only

config SOC_AMD_COMMON_BLOCK_SMI
	bool
	select HAVE_CONFIGURABLE_APMC_SMI_PORT
	help
	  Select this option to add the common functions for setting up the SMI
	  configuration to the build.
```

## src/soc/amd/common/block/smn/Kconfig
```kconfig
config SOC_AMD_COMMON_BLOCK_SMN
	bool
	help
	  Select this option to add functions to access the SMN (system management
	  network) register space to the build.
```

## src/soc/amd/common/block/smu/Kconfig
```kconfig
config SOC_AMD_COMMON_BLOCK_SMU
	bool
	select SOC_AMD_COMMON_BLOCK_SMN
	help
	  Select this option to add functions to communicate with the SMU to the build.

config SOC_AMD_COMMON_BLOCK_SMU_SX_ENTRY
	bool
	depends on SOC_AMD_COMMON_BLOCK_SMU
	help
	  Select this option to add the function to send the S3/4/5 entry
	  message to the SMU.
```

## src/soc/amd/common/block/spi/Kconfig
```kconfig
## SPDX-License-Identifier: GPL-2.0-only

config SOC_AMD_COMMON_BLOCK_SPI
	bool
	select SPI_FLASH_SFDP if SPI_FLASH
	help
	  Select this option to add FCH SPI controller functions to the build.
	  This overwrites the structure spi_flash_ops to use FCH SPI code
	  instead of individual SPI specific code.

config SOC_AMD_COMMON_BLOCK_SPI_DWORD_ACCESS
	bool
	depends on SOC_AMD_COMMON_BLOCK_SPI
	help
	  Select this option when the FCH SPI controller MMIO can be written to
	  with DWORDs instead of just BYTEs. This is supported since AMD Familiy
	  17h Model A0h.

config SOC_AMD_COMMON_BLOCK_SPI_DEBUG
	bool "Enable SPI debugging"

config SOC_AMD_COMMON_BLOCK_SPI_SEMAPHORE
	bool
	help
	  Use hardware semaphore bits in SPI_MISC_CNTRL to synchronize
	  SPI controller access between coreboot and PSP. Works in all
	  boot stages. This is separate from SOC_AMD_COMMON_BLOCK_PSP_SMI.

config SOC_AMD_COMMON_BLOCK_SPI_4DW_BURST
	bool
	depends on !SOC_AMD_STONEYRIDGE
	help
	  Select this option to keep the 4 DWORD burst support enabled.

config SOC_AMD_COMMON_BLOCK_SPI_MMAP_USE_ROM3
	bool
	default y if ROM_SIZE > 0x01000000
	depends on !SOC_AMD_PICASSO && !SOC_AMD_STONEYRIDGE
	depends on !SOC_AMD_COMMON_BLOCK_LPC_SPI_DMA
	depends on USE_X86_64_SUPPORT
	# Enable X86_CUSTOM_BOOTMEDIA because the fast SPI controller
	# driver provides a custom boot media device when multiple decode
	# windows are used for the BIOS region.
	select X86_CUSTOM_BOOTMEDIA
	help
	  AMD specific SPI flash access. The lower 16MiB of the SPI flash are
	  memory mapped on the ROM2 window and the upper SPI flash is mapped using
	  the ROM3 window in high MMIO. The ROM3 window maps up to 64MiB of the
	  SPI flash. The default address of ROM3 is below 1024GiB address boundary
	  and thus can only be used in x86_64 mode.

config SOC_AMD_COMMON_BLOCK_SPI_MMAP
	def_bool y
	select X86_CUSTOM_BOOTMEDIA
	depends on SOC_AMD_COMMON_BLOCK_SPI
	depends on !SOC_AMD_COMMON_BLOCK_LPC_SPI_DMA
	depends on !SOC_AMD_COMMON_BLOCK_SPI_MMAP_USE_ROM3
	help
	  This option is required when CONFIG_ROM_SIZE is greater than 16 MiB.
	  This flash driver still only mmaps 16 MiB of the flash (depending
	  on SPI straps either the upper or lower part, by default the lower).
	  Developers must take care to place all x86 accessible firmware
	  components in the mmap area.

config EFS_SPI_READ_MODE
	int
	range 0 7
	default 0 if EM100
	default 2
	help
	  SPI read mode to be programmed by the PSP.
	  The numbers in the options below indicate how many wires
	  are utilized for command, address and data. For instance 1-1-2
	  means 1 command, 1 address and 2 data wires.
	    0: Normal Read (up to 33M)
	    1: Reserved
	    2: Dual IO (1-1-2)
	    3: Quad IO (1-1-4)
	    4: Dual IO (1-2-2)
	    5: Quad IO (1-4-4)
	    6: Normal Read (up to 66M)
	    7: Fast Read

config EFS_SPI_SPEED
	int
	range 0 5
	default 3 if EM100
	default 1
	help
	  SPI Fast Speed to be programmed by the PSP.
	    0: 66.66Mhz
	    1: 33.33MHz
	    2: 22.22MHz
	    3: 16.66MHz
	    4: 100MHz
	    5: 800KHz

config EFS_SPI_MICRON_FLAG
	int
	range 0 2
	default 0
	help
	  For Family 17h Model 00h and later SoC the PSP must be aware if a Micron
	  part is present in EFS. Automatic detection (option 2) is available
	  for Family 17h Model 30h-3Fh but is unsupported otherwise.
	    0: Board does not use Micron parts
	    1: Board always uses Micron parts
	    2: Micron parts are optional

config NORMAL_READ_SPI_SPEED
	int
	range 0 5
	default 3 if EM100
	default 1
	help
	  SPI Normal Speed to be programmed by coreboot.
	    0: 66.66Mhz
	    1: 33.33MHz
	    2: 22.22MHz
	    3: 16.66MHz
	    4: 100MHz
	    5: 800KHz

config ALT_SPI_SPEED
	int
	range 0 5
	default 3 if EM100
	default 1
	help
	  SPI ALT Speed to be programmed by coreboot.
	    0: 66.66Mhz
	    1: 33.33MHz
	    2: 22.22MHz
	    3: 16.66MHz
	    4: 100MHz
	    5: 800KHz

config TPM_SPI_SPEED
	int
	range 0 5
	default 3 if EM100
	default 1
	help
	  SPI TPM Speed to be programmed by coreboot.
	    0: 66.66Mhz
	    1: 33.33MHz
	    2: 22.22MHz
	    3: 16.66MHz
	    4: 100MHz
	    5: 800KHz

config SOC_AMD_COMMON_BLOCK_PSP_ROM_ARMOR3
	bool "Enable ROM Armor 3"
	select BOOT_DEVICE_NOT_SPI_FLASH
	select BOOT_DEVICE_MEMORY_MAPPED
	select BOOT_DEVICE_SUPPORTS_WRITES
	select SPI_FLASH
	select SPI_FLASH_SMM
	depends on HAVE_SMI_HANDLER
	depends on SOC_AMD_COMMON_BLOCK_PSP
	depends on SOC_AMD_COMMON_BLOCK_SPI
	depends on !SOC_AMD_COMMON_BLOCK_PSP_SMI
	help
	  Select this option to use PSP ROM Armor3 protocol for SPI flash
	  operations. This routes SPI read/write/erase operations through
	  the SMM PSP firmware mailbox interface instead of direct FCH SPI
	  controller access. After MPinit the SPI will become read only from
	  x86 perspective and the SPI Ctrl interface will be deactived.

	  You will be only able to write SPI regions that are marked 'writable' or
	  are whitelisted by BIOS directory entries 0x6d (AMD_BIOS_NV_ST). To gain
	  direct access to the SPI flash, you must issue a reboot.

	  WARNING: Since the flash access in the SMI handler is a blocking
	  operation during which all cores stay in SMM, an erase operation may
	  lock up the system for a long enough time to be noticeable. Reads and
	  writes with small data sizes are less problematic. This is AMD
	  specific design and should be enabled when you don't want to service
	  PSP SMI requests (see CONFIG_SOC_AMD_COMMON_BLOCK_PSP_SMI).

config SOC_AMD_PSP_ROM_ARMOR_64K_ERASE
	bool
	depends on SOC_AMD_COMMON_BLOCK_PSP_ROM_ARMOR3
	default n
	help
	  Enable 64KB erase block size support in addition to 4KB blocks.
	  This can improve erase performance when erasing large regions.
	  The PSP firmware must support 64KB erase commands for this to work.

config SOC_AMD_COMMON_BLOCK_SPI_BACKUP_SPI_FLASH
	bool
	depends on SOC_AMD_COMMON_BLOCK_SPI
	depends on !SOC_AMD_COMMON_BLOCK_PSP_ROM_ARMOR3 # TODO: remove once this is supported
	help
	  Select this option when there is a second SPI flash
	  which can be booted of when the primary SPI flash is
	  corrupted. The recovery mechanism is board specific.
	  The secondary SPI flash must be of the same type and
	  same size as the primary SPI flash.

config BACKUP_BOOT_DEVICE_SPI_CHIP_SELECT
	int
	depends on SOC_AMD_COMMON_BLOCK_SPI_BACKUP_SPI_FLASH
	default 1
	help
	  Which chip select line the backup boot device is connected to.
	  The assumption here is that chip select 0 and this one have an SPI flash connected to
	  it. Depending on which chip select of these two we booted from, we deem one of them
	  our backup/secondary (the one we didn't boot from) SPI flash.
```

## src/soc/amd/common/block/stb/Kconfig
```kconfig
config SOC_AMD_COMMON_BLOCK_STB
	bool
	select SOC_AMD_COMMON_BLOCK_SMN
	select SOC_AMD_COMMON_BLOCK_SMU
	help
	  Select in the SOC if it supports the Smart Trace Buffer

if SOC_AMD_COMMON_BLOCK_STB

config WRITE_STB_BUFFER_TO_CONSOLE
	bool "Write STB entries to the console log"
	default n
	depends on !ENABLE_STB_SPILL_TO_DRAM
	help
	  This option will tell coreboot to print the STB buffer at various
	  points through the boot process. Note that this will prevent the
	  entries from being stored if the Spill-to-DRAM feature is enabled.

config ENABLE_STB_SPILL_TO_DRAM
	bool "Enable Smart Trace Buffer Spill-to-DRAM"
	default n
	help
	  Spill-to-DRAM is an STB feature that extends the buffer from using
	  just the small SRAM buffer to a much larger area reserved in main
	  memory.

config AMD_STB_SIZE_IN_MB
	int "Smart Trace Buffer Spill-to-DRAM buffer size in MB"
	default 3
	range 3 16
	depends on ENABLE_STB_SPILL_TO_DRAM
	help
	  Size of the STB Spill-to-DRAM buffer in MB.

config ADD_POSTCODES_TO_STB
	bool "Add coreboot postcodes to STB"
	default y
	help
	  Add coreboot's postcodes to the smart trace buffer

endif
```

## src/soc/amd/common/block/uart/Kconfig
```kconfig
config SOC_AMD_COMMON_BLOCK_UART
	bool
	default n
	help
	  Select this option to add the common functions for setting up the
	  UART configuration to the build.

if SOC_AMD_COMMON_BLOCK_UART

config AMD_SOC_CONSOLE_UART
	bool "Use integrated AMD SoC UART controller for console"
	default n
	select DRIVERS_UART_8250MEM
	select DRIVERS_UART_8250MEM_32
	select NO_UART_ON_SUPERIO
	select UART_OVERRIDE_REFCLK

endif # SOC_AMD_COMMON_BLOCK_UART
```

## src/soc/amd/common/block/xhci/Kconfig
```kconfig
config SOC_AMD_COMMON_BLOCK_XHCI
	bool
	help
	  Select this option to use AMD common XHCI support.

if SOC_AMD_COMMON_BLOCK_XHCI

config SOC_AMD_COMMON_BLOCK_XHCI_ELOG
	bool
	default y
	depends on ELOG
	select SMM_PCI_RESOURCE_STORE
	help
	  Enables logging of XHCI events in the elog

endif
```

## src/soc/amd/common/fsp/Kconfig
```kconfig
if PLATFORM_USES_FSP2_0

config SOC_AMD_COMMON_FSP_DMI_TABLES
	bool

config SOC_AMD_COMMON_FSP_CCX_CPPC_HOB
	bool

config SOC_AMD_COMMON_FSP_PRELOAD_FSPS
	bool

source "src/soc/amd/common/fsp/*/Kconfig"

endif # PLATFORM_USES_FSP2_0
```

## src/soc/amd/common/fsp/pci/Kconfig
```kconfig
## SPDX-License-Identifier: GPL-2.0-only

config SOC_AMD_COMMON_FSP_PCI
	bool
	select SOC_AMD_COMMON_BLOCK_PCI
	help
	  This option enabled FSP to provide common PCI functions.

config SOC_AMD_COMMON_FSP_PCIE_CLK_REQ
	bool
	depends on SOC_AMD_COMMON_BLOCK_PCIE_GPP_DRIVER
	help
	  This option includes code to disable PCIe clock request if the corresponding
	  PCIe device is disabled.
```

## src/soc/amd/common/pi/Kconfig
```kconfig
config SOC_AMD_PI
	bool
	depends on SOC_AMD_COMMON_BLOCK_ACPI
	select CACHE_MRC_SETTINGS
	select HAVE_DEBUG_RAM_SETUP
	select MRC_WRITE_NV_LATE
	help
	  This option builds functions that interface AMD's AGESA reference
	  code packaged in the binaryPI form and S3-related functionality.

if SOC_AMD_PI

config PI_AGESA_CAR_HEAP_BASE
	hex
	default 0x400000
	help
	  The AGESA PI blob may be built to allow an optional callout for
	  AgesaHeapRebase.  If AGESA calls AgesaHeapRebase, this option
	  determines the location of the heap prior to DRAM availability.

config PI_AGESA_TEMP_RAM_BASE
	hex
	default 0x100000
	help
	  During a boot from S5, AGESA copies its CAR-based heap to a temporary
	  location in DRAM.  Once coreboot has established cbmem, the heap
	  is moved again.  This symbol determines the temporary location for
	  the heap.

config PI_AGESA_HEAP_SIZE
	hex
	default 0x20000
	help
	  This option determines the amount of space allowed for AGESA heap
	  prior to DRAM availability.

endif # SOC_AMD_PI
```

## src/soc/amd/common/psp_verstage/Kconfig
```kconfig
## SPDX-License-Identifier: GPL-2.0-only

config PSP_VERSTAGE_CCP_DMA
	bool
	default n
	help
	  Configure PSP Verstage to use Crypto Co-processor (CCP) DMA while
	  accessing the boot device. Select it on platforms which supports
	  using CCP DMA to access the boot device.

config PSP_S0I3_RESUME_VERSTAGE
	bool "S0i3 resume verstage"
	depends on VBOOT_STARTS_BEFORE_BOOTBLOCK
	default n
	help
	  Select this item to enable running verstage during S0i3 resume.

config PSP_INIT_TPM_ON_S0I3_RESUME
	bool
	depends on TPM2 && PSP_S0I3_RESUME_VERSTAGE
	default PSP_S0I3_RESUME_VERSTAGE
	help
	  If the TPM is reset while in S0i3, it must be reinitialized
	  during s0i3 resume. This must be performed in PSP verstage since
	  coreboot is otherwise not involved with s0i3 resume.

config PSP_SUPPORTS_EFS2_RELATIVE_ADDR
	bool
	default n
	help
	  On SoCs where PSP uses A/B recovery layout, PSP support relative addressing
	  from the start of the SPI ROM. Enable this config on SoCs where PSP supports
	  relative addressing so that PSP verstage can pass the offset.

config SEPARATE_SIGNED_PSPFW
	def_bool n
	help
	  Put signed AMD/PSP firmwares outside FW_MAIN_[AB] so vboot doesn't verify them,
	  and rely on PSP's verification.

config PSP_VERSTAGE_STACK_IS_MAPPED
	bool
	default y if SOC_AMD_PICASSO
	default n
	help
	  This configuration indicates whether the PSP Verstage stack is mapped to a virtual
	  address space. This has been the case so far only in Picasso SoC.

config PSP_VERSTAGE_MAP_ENTIRE_SPIROM
	bool
	default n
	help
	  This configuration indicates whether PSP Verstage needs to map the entire SPI ROM.
	  This is required only in Cezanne SoC at the moment.
```
