## src/soc/intel/common/Kconfig.common
```kconfig
config INTEL_HAS_TOP_SWAP
	bool
	help
	  Set this config if the Intel SoC supports top swap feature

if INTEL_HAS_TOP_SWAP

config INTEL_ADD_TOP_SWAP_BOOTBLOCK
	bool "Include a Top swap bootblock"
	default n
	help
	  Intel PCH/Southbridges have feature that it is possible to have
	  the southbridge/PCH look for the bootblock at a 64K or
	  128K/256K/512K/1MB (in case of newer SoCs) offset
	  instead of the usual top of flash.
	  Select this to put a 'second' bootblock.

config INTEL_TOP_SWAP_BOOTBLOCK_SIZE
	hex "Size of top swap boot block"
	depends on INTEL_ADD_TOP_SWAP_BOOTBLOCK
	default 0x10000
	help
	  Set this config to a supported topswap size.
	  Valid sizes: 0x10000 0x20000 0x40000 0x80000 0x100000

config INTEL_TOP_SWAP_FIT_ENTRY_FMAP_REG
	string
	depends on INTEL_ADD_TOP_SWAP_BOOTBLOCK
	help
	  Use this config to specify the name of a FMAP region (which should
	  hold a microcode) whose address as the first entry in the topswap FIT.
	  This is useful in creating a asymmetric FIT in top swap bootblock
	  than the one in non-topswap bootblock. This string will be passed
	  onto ifittool (-A -n option). ifittool will not parse the region for MCU
	  entries, and only locate the region and insert its address into FIT.

endif

config SOC_INTEL_COMMON
	bool
	select AZALIA_PLUGIN_SUPPORT
	select ACPI_SOC_NVS
	help
	  common code for Intel SOCs

if SOC_INTEL_COMMON

comment "Intel SoC Common Code for IP blocks"
source "src/soc/intel/common/block/Kconfig"

comment "Intel SoC Common PCH Code"
source "src/soc/intel/common/pch/Kconfig"

comment "Intel SoC Common coreboot stages and non-IP blocks"
source "src/soc/intel/common/basecode/Kconfig"

config SOC_INTEL_COMMON_RESET
	bool
	default n
	select HAVE_CF9_RESET

config SOC_INTEL_COMMON_ACPI_WAKE_SOURCE
	bool
	default n

config ACPI_CONSOLE
	bool
	default n
	help
	  Provide a mechanism for serial console based ACPI debug.

config PAVP
	bool "Enable PAVP (Protected Audio-Video Path) support"
	default y
	help
	  Protected Audio-Video Path is an Intel technology used to enforce digital
	  rights protections on multimedia content. Streaming or other media playback
	  services may require it to be enabled for correct functioning.

	  Users might disable PAVP if the concept of digital rights management (DRM)
	  offends them, or if they have concerns about the security of
	  the Management Engine, which is where this technology is implemented.

	  Set this option to n to disable support.

config MMA
	bool "Enable MMA (Memory Margin Analysis) support for Intel Core"
	default n
	depends on SOC_INTEL_KABYLAKE || SOC_INTEL_SKYLAKE
	help
	 Set this option to y to enable MMA (Memory Margin Analysis) support

config MMA_BLOBS_PATH
	string "Path to MMA blobs"
	depends on MMA
	default "3rdparty/blobs/soc/intel/kabylake/mma-blobs" if SOC_INTEL_KABYLAKE
	default "3rdparty/blobs/soc/intel/skylake/mma-blobs" if SOC_INTEL_SKYLAKE

config SOC_INTEL_COMMON_NHLT
	bool
	default n

config TPM_TIS_ACPI_INTERRUPT
	int
	help
	  acpi_get_gpe() is used to provide interrupt status to TPM layer.
	  This option specifies the GPE number.

config SOC_INTEL_DEBUG_CONSENT
	bool "Enable SOC debug interface"
	default n
	help
	  Set this option to enable default debug interface of SoC such as DBC
	  or DCI.

config SMM_MODULE_STACK_SIZE
	hex
	default 0x800

config SOC_INTEL_CRASHLOG
	def_bool n
	select SOC_INTEL_COMMON_BLOCK_CRASHLOG
	select ACPI_BERT
	help
	  Enables Crashlog.

config SOC_INTEL_CRASHLOG_ON_RESET
	def_bool n
	help
	  Enables the PMC to collect crashlog records on every reset event. NOTE:
	  This will result in a BERT table being populated containing a PMC
	  crashlog record on every boot.

endif # SOC_INTEL_COMMON
```

## src/soc/intel/common/basecode/Kconfig
```kconfig
config SOC_INTEL_COMMON_BASECODE
	bool
	help
	  Common coreboot stages and non-IP block for Intel platform

if SOC_INTEL_COMMON_BASECODE

source "src/soc/intel/common/basecode/*/Kconfig"

endif
```

## src/soc/intel/common/basecode/debug/Kconfig
```kconfig
## SPDX-License-Identifier: GPL-2.0-only

config SOC_INTEL_COMMON_BASECODE_DEBUG_FEATURE
	bool
	default n
	help
	  Driver to control runtime features of Intel SoC & coreboot. For example, controlling
	  the CSE firmware update feature without rebuilding the code.

config SOC_INTEL_COMMON_DEBUG_CONSENT
	int "Debug Consent for Intel SoC"
	# USB DBC is more common for developers so make this default to 3 if
	# SOC_INTEL_DEBUG_CONSENT=y
	default 3 if SOC_INTEL_DEBUG_CONSENT
	default 0
	help
	  This is to control debug interface on SOC.
	  Setting non-zero value will allow to use DBC or DCI to debug SOC.
	  PlatformDebugConsent in FspmUpd.h has the details.

	  Desired platform debug type are
	  0:Disabled, 1:Enabled (DCI OOB+[DbC]), 2:Enabled (DCI OOB),
	  3:Enabled (USB3 DbC), 4:Enabled (XDP/MIPI60), 5:Enabled (USB2 DbC),
	  6:Enable (2-wire DCI OOB), 7:Manual.
```

## src/soc/intel/common/basecode/ramtop/Kconfig
```kconfig
config SOC_INTEL_COMMON_BASECODE_RAMTOP
	bool
	default n
	help
	  Driver code to store the top_of_ram (RAMTOP) address into
	  non-volatile space (CMOS) during the first boot and use
	  it across all consecutive boot.

	  Purpose of this driver code is to cache the RAMTOP (with a
	  fixed size) for all consecutive boots even before calling
	  into the FSP. Otherwise, this range remains un-cached until postcar
	  boot stage updates the MTRR programming. FSP-M and late romstage
	  uses this uncached RAMTOP range for various purposes and having the
	  ability to cache this range beforehand would help to optimize the boot
	  time (more than 50ms).
```

## src/soc/intel/common/basecode/tom/Kconfig
```kconfig
config SOC_INTEL_COMMON_BASECODE_TOM
	bool
	default n
	help
	  Driver code to store the top_of_ram (TOM) address into
	  non-volatile space (CMOS) during the first boot and use
	  it across all consecutive boot.

	  Purpose of this driver code is to cache the TOM (with a
	  fixed size) for all consecutive boots even before calling
	  into the FSP. Otherwise, this range remains un-cached until postcar
	  boot stage updates the MTRR programming. FSP-M and late romstage
	  uses this uncached TOM range for various purposes and having the
	  ability to cache this range beforehand would help to optimize the boot
	  time (more than 50ms).
```

## src/soc/intel/common/block/Kconfig
```kconfig
## SPDX-License-Identifier: GPL-2.0-only

config SOC_INTEL_COMMON_BLOCK
	bool
	help
	  SoC driver for intel common IP code

if SOC_INTEL_COMMON_BLOCK

source "src/soc/intel/common/block/*/Kconfig"

endif
```

## src/soc/intel/common/block/acpi/Kconfig
```kconfig
## SPDX-License-Identifier: GPL-2.0-only

config SOC_INTEL_COMMON_BLOCK_ACPI
	depends on SOC_INTEL_COMMON_BLOCK_CPU
	depends on SOC_INTEL_COMMON_BLOCK_PMC
	select ACPI_COMMON_MADT_IOAPIC
	select ACPI_COMMON_MADT_LAPIC if !SOC_INTEL_COMMON_BLOCK_ACPI_CPU_HYBRID
	select ACPI_CUSTOM_MADT
	bool
	help
	  Intel Processor common code for ACPI

config SOC_INTEL_COMMON_BLOCK_ACPI_GPIO
	bool

config SOC_INTEL_COMMON_BLOCK_ACPI_LPIT
	bool
	depends on HAVE_ACPI_TABLES
	select ACPI_LPIT
	help
	  Generate LPIT table with LPI state entries

config SOC_INTEL_COMMON_BLOCK_ACPI_PEP
	bool
	depends on HAVE_ACPI_TABLES
	help
	  Generate an Intel Power Engine device object in the SSDT. This is
	  usually used for providing ACPI hooks for S0ix exit/entry.

config SOC_INTEL_COMMON_BLOCK_ACPI_PEP_LPM_REQ
	bool
	depends on SOC_INTEL_COMMON_BLOCK_ACPI_PEP
	help
	  Generate a 2nd set of _DSM functions for the Power Engine device that
	  will return a buffer that contains the contents of the PMC's LPM
	  requirements registers. A kernel can use this to display the
	  requirements for different LPM substates.

config SOC_INTEL_COMMON_BLOCK_CRASHLOG
	bool
	depends on SOC_INTEL_CRASHLOG
	help
	  Generate crash data for BERT table

if SOC_INTEL_COMMON_BLOCK_ACPI

config SOC_INTEL_COMMON_BLOCK_ACPI_CPPC
	bool
	help
	  Generate CPPC entries for Intel SpeedShift

config SOC_INTEL_COMMON_BLOCK_ACPI_CPU_HYBRID
	bool
	help
	  Defines hybrid CPU specific ACPI helper functions.

config SOC_INTEL_UFS_OCP_TIMER_DISABLE
	bool
	help
	  OCP Timer need to be disabled in SCS UFS IOSF Bridge to
	  work around the Silicon Issue due to which LTR mechanism
	  doesn't work.

config SOC_INTEL_UFS_LTR_DISQUALIFY
	bool
	help
	  LTR needs to be disqualified for UFS in D3 to ensure PMC
	  ignores LTR from UFS IP which is infinite.
endif

if SOC_INTEL_COMMON_BLOCK_ACPI_LPIT

config SOC_INTEL_COMMON_BLOCK_ACPI_SLP_S0_FREQ_HZ
	hex
	help
	  Define the slp_s0_residency frequency to be reported in the
	  LPIT ACPI table.

config SOC_INTEL_COMMON_BLOCK_ACPI_HAVE_GPE1
	bool
	help
	  This flag indicates that the SoC implements GPE1. GPE1 Event Bit is an
	  extension of GPE0 (present in all Intel SoC platform). GPE1 Events is
	  SoC-specific, which might include the power management, hot plug, and
	  PCIe events for the internal devices. Select this Kconfig to support SoCs
	  that publish GPE1 as part of PMC IO register. The dummy GPE1_ macros with
	  their values set to '0' will be added when this flag is not set for
	  backward compatibility matter.

config SOC_INTEL_COMMON_BLOCK_ACPI_USE_GPE1
	bool
	depends on SOC_INTEL_COMMON_BLOCK_ACPI_HAVE_GPE1
	help
	  This flags will expose GPE1 STS and EN registers in FADT. SoC needs to
	  have GPE1 block implemented to select this.  It is required to define
	  GPE1_STS(), GPE_EN(), and GPE1_REG_MAX from the SoC header. When selected,
	  GPE1 functions will be added and GPE1 events will be cleared and disabled
	  during boot. The SoC is required to provide the overridden GPE1 functions.
	  In addition, this flag will also be used to determine the standard GPE0/1
	  event methods to use in the ASL code and devicetree for the internal wake
	  capable devices. The purpose of this flag is to enable to switch in
	  between new GPE1 approach and old GPE0 method. The mainboard should decide
	  to use the GPE1 via this flag; or else
	  SOC_INTEL_COMMON_BLOCK_ACPI_HAVE_GPE1 exposes a SoC capability using ACPI.

endif
```

## src/soc/intel/common/block/aspm/Kconfig
```kconfig
## SPDX-License-Identifier: GPL-2.0-only

config SOC_INTEL_COMMON_BLOCK_ASPM
	bool
	help
	  Intel Processor common ASPM support
```
