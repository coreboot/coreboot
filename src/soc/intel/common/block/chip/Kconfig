## src/soc/intel/common/block/dmi/Kconfig
```kconfig
config SOC_INTEL_COMMON_BLOCK_DMI
	bool
	select SOC_INTEL_COMMON_BLOCK_PCR
	help
	  Intel Processor common DMI support
```

## src/soc/intel/common/block/dsp/Kconfig
```kconfig
## SPDX-License-Identifier: GPL-2.0-only

config SOC_INTEL_COMMON_BLOCK_DSP
	bool
	help
	  Intel Processor common DSP support
```

## src/soc/intel/common/block/dtt/Kconfig
```kconfig
## SPDX-License-Identifier: GPL-2.0-only

config SOC_INTEL_COMMON_BLOCK_DTT
	bool
	default n
	help
	  Minimal PCI Driver for enabling SSDT generation of Intel
	  Dynamic Tuning Technology (DTT) policies and controls, also
	  known as Intel DPTF (Dynamic Platform and Thermal Framework)

config SOC_INTEL_COMMON_BLOCK_DTT_STATIC_ASL
	bool
	depends on SOC_INTEL_COMMON_BLOCK_DTT
	default n
	help
	  Mainboards which include `soc/intel/common/acpi/dptf/dptf.asl`
	  should select this to avoid generating a duplicate TCPU ACPI
	  device and rendering the SSDT invalid.
```

## src/soc/intel/common/block/ebda/Kconfig
```kconfig
config SOC_INTEL_COMMON_BLOCK_EBDA
	bool
	select EARLY_EBDA_INIT
	help
	  Intel Processor common EBDA library support
```

## src/soc/intel/common/block/fast_spi/Kconfig
```kconfig
config SOC_INTEL_COMMON_BLOCK_FAST_SPI
	bool
	select SPI_FLASH_DONT_INCLUDE_ALL_DRIVERS
	help
	  Intel Processor common FAST_SPI support

config FAST_SPI_DISABLE_WRITE_STATUS
	bool "Disable write status SPI opcode"
	depends on SOC_INTEL_COMMON_BLOCK_FAST_SPI
	default n if CHROMEOS
	default y
	help
	  Disable the write status SPI opcode in Intel Fast SPI block.

config FAST_SPI_SUPPORTS_EXT_BIOS_WINDOW
	bool
	depends on SOC_INTEL_COMMON_BLOCK_FAST_SPI
	# Enable X86_CUSTOM_BOOTMEDIA because the fast SPI controller
	# driver provides a custom boot media device when multiple decode
	# windows are used for the BIOS region.
	select X86_CUSTOM_BOOTMEDIA
	help
	  Fast SPI controller on the platform supports additional
	  window for memory mapping BIOS region (region 1) on the SPI
	  flash beyond the standard limit of 16MiB. Depending upon the
	  size of the SPI flash part used by the mainboard, two decode
	  windows will be enabled:
	    1. Fixed decode window up to a maximum size of 16MiB under
	       4G boundary.
	    2. Extended decode window up to a maximum size provided by
	       the platform to map the rest of the BIOS region.
	  SoC selecting this config is expected to provide the base and
	  maximum size of the extended window in the host address space
	  using configs EXT_BIOS_WIN_BASE and EXT_BIOS_WIN_SIZE.

config EXT_BIOS_WIN_BASE
	hex
	help
	  If an additional window for mapping BIOS region greater than
	  16MiB is supported, then this config is used to provide the
	  base address reserved for the mapping. Since the mapping is
	  done at the top of the window, depending upon the size of the
	  BIOS region, the actual base address configured in the fast
	  SPI controller can be higher at runtime.

config EXT_BIOS_WIN_SIZE
	hex
	help
	  Maximum size of the extended window reserved for mapping BIOS
	  region greater than 16MiB. The actual mapped window might be
	  smaller depending upon the size of the BIOS region.

config FAST_SPI_GENERATE_SSDT
	bool
	default n
	help
	  Select this option if the Fast SPI controller is hidden from the OS.
	  If this switch is selected, an entry in the SSDT will be generated
	  for the controller to report the occupied resource which is not
	  discoverable at OS runtime.
```

## src/soc/intel/common/block/gpio/Kconfig
```kconfig
config SOC_INTEL_COMMON_BLOCK_GPIO
	bool
	select HAVE_DEBUG_GPIO
	select HAVE_GPIO_SNAPSHOT_VERIFY_SUPPORT
	help
	  Intel Processor common GPIO support

if SOC_INTEL_COMMON_BLOCK_GPIO

# Use to program Interrupt Polarity Control (IPCx) register
# Each bit represents IRQx Active High Polarity Disable configuration:
# when set to 1, the interrupt polarity associated with IRQx is inverted
# to appear as Active Low to IOAPIC and vice versa
config SOC_INTEL_COMMON_BLOCK_GPIO_ITSS_POL_CFG
	bool
	default n

# Used to configure Pad Tolerance as 1.8V or 3.3V
config SOC_INTEL_COMMON_BLOCK_GPIO_PADCFG_PADTOL
	bool
	default n

# Used to configure IOSSTATE and IOSTERM
config SOC_INTEL_COMMON_BLOCK_GPIO_IOSTANDBY
	bool
	default n

# Indicate if multiple ACPI devices are used for each gpio community.
config SOC_INTEL_COMMON_BLOCK_GPIO_MULTI_ACPI_DEVICES
	bool
	default n

# Indicate if SoC supports dual-routing of GPIOs (to different paths like SCI,
# NMI, SMI, IOAPIC). This is required to support IRQ and wake on the same pad.
config SOC_INTEL_COMMON_BLOCK_GPIO_DUAL_ROUTE_SUPPORT
	bool
	default n

config SOC_INTEL_COMMON_BLOCK_GPIO_LOCK_USING_SBI
	bool
	default n
	help
	  Till ADL PCH,`Pad Configuration Lock` can only be set or cleared
	  using non-posted sideband write.

config SOC_INTEL_COMMON_BLOCK_GPIO_LOCK_USING_PCR
	bool
	default n
	depends on !SOC_INTEL_COMMON_BLOCK_GPIO_LOCK_USING_SBI
	help
	  SoC user to select this config if `Pad Configuration Lock` can only be set or
	  cleared using private configuration register (PCR) write.
	  Starting with MTL SoC, the recommendation is to use PCR for locking down the
	  GPIO configuration.

endif
```

## src/soc/intel/common/block/gpmr/Kconfig
```kconfig
## SPDX-License-Identifier: GPL-2.0-only

config SOC_INTEL_COMMON_BLOCK_GPMR
	bool
	select SOC_INTEL_COMMON_BLOCK_PCR
	help
	  Intel Processor common GPMR support

if SOC_INTEL_COMMON_BLOCK_GPMR

config USE_SOC_GPMR_DEFS
	bool
	default n
	help
	  Specify if the SoC has specific GPMR register definitions.

endif
```

## src/soc/intel/common/block/graphics/Kconfig
```kconfig
## SPDX-License-Identifier: GPL-2.0-only

config SOC_INTEL_COMMON_BLOCK_GRAPHICS
	bool
	select ROMSTAGE_VGA if MAINBOARD_USE_EARLY_LIBGFXINIT
	help
	  Intel Processor common Graphics support

if SOC_INTEL_COMMON_BLOCK_GRAPHICS

config SOC_INTEL_CONFIGURE_DDI_A_4_LANES
	bool
	help
	  Selected by platforms that require DDI-A bifurcation setup.

config SOC_INTEL_DISABLE_IGD
	bool "Disable Integrated GFX Controller (0:2:0)"
	default n
	select MAINBOARD_NO_FSP_GOP
	help
	  Selected by mainboard user that need to skip IGD initialization
	  where OS can only use one GPU hence need to disable IGD and don't
	  need to run FSP GOP.

config SOC_INTEL_GFX_FRAMEBUFFER_OFFSET
	hex
	default 0x0
	help
	  PCI config offset 0x18 point to LMEMBAR and need to add GTT size to
	  reach at DSM which is referred here as SOC_INTEL_GFX_MEMBASE_OFFSET.
	  SoC that follow such design would override SOC_INTEL_GFX_FRAMEBUFFER_OFFSET
	  with GTT_SIZE value. On SoC platform where PCI config offset 0x18 points
	  to the GMADR directly can use the default value 0x0 without any override.

config SOC_INTEL_GFX_NON_PREFETCHABLE_MMIO
	bool
	default n
	help
	  Ignore BAR0(offset 0x10)'s pre-fetchable attribute to use non-prefetchable
	  MMIO to fix OS display driver failure.

config SOC_INTEL_GFX_MBUS_JOIN
	bool
	help
	  The MBUS (Memory Bus) is a high-speed interface that connects the graphics
	  controller to the system memory. It provides a dedicated data path for graphics
	  data, which helps to improve graphics performance.

	  The MBUS is a key technology that helps to make the Intel i915 driver powerful
	  and versatile graphics drivers available. It provides the high-speed data transfer
	  capabilities that are essential for smooth and responsive graphics performance.

	  Enable this config to ensure that the Intel GFX controller joins the MBUS before the
	  i915 driver is loaded. This is necessary to prevent the i915 driver from re-initializing
	  the display if the firmware has already initialized it. Without this config, the i915
	  driver will initialize the display to bring up the login screen although the firmware
	  has initialized the display using the GFX MMIO registers and framebuffer.

	  When enabled, saves 75ms-80ms of the boot time by avoiding redundent display
	  initialization by kernel graphics driver (i.e., i915_gfx).

endif
```

## src/soc/intel/common/block/gspi/Kconfig
```kconfig
config SOC_INTEL_COMMON_BLOCK_GSPI
	bool
	help
	  Intel Processor Common GSPI support

config SOC_INTEL_COMMON_BLOCK_GSPI_CLOCK_MHZ
	int
	depends on SOC_INTEL_COMMON_BLOCK_GSPI
	help
	  The input clock speed into the SPI controller IP block, in MHz.
	  No default is set here as this is an SOC-specific value
	  and must be provided by the SOC.

config SOC_INTEL_COMMON_BLOCK_GSPI_MAX
	int
	depends on SOC_INTEL_COMMON_BLOCK_GSPI
	help
	  Maximum number of GSPI controllers supported by the PCH. SoC
	  must define this config if SOC_INTEL_COMMON_BLOCK_GSPI is
	  selected.

config SOC_INTEL_COMMON_BLOCK_GSPI_VERSION_2
	bool
	default n
	select SOC_INTEL_COMMON_BLOCK_GSPI
	help
	  Intel Processor Common GSPI support with quirks to handle
	  SPI_CS_CONTROL changes introduced in CNL.
```

## src/soc/intel/common/block/hda/Kconfig
```kconfig
## SPDX-License-Identifier: GPL-2.0-only

config SOC_INTEL_COMMON_BLOCK_HDA
	bool
	help
	  Intel Processor common High Definition Audio driver support

config SOC_INTEL_COMMON_BLOCK_HDA_VERB
	bool
	depends on SOC_INTEL_COMMON_BLOCK_HDA
	help
	  Enable initialization of HDA codecs.
```

## src/soc/intel/common/block/i2c/Kconfig
```kconfig
## SPDX-License-Identifier: GPL-2.0-only

config SOC_INTEL_COMMON_BLOCK_I2C
	bool
	select DRIVERS_I2C_DESIGNWARE
	help
	  Intel Processor Common I2C support
```

## src/soc/intel/common/block/imc/Kconfig
```kconfig
## SPDX-License-Identifier: GPL-2.0-only

config SOC_INTEL_COMMON_BLOCK_IMC
	bool
	depends on ECAM_MMCONF_SUPPORT
	default n
	help
	  Select this to access SPD data through Integrated Memory Controller.
```

## src/soc/intel/common/block/ioc/Kconfig
```kconfig
config SOC_INTEL_COMMON_BLOCK_IOC
	bool
	depends on SOC_INTEL_COMMON_BLOCK_SA
	help
	  Intel Processor common IO Cache (IOC).
	  IOC will replace DMI interface starting with Meteor Lake SoC
	  (which does not have the PCH die).
```

## src/soc/intel/common/block/ipu/Kconfig
```kconfig
## SPDX-License-Identifier: GPL-2.0-only

config SOC_INTEL_COMMON_BLOCK_IPU
	bool
	help
	  Intel Image Processing Unit driver
```

## src/soc/intel/common/block/irq/Kconfig
```kconfig
config SOC_INTEL_COMMON_BLOCK_IRQ
	bool
	select SOC_INTEL_COMMON_BLOCK_GPIO
	select SOUTHBRIDGE_INTEL_COMMON_PIRQ_ACPI_GEN
	help
	  Intel common block support for assigning PCI IRQs dynamically. This
	  allows coreboot to control the IRQ assignments. They are passed to the
	  FSP via UPD, and also exposed to the OS in ACPI tables. The SoC must
	  provide a list of IRQ programming constraints; this module will avoid
	  IRQs that are used by GPIOs routed to IOAPIC.
```

## src/soc/intel/common/block/itss/Kconfig
```kconfig
config SOC_INTEL_COMMON_BLOCK_ITSS
	bool
	help
	  Intel Processor common interrupt timer subsystem support
```

## src/soc/intel/common/block/lpc/Kconfig
```kconfig
## SPDX-License-Identifier: GPL-2.0-only

config SOC_INTEL_COMMON_BLOCK_LPC
	bool
	help
	  Use common LPC code for platform. Only soc specific code needs to
	  be implemented as per requirement.

config SOC_INTEL_COMMON_BLOCK_LPC_COMB_ENABLE
	depends on SOC_INTEL_COMMON_BLOCK_LPC && DRIVERS_UART_8250IO
	bool
	default n
	help
	  By default COMA range to LPC is enable. COMB range to LPC is optional
	  and should select based on platform dedicated selection.

config SOC_INTEL_COMMON_BLOCK_LPC_MIRROR_TO_GPMR
	bool
	depends on SOC_INTEL_COMMON_BLOCK_GPMR
	help
	  Mirror LPC registers for IO/MMIO to their corresponding GPMR registers.
	  Required for platforms starting from SPT.

config SOC_INTEL_COMMON_BLOCK_LPC_GPMR_IOC_1MB
	bool
	depends on SOC_INTEL_COMMON_BLOCK_LPC_MIRROR_TO_GPMR && SOC_INTEL_COMMON_BLOCK_IOC
	help
	  Select this for platforms where IOC uses the 1MB GPMR/LGMR register
	  encoding. IOC and eSPI do not use identical address field definitions:
	  IOC encodes the address in bits [27:16], while eSPI uses bits [31:16].
	  Enabling this option ensures LPC->GPMR mirroring uses IOC-compatible
	  encoding instead of assuming the eSPI field layout.
```

## src/soc/intel/common/block/lpss/Kconfig
```kconfig
## SPDX-License-Identifier: GPL-2.0-only

config SOC_INTEL_COMMON_BLOCK_LPSS
	bool
	help
	  Intel Processor common LPSS support
```

## src/soc/intel/common/block/memory/Kconfig
```kconfig
config SOC_INTEL_COMMON_BLOCK_MEMINIT
	bool
	help
	  Intel common block support for performing initialization
	  of FSPM UPDs.

if SOC_INTEL_COMMON_BLOCK_MEMINIT

config DIMMS_PER_CHANNEL
	int
	default 0
	help
	  Maximum number of DIMMs per channel if the memory controller
	  supports DIMM modules for any memory technology.

config DATA_BUS_WIDTH
	int
	default 0
	help
	  Data bus width of the platform.

config MRC_CHANNEL_WIDTH
	int
	default 0
	help
	  Width of the memory channel from the perspective of MRC. This
	  determines the UPD organization. SoC using this common block
	  support is expected to set MRC_CHANNEL_WIDTH as per the FSP
	  MRC expectation.

config SPD_CACHE_ENABLE
	bool
	default n
	help
	  Enable to cache the spd data to the RW_SPD_CACHE region. If
	  this option is enabled, please make sure the RW_SPD_CACHE
	  region is added to the flash layout.

endif
```

## src/soc/intel/common/block/oc_wdt/Kconfig
```kconfig
## SPDX-License-Identifier: GPL-2.0-only

config SOC_INTEL_COMMON_BLOCK_OC_WDT
	bool
	depends on SOC_INTEL_COMMON_BLOCK_PMC
	help
	  Intel Processor common Overclocking Watchdog support

config SOC_INTEL_COMMON_OC_WDT_ENABLE
	bool "Enable overclocking watchdog during boot"
	depends on SOC_INTEL_COMMON_BLOCK_OC_WDT
	help
	  Enables Intel chipset Overclocking Watchdog to count during system
	  boot. The platform will reset during lockups if watchdog is not
	  reloaded. Software/firmware is responsible for feeding the watchdog.

	  If unsure, say N.

config SOC_INTEL_COMMON_OC_WDT_TIMEOUT_SECONDS
	int
	depends on SOC_INTEL_COMMON_OC_WDT_ENABLE
	range 70 1024
	default 600
	help
	  The Intel chipset Overclocking Watchdog timeout value in seconds.
	  coreboot will preload the watchdog with the timeout value specified
	  in this option. Specify a high enough value so that the platform
	  will have a chance to perform full memory training and boot. Default
	  is 10 minutes. Boards and SoCs may override this value.

config SOC_INTEL_COMMON_OC_WDT_RELOAD_IN_PERIODIC_SMI
	bool "Reload the overclocking watchdog using periodic SMI"
	depends on SOC_INTEL_COMMON_OC_WDT_ENABLE
	depends on SOC_INTEL_COMMON_BLOCK_SMM
	default y
	help
	  Enables Intel chipset Overclocking Watchdog reloading in the periodic
	  SMI handler. Without this option the platform will keep power cycling
	  unless the OS drivers are installed for this watchdog.

	  If unsure, say Y.
```

## src/soc/intel/common/block/p2sb/Kconfig
```kconfig
## SPDX-License-Identifier: GPL-2.0-only

config SOC_INTEL_COMMON_BLOCK_BASE_P2SB
	bool
	depends on SOC_INTEL_COMMON_BLOCK_PCR
	help
	  Intel Processor common P2SB base driver

config SOC_INTEL_COMMON_BLOCK_P2SB
	bool
	select SOC_INTEL_COMMON_BLOCK_BASE_P2SB
	help
	  Intel Processor common P2SB driver for PCH or SoC die

config SOC_INTEL_COMMON_BLOCK_P2SB2
	bool
	select SOC_INTEL_COMMON_BLOCK_BASE_P2SB
	help
	  Intel Processor common driver for a second P2SB (Primary to
	  SideBand) interface to PCH or SoC die

config SOC_INTEL_COMMON_BLOCK_IOE_P2SB
	bool
	select SOC_INTEL_COMMON_BLOCK_BASE_P2SB
	help
	  Intel Processor common P2SB driver for IOE die
```
