## src/soc/intel/common/block/pcie/Kconfig
```kconfig
config SOC_INTEL_COMMON_BLOCK_PCIE
	bool
	select PCIEXP_COMMON_CLOCK
	help
	  Intel Processor common PCIE support

if SOC_INTEL_COMMON_BLOCK_PCIE

source "src/soc/intel/common/block/pcie/*/Kconfig"

config PCIEXP_ASPM
	default y

config PCIEXP_CLK_PM
	default y

config PCIEXP_L1_SUB_STATE
	default y

config PCIE_LTR_MAX_SNOOP_LATENCY
	hex
	default 0x1003
	help
	  Latency tolerance reporting, max snoop latency value defaults to 3.14 ms.

config PCIE_LTR_MAX_NO_SNOOP_LATENCY
	hex
	default 0x1003
	help
	  Latency tolerance reporting, max non-snoop latency value defaults to 3.14 ms.

endif # SOC_INTEL_COMMON_BLOCK_PCIE

config PCIE_DEBUG_INFO
	bool
	help
	  Enable debug logs in PCIe module. Allows debug information on memory
	  base and limit, prefetchable memory base and limit, prefetchable memory
	  base upper 32 bits and prefetchable memory limit upper 32 bits.

config PCIE_CLOCK_CONTROL_THROUGH_P2SB
	bool
	default n
	depends on SOC_INTEL_COMMON_BLOCK_PCIE_RTD3
	help
	  Enables PCIe CLK control (on/off) through P2SB. The mechanism is supported
	  starting from MTL platform. In older platforms like ADL & TGL, PCIe CLK is
	  controlled by sending IPC CMD to PMC.

config IOE_DIE_CLOCK_START
	int
	depends on SOC_INTEL_COMMON_BLOCK_IOE_P2SB
	default 0
	help
	  The beginning of IOE DIE pcie src clk number. IOE DIE is started from MTL.
```

## src/soc/intel/common/block/pcie/rtd3/Kconfig
```kconfig
config SOC_INTEL_COMMON_BLOCK_PCIE_RTD3
	bool
	default n
	depends on HAVE_ACPI_TABLES
	select PMC_IPC_ACPI_INTERFACE
	help
	   When enabled, this driver will add support for ACPI controlled
	   Runtime D3 using GPIOs for power/reset control of the device
	   attached to a PCIe root port.
```

## src/soc/intel/common/block/pcr/Kconfig
```kconfig
config SOC_INTEL_COMMON_BLOCK_PCR
	bool
	help
	  Intel Processor common Private configuration registers (PCR)

config PCR_COMMON_IOSF_1_0
	bool
	depends on SOC_INTEL_COMMON_BLOCK_PCR
	help
	  The mapping of addresses via the SBREG_BAR assumes the IOSF-SB
	  agents are using 32-bit aligned accesses for their configuration
	  registers. For IOSF versions greater than 1_0, IOSF-SB
	  agents can use any access (8/16/32 bit aligned) for their
	  configuration registers
```

## src/soc/intel/common/block/pmc/Kconfig
```kconfig
config SOC_INTEL_COMMON_BLOCK_PMC
	depends on SOC_INTEL_COMMON_BLOCK_GPIO
	depends on ACPI_INTEL_HARDWARE_SLEEP_VALUES
	bool
	select HAVE_POWER_STATE_AFTER_FAILURE
	select HAVE_POWER_STATE_PREVIOUS_AFTER_FAILURE
	help
	  Intel Processor common code for Power Management controller(PMC)
	  subsystem

if SOC_INTEL_COMMON_BLOCK_PMC

config SOC_INTEL_MEM_MAPPED_PM_CONFIGURATION
	bool
	help
	  Select this on platforms where the PMC register for PM configuration (i.e.,
	  GEN_PMCON_A/B etc. are memory mapped).

config POWER_STATE_DEFAULT_ON_AFTER_FAILURE
	default y

config SOC_INTEL_COMMON_BLOCK_PMC_DISCOVERABLE
	bool
	help
	  Select this on platforms where the PMC device is discoverable
	  when scanning buses.

config SOC_INTEL_COMMON_BLOCK_PMC_EPOC
	bool
	help
	  Enable this for PMC devices to perform EPOC (CPU Early Power-on
	  Configuration) related functions.

endif # SOC_INTEL_COMMON_BLOCK_PMC

config PMC_INVALID_READ_AFTER_WRITE
	bool
	default n
	help
	  Enable this for PMC devices where a read back of ACPI BAR and
	  IO access bit does not return the previously written value.

config PMC_IPC_ACPI_INTERFACE
	bool
	default n
	depends on HAVE_ACPI_TABLES
	help
	  Enable this to have the PMC IPC mailbox ACPI interface added
	  to the SSDT for use by other drivers.

config PMC_GLOBAL_RESET_ENABLE_LOCK
	bool
	help
	  Enable this for PMC devices where the reset configuration
	  and lock register is located under PMC BASE at offset ETR.
	  Note that the reset register is still at 0xCF9 this only
	  controls the enable and lock feature.

config NO_PM_ACPI_TIMER
	bool
	help
	  Selected by SoCs that do not have a PM ACPI timer.

config USE_PM_ACPI_TIMER
	bool "Enable ACPI PM timer"
	default y
	depends on !NO_PM_ACPI_TIMER
	help
	  This should be disabled for devices running on battery since
	  it can draw much power. Further, it must be disabled, if S0ix
	  is enabled.

	  Disabling this option also stops the hardware TCO timer and makes
	  the TCO watchdog unavailable.

	  Note: On platforms without uCode PM Timer emulation, legacy OSes
	        or payloads with ACPI version < 5.0A might not work without
	        PM ACPI timer.

	        (Legacy) software requiring `TMR_STS` (for timer overflow
	        interrupts) will not work with this option disabled.
```

## src/soc/intel/common/block/power_limit/Kconfig
```kconfig
## SPDX-License-Identifier: GPL-2.0-only

config SOC_INTEL_COMMON_BLOCK_POWER_LIMIT
	bool
	default n
	help
	  This option allows to configure processor power limit values.

config SOC_HAS_MSR_VR_CURRENT_CONFIG
	bool
	default y
	depends on SOC_INTEL_COMMON_BLOCK_POWER_LIMIT
	help
	  Select if the SoC supports programming PL4 through
	  MSR_VR_CURRENT_CONFIG.

config SOC_INTEL_RAPL_DISABLE_VIA_MCHBAR
	bool
	default n
	help
	  Select if disabling Running Average Power Limit (RAPL) has to be done via MCHBAR.

config SOC_INTEL_COMMON_BLOCK_VARIANT_POWER_LIMIT
	bool
	default n
	help
	  This option allows to configure processor power limit values
	  for different variants based on CPU TDP and machine id.
```

## src/soc/intel/common/block/rtc/Kconfig
```kconfig
## SPDX-License-Identifier: GPL-2.0-only

config SOC_INTEL_COMMON_BLOCK_RTC
	bool
	select RTC
	help
	  Intel Processor common RTC support
```

## src/soc/intel/common/block/sata/Kconfig
```kconfig
## SPDX-License-Identifier: GPL-2.0-only

config SOC_INTEL_COMMON_BLOCK_SATA
	bool
	help
	  Common SATA module for Intel PCH
```

## src/soc/intel/common/block/scs/Kconfig
```kconfig
config SOC_INTEL_COMMON_BLOCK_SCS
	bool
	help
	  Intel Processor common storage and communication subsystem support

config SOC_INTEL_COMMON_EARLY_MMC_WAKE
	bool
	default n
	select COMMONLIB_STORAGE
	select COMMONLIB_STORAGE_MMC
	select SDHCI_CONTROLLER
	help
	  Send CMD1 early in romstage to improve boot time. It requires emmc
	  DLL tuning parameters to be added to devicetree.cb

config SOC_INTEL_COMMON_MMC_OVERRIDE
	bool
	default n
	help
	  Override the MMC settings after FSP-S.
	  It should be used only when there is no FSP UPDs for certain setting.
```

## src/soc/intel/common/block/sgx/Kconfig
```kconfig
config SOC_INTEL_COMMON_BLOCK_SGX
	bool
	select CPU_INTEL_COMMON
	default n
	help
	  Intel Processor common SGX support

if SOC_INTEL_COMMON_BLOCK_SGX

config SOC_INTEL_COMMON_BLOCK_SGX_LOCK_MEMORY
	bool
	default n
	help
	 Lock memory before SGX activation. This is only needed if MCHECK does not do it.

config SOC_INTEL_COMMON_BLOCK_SGX_ENABLE
	bool "Enable Software Guard Extensions (SGX) if available"
	default n
	help
	  Intel Software Guard Extensions (SGX) is a set of new CPU instructions that can be
	  used by applications to set aside private regions (so-called Secure Enclaves) of
	  code and data.

	  SGX will only be enabled when supported by the CPU! Configure PRMRR size using
	  SOC_INTEL_COMMON_BLOCK_PRMRR_SIZE config option.

endif
```

## src/soc/intel/common/block/smbus/Kconfig
```kconfig
config SOC_INTEL_COMMON_BLOCK_SMBUS
	bool
	select SOUTHBRIDGE_INTEL_COMMON_SMBUS
	help
	  Intel Processor common SMBus support

config FIXED_SMBUS_IO_BASE
	default 0xefa0

config SOC_INTEL_COMMON_BLOCK_SMBUS_ACPI_DRIVER
	bool
	default n
	depends on SOC_INTEL_COMMON_BLOCK_SMBUS
	help
	  Intel Processor SMBus ACPI driver support

config SOC_INTEL_COMMON_BLOCK_TCO
	bool
	help
	  Intel Processor common TCO support

config SOC_INTEL_COMMON_BLOCK_TCO_ENABLE_THROUGH_SMBUS
	bool
	depends on SOC_INTEL_COMMON_BLOCK_TCO
	help
	  Select this config to enable TCO BAR through SMBUS
```

## src/soc/intel/common/block/smm/Kconfig
```kconfig
config SOC_INTEL_COMMON_BLOCK_SMM
	bool
	help
	  Intel Processor common SMM support

config SOC_INTEL_COMMON_BLOCK_SMM_IO_TRAP
	bool
	help
	  Intel Processor trap flag if it is supported

config SOC_INTEL_COMMON_BLOCK_SMM_LOCK_GPIO_PADS
	bool
	help
	  Enable locking of security-sensitive SoC and mainboard GPIOs.
	  An SoC may provide a list of gpios to lock, and the mainboard
	  may also provide a list of gpios to lock.

config SOC_INTEL_COMMON_BLOCK_SMM_ESPI_DISABLE
	bool
	default n
	help
	  Disable eSPI SMI source to prevent the embedded controller
	  from asserting SMI while in firmware.

config SOC_INTEL_COMMON_BLOCK_SMM_TCO_ENABLE
	bool "Enable TCO SMI"
	default n
	help
	  Enable TCO SMI source to e.g. handle case instrusion.

config SOC_INTEL_COMMON_BLOCK_SMM_S5_DELAY_MS
	int
	default 100 if CHROMEOS
	default 0
	help
	  Time in milliseconds that SLP_SMI for S5 waits for before
	  enabling sleep. This is required to avoid any race between
	  SLP_SMI and PWRBTN SMI.

config HECI_DISABLE_USING_SMM
	bool
	depends on SOC_INTEL_COMMON_BLOCK_SMM
	default n
	help
	  HECI disable using SMM. Select this option to make HECI disable
	  using SMM mode, independent of dedicated UPD to perform HECI disable.
```

## src/soc/intel/common/block/spi/Kconfig
```kconfig
## SPDX-License-Identifier: GPL-2.0-only

config SOC_INTEL_COMMON_BLOCK_SPI
	bool
	help
	  Intel Processor common SPI support
```

## src/soc/intel/common/block/sram/Kconfig
```kconfig
## SPDX-License-Identifier: GPL-2.0-only

config SOC_INTEL_COMMON_BLOCK_SRAM
	bool
	help
	  Intel Processor common SRAM support
```

## src/soc/intel/common/block/systemagent-server/Kconfig
```kconfig
## SPDX-License-Identifier: GPL-2.0-only

config SOC_INTEL_COMMON_BLOCK_SA_SERVER
	bool
	help
	  Intel Server Processor common System Agent support

if SOC_INTEL_COMMON_BLOCK_SA_SERVER

config TOUUD_LIMIT
	bool
	default y
	help
	  Specify if the lower bits in top of upper usable DRAM register should be
	  treated as 1s.

config TOLUD_LIMIT
	bool
	default y
	help
	  Specify if the lower bits in top of lower usable DRAM register should be
	  treated as 1s.

endif
```

## src/soc/intel/common/block/tcss/Kconfig
```kconfig
## SPDX-License-Identifier: GPL-2.0-only

config SOC_INTEL_COMMON_BLOCK_TCSS
	def_bool n
	select FSPS_USE_MULTI_PHASE_INIT
	help
	  Sets up USB2/3 port mapping in TCSS MUX

config SOC_INTEL_TCSS_USE_PDC_PMC_USBC_MUX_CONFIGURATION
	def_bool n
	help
	  TCSS uses PDC<->PMC communication to perform mux configuration. When this config is
	  enabled, communication happens directly between PDC and PMC. Avoid sending PMC
	  commands from AP/EC.

config TCSS_HAS_USBC_OPS
	bool "Enable USB-C MUX operations via the EC"
	default y if EC_GOOGLE_CHROMEEC
	depends on SOC_INTEL_COMMON_BLOCK_TCSS && \
			!SOC_INTEL_TCSS_USE_PDC_PMC_USBC_MUX_CONFIGURATION
	help
	  Enable USB-C operations via the EC. Requires `usbc_get_ops` to control features
	  such as HPD and DP Mode entry. Currently, only the ChromeEC implements this, see
	  (ec/google/chromeec/usbc_mux.c).

	  This results in the MUX being set to a disabled state.

config ENABLE_TCSS_DISPLAY_DETECTION
	bool "Enable detection of displays over USB Type-C ports with TCSS"
	depends on TCSS_HAS_USBC_OPS && RUN_FSP_GOP
	help
	  Enable displays to be detected over Type-C ports during boot.

config ENABLE_TCSS_USB_DETECTION
	bool "Enable detection of USB boot devices attached to USB Type-C ports with TCSS"
	depends on TCSS_HAS_USBC_OPS
	help
	  Enable USB-C attached storage devices to be detected at boot.
	  This option is required for some payloads (eg, edk2), without which devices attached
	  to USB-C ports will not be detected and available to boot from.
```

## src/soc/intel/common/block/thermal/Kconfig
```kconfig
config SOC_INTEL_COMMON_BLOCK_THERMAL
	bool
	default n
	help
	  This option allows to configure PCH thermal registers for supported PCH.

config SOC_INTEL_COMMON_BLOCK_THERMAL_PCI_DEV
	bool
	default n
	select SOC_INTEL_COMMON_BLOCK_THERMAL
	help
	  This option allows to configure PCH thermal registers using Thermal PCI device
	  for chipsets till Ice Lake PCH.

config SOC_INTEL_COMMON_BLOCK_THERMAL_BEHIND_PMC
	bool
	default n
	depends on !SOC_INTEL_COMMON_BLOCK_THERMAL_PCI_DEV
	select SOC_INTEL_COMMON_BLOCK_THERMAL
	help
	  This option allows to configure PCH thermal registers using PMC PWRMBASE
	  for chipsets since Tiger Lake PCH.
```

## src/soc/intel/common/block/timer/Kconfig
```kconfig
config SOC_INTEL_COMMON_BLOCK_TIMER
	bool
	help
	  Intel Processor common TIMER support

config USE_LEGACY_8254_TIMER
	bool "Use Legacy 8254 Timer"
	default y if PAYLOAD_SEABIOS || VGA_ROM_RUN
	default n
	help
	  Setting this makes the Legacy 8254 Timer available by disabling
	  clock gating. This needs to be enabled in order to boot a legacy
	  BIOS or OS not supporting other timers like PM timer or TSC.

	  While SeaBIOS does not require this timer anymore, it is needed
	  when OpRoms are being used.

	  Disable this setting to save power, when the timer is not needed.
```

## src/soc/intel/common/block/tracehub/Kconfig
```kconfig
config SOC_INTEL_COMMON_BLOCK_TRACEHUB
	bool
	default n
	help
	 Enable Intel Trace Hub (TH) driver. Intel FSP reserves some portion of
	 memory for TH to store traces. This memory region information is
	 passed via FSP HOB to coreboot. This driver locates the HOB and marks
	 that memory region as reserved so that Operating System does not use
	 this memory.
```

## src/soc/intel/common/block/uart/Kconfig
```kconfig
config SOC_INTEL_COMMON_BLOCK_UART
	bool
	select SOC_INTEL_COMMON_BLOCK_LPSS
	help
	  Intel Processor common UART support

if SOC_INTEL_COMMON_BLOCK_UART

config INTEL_LPSS_UART_FOR_CONSOLE
	bool
	select DRIVERS_UART_8250MEM_32
	select FIXED_UART_FOR_CONSOLE
	help
	  Selected by mainboards that use one of the SoC's LPSS UARTS
	  for the coreboot console.
	  WARNING: UART_FOR_CONSOLE has to be set to a correct value,
	           otherwise wrong pad configurations might be selected.

endif
```

## src/soc/intel/common/block/usb4/Kconfig
```kconfig
## SPDX-License-Identifier: GPL-2.0-only

config SOC_INTEL_COMMON_BLOCK_USB4
	bool
	default n
	depends on SOC_INTEL_COMMON_BLOCK_TCSS
	help
	  Minimal PCI Driver for enabling SSDT generation for the DMA component
	  of Intel Thunderbolt/USB4 ports.

config SOC_INTEL_COMMON_BLOCK_USB4_PCIE
	bool
	default n
	help
	  Chip driver for adding PCI ops and SSDT generation for common Intel
	  USB4/Thunderbolt root ports.

config SOC_INTEL_COMMON_BLOCK_USB4_XHCI
	bool
	default n
	help
	  Minimal PCI driver for adding PCI ops and SSDT generation for common
	  Intel USB4/Thunderbolt North XHCI ports.

config SOC_INTEL_ENABLE_USB4_PCIE_RESOURCES
	bool
	default n
	depends on SOC_INTEL_COMMON_BLOCK_USB4
	select PCIEXP_HOTPLUG
	help
	  Enable USB4 PCIe resources for reserving hotplug buses and memory.

config DEFAULT_SOFTWARE_CONNECTION_MANAGER
	bool
	help
	  select to default to using the Software Connection Manager

choice
	prompt "Connection Manager"
	depends on SOC_INTEL_COMMON_BLOCK_USB4
	default SOFTWARE_CONNECTION_MANAGER if DEFAULT_SOFTWARE_CONNECTION_MANAGER
	default FIRMWARE_CONNECTION_MANAGER
	help
	  Software Connection Manager doesn't work with Linux 5.13 or later,
	  resulting in TBT ports timing out. Firmware Connection Manager works
	  correctly.
	  Linux patch:
	    torvalds/linux@c6da62a
	    c6da62a219d028de10f2e22e93a34c7ee2b88d03

config FIRMWARE_CONNECTION_MANAGER
	bool "Firmware Connection Manager"
	help
	  Disable SCM so that FCM can be used

config SOFTWARE_CONNECTION_MANAGER
	bool "Software Connection Manager"
	help
	  Enable SCM so it's used instead of FCM.
endchoice

config IOM_ACPI_DEVICE_VISIBLE
	bool
	depends on SOC_INTEL_COMMON_BLOCK_USB4
	default n
	help
	  Select this config if the mainboard needs the IOM ACPI device
	  visible to the OS. This is needed for ChromeOS devices for
	  which ChromeEC acts as the TCPC, otherwise should be left
	  unselected.
```

## src/soc/intel/common/block/vmx/Kconfig
```kconfig
config SOC_INTEL_COMMON_BLOCK_VMX
	bool "Enable VMX for virtualization"
	default n
```
