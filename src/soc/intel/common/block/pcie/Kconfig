## src/soc/intel/common/block/vtd/Kconfig
```kconfig
config SOC_INTEL_COMMON_BLOCK_VTD
	bool
	depends on PLATFORM_USES_FSP2_0
	help
	  Intel Processor common VT-d/IOMMU support

config ENABLE_EARLY_DMA_PROTECTION
	bool "Enable early DMA protection"
	depends on SOC_INTEL_COMMON_BLOCK_VTD
	default n
	help
	  Setting this makes the whole memory from 0 to TOLUM and from 4GB
	  to TOUUD DMA protected with VT-d PMR registers.

	  Disable this setting if your OS does not support IOMMU. The payload
	  must be aware of the DMA protection, otherwise I/O devices might not
	  work.

	  If unsure, say N.
```

## src/soc/intel/common/block/xdci/Kconfig
```kconfig
## SPDX-License-Identifier: GPL-2.0-only

config SOC_INTEL_COMMON_BLOCK_XDCI
	bool
	help
	  Intel Processor common XDCI support
```

## src/soc/intel/common/block/xhci/Kconfig
```kconfig
config SOC_INTEL_COMMON_BLOCK_XHCI
	bool
	help
	  Intel Processor common XHCI support

config SOC_INTEL_COMMON_BLOCK_XHCI_ELOG
	bool
	default n
	depends on SOC_INTEL_COMMON_BLOCK_XHCI
	help
	  Set this option to identify if XHCI caused a wake up and log that
	  information into the event log.
```

## src/soc/intel/common/feature/Kconfig
```kconfig
## SPDX-License-Identifier: GPL-2.0-only

config SOC_INTEL_COMMON_FEATURE
	bool
	help
	  Intel SoC common feature code. This option enables sharing of
	  SoC-specific code across Intel SoC generations to reduce code
	  duplication. Unlike the common block code which is intended for
	  reusable IP blocks, the feature code is for SoC-specific
	  functionality that is similar across multiple generations but
	  may have minor platform-specific differences handled through
	  configuration options or platform-specific macros.

if SOC_INTEL_COMMON_FEATURE

source "src/soc/intel/common/feature/*/Kconfig"

endif
```
