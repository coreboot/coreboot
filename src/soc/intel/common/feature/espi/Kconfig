## src/soc/intel/common/feature/espi/Kconfig
```kconfig
## SPDX-License-Identifier: GPL-2.0-only

config SOC_INTEL_COMMON_FEATURE_ESPI
	bool
	help
	  Select this if the platform supports common eSPI/LPC initialization
	  with generic IO decode range configuration and standard interrupt
	  setup. This is applicable for most modern Intel client platforms.
```

## src/soc/intel/common/feature/finalize/Kconfig
```kconfig
## SPDX-License-Identifier: GPL-2.0-only

config SOC_INTEL_COMMON_FEATURE_FINALIZE
	bool
	help
	  Include common finalize implementation for Intel SoCs. This driver
	  consolidates the nearly identical finalize implementations across
	  Meteor Lake and Panther Lake platforms.
```

## src/soc/intel/common/feature/globalreset/Kconfig
```kconfig
## SPDX-License-Identifier: GPL-2.0-only

config SOC_INTEL_COMMON_FEATURE_GLOBAL_RESET_CSE_PMC
	bool
	help
	  Include common implementation of do_global_reset() that uses CSE
	  (Converged Security Engine) with PMC (Power Management Controller)
	  fallback. This implementation is identical across multiple Intel
	  client platforms.
```

## src/soc/intel/common/feature/gspi/Kconfig
```kconfig
## SPDX-License-Identifier: GPL-2.0-only

config SOC_INTEL_COMMON_FEATURE_GSPI_DEVFN
	bool
	help
	  Common GSPI device function to bus mapping implementation.
	  SoCs using this must define SOC_GSPI_DEVFN(n) macro in their
	  pci_devs.h and CONFIG_SOC_INTEL_COMMON_BLOCK_GSPI_MAX in their
	  Kconfig.
```

## src/soc/intel/common/feature/i2c/Kconfig
```kconfig
## SPDX-License-Identifier: GPL-2.0-only

config SOC_INTEL_COMMON_FEATURE_I2C_DEVFN
	bool
	help
	  Common I2C device function to bus mapping implementation.
	  SoCs using this must define SOC_I2C_DEVFN(n) macro in their
	  pci_devs.h and CONFIG_SOC_INTEL_I2C_DEV_MAX in their Kconfig.
```

## src/soc/intel/common/feature/lockdown/Kconfig
```kconfig
## SPDX-License-Identifier: GPL-2.0-only

config SOC_INTEL_COMMON_FEATURE_LOCKDOWN
	bool
	help
	  Include common PMC lockdown driver for Intel SoCs. This driver
	  consolidates the nearly identical PMC lockdown implementations
	  across multiple Intel platform generations.
```

## src/soc/intel/common/feature/pmutil/Kconfig
```kconfig
## SPDX-License-Identifier: GPL-2.0-only

config SOC_INTEL_COMMON_FEATURE_PMUTIL
	bool
	help
	  Select this if the platform supports common PMC utility driver
	  for modern Intel platforms that share consistent PM register
	  layouts. This consolidates power management utility functions
	  including SMI/TCO/GPE status handling, PMC MMIO access, RTC
	  failure detection, sleep state management, and GPE configuration.
```

## src/soc/intel/common/feature/smihandler/Kconfig
```kconfig
## SPDX-License-Identifier: GPL-2.0-only

config SOC_INTEL_COMMON_FEATURE_SMIHANDLER
	bool
	help
	  Select this if the platform supports common PCH client SMI handler
	  implementation. This consolidates SMI handler code for PCH client
	  platforms including PMC bus master control and standard SMI handler
	  mappings. The platform must define SOC_PMC_DEV in soc/pci_devs.h.
```

## src/soc/intel/common/feature/soundwire/Kconfig
```kconfig
## SPDX-License-Identifier: GPL-2.0-only

config SOC_INTEL_COMMON_FEATURE_SOUNDWIRE
	bool
	help
	  Intel Processor Common SoundWire support. This provides a common
	  implementation of soc_fill_soundwire_controller() for platforms
	  that use the same SoundWire link configuration. The platform must
	  define SOC_SOUNDWIRE_ACPI_ADDRESS and SOC_SOUNDWIRE_MASTER_COUNT
	  in their Kconfig.

config SOC_SOUNDWIRE_ACPI_ADDRESS
	hex
	default 0x40000000
	depends on SOC_INTEL_COMMON_FEATURE_SOUNDWIRE
	help
	  ACPI address for the SoundWire controller.

config SOC_SOUNDWIRE_MASTER_COUNT
	int
	default 4
	depends on SOC_INTEL_COMMON_FEATURE_SOUNDWIRE
	help
	  Number of SoundWire master interfaces supported by the platform.
```

## src/soc/intel/common/feature/spi/Kconfig
```kconfig
## SPDX-License-Identifier: GPL-2.0-only

config SOC_INTEL_COMMON_FEATURE_SPI_DEVFN
	bool
	default n
	depends on SOC_INTEL_COMMON_BLOCK_SPI
	help
	  Use common SPI device function to bus mapping. SoCs must define
	  CONFIG_SOC_INTEL_SPI_DEV_MAX and SOC_GSPI_DEVFN(n) macro in
	  soc/pci_devs.h.

config SOC_INTEL_SPI_DEV_MAX
	int
	default 0
	depends on SOC_INTEL_COMMON_FEATURE_SPI_DEVFN
	help
	  Number of SPI controllers available on the platform. This is used
	  for SPI device function to bus number mapping. Platforms should
	  override this with the actual count of SPI controllers.

config SOC_INTEL_COMMON_FEATURE_SPI_DEVFN_PSF
	bool
	default n
	depends on SOC_INTEL_COMMON_FEATURE_SPI_DEVFN
	help
	  SoC provides soc_get_spi_psf_destination_id() via common driver.
	  Platforms must define CONFIG_SOC_INTEL_SPI_PSF_DESTINATION_ID.

config SOC_INTEL_SPI_PSF_DESTINATION_ID
	hex
	default 0x0
	depends on SOC_INTEL_COMMON_FEATURE_SPI_DEVFN_PSF
	help
	  PSF destination ID for SPI controller. This value is platform-specific
	  and is used for PSF programming. Platforms should override this with
	  the correct value from their hardware specification.
```

## src/soc/intel/common/feature/uart/Kconfig
```kconfig
## SPDX-License-Identifier: GPL-2.0-only

config SOC_INTEL_COMMON_FEATURE_UART_DEVICES
	bool
	help
	  Include common UART device list support. This option eliminates
	  per-platform duplication of uart.c files by providing a common
	  implementation. Platforms must define PCI_UART_DEVFN* macro in
	  their soc/pci_devs.h header.
```

## src/soc/intel/common/pch/Kconfig
```kconfig
config SOC_INTEL_INTEGRATED_SOUTHCLUSTER
	bool
	help
	  Apollo Lake and Gemini Lake are single-chip platforms with a south
	  cluster instead of a PCH. Most of the IP blocks are the same as in
	  PCH platforms, but there are several differences that need to be
	  accounted for.

config SOC_INTEL_COMMON_PCH_CLIENT
	bool
	select SOC_INTEL_COMMON_PCH_BASE
	help
	  Selected by "Client" platforms, i.e. desktops, workstations,
	  laptops, tablets... This also includes uniprocessor servers
	  based on the same silicon as desktops and workstations. The
	  "Client" platforms include additional IP blocks that are of
	  little to no use on servers.

config SOC_INTEL_COMMON_PCH_SERVER
	bool
	select SOC_INTEL_COMMON_PCH_BASE
	help
	  Selected by "Server" platforms, i.e. multi-socket capable
	  platforms used in large servers and workstations, such as
	  those using the Lewisburg (C620) PCH.

config SOC_INTEL_COMMON_PCH_BASE
	bool
	depends on SOC_INTEL_COMMON_BLOCK
	help
	  This option is meant to be selected by the specific options above.

if SOC_INTEL_COMMON_PCH_BASE

source "src/soc/intel/common/pch/*/Kconfig"

config PCH_SPECIFIC_BASE_OPTIONS
	def_bool y
	select SOC_INTEL_COMMON_BLOCK_CHIP_CONFIG
	select SOC_INTEL_COMMON_BLOCK_CSE
	select SOC_INTEL_COMMON_BLOCK_FAST_SPI
	select SOC_INTEL_COMMON_BLOCK_GPIO
	select SOC_INTEL_COMMON_BLOCK_GPIO_ITSS_POL_CFG
	select SOC_INTEL_COMMON_BLOCK_ITSS
	select SOC_INTEL_COMMON_BLOCK_LPC
	select SOC_INTEL_COMMON_BLOCK_P2SB
	select SOC_INTEL_COMMON_BLOCK_PCR
	select SOC_INTEL_COMMON_BLOCK_PMC
	select SOC_INTEL_COMMON_BLOCK_RTC
	select SOC_INTEL_COMMON_BLOCK_SMBUS
	select SOC_INTEL_COMMON_BLOCK_SPI
	select SOC_INTEL_COMMON_BLOCK_TCO
	select SOC_INTEL_COMMON_BLOCK_TIMER
	select SOC_INTEL_COMMON_BLOCK_XHCI
	select SOC_INTEL_COMMON_PCH_LOCKDOWN
	select SOUTHBRIDGE_INTEL_COMMON_SMBUS

config PCH_SPECIFIC_DISCRETE_OPTIONS
	def_bool !SOC_INTEL_INTEGRATED_SOUTHCLUSTER
	select SOC_INTEL_COMMON_BLOCK_GPMR
	select SOC_INTEL_COMMON_BLOCK_LPC_MIRROR_TO_GPMR
	select SOC_INTEL_COMMON_BLOCK_SATA
	select SOC_INTEL_COMMON_BLOCK_TCO_ENABLE_THROUGH_SMBUS

config PCH_SPECIFIC_CLIENT_OPTIONS
	def_bool SOC_INTEL_COMMON_PCH_CLIENT
	select SOC_INTEL_COMMON_BLOCK_DSP
	select SOC_INTEL_COMMON_BLOCK_GRAPHICS
	select SOC_INTEL_COMMON_BLOCK_I2C
	select SOC_INTEL_COMMON_BLOCK_LPSS
	select SOC_INTEL_COMMON_BLOCK_PCIE
	select SOC_INTEL_COMMON_BLOCK_UART
	select SOC_INTEL_COMMON_BLOCK_XDCI

endif # SOC_INTEL_COMMON_PCH_BASE
```

## src/soc/intel/common/pch/lockdown/Kconfig
```kconfig
config SOC_INTEL_COMMON_PCH_LOCKDOWN
	bool
	default n
	help
	  This option allows to have chipset lockdown for DMI, FAST_SPI and
	  soc_lockdown_config() to implement any additional lockdown as PMC,
	  LPC for supported PCH.
```

## src/soc/intel/denverton_ns/Kconfig
```kconfig
# SPDX-License-Identifier: GPL-2.0-only

config SOC_INTEL_DENVERTON_NS
	bool
	help
	  Intel Denverton-NS SoC support

if SOC_INTEL_DENVERTON_NS

config CPU_INTEL_NUM_FIT_ENTRIES
	int
	default 1

config CPU_SPECIFIC_OPTIONS
	def_bool y
	select ARCH_X86
	select BOOT_DEVICE_SUPPORTS_WRITES
	select CACHE_MRC_SETTINGS
	select CPU_INTEL_COMMON
	select CPU_INTEL_FIRMWARE_INTERFACE_TABLE
	select CPU_SUPPORTS_PM_TIMER_EMULATION
	select DEBUG_GPIO
	select FSP_M_XIP
	select FSP_T_XIP if FSP_CAR
	select HAVE_INTEL_FSP_REPO
	select HAVE_SMI_HANDLER
	select INTEL_DESCRIPTOR_MODE_CAPABLE
	select PCR_COMMON_IOSF_1_0
	select PLATFORM_USES_FSP2_0
	select SOC_INTEL_COMMON
	select SOC_INTEL_COMMON_RESET
	select SOC_INTEL_COMMON_BLOCK
	select SOC_INTEL_COMMON_BLOCK_CPU
	select SOC_INTEL_COMMON_BLOCK_ACPI
	select SOC_INTEL_COMMON_BLOCK_PMC
	select ACPI_INTEL_HARDWARE_SLEEP_VALUES
	select SOC_INTEL_COMMON_BLOCK_FAST_SPI
	select SOC_INTEL_COMMON_BLOCK_GPIO
	select SOC_INTEL_COMMON_BLOCK_PCR
	select SOC_INTEL_COMMON_BLOCK_PMC_DISCOVERABLE
	select SOC_INTEL_COMMON_BLOCK_SMBUS
	select SUPPORT_CPU_UCODE_IN_CBFS
	select SOUTHBRIDGE_INTEL_COMMON_SMBUS
	select TSC_MONOTONIC_TIMER
	select TSC_SYNC_MFENCE
	select UDELAY_TSC
	select UDK_2015_BINDING
	select USE_FSP_NOTIFY_PHASE_POST_PCI_ENUM
	select USE_FSP_NOTIFY_PHASE_READY_TO_BOOT
	select USE_FSP_NOTIFY_PHASE_END_OF_FIRMWARE

config ECAM_MMCONF_BASE_ADDRESS
	default 0xe0000000

config ECAM_MMCONF_BUS_NUMBER
	int
	default 256

config FSP_HEADER_PATH
	default "3rdparty/fsp/DenvertonNSFspBinPkg/Include/"

config FSP_FD_PATH
	default "3rdparty/fsp/DenvertonNSFspBinPkg/FspBin/DenvertonNSFsp.fd"

# CAR memory layout on DENVERTON_NS hardware:
## CAR base address - 0xfef00000
## CAR size 1MB - 0x100 (0xfff00)
## coreboot usage:
## DCACHE base - 0xfef00000
## DCACHE size - 0xb0000
## FSP usage:
## FSP base - 0xfefb0000
## FSP size - 0x50000 - 0x100 (0x4ff00)
config MAX_CPUS
	int
	default 16

config PCR_BASE_ADDRESS
	hex
	default 0xfd000000
	help
	  This option allows you to select MMIO Base Address of sideband bus.

config DCACHE_RAM_BASE
	hex
	default 0xfef00000

config DCACHE_RAM_SIZE
	hex
	default 0xb0000 if FSP_CAR
	default 0x100000 if !FSP_CAR

config DCACHE_BSP_STACK_SIZE
	hex
	default 0x10000

config CPU_BCLK_MHZ
	int
	default 100

config CPU_XTAL_HZ
	default 24000000

config SMM_TSEG_SIZE
	hex
	default 0x200000

config SMM_RESERVED_SIZE
	hex
	default 0x000000

config IQAT_ENABLE
	bool "Enable IQAT"
	default y

config HSUART_DEV
	hex
	default 0x1a

choice
	prompt "UART mode selection"
	default NON_LEGACY_UART_MODE

config NON_LEGACY_UART_MODE
	bool "Non Legacy Mode"
	help
	  Disable legacy UART mode

config LEGACY_UART_MODE
	bool "Legacy Mode"
	help
	  Enable legacy UART mode
	select CONSOLE_SERIAL
	select DRIVERS_UART
	select DRIVERS_UART_8250IO
endchoice

config ENABLE_HSUART
	depends on NON_LEGACY_UART_MODE
	bool "Enable High-speed UART debug port selected by UART_FOR_CONSOLE."
	default n
	select CONSOLE_SERIAL
	select DRIVERS_UART
	select DRIVERS_UART_8250MEM

config CONSOLE_UART_BASE_ADDRESS
	depends on ENABLE_HSUART
	hex "MMIO base address for UART"
	default 0xd4000000

choice
	prompt "Cache-as-ram implementation"
	default USE_DENVERTON_NS_CAR_NEM_ENHANCED
	help
	  This option allows you to select how cache-as-ram (CAR) is set up.

config USE_DENVERTON_NS_CAR_NEM_ENHANCED
	bool "Enhanced Non-evict mode"
	select SOC_INTEL_COMMON_BLOCK_CAR
	select INTEL_CAR_NEM_ENHANCED
	help
	  A current limitation of NEM (Non-Evict mode) is that code and data sizes
	  are derived from the requirement to not write out any modified cache line.
	  With NEM, if there is no physical memory behind the cached area,
	  the modified data will be lost and NEM results will be inconsistent.
	  ENHANCED NEM guarantees that modified data is always
	  kept in cache while clean data is replaced.

config USE_DENVERTON_NS_FSP_CAR
	bool "Use FSP CAR"
	select FSP_CAR
	help
	  Use FSP APIs to initialize and tear down the Cache-As-Ram.

endchoice

config IFD_CHIPSET
	string
	default "dnv"

endif ## SOC_INTEL_DENVERTON_NS
```
