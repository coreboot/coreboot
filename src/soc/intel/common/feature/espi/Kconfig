## src/soc/intel/elkhartlake/Kconfig
```kconfig
config SOC_INTEL_ELKHARTLAKE
	bool
	help
	  Intel Elkhartlake support

if SOC_INTEL_ELKHARTLAKE

config CPU_SPECIFIC_OPTIONS
	def_bool y
	select ACPI_INTEL_HARDWARE_SLEEP_VALUES
	select ARCH_X86
	select BOOT_DEVICE_SUPPORTS_WRITES
	select CACHE_MRC_SETTINGS
	select CPU_INTEL_COMMON
	select CPU_INTEL_FIRMWARE_INTERFACE_TABLE
	select CPU_SUPPORTS_PM_TIMER_EMULATION
	select DISPLAY_FSP_VERSION_INFO
	select EDK2_CPU_TIMER_LIB if PAYLOAD_EDK2
	select FSP_COMPRESS_FSP_S_LZ4
	select FSP_M_XIP
	select FSP_STATUS_GLOBAL_RESET_REQUIRED_3
	select GENERIC_GPIO_LIB
	select HAVE_FSP_GOP
	select HAVE_SMI_HANDLER
	select IDT_IN_EVERY_STAGE
	select INTEL_CAR_NEM
	select INTEL_DESCRIPTOR_MODE_CAPABLE
	select INTEL_GMA_ACPI
	select INTEL_GMA_ADD_VBT if RUN_FSP_GOP
	select MP_SERVICES_PPI_V1
	select MRC_SETTINGS_PROTECT
	select PARALLEL_MP_AP_WORK
	select PLATFORM_USES_FSP2_1
	select PMC_GLOBAL_RESET_ENABLE_LOCK
	select SOC_INTEL_COMMON
	select SOC_INTEL_COMMON_ACPI_WAKE_SOURCE
	select SOC_INTEL_COMMON_BLOCK
	select SOC_INTEL_COMMON_BLOCK_ACPI
	select SOC_INTEL_COMMON_BLOCK_ACPI_CPPC
	select SOC_INTEL_COMMON_BLOCK_ACPI_GPIO
	select SOC_INTEL_COMMON_BLOCK_ACPI_LPIT
	select SOC_INTEL_COMMON_BLOCK_ACPI_PEP
	select SOC_INTEL_COMMON_BLOCK_CAR
	select SOC_INTEL_COMMON_BLOCK_CHIP_CONFIG
	select SOC_INTEL_COMMON_BLOCK_CPU
	select SOC_INTEL_COMMON_BLOCK_CPU_MPINIT
	select SOC_INTEL_COMMON_BLOCK_CPU_SMMRELOCATE
	select SOC_INTEL_COMMON_BLOCK_GPIO_DUAL_ROUTE_SUPPORT
	select SOC_INTEL_COMMON_BLOCK_GSPI_VERSION_2
	select SOC_INTEL_COMMON_BLOCK_HDA
	select HAVE_INTEL_FSP_REPO
	select HECI_DISABLE_USING_SMM if DISABLE_HECI1_AT_PRE_BOOT
	select SOC_INTEL_COMMON_BLOCK_PMC_EPOC
	select SOC_INTEL_COMMON_BLOCK_POWER_LIMIT
	select SOC_INTEL_COMMON_BLOCK_SA
	select SOC_INTEL_COMMON_BLOCK_SCS
	select SOC_INTEL_COMMON_BLOCK_SMM
	select SOC_INTEL_COMMON_BLOCK_SMM_IO_TRAP
	select SOC_INTEL_COMMON_FSP_RESET
	select SOC_INTEL_COMMON_PCH_CLIENT
	select SOC_INTEL_COMMON_RESET
	select SOC_INTEL_MEM_MAPPED_PM_CONFIGURATION
	select SSE2
	select SUPPORT_CPU_UCODE_IN_CBFS
	select TSC_MONOTONIC_TIMER
	select UDELAY_TSC
	select UDK_202005_BINDING
	select USE_FSP_NOTIFY_PHASE_POST_PCI_ENUM
	select SOC_INTEL_RAPL_DISABLE_VIA_MCHBAR

config MAX_CPUS
	int
	default 4

config DCACHE_RAM_BASE
	default 0xfef00000

config DCACHE_RAM_SIZE
	default 0xc0000
	help
	  The size of the cache-as-ram region required during bootblock
	  and/or romstage.

config DCACHE_BSP_STACK_SIZE
	hex
	default 0x30000
	help
	  The amount of anticipated stack usage in CAR by bootblock and
	  other stages. In the case of FSP_USES_CB_STACK default value will be
	  sum of FSP-M stack requirement (192KiB) and CB romstage stack requirement (~1KiB).

config FSP_TEMP_RAM_SIZE
	hex
	default 0x40000
	help
	  The amount of anticipated heap usage in CAR by FSP.
	  Refer to Platform FSP integration guide document to know
	  the exact FSP requirement for Heap setup.

config IFD_CHIPSET
	string
	default "ehl"

config IED_REGION_SIZE
	hex
	default 0x0

config HEAP_SIZE
	hex
	default 0x8000

config MAX_ROOT_PORTS
	int
	default 7

config MAX_SATA_PORTS
	int
	default 2

config MAX_PCIE_CLOCK_SRC
	int
	default 6

config SMM_TSEG_SIZE
	hex
	default 0x1000000

config SMM_RESERVED_SIZE
	hex
	default 0x200000

config PCR_BASE_ADDRESS
	hex
	default 0xfd000000
	help
	  This option allows you to select MMIO Base Address of sideband bus.

config ECAM_MMCONF_BASE_ADDRESS
	default 0xc0000000

config CPU_BCLK_MHZ
	int
	default 100

config SOC_INTEL_COMMON_BLOCK_GSPI_CLOCK_MHZ
	int
	default 120

config CPU_XTAL_HZ
	default 38400000

config DRIVERS_I2C_DESIGNWARE_CLOCK_MHZ
	int
	default 100

config SOC_INTEL_COMMON_BLOCK_GSPI_MAX
	int
	default 3

config SOC_INTEL_I2C_DEV_MAX
	int
	default 8

config SOC_INTEL_UART_DEV_MAX
	int
	default 3

config CONSOLE_UART_BASE_ADDRESS
	hex
	default 0xfe042000
	depends on INTEL_LPSS_UART_FOR_CONSOLE

# Clock divider parameters for 115200 baud rate
# Baudrate = (UART source clock * M) /(N *16)
# EHL UART source clock: 100MHz
config SOC_INTEL_COMMON_LPSS_UART_CLK_M_VAL
	hex
	default 0x25a

config SOC_INTEL_COMMON_LPSS_UART_CLK_N_VAL
	hex
	default 0x7fff

config VBOOT
	select VBOOT_MUST_REQUEST_DISPLAY
	select VBOOT_STARTS_IN_BOOTBLOCK

config CBFS_SIZE
	default 0x200000

config FSP_HEADER_PATH
	default "3rdparty/fsp/ElkhartLakeFspBinPkg/Include/"

config FSP_FD_PATH
	string
	depends on FSP_USE_REPO
	default "3rdparty/fsp/ElkhartLakeFspBinPkg/FspBin/FSPRel.bin"

config PSE_ENABLE
	bool "Enable PSE ARM controller"
	help
	  Enable PSE IP. The PSE describes the integrated programmable
	  service engine that is designed together with x86 Atom cores
	  as an Asymmetric Multi-Processing (AMP) system.

config ADD_PSE_IMAGE_TO_CBFS
	bool "Add PSE Firmware to CBFS"
	depends on PSE_ENABLE
	default n
	help
	  PSE FW binary is required to use PSE dedicated peripherals from
	  x86 subsystem. Once PSE is enabled, the FW will be loaded from
	  CBFS by FSP and executed.

config PSE_IMAGE_FILE
	string "PSE binary path and filename"
	depends on ADD_PSE_IMAGE_TO_CBFS
	help
	  The path and filename of the PSE binary.

config PSE_FW_FILE_SIZE_KIB
	hex "Memory buffer (KiB) for PSE FW image"
	depends on ADD_PSE_IMAGE_TO_CBFS
	default 0x200
	help
	  It is recommended to allocate at least 512 KiB for PSE FW.

config PSE_CONFIG_BUFFER_SIZE_KIB
	hex "Memory buffer (KiB) for PSE config data"
	depends on ADD_PSE_IMAGE_TO_CBFS
	default 0x100
	help
	  It is recommended to allocate at least 256 KiB for PSE config
	  data (FSP will append PSE config data to memory region right
	  after PSE FW memory region).

config EHL_TSN_DRIVER
	bool
	default n
	help
	  Enable TSN GbE driver to provide board specific settings in the GBE MAC.
	  As an example of a possible change, the MAC address could be adjusted.

config SOC_INTEL_ELKHARTLAKE_DEBUG_CONSENT
	int "Debug Consent for EHL"
	# USB DBC is more common for developers so make this default to 3 if
	# SOC_INTEL_DEBUG_CONSENT=y
	default 3 if SOC_INTEL_DEBUG_CONSENT
	default 0
	help
	  This is to control debug interface on SOC.
	  Setting non-zero value will allow to use DBC or DCI to debug SOC.
	  PlatformDebugConsent in FspmUpd.h has the details.

	  Desired platform debug type are
	  0:Disabled, 1:Enabled (DCI OOB+[DbC]), 2:Enabled (DCI OOB),
	  3:Enabled (USB3 DbC), 4:Enabled (XDP/MIPI60), 5:Enabled (USB2 DbC),
	  6:Enable (2-wire DCI OOB), 7:Manual

config PRERAM_CBMEM_CONSOLE_SIZE
	hex
	default 0x1400

config SOC_INTEL_ELKHARTLAKE_TCO_NO_REBOOT_EN
	bool "Disable reset on second TCO expiration"
	depends on SOC_INTEL_COMMON_BLOCK_TCO
	default n
	help
	  Setting this option will prevent a host reset if the TCO timer expires
	  for the second time. Since this feature is not exposed to the OS in the
	  standard TCO interface, this setting can be enabled on firmware level.
	  This might be useful depending on the TCO policy.
endif
```

## src/soc/intel/fsp_baytrail/Kconfig
```kconfig
##
## This file is part of the coreboot project.
##
## Copyright (C) 2011 The ChromiumOS Authors. All rights reserved.
## Copyright (C) 2013-2014 Sage Electronic Engineering, LLC.
##
## This program is free software; you can redistribute it and/or modify
## it under the terms of the GNU General Public License as published by
## the Free Software Foundation; version 2 of the License.
##
## This program is distributed in the hope that it will be useful,
## but WITHOUT ANY WARRANTY; without even the implied warranty of
## MERCHANTABILITY or FITNESS FOR A PARTICULAR PURPOSE.  See the
## GNU General Public License for more details.
##

config SOC_INTEL_FSP_BAYTRAIL
	bool
	help
	  Bay Trail I part support using the Intel FSP.

if SOC_INTEL_FSP_BAYTRAIL

config CPU_SPECIFIC_OPTIONS
	def_bool y
	select ACPI_INTEL_HARDWARE_SLEEP_VALUES
	select ARCH_BOOTBLOCK_X86_32
	select ARCH_VERSTAGE_X86_32
	select ARCH_ROMSTAGE_X86_32
	select ARCH_RAMSTAGE_X86_32
	select HAVE_SMI_HANDLER
	select HAVE_HARD_RESET
	select RELOCATABLE_MODULES
	select NO_RELOCATABLE_RAMSTAGE
	select PARALLEL_MP
	select REG_SCRIPT
	select SMM_TSEG
	select SMP
	select SPI_FLASH
	select SSE2
	select TSC_CONSTANT_RATE
	select TSC_SYNC_MFENCE
	select UDELAY_TSC
	select SUPPORT_CPU_UCODE_IN_CBFS
	select HAVE_INTEL_FIRMWARE
	select HAVE_SPI_CONSOLE_SUPPORT

	# Microcode header files are delivered in FSP package
	select USES_MICROCODE_HEADER_FILES if HAVE_FSP_BIN

config SOC_INTEL_FSP_BAYTRAIL_MD
	bool
	default n

config BOOTBLOCK_CPU_INIT
	string
	default "soc/intel/fsp_baytrail/bootblock/bootblock.c"

config MMCONF_BASE_ADDRESS
	hex
	default 0xe0000000

config MAX_CPUS
	int
	default 4

config CPU_ADDR_BITS
	int
	default 36

config SMM_TSEG_SIZE
	hex
	default 0x800000
	help
	  This is set by the FSP

config SMM_RESERVED_SIZE
	hex
	default 0x100000

config VGA_BIOS_ID
	string
	default "8086,0f31"
	help
	  This is the default PCI ID for the Bay Trail graphics
	  devices.  This string names the vbios ROM in cbfs.

config ENABLE_BUILTIN_COM1
	bool "Enable built-in legacy Serial Port"
	help
	  The Baytrail SOC has one legacy serial port. Choose this option to
	  configure the pads and enable it. This serial port can be used for
	  the debug console.

config VGA_BIOS_FILE
	string
	default "../intel/cpu/baytrail/vbios/Vga.dat" if VGA_BIOS

config CPU_MICROCODE_HEADER_FILES
	string
	default "../intel/cpu/baytrail/microcode/M0130673322.h ../intel/cpu/baytrail/microcode/M0130679901.h ../intel/cpu/baytrail/microcode/M0230672228.h"

## Baytrail Specific FSP Kconfig
source src/soc/intel/fsp_baytrail/fsp/Kconfig

endif	#SOC_INTEL_FSP_BAYTRAIL
```

## src/soc/intel/fsp_baytrail/fsp/Kconfig
```kconfig
##
## This file is part of the coreboot project.
##
## Copyright (C) 2014 Sage Electronic Engineering, LLC.
##
## This program is free software; you can redistribute it and/or modify
## it under the terms of the GNU General Public License as published by
## the Free Software Foundation; version 2 of the License.
##
## This program is distributed in the hope that it will be useful,
## but WITHOUT ANY WARRANTY; without even the implied warranty of
## MERCHANTABILITY or FITNESS FOR A PARTICULAR PURPOSE.  See the
## GNU General Public License for more details.
##

config BAYTRAIL_FSP_SPECIFIC_OPTIONS
	def_bool y
	select PLATFORM_USES_FSP1_0
	select USE_GENERIC_FSP_CAR_INC
	select FSP_USES_UPD

config FSP_FILE
	string
	default "../intel/fsp/baytrail/BAYTRAIL_FSP.fd"
	help
	  The path and filename of the Intel FSP binary for this platform.

config FSP_LOC
	hex
	default 0xfffc0000
	help
	  The location in CBFS that the FSP is located. This must match the
	  value that is set in the FSP binary.  If the FSP needs to be moved,
	  rebase the FSP with Intel's BCT (tool).

	  The Bay Trail FSP is built with a preferred base address of
	  0xFFFC0000.
```

## src/soc/intel/fsp_broadwell_de/Kconfig
```kconfig
config SOC_INTEL_FSP_BROADWELL_DE
	bool
	help
	  Broadwell-DE support using the Intel FSP.

if SOC_INTEL_FSP_BROADWELL_DE

config CPU_SPECIFIC_OPTIONS
	def_bool y
	select ACPI_INTEL_HARDWARE_SLEEP_VALUES
	select ARCH_BOOTBLOCK_X86_32
	select ARCH_VERSTAGE_X86_32
	select ARCH_ROMSTAGE_X86_32
	select ARCH_RAMSTAGE_X86_32
	select SOUTHBRIDGE_INTEL_COMMON_SPI
	select SOUTHBRIDGE_INTEL_COMMON_RESET
	select SOUTHBRIDGE_INTEL_COMMON_RTC
	select PARALLEL_MP
	select SMP
	select IOAPIC
	select SSE2
	select UDELAY_TSC
	select SUPPORT_CPU_UCODE_IN_CBFS
	select INTEL_DESCRIPTOR_MODE_CAPABLE
	select HAVE_SMI_HANDLER
	select X86_SMM_LOADER_VERSION2
	select TSC_MONOTONIC_TIMER
	select HAVE_FSP_BIN
	select CPU_INTEL_FIRMWARE_INTERFACE_TABLE
	select SOC_INTEL_COMMON
	select SOC_INTEL_COMMON_BLOCK
	select SOC_INTEL_COMMON_BLOCK_IMC
	select BOOT_DEVICE_SUPPORTS_WRITES
	select BOOT_DEVICE_SPI_FLASH_RW_NOMMAP_EARLY

config VBOOT
	select VBOOT_STARTS_IN_ROMSTAGE

config CBFS_SIZE
	hex
	default 0x200000

config HEAP_SIZE
	hex
	default 0x100000

config BOOTBLOCK_CPU_INIT
	string
	default "soc/intel/fsp_broadwell_de/bootblock/bootblock.c"

config MMCONF_BASE_ADDRESS
	hex
	default 0x80000000

config MAX_CPUS
	int
	default 32

config CPU_ADDR_BITS
	int
	default 36

config VGA_BIOS
	bool
	default n

config IED_REGION_SIZE
	hex
	default 0x400000

config SMM_RESERVED_SIZE
	hex
	default 0x100000

config INTEGRATED_UART
	bool "Integrated UART ports"
	default y
	select DRIVERS_UART_8250IO
	select CONSOLE_SERIAL
	help
	  Use Broadwell-DE Integrated UART ports @3F8h and 2F8h.

config SERIRQ_CONTINUOUS_MODE
	bool
	default n
	help
	  If you set this option to y, the serial IRQ machine will be
	  operated in continuous mode.

config DIMM_SPD_SIZE
	int
	default 512

config HPET_MIN_TICKS
	hex
	default 0x80

## Broadwell-DE Specific FSP Kconfig
source src/soc/intel/fsp_broadwell_de/fsp/Kconfig

endif	# SOC_INTEL_FSP_BROADWELL_DE
```

## src/soc/intel/fsp_broadwell_de/fsp/Kconfig
```kconfig
config BROADWELL_DE_FSP_SPECIFIC_OPTIONS
	def_bool y
	select PLATFORM_USES_FSP1_0
	select USE_GENERIC_FSP_CAR_INC
	select FSP_USES_UPD

config FSP_FILE
	string
	default "../intel/fsp/broadwell_de/BROADWELLDE_FSP.bin"
	help
	  The path and filename of the Intel FSP binary for this platform.

config FSP_LOC
	hex
	default 0xffeb0000
	help
	  The location in CBFS that the FSP is located. This must match the
	  value that is set in the FSP binary.  If the FSP needs to be moved,
	  rebase the FSP with Intel's BCT (tool).

	  The Broadwell-DE FSP is built with a preferred base address of
	  0xffeb0000.

config DCACHE_RAM_BASE
	hex
	default 0xfe100000
	help
	  This address needs to match the setup performed inside FSP.
	  On Broadwell-DE the FSP allocates temporary RAM starting at 0xfe100000.

config DCACHE_RAM_SIZE
	hex
	default 0x8000
	help
	  The DCACHE is shared between FSP itself and the rest of the coreboot
	  stages. A size of 0x8000 works fine while providing enough space for
	  features like VBOOT in verstage. Further increase to a power of two
	  aligned value leads to errors in FSP.

config FSP_MEMORY_DOWN
	bool "Enable Memory Down"
	default n
	help
	  Load SPD data from ROM instead of trying to read from SMBus.

	  If the platform has DIMM sockets, say N. If memory is down, say Y and
	  supply the appropriate SPD data for each Channel/DIMM.

config FSP_MEMORY_DOWN_CH0DIMM0_SPD_PRESENT
	bool "Channel 0, DIMM 0 Present"
	default n
	depends on FSP_MEMORY_DOWN
	help
	  Select Y if Channel 0, DIMM 0 is present.

config FSP_MEMORY_DOWN_CH0DIMM0_SPD_FILE
	string "Channel 0, DIMM 0 SPD File"
	default "spd_ch0_dimm0.bin"
	depends on FSP_MEMORY_DOWN_CH0DIMM0_SPD_PRESENT
	help
	  Path to the file which contains the SPD data for Channel 0, DIMM 0.

config FSP_MEMORY_DOWN_CH0DIMM1_SPD_PRESENT
	bool "Channel 0, DIMM 1 Present"
	default n
	depends on FSP_MEMORY_DOWN
	help
	  Select Y if Channel 0, DIMM 1 is present.

config FSP_MEMORY_DOWN_CH0DIMM1_SPD_FILE
	string "Channel 0, DIMM 1 SPD File"
	default "spd_ch0_dimm1.bin"
	depends on FSP_MEMORY_DOWN_CH0DIMM1_SPD_PRESENT
	help
	  Path to the file which contains the SPD data for Channel 0, DIMM 1.

config FSP_MEMORY_DOWN_CH1DIMM0_SPD_PRESENT
	bool "Channel 1, DIMM 0 Present"
	default n
	depends on FSP_MEMORY_DOWN
	help
	  Select Y if Channel 1, DIMM 0 is present.

config FSP_MEMORY_DOWN_CH1DIMM0_SPD_FILE
	string "Channel 1, DIMM 0 SPD File"
	default "spd_ch1_dimm0.bin"
	depends on FSP_MEMORY_DOWN_CH1DIMM0_SPD_PRESENT
	help
	  Path to the file which contains the SPD data for Channel 1, DIMM 0.

config FSP_MEMORY_DOWN_CH1DIMM1_SPD_PRESENT
	bool "Channel 1, DIMM 1 Present"
	default n
	depends on FSP_MEMORY_DOWN
	help
	  Select Y if Channel 1, DIMM 1 is present.

config FSP_MEMORY_DOWN_CH1DIMM1_SPD_FILE
	string "Channel 1, DIMM 1 SPD File"
	default "spd_ch1_dimm1.bin"
	depends on FSP_MEMORY_DOWN_CH1DIMM1_SPD_PRESENT
	help
	  Path to the file which contains the SPD data for Channel 1, DIMM 1.

config FSP_HYPERTHREADING
	bool "Enable Hyper-Threading"
	default y
	help
	  Enable Intel(r) Hyper-Threading Technology for the Broadwell-DE SoC.
```
