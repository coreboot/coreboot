## src/soc/intel/xeon_sp/Kconfig
```kconfig
# SPDX-License-Identifier: GPL-2.0-or-later

source "src/soc/intel/xeon_sp/*/Kconfig"

config XEON_SP_IBL
	bool
	default n

config XEON_SP_COMMON_BASE
	bool
	select ACPI_INTEL_HARDWARE_SLEEP_VALUES
	select ARCH_X86
	select BOOT_DEVICE_SUPPORTS_WRITES
	select CPU_INTEL_COMMON
	select CPU_INTEL_FIRMWARE_INTERFACE_TABLE
	select FSP_CAR
	select FSP_M_XIP
	select FSP_COMPRESS_FSP_S_LZ4
	select FSP_PLATFORM_MEMORY_SETTINGS_VERSIONS
	select FSP_T_XIP
	select HAVE_SMI_HANDLER
	select INTEL_CAR_NEM # For postcar only now
	select INTEL_DESCRIPTOR_MODE_CAPABLE
	select PARALLEL_MP_AP_WORK
	select PMC_GLOBAL_RESET_ENABLE_LOCK
	select POSTCAR_STAGE
	select REG_SCRIPT
	select SMM_TSEG
	select SOC_INTEL_COMMON
	select SOC_INTEL_COMMON_RESET
	select SOC_INTEL_COMMON_BLOCK
	select SOC_INTEL_COMMON_BLOCK_ACPI
	select SOC_INTEL_COMMON_BLOCK_CPU
	select SOC_INTEL_COMMON_BLOCK_GPIO_DUAL_ROUTE_SUPPORT
	select SOC_INTEL_COMMON_BLOCK_GPIO_PADCFG_PADTOL
	select SOC_INTEL_COMMON_BLOCK_PMC_DISCOVERABLE
	select SOC_INTEL_COMMON_BLOCK_SMM
	select SOC_INTEL_COMMON_BLOCK_TCO
	select SUPPORT_CPU_UCODE_IN_CBFS
	select SMM_PCI_RESOURCE_STORE
	select SOC_INTEL_COMMON_PCH_SERVER if !XEON_SP_IBL
	select SOC_INTEL_COMMON_IBL_BASE if XEON_SP_IBL
	select TSC_MONOTONIC_TIMER
	select TPM_STARTUP_IGNORE_POSTINIT if INTEL_TXT
	select UDELAY_TSC
	select USE_FSP_NOTIFY_PHASE_POST_PCI_ENUM
	select USE_FSP_NOTIFY_PHASE_READY_TO_BOOT
	select USE_FSP_NOTIFY_PHASE_END_OF_FIRMWARE
	select IDT_IN_EVERY_STAGE

if XEON_SP_COMMON_BASE

config MAX_SOCKET
	int
	default 2

config MAX_HECI_DEVICES
	int
	default 5

# For 2S config, the number of cpus could be as high as
# 2 threads * 20 cores * 2 sockets
config MAX_CPUS
	int
	default 80

config INTEL_SPI_BASE_ADDRESS
	hex
	default 0xfe010000
	help
	  SPI BAR0 Base address.

config INTEL_ACPI_BASE_ADDRESS
	hex
	default 0x500
	help
	  IO Address of ACPI.

config INTEL_PCH_PWRM_BASE_ADDRESS
	hex
	default 0xfe000000
	help
	  PCH PWRM Base address.

config PCR_BASE_ADDRESS
	hex
	default 0xfd000000
	help
	  This option allows you to select MMIO Base Address of sideband bus.

config DCACHE_BSP_STACK_SIZE
	hex
	default 0x10000

config ECAM_MMCONF_BASE_ADDRESS
	default 0x80000000

config ECAM_MMCONF_BUS_NUMBER
	default 512 if MAX_SOCKET = 4
	default 256

config ALWAYS_ALLOW_ABOVE_4G_ALLOCATION
	default y

config HPET_MIN_TICKS
	hex
	default 0x80

config SOC_INTEL_XEON_RAS
	bool
	select SOC_ACPI_HEST
	select SOC_RAS_ELOG

config HAVE_IOAT_DOMAINS
	bool

config SOC_INTEL_HAS_CXL
	bool

config SUPPORT_SIMICS_SIMULATION
	bool
	default y
	select SHADOW_ROM_TABLE_TO_EBDA

endif ## SOC_INTEL_XEON_SP
```

## src/soc/intel/xeon_sp/cpx/Kconfig
```kconfig
## SPDX-License-Identifier: GPL-2.0-only

if SOC_INTEL_COOPERLAKE_SP

config SOC_SPECIFIC_OPTIONS
	def_bool y
	select HAVE_INTEL_FSP_REPO

config FSP_HEADER_PATH
	default "3rdparty/fsp/CedarIslandFspBinPkg/Include"

config FSP_FD_PATH
	default "3rdparty/fsp/CedarIslandFspBinPkg/Fsp.fd"

config MAX_SOCKET
	int
	default 2

config MAX_CPUS
	int
	default 255

config PCR_BASE_ADDRESS
	hex
	default 0xfd000000
	help
	  This option allows you to select MMIO Base Address of sideband bus.

config DCACHE_RAM_BASE
	hex
	default 0xfe800000

config DCACHE_RAM_SIZE
	hex
	default 0x1fff00
	help
	  The size of the cache-as-ram region required during bootblock
	  and/or romstage. FSP-T reserves the upper 0x100 for
	  FspReservedBuffer.

config DCACHE_BSP_STACK_SIZE
	hex
	default 0x40000
	help
	  The amount of anticipated stack usage in CAR by bootblock and
	  other stages. It needs to include FSP-M stack requirement and
	  CB romstage stack requirement. The integration documentation
	  says this needs to be 256KiB.

config FSP_M_RC_HEAP_SIZE
	hex
	default 0x130000
	help
	  On xeon_sp/cpx FSP-M has two separate heap managers, one regular
	  whose size and base are controllable via the StackBase and
	  StackSize UPDs and a 'rc' heap manager that is statically
	  allocated at 0xfe800000 (the CAR base) and consumes about 0x130000
	  bytes of memory.

config CPU_MICROCODE_CBFS_LOC
	hex
	default 0xfff0fdc0

config CPU_MICROCODE_CBFS_LEN
	hex
	default 0x7C00

config HEAP_SIZE
	hex
	default 0x80000

config STACK_SIZE
	hex
	default 0x4000

config FSP_TEMP_RAM_SIZE
	hex
	depends on FSP_USES_CB_STACK
	default 0x40000
	help
	  The amount of anticipated heap usage in CAR by FSP.
	  Refer to Platform FSP integration guide document to know
	  the exact FSP requirement for Heap setup.  The FSP integration
	  documentation says this needs to be at least 128KiB, but practice
	  show this needs to be 256KiB or more.

config IED_REGION_SIZE
	hex
	default 0x400000

config IFD_CHIPSET
	string
	default "lbg"

config SOC_INTEL_COMMON_BLOCK_P2SB
	def_bool y

config CPU_BCLK_MHZ
	int
	default 100

# CPX-SP has 2 IMCs, 3 channels per IMC, 2 DIMMs per channel
# Default value is set to one socket, full config.
config DIMM_MAX
	default 12

# DDR4
config DIMM_SPD_SIZE
	default 512

config XEON_SP_HAVE_IIO_IOAPIC
	bool
	default y

config XEON_SP_PCH_IOAPIC_GSI_BASES
	hex
	default 0x78

if INTEL_TXT

config INTEL_TXT_SINIT_SIZE
	hex
	default 0x50000
	help
	  According to document number 572782 this needs to be 256KiB
	  for the SINIT module and 64KiB for SINIT data.

config INTEL_TXT_HEAP_SIZE
	hex
	default 0xf0000
	help
	  This must be 960KiB according to 572782.

endif # INTEL_TXT

endif
```

## src/soc/intel/xeon_sp/gnr/Kconfig
```kconfig
## SPDX-License-Identifier: GPL-2.0-only

config SOC_INTEL_GRANITERAPIDS
	bool
	select FSP_NVS_DATA_POST_SILICON_INIT
	select SOC_INTEL_MEM_MAPPED_PM_CONFIGURATION
	select XEON_SP_COMMON_BASE
	select PLATFORM_USES_FSP2_4
	select CACHE_MRC_SETTINGS
	select CPU_INTEL_TURBO_NOT_PACKAGE_SCOPED
	select XEON_SP_IBL
	select DEFAULT_X2APIC_RUNTIME
	select UDK_202302_BINDING
	select PLATFORM_USES_FSP2_X86_32
	select HAVE_IOAT_DOMAINS
	select FSP_SPEC_VIOLATION_XEON_SP_HEAP_WORKAROUND
	select DRAM_SUPPORT_DDR5
	help
	  Intel Granite Rapids support

if SOC_INTEL_GRANITERAPIDS

config CHIPSET_DEVICETREE
	string
	default "soc/intel/xeon_sp/gnr/chipset.cb"

config FSP_HEADER_PATH
	string "Location of FSP headers"
	default "src/vendorcode/intel/fsp/fsp2_0/graniterapids/ap"

config MAX_CPUS
	int
	default 512

config PCR_BASE_ADDRESS
	hex
	default 0xf7000000
	help
	  This option allows you to select MMIO Base Address of sideband bus.

config INTEL_PCH_PWRM_BASE_ADDRESS
	hex
	default 0xf6800000
	help
	  PCH PWRM Base address.

config DCACHE_RAM_BASE
	hex
	default 0xfe800000

config DCACHE_RAM_SIZE
	hex
	default 0x1fff00
	help
	  The size of the cache-as-ram region required during bootblock
	  and/or romstage. FSP-T reserves the upper 0x100 for
	  FspReservedBuffer.

config FSP_M_RC_HEAP_SIZE
	hex
	default 0x142000
	help
	  On xeon_sp/gnr FSP-M has two separate heap managers, one regular
	  whose size and base are controllable via the StackBase and
	  StackSize UPDs and a 'rc' heap manager that is statically
	  allocated at 0xfe800000 (the CAR base) and consumes about 0x142000
	  bytes of memory.

config HEAP_SIZE
	hex
	default 0x80000

config STACK_SIZE
	hex
	default 0x4000

config FSP_TEMP_RAM_SIZE
	hex
	depends on FSP_USES_CB_STACK
	default 0x58000
	help
	  The amount of anticipated heap usage in CAR by FSP.
	  Refer to Platform FSP integration guide document to know
	  the exact FSP requirement for Heap setup. The FSP integration
	  documentation says this needs to be at least 128KiB, but practice
	  show this needs to be 256KiB or more.

config IED_REGION_SIZE
	hex
	default 0x400000

config CPU_BCLK_MHZ
	int
	default 100

# DDR4
config DIMM_SPD_SIZE
	int
	default 1024

config MAX_ACPI_TABLE_SIZE_KB
	int
	default 224

config SOC_INTEL_HAS_NCMEM
	def_bool y

config SOC_INTEL_HAS_CXL
	def_bool n

config INTEL_SPI_BASE_ADDRESS
	hex
	default 0xf6830000
	help
	  SPI BAR0 Base address.

endif
```

## src/soc/intel/xeon_sp/ras/Kconfig
```kconfig
# SPDX-License-Identifier: GPL-2.0-or-later

config SOC_ACPI_HEST
	def_bool n
	depends on HAVE_ACPI_TABLES
	help
	  This variable provides control for ACPI hardware error source table (HEST)

config SOC_RAS_ELOG
	def_bool n
	depends on SOC_ACPI_HEST
	help
	  This variable provides enhanced error logging support used with HEST

config ERROR_LOG_BUFFER_SIZE
	hex
	default 0x4000
	depends on SOC_RAS_ELOG
	help
	  This variable allows a configurable error log based on system requirements
```

## src/soc/intel/xeon_sp/skx/Kconfig
```kconfig
## SPDX-License-Identifier: GPL-2.0-only

config SOC_INTEL_SKYLAKE_SP
	bool
	select XEON_SP_COMMON_BASE
	select PLATFORM_USES_FSP2_0
	select NO_FSP_TEMP_RAM_EXIT
	select UDK_202005_BINDING
	help
	  Intel Skylake-SP support

if SOC_INTEL_SKYLAKE_SP

config FSP_HEADER_PATH
	  string "Location of FSP headers"
	  default "src/vendorcode/intel/fsp/fsp2_0/skylake_sp"

config MAX_SOCKET
	int
	default 2

# For 2S config, the number of cpus could be as high as
# 2 threads * 20 cores * 2 sockets
config MAX_CPUS
	int
	default 80

config CPU_BCLK_MHZ
	int
	default 100

config PCR_BASE_ADDRESS
	hex
	default 0xfd000000
	help
	  This option allows you to select MMIO Base Address of sideband bus.

config DCACHE_RAM_BASE
	hex
	default 0xfe800000

config DCACHE_RAM_SIZE
	hex
	default 0x200000

config DCACHE_BSP_STACK_SIZE
	hex
	default 0x10000

config CPU_MICROCODE_CBFS_LOC
	hex
	default 0xfff0fdc0

config CPU_MICROCODE_CBFS_LEN
	hex
	default 0x7C00

config IED_REGION_SIZE
	hex
	default 0x400000

config IFD_CHIPSET
	string
	default "lbg"

config XEON_SP_HAVE_IIO_IOAPIC
	bool
	default y

endif
```

## src/soc/intel/xeon_sp/spr/Kconfig
```kconfig
## SPDX-License-Identifier: GPL-2.0-only

config SOC_INTEL_SAPPHIRERAPIDS_SP
	bool
	select FSP_NVS_DATA_POST_SILICON_INIT
	select SOC_INTEL_MEM_MAPPED_PM_CONFIGURATION
	select DISABLE_ACPI_HIBERNATE
	select DEFAULT_X2APIC_RUNTIME
	select CACHE_MRC_SETTINGS
	select CPU_INTEL_TURBO_NOT_PACKAGE_SCOPED
	select PLATFORM_USES_FSP2_3
	select SOC_INTEL_CSE_SERVER_SKU
	select XEON_SP_COMMON_BASE
	select HAVE_IOAT_DOMAINS
	select FSP_SPEC_VIOLATION_XEON_SP_HEAP_WORKAROUND
	select UDK_202005_BINDING
	select SOC_INTEL_HAS_CXL
	select HAVE_X86_64_SUPPORT
	help
	  Intel Sapphire Rapids-SP support

if SOC_INTEL_SAPPHIRERAPIDS_SP

config CHIPSET_DEVICETREE
	string
	default "soc/intel/xeon_sp/spr/chipset.cb"

config FSP_HEADER_PATH
	string "Location of FSP headers"
	default "src/vendorcode/intel/fsp/fsp2_0/sapphirerapids_sp"

config MAX_CPUS
	int
	default 255

config ACPI_CPU_STRING
	string
	default "C%03X"

config PCR_BASE_ADDRESS
	hex
	default 0xfd000000
	help
	  This option allows you to select MMIO Base Address of sideband bus.

config DCACHE_RAM_BASE
	hex
	default 0xfe800000

config DCACHE_RAM_SIZE
	hex
	default 0x1fff00
	help
	  The size of the cache-as-ram region required during bootblock
	  and/or romstage. FSP-T reserves the upper 0x100 for
	  FspReservedBuffer.

config DCACHE_BSP_STACK_SIZE
	hex
	default 0x40000
	help
	  The amount of anticipated stack usage in CAR by bootblock and
	  other stages. It needs to include FSP-M stack requirement and
	  CB romstage stack requirement. The integration documentation
	  says this needs to be 256KiB.

config FSP_M_RC_HEAP_SIZE
	hex
	default 0x150000
	help
	  On xeon_sp/spr FSP-M has two separate heap managers, one regular
	  whose size and base are controllable via the StackBase and
	  StackSize UPDs and a 'rc' heap manager that is statically
	  allocated at 0xfe800000 (the CAR base) and consumes about 0x150000
	  bytes of memory.


config STACK_SIZE
	hex
	default 0x4000

config FSP_TEMP_RAM_SIZE
	hex
	depends on FSP_USES_CB_STACK
	default 0x60000
	help
	  The amount of anticipated heap usage in CAR by FSP.
	  Refer to Platform FSP integration guide document to know
	  the exact FSP requirement for Heap setup.  The FSP integration
	  documentation says this needs to be at least 128KiB, but practice
	  show this needs to be 256KiB or more.

config IED_REGION_SIZE
	hex
	default 0x400000

config IFD_CHIPSET
	string
	default "lbg"

config SOC_INTEL_COMMON_BLOCK_P2SB
	def_bool y

config SOC_INTEL_HAS_BIOS_DONE_MSR
	def_bool y

config SOC_INTEL_HAS_NCMEM
	def_bool y

config SOC_INTEL_MMAPVTD_ONLY_FOR_DPR
	def_bool y

config CPU_BCLK_MHZ
	int
	default 100

# SPR-SP has 4 IMCs, 2 channels per IMC, 2 DIMMs per channel
# Default value is set to two sockets, full config.
config MAX_IMC
	int
	default 4

config DIMM_MAX
	int
	default 32

# DDR4
config DIMM_SPD_SIZE
	int
	default 1024

config MAX_ACPI_TABLE_SIZE_KB
	int
	default 512 if MAX_SOCKET = 4
	default 224

config FIXED_SMBUS_IO_BASE
	default 0x780

config DISPLAY_UPD_IIO_DATA
	def_bool n
	depends on DISPLAY_UPD_DATA

if INTEL_TXT

config INTEL_TXT_SINIT_SIZE
	hex
	default 0x50000
	help
	  According to document number 572782 this needs to be 256KiB
	  for the SINIT module and 64KiB for SINIT data.

config INTEL_TXT_HEAP_SIZE
	hex
	default 0xf0000
	help
	  This must be 960KiB according to 572782.

endif # INTEL_TXT

config ENABLE_IO_MARGINING
	bool "Enable IO Margining"
	default n
	depends on !PCIEXP_ASPM
	help
	  Enable support for I/O margining. This is mutually exclusive with
	  ASPM. This option is intended for debugging and validation and
	  should normally be disabled.

config ENABLE_RMT
	bool "Enable RMT"
	default n
	help
	  Enable Rank Margining Tool. This option is intended for debugging and
	  validation and should normally be disabled.

config RMT_MEM_POR_FREQ
	bool "Enforce Plan Of Record restrictions for DDR5 frequency and voltage"
	default n
	depends on ENABLE_RMT
	help
	  When RMT is enabled. Select this option to enforce Intel Plan Of Record(POR)
	  restriction on DDR5 frequency & voltage settings.
endif
```

## src/soc/lowrisc/lowrisc/Kconfig
```kconfig
config SOC_LOWRISC_LOWRISC
	select ARCH_RISCV
	select ARCH_BOOTBLOCK_RISCV
	select ARCH_VERSTAGE_RISCV
	select ARCH_ROMSTAGE_RISCV
	select ARCH_RAMSTAGE_RISCV
	select BOOTBLOCK_CONSOLE
	select DRIVERS_UART_8250MEM_32
	bool
	default n

if SOC_LOWRISC_LOWRISC

config RISCV_ARCH
	string
	default "rv64imafd"

config RISCV_ABI
	string
	default "lp64d"

config RISCV_CODEMODEL
	string
	default "medany"

endif
```

## src/soc/marvell/armada38x/Kconfig
```kconfig
config SOC_MARVELL_ARMADA38X
	bool
	default n
	select ARCH_BOOTBLOCK_ARMV7
	select ARCH_VERSTAGE_ARMV7
	select ARCH_ROMSTAGE_ARMV7
	select ARCH_RAMSTAGE_ARMV7
	select HAVE_UART_SPECIAL
	select BOOTBLOCK_CONSOLE
	select BOOTBLOCK_CUSTOM
	select GENERIC_UDELAY
	select UART_OVERRIDE_REFCLK

if SOC_MARVELL_ARMADA38X

config VBOOT
	select VBOOT_RETURN_FROM_VERSTAGE

config BOOTBLOCK_CPU_INIT
	string
	default "soc/marvell/armada38x/bootblock.c"
	help
	  CPU/SoC-specific bootblock code. This is useful if the
	  bootblock must load microcode or copy data from ROM before
	  searching for the bootblock.

config CONSOLE_SERIAL_UART_ADDRESS
	hex
	default 0xf1012000
endif
```

## src/soc/marvell/bg4cd/Kconfig
```kconfig
##
## This file is part of the coreboot project.
##
## Copyright 2014 Google Inc.
##
## This program is free software; you can redistribute it and/or modify
## it under the terms of the GNU General Public License as published by
## the Free Software Foundation; version 2 of the License.
##
## This program is distributed in the hope that it will be useful,
## but WITHOUT ANY WARRANTY; without even the implied warranty of
## MERCHANTABILITY or FITNESS FOR A PARTICULAR PURPOSE.  See the
## GNU General Public License for more details.
##

config SOC_MARVELL_BG4CD
	bool
	default n
	select ARCH_BOOTBLOCK_ARMV7_M
	select BOOTBLOCK_CUSTOM if VBOOT_VERIFY_FIRMWARE
	select ARCH_RAMSTAGE_ARMV7
	select ARCH_ROMSTAGE_ARMV7
	select ARCH_VERSTAGE_ARMV7_M
	select BOOTBLOCK_CONSOLE
	select GENERIC_UDELAY
	select HAVE_MONOTONIC_TIMER
	select GENERIC_GPIO_LIB

if SOC_MARVELL_BG4CD

config CHROMEOS
	select VBOOT_STARTS_IN_BOOTBLOCK

endif
```
