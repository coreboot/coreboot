## src/soc/marvell/mvmap2315/Kconfig
```kconfig
##
## This file is part of the coreboot project.
##
## Copyright (C) 2016 Marvell, Inc.
##
## This program is free software; you can redistribute it and/or modify
## it under the terms of the GNU General Public License as published by
## the Free Software Foundation; version 2 of the License.
##
## This program is distributed in the hope that it will be useful,
## but WITHOUT ANY WARRANTY; without even the implied warranty of
## MERCHANTABILITY or FITNESS FOR A PARTICULAR PURPOSE.  See the
## GNU General Public License for more details.
##

config SOC_MARVELL_MVMAP2315
	bool
	default n
	select ARCH_BOOTBLOCK_ARMV7_R
	select ARCH_RAMSTAGE_ARMV8_64
	select ARCH_ROMSTAGE_ARMV8_64
	select ARCH_VERSTAGE_ARMV8_64
	select BOOTBLOCK_CONSOLE
	select COLLECT_TIMESTAMPS
	select DRIVERS_UART_8250MEM_32
	select HAVE_HARD_RESET
	select HAVE_MONOTONIC_TIMER
	select GENERIC_UDELAY
	select UNCOMPRESSED_RAMSTAGE
	select UART_OVERRIDE_REFCLK

if SOC_MARVELL_MVMAP2315

config VBOOT
	select VBOOT_STARTS_IN_ROMSTAGE

config CONSOLE_SERIAL_MVMAP2315_UART_ADDRESS
	hex
	depends on CONSOLE_SERIAL
	default 0xE1060000
	help
	  Map the UART to the respective MMIO address

config TTYS0_BAUD
	int
	depends on CONSOLE_SERIAL
	default 9600
	help
	  Baud rate for the UART
endif
```

## src/soc/mediatek/common/Kconfig
```kconfig
## SPDX-License-Identifier: GPL-2.0-only

config SOC_MEDIATEK_COMMON
	bool
	select NO_ECAM_MMCONF_SUPPORT if PCI
	help
	  common code blocks for Mediatek SOCs

if SOC_MEDIATEK_COMMON

config MEDIATEK_DRAM_ADAPTIVE
	bool
	default n if SOC_MEDIATEK_MT8173
	default n if SOC_MEDIATEK_MT8183
	default n if SOC_MEDIATEK_MT8192
	default y
	help
	  Starting from MT8195, MediaTek platform supports "dram adaptive" to
	  automatically detect dram information, including channel, rank, die
	  size..., and can automatically configure EMI settings. So we can just
	  pass a placeholder param blob to `mt_mem_init_run` by enabling this
	  option.
	  Platforms (MT8173, MT8183, MT8192) which do not support "dram adaptive"
	  need to implement `get_sdram_config` to get the DRAM configuration info.

config MEDIATEK_DRAM_DVFS
	bool
	default n
	help
	  This option enables DRAM calibration with multiple frequencies (low,
	  medium and high frequency groups, with total 7 frequencies) for DVFS
	  feature. All supported data rates are: 800, 1200, 1600, 1866, 2400,
	  3200, 4266.

config MEDIATEK_DRAM_DVFS_LIMIT_FREQ_CNT
	bool
	default y
	depends on MEDIATEK_DRAM_DVFS
	help
	  This options limit DRAM frequency calibration count from total 7 to 3,
	  other frequency will directly use the low frequency shu result.

config MEDIATEK_DRAM_BLOB_FAST_INIT
	bool "Enable running fast calibration by blob"
	default n
	help
	  This option allows performing fast calibration through different
	  open-source policy.

config MEDIATEK_DRAM_SCRAMBLE
	bool "Enable DRAM scramble feature"
	default n
	help
	  This option enables DRAM data scramble, which can prevent DRAM data from
	  being hacked.

config MEMORY_TEST
	bool
	default y
	help
	  This option enables memory basic compare test to verify the DRAM read
	  or write is as expected.

config DPM_FOUR_CHANNEL
	bool
	default n
	help
	  This option enables four channel configuration for DPM.

config DPM_BROADCAST
	bool
	default n
	help
	  This option enables the DPM Broadcast function, applicable only for dpm_v2.

config MTK_DFD
	bool "Enable MediaTek DFD (Design For Debug) settings"
	help
	  DFD (Design for Debug) is a debugging tool, which scans flip-flops
	  and dumps to internal RAM on the WDT reset. We reserve 1MB on DRAM
	  to store logs of DFD.

config USE_CBMEM_DRAM_INFO
	bool "Support filling dram information to cbmem"
	help
	  The DRAM initialization will keep and return DRAM information (size,
	  geometry and other DDR info) so we can fill that into the CBMEM.

config FLASH_DUAL_IO_READ
	bool
	default n
	help
	  When this option is enabled, the flash controller provides the ability
	  to dual IO read mode.

config PWRAP_WITH_PMIF_SPMI
	bool
	default n
	help
	  When this option is enabled, the PMIC interface only supports PWRAP
	  and PMIF_SPMI.

config PMIF_SPMI_IOCFG_DEFAULT_SETTING
	bool
	default n
	help
	  For SoCs where IO pins default to PMIF_SPMI mode, enable this option
	  to skip software PMIF_SPMI IO pins configuration.

config DEVAPC_DEBUG
	bool
	default n
	help
	  When this option is enabled, the DEVAPC driver prints the settings after
	  initialization.

config EARLY_MMU_INIT
	bool
	default n
	help
	  When this option is enabled, `mtk_mmu_init()` will be done in
	  `bootblock_soc_early_init()` to reduce the boot time.

endif
```

## src/soc/mediatek/mt8173/Kconfig
```kconfig
config SOC_MEDIATEK_MT8173
	bool
	default n
	select ARM64_A53_ERRATUM_843419
	select ARCH_BOOTBLOCK_ARMV8_64
	select ARCH_RAMSTAGE_ARMV8_64
	select ARCH_ROMSTAGE_ARMV8_64
	select ARCH_VERSTAGE_ARMV8_64
	select ARM64_USE_ARM_TRUSTED_FIRMWARE
	select HAVE_UART_SPECIAL
	select GENERIC_GPIO_LIB
	select RTC
	select SOC_MEDIATEK_COMMON

if SOC_MEDIATEK_MT8173

config MEMLAYOUT_LD_FILE
	string
	default "src/soc/mediatek/mt8173/memlayout.ld"

config VBOOT
	select VBOOT_MUST_REQUEST_DISPLAY
	select VBOOT_STARTS_IN_BOOTBLOCK
	select VBOOT_SEPARATE_VERSTAGE

config DEBUG_SOC_DRIVER
	bool "The top level switch for soc driver debug messages"
	default n
	select DEBUG_DRAM
	select DEBUG_I2C
	select DEBUG_PMIC
	select DEBUG_PMIC_WRAP

config DEBUG_DRAM
	bool "Output verbose DRAM related debug messages"
	default n
	help
	  This option enables additional DRAM related debug messages.

config DEBUG_I2C
	bool "Output verbose I2C related debug messages"
	default n
	help
	  This option enables I2C related debug messages.

config DEBUG_PMIC
	bool "Output verbose PMIC related debug messages"
	default n
	help
	  This option enables PMIC related debug messages.

config DEBUG_PMIC_WRAP
	bool "Output verbose PMIC WRAP related debug messages"
	default n
	help
	  This option enables PMIC WRAP related debug messages.
endif
```

## src/soc/mediatek/mt8183/Kconfig
```kconfig
config SOC_MEDIATEK_MT8183
	bool
	default n
	select ARCH_BOOTBLOCK_ARMV8_64
	select ARCH_RAMSTAGE_ARMV8_64
	select ARCH_ROMSTAGE_ARMV8_64
	select ARCH_VERSTAGE_ARMV8_64
	select ARM64_USE_ARM_TRUSTED_FIRMWARE
	select HAVE_UART_SPECIAL
	select COMPRESS_BOOTBLOCK
	select SOC_MEDIATEK_COMMON

if SOC_MEDIATEK_MT8183

config MEMLAYOUT_LD_FILE
	string
	default "src/soc/mediatek/mt8183/memlayout.ld"

config VBOOT
	select VBOOT_MUST_REQUEST_DISPLAY
	select VBOOT_STARTS_IN_BOOTBLOCK
	select VBOOT_SEPARATE_VERSTAGE
	select VBOOT_RETURN_FROM_VERSTAGE

config DEBUG_DRAM
	bool "Output verbose DRAM related debug messages"
	default n
	help
	  This option enables additional DRAM related debug messages.

config MT8183_DRAM_EMCP
	bool
	default n
	help
	  The eMCP platform should select this option to run at different DRAM
	  frequencies.

config MT8183_DRAM_DVFS
	bool
	default y
	help
	  This options enables DRAM calibration with multiple frequencies (low,
	  medium and high) for DVFS feature.

config SSPM_FIRMWARE
	string
	default "sspm.bin"
	help
	  The file name of the MediaTek SSPM firmware.


endif
```

## src/soc/mediatek/mt8186/Kconfig
```kconfig
config SOC_MEDIATEK_MT8186
	bool
	default n
	select ARCH_BOOTBLOCK_ARMV8_64
	select ARCH_VERSTAGE_ARMV8_64
	select ARCH_ROMSTAGE_ARMV8_64
	select ARCH_RAMSTAGE_ARMV8_64
	select ARM64_USE_ARM_TRUSTED_FIRMWARE
	select CACHE_MRC_SETTINGS
	select HAVE_UART_SPECIAL
	select SOC_MEDIATEK_COMMON
	select MEDIATEK_BLOB_FAST_INIT
	select USE_CBMEM_DRAM_INFO
	select FLASH_DUAL_IO_READ

if SOC_MEDIATEK_MT8186

config VBOOT
	select VBOOT_MUST_REQUEST_DISPLAY
	select VBOOT_STARTS_IN_BOOTBLOCK
	select VBOOT_SEPARATE_VERSTAGE
	select VBOOT_RETURN_FROM_VERSTAGE

config SPM_FIRMWARE
	string
	default "spm_firmware.bin"
	help
	  The file name of the MediaTek SPM firmware.

config SSPM_FIRMWARE
	string
	default "sspm.bin"
	help
	  The file name of the MediaTek SSPM firmware.

endif
```

## src/soc/mediatek/mt8188/Kconfig
```kconfig
config SOC_MEDIATEK_MT8188
	bool
	default n
	select ARCH_BOOTBLOCK_ARMV8_64
	select ARCH_VERSTAGE_ARMV8_64
	select ARCH_ROMSTAGE_ARMV8_64
	select ARCH_RAMSTAGE_ARMV8_64
	select ARM64_USE_ARM_TRUSTED_FIRMWARE
	select HAVE_UART_SPECIAL
	select SOC_MEDIATEK_COMMON
	select FLASH_DUAL_IO_READ
	select CACHE_MRC_SETTINGS
	select MEDIATEK_BLOB_FAST_INIT
	select USE_CBMEM_DRAM_INFO
	select DPM_FOUR_CHANNEL

if SOC_MEDIATEK_MT8188

config VBOOT
	select VBOOT_MUST_REQUEST_DISPLAY
	select VBOOT_STARTS_IN_BOOTBLOCK
	select VBOOT_SEPARATE_VERSTAGE
	select VBOOT_RETURN_FROM_VERSTAGE

config DPM_DM_FIRMWARE
	string
	default "dpm.dm"
	help
	  The file name of the MediaTek DPM DM firmware.

config DPM_PM_FIRMWARE
	string
	default "dpm.pm"
	help
	  The file name of the MediaTek DPM PM firmware.

config MCUPM_FIRMWARE
	string
	default "mcupm.bin"
	help
	  The file name of the MediaTek MCUPM firmware.

config SPM_FIRMWARE
	string
	default "spm_firmware.bin"
	help
	  The file name of the MediaTek SPM firmware.

config SSPM_FIRMWARE
	string
	default "sspm.bin"
	help
	  The file name of the MediaTek SSPM firmware.

endif
```

## src/soc/mediatek/mt8189/Kconfig
```kconfig
## SPDX-License-Identifier: GPL-2.0-only OR MIT

config SOC_MEDIATEK_MT8189
	bool
	default n
	select ARCH_BOOTBLOCK_ARMV8_64
	select ARCH_VERSTAGE_ARMV8_64
	select ARCH_ROMSTAGE_ARMV8_64
	select ARCH_RAMSTAGE_ARMV8_64
	select ARM64_USE_ARM_TRUSTED_FIRMWARE
	select HAVE_UART_SPECIAL
	select CACHE_MRC_SETTINGS
	select MEDIATEK_DRAM_BLOB_FAST_INIT
	select USE_CBMEM_DRAM_INFO
	select SOC_MEDIATEK_COMMON
	select FLASH_DUAL_IO_READ
	select ARM64_USE_ARCH_TIMER

if SOC_MEDIATEK_MT8189

config VBOOT
	select VBOOT_MUST_REQUEST_DISPLAY
	select VBOOT_STARTS_IN_BOOTBLOCK
	select VBOOT_SEPARATE_VERSTAGE
	select VBOOT_RETURN_FROM_VERSTAGE

config DPM_DM_FIRMWARE
	string
	default "dpm.dm"
	help
	  The file name of the MediaTek DPM DM firmware.

config DPM_PM_FIRMWARE
	string
	default "dpm.pm"
	help
	  The file name of the MediaTek DPM PM firmware.

config MCUPM_FIRMWARE
	string
	default "mcupm.bin"
	help
	  The file name of the MediaTek MCUPM firmware.

config SPM_FIRMWARE
	string
	default "spm_firmware.bin"
	help
	  The file name of the MediaTek SPM firmware.

config SSPM_FIRMWARE
	string
	default "sspm.bin"
	help
	  The file name of the MediaTek SSPM firmware.

endif
```

## src/soc/mediatek/mt8192/Kconfig
```kconfig
config SOC_MEDIATEK_MT8192
	bool
	default n
	select ARCH_BOOTBLOCK_ARMV8_64
	select ARCH_VERSTAGE_ARMV8_64
	select ARCH_ROMSTAGE_ARMV8_64
	select ARCH_RAMSTAGE_ARMV8_64
	select ARM64_USE_ARM_TRUSTED_FIRMWARE
	select CACHE_MRC_SETTINGS
	select HAVE_DEBUG_RAM_SETUP
	select HAVE_UART_SPECIAL
	select SOC_MEDIATEK_COMMON
	select MEDIATEK_DRAM_DVFS
	select FLASH_DUAL_IO_READ

if SOC_MEDIATEK_MT8192

config VBOOT
	select VBOOT_MUST_REQUEST_DISPLAY
	select VBOOT_STARTS_IN_BOOTBLOCK
	select VBOOT_SEPARATE_VERSTAGE
	select VBOOT_RETURN_FROM_VERSTAGE

config DPM_DM_FIRMWARE
	string
	default "dpm.dm"
	help
	  The file name of the MediaTek DPM DM firmware

config DPM_PM_FIRMWARE
	string
	default "dpm.pm"
	help
	  The file name of the MediaTek DPM PM firmware

config MCUPM_FIRMWARE
	string
	default "mcupm.bin"
	help
	  The file name of the MediaTek MCUPM firmware.

config SPM_FIRMWARE
	string
	default "spm_firmware.bin"
	help
	  The file name of the MediaTek SPM firmware.

config SSPM_FIRMWARE
	string
	default "sspm.bin"
	help
	  The file name of the MediaTek SSPM firmware.

config SRCLKEN_RC_SUPPORT
	bool
	default y
	help
	  This option enables clock buffer remote controller module
	  to control PMIC 26MHz clock output.

endif
```

## src/soc/mediatek/mt8196/Kconfig
```kconfig
## SPDX-License-Identifier: GPL-2.0-only

config SOC_MEDIATEK_MT8196
	bool
	default n
	select ARCH_BOOTBLOCK_ARMV8_64
	select ARCH_VERSTAGE_ARMV8_64
	select ARCH_ROMSTAGE_ARMV8_64
	select ARCH_RAMSTAGE_ARMV8_64
	select ARM64_USE_ARM_TRUSTED_FIRMWARE
	select HAVE_UART_SPECIAL
	select CACHE_MRC_SETTINGS
	select MEDIATEK_DRAM_BLOB_FAST_INIT
	select USE_CBMEM_DRAM_INFO
	select SOC_MEDIATEK_COMMON
	select DPM_BROADCAST
	select FLASH_DUAL_IO_READ
	select ARM64_USE_ARCH_TIMER
	select PCI
	select EARLY_MMU_INIT

if SOC_MEDIATEK_MT8196

config VBOOT
	select VBOOT_MUST_REQUEST_DISPLAY
	select VBOOT_STARTS_IN_BOOTBLOCK
	select VBOOT_SEPARATE_VERSTAGE
	select VBOOT_RETURN_FROM_VERSTAGE
	select VBOOT_DEFINE_WIDEVINE_COUNTERS

config DPM_DM_FIRMWARE
	string
	default "dpm.dm"
	help
	  The file name of the MediaTek DPM DM firmware.

config DPM_PM_FIRMWARE
	string
	default "dpm.pm"
	help
	  The file name of the MediaTek DPM PM firmware.

config PI_IMG_FIRMWARE
	string
	default "pi_img.img"
	help
	  The file name of the MediaTek PI_IMG firmware. The main purpose of the pi_img is to
	  pass various frequency and voltage scaling parameters and settings to MCUPM.

config SSPM_FIRMWARE
	string
	default "sspm.bin"
	help
	  The file name of the MediaTek SSPM firmware.

config SPM_FIRMWARE
	string
	default "spm_firmware.bin"
	help
	  The file name of the MediaTek SPM firmware.

config GPUEB_FIRMWARE
	string
	default "gpueb_fw.img"
	help
	  The file name of the MediaTek GPUEB firmware.

config MCUPM_FIRMWARE
	string
	default "mcupm.bin"
	help
	  The file name of the MediaTek MCUPM firmware.

endif
```

## src/soc/nvidia/tegra124/Kconfig
```kconfig
## SPDX-License-Identifier: GPL-2.0-only

config SOC_NVIDIA_TEGRA124
	bool
	default n
	select ARCH_BOOTBLOCK_ARMV4
	select BOOTBLOCK_CUSTOM
	select ARCH_VERSTAGE_ARMV7
	select ARCH_ROMSTAGE_ARMV7
	select ARCH_RAMSTAGE_ARMV7
	select HAVE_UART_SPECIAL
	select ARM_LPAE
	select GENERIC_GPIO_LIB
	select MAINBOARD_HAS_NATIVE_VGA_INIT
	select MAINBOARD_FORCE_NATIVE_VGA_INIT
	select HAVE_LINEAR_FRAMEBUFFER
	# clang creates larger binaries that may not fit
	select CLANG_UNSUPPORTED if CHROMEOS

if SOC_NVIDIA_TEGRA124

config MEMLAYOUT_LD_FILE
	string
	default "src/soc/nvidia/tegra124/memlayout.ld"

config VBOOT
	select VBOOT_MUST_REQUEST_DISPLAY
	select VBOOT_STARTS_IN_BOOTBLOCK
	select VBOOT_SEPARATE_VERSTAGE

config TEGRA124_MODEL_TD570D
	bool "TD570D"

config TEGRA124_MODEL_TD580D
	bool "TD580D"

config TEGRA124_MODEL_CD570M
	bool "CD570M"

config TEGRA124_MODEL_CD580M
	bool "CD580M"

# Default to 2GHz, the lowest maximum frequency.
config PLLX_KHZ
	int
	default 2000000 if TEGRA124_MODEL_TD570D
	default 2300000 if TEGRA124_MODEL_TD580D
	default 2100000 if TEGRA124_MODEL_CD570M
	default 2300000 if TEGRA124_MODEL_CD580M
	default 2000000

endif
```
