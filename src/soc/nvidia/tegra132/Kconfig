## src/soc/nvidia/tegra132/Kconfig
```kconfig
config SOC_NVIDIA_TEGRA132
	bool
	default n
	select ARCH_BOOTBLOCK_ARMV4
	select BOOTBLOCK_CUSTOM
	select ARCH_VERSTAGE_ARMV4
	select ARCH_ROMSTAGE_ARMV4
	select ARCH_RAMSTAGE_ARMV8_64
	select BOOTBLOCK_CONSOLE
	select GIC
	select HAVE_MONOTONIC_TIMER
	select GENERIC_UDELAY
	select HAVE_HARD_RESET
	select HAVE_UART_SPECIAL
	select GENERIC_GPIO_LIB
	select HAS_PRECBMEM_TIMESTAMP_REGION

if SOC_NVIDIA_TEGRA132

config MAINBOARD_DO_DSI_INIT
	bool "Use dsi graphics interface"
	depends on MAINBOARD_DO_NATIVE_VGA_INIT
	default n
	help
	  Initialize dsi display

config MAINBOARD_DO_SOR_INIT
	bool "Use dp graphics interface"
	depends on MAINBOARD_DO_NATIVE_VGA_INIT
	default n
	help
	  Initialize dp display

config MTS_DIRECTORY
	string "Directory where MTS microcode files are located"
	default "3rdparty/blobs/cpu/nvidia/tegra132/current/prod"
	help
	  Path to directory where MTS microcode files are located.

config TRUSTZONE_CARVEOUT_SIZE_MB
	hex "Size of Trust Zone region"
	default 0x4
	help
	  Size of Trust Zone area in MiB to reserve in memory map.

config BOOTROM_SDRAM_INIT
	bool "SoC BootROM does SDRAM init with full BCT"
	default n
	help
	  Use during Ryu LPDDR3 bringup

# Default to 700MHz. This value is based on nv bootloader setting.
config PLLX_KHZ
	int
	default 700000
endif
```

## src/soc/nvidia/tegra210/Kconfig
```kconfig
config SOC_NVIDIA_TEGRA210
	bool
	default n
	select ARCH_BOOTBLOCK_ARMV4
	select BOOTBLOCK_CUSTOM
	select ARCH_VERSTAGE_ARMV4
	select ARCH_ROMSTAGE_ARMV4
	select ARCH_RAMSTAGE_ARMV8_64
	select HAVE_UART_SPECIAL
	select ARM64_USE_ARM_TRUSTED_FIRMWARE
	select GENERIC_GPIO_LIB

if SOC_NVIDIA_TEGRA210

config MEMLAYOUT_LD_FILE
	string
	default "src/soc/nvidia/tegra210/memlayout.ld"

config VBOOT
	select VBOOT_STARTS_IN_BOOTBLOCK
	select VBOOT_SEPARATE_VERSTAGE
	select VBOOT_RETURN_FROM_VERSTAGE
	select VBOOT_MUST_REQUEST_DISPLAY

config MAINBOARD_DO_DSI_INIT
	bool "Use dsi graphics interface"
	depends on MAINBOARD_DO_NATIVE_VGA_INIT
	default n
	select HAVE_LINEAR_FRAMEBUFFER
	help
	  Initialize dsi display

config MAINBOARD_DO_SOR_INIT
	bool "Use dp graphics interface"
	depends on MAINBOARD_DO_NATIVE_VGA_INIT
	default n
	select HAVE_LINEAR_FRAMEBUFFER
	help
	  Initialize dp display

choice
	prompt "Serial Console UART"
	default CONSOLE_SERIAL_TEGRA210_UARTA
	depends on CONSOLE_SERIAL

config CONSOLE_SERIAL_TEGRA210_UARTA
	bool "UARTA"
	help
	  Serial console on UART A.

config CONSOLE_SERIAL_TEGRA210_UARTB
	bool "UARTB"
	help
	  Serial console on UART B.

config CONSOLE_SERIAL_TEGRA210_UARTC
	bool "UARTC"
	help
	  Serial console on UART C.

config CONSOLE_SERIAL_TEGRA210_UARTD
	bool "UARTD"
	help
	  Serial console on UART D.

config CONSOLE_SERIAL_TEGRA210_UARTE
	bool "UARTE"
	help
	  Serial console on UART E.

endchoice

config CONSOLE_SERIAL_TEGRA210_UART_ADDRESS
	hex
	depends on CONSOLE_SERIAL
	default 0x70006000 if CONSOLE_SERIAL_TEGRA210_UARTA
	default 0x70006040 if CONSOLE_SERIAL_TEGRA210_UARTB
	default 0x70006200 if CONSOLE_SERIAL_TEGRA210_UARTC
	default 0x70006300 if CONSOLE_SERIAL_TEGRA210_UARTD
	default 0x70006400 if CONSOLE_SERIAL_TEGRA210_UARTE
	help
	  Map the UART names to the respective MMIO addresses.

config BOOTROM_SDRAM_INIT
	bool "SoC BootROM does SDRAM init with full BCT"
	default n
	help
	  Use during Foster LPDDR4 bringup.

config TRUSTZONE_CARVEOUT_SIZE_MB
	hex "Size of Trust Zone region"
	default 0x14
	help
	  Size of Trust Zone area in MiB to reserve in memory map.

config TTB_SIZE_MB
	hex "Size of TTB"
	default 0x4
	help
	  Maximum size of Translation Table Buffer in MiB.

config SEC_COMPONENT_SIZE_MB
	hex "Size of resident EL3 components"
	default 0x10
	help
	  Maximum size of resident EL3 components in MiB including BL31 and
	  Secure OS.

# Default to 700MHz. This value is based on nv bootloader setting.
config PLLX_KHZ
	int
	default 700000

config HAVE_MTC
	bool "Add external Memory controller Training Code binary"
	default n
	depends on USE_BLOBS
	help
	  Select this option to add emc training firmware

if HAVE_MTC

config MTC_FILE
	string "tegra mtc firmware filename"
	default "tegra_mtc.bin"
	help
	  The filename of the mtc firmware

config MTC_DIRECTORY
	string "Directory where MTC firmware file is located"
	default "."
	help
	  Path to directory where MTC firmware file is located.

config MTC_ADDRESS
	hex
	default 0x81000000
	help
	  The DRAM location where MTC firmware to be loaded in. This location
	  needs to be consistent with the location defined in tegra_mtc.ld

endif # HAVE_MTC

endif # SOC_NVIDIA_TEGRA210
```

## src/soc/qualcomm/calypso/Kconfig
```kconfig
## SPDX-License-Identifier: GPL-2.0-only

config SOC_QUALCOMM_CALYPSO_BASE
	bool
	default n
	select ARCH_BOOTBLOCK_ARMV8_64
	select ARCH_RAMSTAGE_ARMV8_64
	select ARCH_ROMSTAGE_ARMV8_64
	select ARCH_VERSTAGE_ARMV8_64
	select ARM64_USE_ARCH_TIMER
	select ARM64_USE_ARM_TRUSTED_FIRMWARE
	select CACHE_MRC_SETTINGS
	select CBFS_PRELOAD
	select COOP_MULTITASKING
	select COMMONLIB_STORAGE
	select COMMONLIB_STORAGE_SD
	select COMPRESS_BOOTBLOCK
	select FIXED_UART_FOR_CONSOLE
	select GENERIC_GPIO_LIB
	select GENERIC_UDELAY
	select HAS_RECOVERY_MRC_CACHE
	select HAVE_LINEAR_FRAMEBUFFER
	select HAVE_MONOTONIC_TIMER
	select HAVE_UART_SPECIAL
	select MAINBOARD_FORCE_NATIVE_VGA_INIT
	select MAINBOARD_HAS_NATIVE_VGA_INIT
	select NO_ECAM_MMCONF_SUPPORT
	select PCI
	select QC_SANITIZE_MEMCHIP_INFO
	select SOC_QUALCOMM_COMMON
	select SOC_QUALCOMM_QCLIB_SKIP_MMU_TOGGLE

config SOC_QUALCOMM_CALYPSO
	bool
	select SOC_QUALCOMM_CALYPSO_BASE
	select ARM64_USE_SECURE_OS
	select ARM64_USE_SECURE_OS_PAYLOAD
	select QMP_PHY_PCIE5_1X4
	default n
	help
	  Choose this option if the mainboard is built using Calypso system-on-a-chip SoC.

if SOC_QUALCOMM_CALYPSO_BASE

config QC_BLOBS_UPSTREAM
	bool "QC blobs are available in upstream repository"
	select USE_QC_BLOBS
	default n
	help
	  Select based on availability of QC blobs in upstream coreboot `3rdparty/qc_blobs`.

config MEMLAYOUT_LD_FILE
	string
	default "src/soc/qualcomm/calypso/memlayout.ld"

config VBOOT
	select VBOOT_MUST_REQUEST_DISPLAY
	select VBOOT_RETURN_FROM_VERSTAGE
	select VBOOT_SEPARATE_VERSTAGE
	select VBOOT_STARTS_IN_BOOTBLOCK

config BOOT_DEVICE_SPI_FLASH_BUS
	int
	default 26

config UART_FOR_CONSOLE
	int
	default 21 # QUP2_SE5
	help
	 Select the QUP instance to be used for UART console output.

config UART_BITBANG_TX_DELAY_MS
	int
	default 1

config SPI_FREQ_25MHZ
	def_bool n

config SPI_FREQ_50MHZ
	def_bool n

config SPI_FREQ_75MHZ
	def_bool n

config SPI_FREQ_100MHZ
	def_bool n

config SOC_SPI_FREQ_MHZ
	int
	default 25 if SPI_FREQ_25MHZ
	default 50 if SPI_FREQ_50MHZ
	default 75 if SPI_FREQ_75MHZ
	default 100 if SPI_FREQ_100MHZ
	default 50
	help
	  Supported SPI Frequency for Hamoa/X1P42100 Platforms

endif
```

## src/soc/qualcomm/common/Kconfig
```kconfig
## SPDX-License-Identifier: GPL-2.0-only

config SOC_QUALCOMM_COMMON
	bool
	default n
	help
	  Selected by platforms that use the common code.

config QC_COMMON_QUPV3_2
	bool
	default n
	help
	  Selected by chipsets that has QUPv3 HW Version 2.

config QMP_PHY_2X2_1X4
	bool
	default n
	help
	  Selected by chipsets that have PCIE QMP PHY 2X2/1X4

config QMP_PHY_PCIE5_1X4
	bool
	default n
	help
	  Selected by chipsets that have the PCIe5 5x4 QMP PHY.
	  This PHY uses a unified TXRXZ broadcast register (all 4 lanes),
	  PCS_LANEZ broadcast, and has different PCS_COM control register
	  offsets.

if SOC_QUALCOMM_COMMON

config QC_SDI_ENABLE
	bool
	default n
	prompt "Debug Build: enable SDI"

config QC_APDP_ENABLE
	bool
	default n
	prompt "Debug Build: enable APDP"
	help
	  Application Processor Debug Policy (APDP) is a configuration image
	  to define and enforce debugging capabilities and restrictions for APPS.

config QC_RAMDUMP_ENABLE
	bool
	default n
	prompt "Debug Build: enable Ramdump"
	help
	  Ramdump is a debug image that is loaded during a system crash to capture
	  memory contents for post-crash analysis.

config QC_SKIP_SOC_DEBUG_FEATURES_IN_RECOVERY
	bool
	default n
	help
	  Skip Qualcomm SoC debug features in the recovery mode.

	  Select this option if the platform's recovery partition is not
	  sufficient to store binaries required to support Qualcomm SoC
	  debug features such as ramdump.

config SOC_QUALCOMM_CDT
	bool
	default n
	help
	  When enabled, the CDT data from RW_CDT partition is passed to QcLib,
	  which populates the platform information in SMEM. This information is
	  later used by depthcharge to select the platform-specific DTBO.

config SOC_QUALCOMM_QCLIB_SKIP_MMU_TOGGLE
	bool
	default n
	help
	  Avoid disabling and re-enabling the MMU during QCLib execution.

	  Select this option if the platform's QCLib version supports running
	  within the existing coreboot MMU configuration without modification.

	  Enabling this reduces boot latency by eliminating redundant cache
	  flushes and TLB invalidations associated with mmu_disable() and
	  mmu_enable() calls.

config SOC_QUALCOMM_DEBUG_TSENS
	bool
	default n
	help
	  When enabled, a call to monitor TSENS will dump the sensor data on
	  the debug console.

config SOC_QUALCOMM_PCIE_ASYNCHRONOUS_INIT
	bool
	default n
	help
	  When enabled, qcom_setup_pcie_host will initiate the PCIe
	  hardware power-up sequence but will not block the boot flow
	  to wait for the link-up status. This can reduce overall
	  boot time, but requires late-stage drivers to verify link
	  readiness before access.

config QC_DUMP_MEMCHIP_INFO
	bool
	default n
	help
	  When enabled, coreboot will print detailed memory chip attributes
	  to the console during the boot process. This includes
	  Manufacturer IDs, Revision IDs, and Serial IDs for each rank.

	  Note: Enabling this feature increases the size of the romstage
	  binary. If your platform is near its ROM size limit, this may
	  cause a build failure. Only enable this for memory bring-up or
	  debugging.

config QC_SANITIZE_MEMCHIP_INFO
	bool
	default n
	help
	  Enable this option to filter out MEM_CHIP_UNDEFINED entries from the
	  memory chip information table provided by the Qualcomm library (QCLib).

	  When enabled, the table is collapsed in-place to remove empty slots,
	  ensuring that logs and downstream data consumers only see valid
	  memory hardware information.

	  If unsure, say N.

config QC_QDUTT_ENABLE
	bool
	default n
	prompt "Enable QDUTT for DRAM Eye Diagram Testing"
	help
	  QDUTT provides specialized utilities for DDR PHY training and
	  margin analysis.

	  Enable this option to allow the collection of DRAM eye diagram
	  data during the bootloader training phase. This is essential for
	  validating signal integrity and optimizing DRAM performance
	  on new hardware iterations.

config QC_SPI_DRIVE_STRENGTH_MA
	int
	default 3
	help
	  Sets the drive strength for the QSPI GPIO lines (CLK, DATA_0, DATA_1).
	  Lower frequencies default to 8mA (GPIO_8MA aka 3).
	  Allow SoC/mainboard to override the SPI drive strength as applicable.
	  Refer to `GPIO TLMM: Drive Strength` enum inside gpio_common.h

endif
```

## src/soc/qualcomm/ipq40xx/Kconfig
```kconfig
## SPDX-License-Identifier: GPL-2.0-only

config SOC_QC_IPQ40XX
	bool
	default n
	select ARCH_BOOTBLOCK_ARMV7
	select ARCH_VERSTAGE_ARMV7
	select ARCH_ROMSTAGE_ARMV7
	select ARCH_RAMSTAGE_ARMV7
	select HAVE_UART_SPECIAL
	select GENERIC_GPIO_LIB
# clang creates larger binaries that may not fit
	select CLANG_UNSUPPORTED if CHROMEOS

if SOC_QC_IPQ40XX

config MEMLAYOUT_LD_FILE
	string
	default "src/soc/qualcomm/ipq40xx/memlayout.ld"

config GENERIC_UDELAY
	def_bool n

config VBOOT
	select VBOOT_STARTS_IN_BOOTBLOCK
	select VBOOT_SEPARATE_VERSTAGE
	select VBOOT_RETURN_FROM_VERSTAGE
	select VBOOT_VBNV_FLASH

config IPQ_QFN_PART
	bool
	default n
	help
	  Is the SoC a QFN part (as opposed to a BGA part)

config CDT_MBN
	string "CDT binary blob"
	default "cdt-AP.DK01.1-C1.bin"

config DDR_MBN
	string "DDR driver binary blob"
	default "ddr.mbn"

config TZ_MBN
	string "TZ binary blob"
	default "tzbsp_no_xpu.mbn"

config SBL_ELF
	depends on USE_BLOBS
	string "file name of the QCA SBL ELF"
	default "3rdparty/blobs/cpu/qualcomm/ipq40xx/sbl.elf"
	help
	  The path and filename of the binary blob containing
	  ipq40xx early initialization code, as supplied by the
	  vendor.

config SBL_UTIL_PATH
	depends on USE_BLOBS
	string "Path for utils to combine SBL_ELF and bootblock"
	default "util/qualcomm"
	help
	  Path for utils to combine SBL_ELF and bootblock

endif
```

## src/soc/qualcomm/ipq806x/Kconfig
```kconfig
## SPDX-License-Identifier: GPL-2.0-only

config SOC_QC_IPQ806X
	bool
	default n
	select ARCH_BOOTBLOCK_ARMV7
	select ARCH_VERSTAGE_ARMV7
	select ARCH_ROMSTAGE_ARMV7
	select ARCH_RAMSTAGE_ARMV7
	select HAVE_UART_SPECIAL
	select GENERIC_GPIO_LIB
	select NO_MONOTONIC_TIMER
# clang creates larger binaries that may not fit
	select CLANG_UNSUPPORTED if CHROMEOS

if SOC_QC_IPQ806X

config MEMLAYOUT_LD_FILE
	string
	default "src/soc/qualcomm/ipq806x/memlayout.ld"

config VBOOT
	select VBOOT_STARTS_IN_BOOTBLOCK
	select VBOOT_VBNV_FLASH
	select VBOOT_SEPARATE_VERSTAGE
	select VBOOT_RETURN_FROM_VERSTAGE

config SBL_BLOB
	depends on USE_BLOBS
	string "file name of the Qualcomm SBL blob"
	default "3rdparty/blobs/cpu/qualcomm/ipq806x/uber-sbl.mbn"
	help
	  The path and filename of the binary blob containing
	  ipq806x early initialization code, as supplied by the
	  vendor.

endif
```

## src/soc/qualcomm/sc7280/Kconfig
```kconfig
config SOC_QUALCOMM_SC7280
	bool
	default n
	depends on USE_QC_BLOBS
	select ARCH_BOOTBLOCK_ARMV8_64
	select ARCH_RAMSTAGE_ARMV8_64
	select ARCH_ROMSTAGE_ARMV8_64
	select ARCH_VERSTAGE_ARMV8_64
	select ARM64_USE_ARM_TRUSTED_FIRMWARE
	select GENERIC_GPIO_LIB
	select GENERIC_UDELAY
	select HAVE_MONOTONIC_TIMER
	select ARM64_USE_ARCH_TIMER
	select SOC_QUALCOMM_COMMON
	select CACHE_MRC_SETTINGS
	select HAS_RECOVERY_MRC_CACHE
	select MAINBOARD_HAS_NATIVE_VGA_INIT
	select MAINBOARD_FORCE_NATIVE_VGA_INIT
	select HAVE_LINEAR_FRAMEBUFFER
	select COMPRESS_BOOTBLOCK
	select HAVE_UART_SPECIAL
	select PCI
	select NO_ECAM_MMCONF_SUPPORT

if SOC_QUALCOMM_SC7280

config MEMLAYOUT_LD_FILE
	string
	default "src/soc/qualcomm/sc7280/memlayout.ld"

config VBOOT
	select VBOOT_SEPARATE_VERSTAGE
	select VBOOT_RETURN_FROM_VERSTAGE
	select VBOOT_MUST_REQUEST_DISPLAY
	select VBOOT_STARTS_IN_BOOTBLOCK

config SC7280_QSPI
	bool
	default y if COMMON_CBFS_SPI_WRAPPER
	prompt "Build Flash Using SPI-NOR"

config BOOT_DEVICE_SPI_FLASH_BUS
	int
	default 16

config UART_FOR_CONSOLE
	int
	default 5
	help
	 Select the QUP instance to be used for UART console output.

endif
```

## src/soc/qualcomm/sdm845/Kconfig
```kconfig
config SOC_QUALCOMM_SDM845
	bool
	default n
	select ARCH_BOOTBLOCK_ARMV8_64
	select ARCH_RAMSTAGE_ARMV8_64
	select ARCH_ROMSTAGE_ARMV8_64
	select ARCH_VERSTAGE_ARMV8_64
	select BOOTBLOCK_CONSOLE
	select GENERIC_GPIO_LIB
	select GENERIC_UDELAY
	select HAVE_MONOTONIC_TIMER
	select ARM64_USE_ARCH_TIMER

if SOC_QUALCOMM_SDM845

config VBOOT
	select VBOOT_SEPARATE_VERSTAGE
	select VBOOT_RETURN_FROM_VERSTAGE
	select VBOOT_OPROM_MATTERS
	select VBOOT_STARTS_IN_BOOTBLOCK
endif
```
