## src/soc/qualcomm/x1p42100/Kconfig
```kconfig
## SPDX-License-Identifier: GPL-2.0-only

config SOC_QUALCOMM_X1P42100
	bool
	default n
	select ARCH_BOOTBLOCK_ARMV8_64
	select ARCH_RAMSTAGE_ARMV8_64
	select ARCH_ROMSTAGE_ARMV8_64
	select ARCH_VERSTAGE_ARMV8_64
	select ARM64_USE_ARCH_TIMER
	select ARM64_USE_ARM_TRUSTED_FIRMWARE
	select CACHE_MRC_SETTINGS
	select COMMONLIB_STORAGE
	select COMMONLIB_STORAGE_SD
	select FIXED_UART_FOR_CONSOLE
	select GENERIC_GPIO_LIB
	select GENERIC_UDELAY
	select HAS_RECOVERY_MRC_CACHE
	select HAVE_LINEAR_FRAMEBUFFER
	select HAVE_MONOTONIC_TIMER
	select HAVE_UART_SPECIAL
	select MAINBOARD_FORCE_NATIVE_VGA_INIT
	select MAINBOARD_HAS_NATIVE_VGA_INIT
	select PCI
	select QC_COMMON_QUPV3_2
	select QMP_PHY_2X2_1X4
	select NO_ECAM_MMCONF_SUPPORT
	select SDHCI_CONTROLLER
	select SOC_QUALCOMM_COMMON

if SOC_QUALCOMM_X1P42100

config QC_BLOBS_UPSTREAM
	bool "QC blobs are available in upstream repository"
	select USE_QC_BLOBS
	default n
	help
	  Select based on availability of QC blobs in upstream coreboot `3rdparty/qc_blobs`.

config MEMLAYOUT_LD_FILE
	string
	default "src/soc/qualcomm/x1p42100/memlayout.ld"

config VBOOT
	select VBOOT_MUST_REQUEST_DISPLAY
	select VBOOT_RETURN_FROM_VERSTAGE
	select VBOOT_SEPARATE_VERSTAGE
	select VBOOT_STARTS_IN_BOOTBLOCK

config BOOT_DEVICE_SPI_FLASH_BUS
	int
	default 24

config UART_FOR_CONSOLE
	int
	default 21
	help
	 Select the QUP instance to be used for UART console output.

endif
```

## src/soc/rdc/r8610/Kconfig
```kconfig
##
## This file is part of the coreboot project.
##
## Copyright (C) 2008-2009 coresystems GmbH
##
## This program is free software; you can redistribute it and/or modify
## it under the terms of the GNU General Public License as published by
## the Free Software Foundation; version 2 of the License.
##
## This program is distributed in the hope that it will be useful,
## but WITHOUT ANY WARRANTY; without even the implied warranty of
## MERCHANTABILITY or FITNESS FOR A PARTICULAR PURPOSE.  See the
## GNU General Public License for more details.
##

config SOC_RDC_R8610
	bool
	select ARCH_BOOTBLOCK_X86_32
	select ARCH_VERSTAGE_X86_32
	select ARCH_ROMSTAGE_X86_32
	select ARCH_RAMSTAGE_X86_32
	select ROMCC
	select LATE_CBMEM_INIT

config BOOTBLOCK_SOUTHBRIDGE_INIT
	string
	default "soc/rdc/r8610/bootblock.c"
	depends on SOC_RDC_R8610
```

## src/soc/rockchip/rk3288/Kconfig
```kconfig
# SPDX-License-Identifier: GPL-2.0-only

config SOC_ROCKCHIP_RK3288
	bool
	default n
	select ARCH_BOOTBLOCK_ARMV7
	select ARCH_VERSTAGE_ARMV7
	select ARCH_ROMSTAGE_ARMV7
	select ARCH_RAMSTAGE_ARMV7
	select DRIVERS_UART_8250MEM_32
	select UNCOMPRESSED_RAMSTAGE
	select GENERIC_GPIO_LIB
	select RTC
	select UART_OVERRIDE_REFCLK
	select MAINBOARD_HAS_NATIVE_VGA_INIT
	select MAINBOARD_FORCE_NATIVE_VGA_INIT
	select HAVE_LINEAR_FRAMEBUFFER
	select NO_BOOTBLOCK_CONSOLE
	select NO_FMAP_CACHE
	select NO_CBFS_MCACHE

if SOC_ROCKCHIP_RK3288

config MEMLAYOUT_LD_FILE
	string
	default "src/soc/rockchip/rk3288/memlayout.ld"

config VBOOT
	select VBOOT_MUST_REQUEST_DISPLAY
	select VBOOT_STARTS_IN_BOOTBLOCK
	select VBOOT_SEPARATE_VERSTAGE
	select VBOOT_RETURN_FROM_VERSTAGE

config PMIC_BUS
	int
	default -1

endif
```

## src/soc/rockchip/rk3399/Kconfig
```kconfig
config SOC_ROCKCHIP_RK3399
	bool
	default n
	select ARCH_BOOTBLOCK_ARMV8_64
	select ARCH_RAMSTAGE_ARMV8_64
	select ARCH_ROMSTAGE_ARMV8_64
	select ARCH_VERSTAGE_ARMV8_64
	select ARM64_USE_ARM_TRUSTED_FIRMWARE
	select DRIVERS_UART_8250MEM_32
	select GENERIC_GPIO_LIB
	select UART_OVERRIDE_REFCLK
	select HAVE_LINEAR_FRAMEBUFFER if MAINBOARD_DO_NATIVE_VGA_INIT
	select COMPRESS_BOOTBLOCK

if SOC_ROCKCHIP_RK3399

config MEMLAYOUT_LD_FILE
	string
	default "src/soc/rockchip/rk3399/memlayout.ld"

config VBOOT
	select VBOOT_SEPARATE_VERSTAGE
	select VBOOT_RETURN_FROM_VERSTAGE
	select VBOOT_MUST_REQUEST_DISPLAY
	select VBOOT_STARTS_IN_BOOTBLOCK

config PMIC_BUS
	int
	default -1

config RK3399_SPREAD_SPECTRUM_DDR
	bool "Spread-spectrum DDR clock"
	default n
	help
	  Select Spread Spectrum Modulator (SSMOD) is a fully-digital circuit
	  used to modulate the frequency of the Silicon Creations' Fractional
	  PLL in order to reduce EMI.

endif
```

## src/soc/samsung/exynos5250/Kconfig
```kconfig
config CPU_SAMSUNG_EXYNOS5250
	select ARCH_BOOTBLOCK_ARMV7
	select ARCH_VERSTAGE_ARMV7
	select ARCH_ROMSTAGE_ARMV7
	select ARCH_RAMSTAGE_ARMV7
	select HAVE_UART_SPECIAL
	bool
	default n

if CPU_SAMSUNG_EXYNOS5250

config MEMLAYOUT_LD_FILE
	string
	default "src/soc/samsung/exynos5250/memlayout.ld"

config VBOOT
	select VBOOT_STARTS_IN_ROMSTAGE

endif
```

## src/soc/samsung/exynos5420/Kconfig
```kconfig
config CPU_SAMSUNG_EXYNOS5420
	select ARCH_BOOTBLOCK_ARMV7
	select ARCH_VERSTAGE_ARMV7
	select ARCH_ROMSTAGE_ARMV7
	select ARCH_RAMSTAGE_ARMV7
	select HAVE_UART_SPECIAL
	select RELOCATABLE_MODULES
	select NO_BOOTBLOCK_CONSOLE
	bool
	default n

if CPU_SAMSUNG_EXYNOS5420

config MEMLAYOUT_LD_FILE
	string
	default "src/soc/samsung/exynos5420/memlayout.ld"

config VBOOT
	select VBOOT_STARTS_IN_ROMSTAGE

endif
```

## src/soc/sifive/fu540/Kconfig
```kconfig
# SPDX-License-Identifier: GPL-2.0-only

config SOC_SIFIVE_FU540
	bool
	select ARCH_RISCV_RV64
	select ARCH_RISCV_S
	select ARCH_RISCV_U
	select ARCH_RISCV_PMP
	select ARCH_BOOTBLOCK_RISCV
	select ARCH_VERSTAGE_RISCV
	select ARCH_ROMSTAGE_RISCV
	select ARCH_RAMSTAGE_RISCV
	select DRIVERS_UART_SIFIVE
	select RISCV_USE_ARCH_TIMER
	select UART_OVERRIDE_REFCLK
	select RISCV_HAS_OPENSBI

if SOC_SIFIVE_FU540

config MEMLAYOUT_LD_FILE
	string
	default "src/soc/sifive/fu540/memlayout.ld"

config RISCV_ARCH
	string
	default "rv64imac"

config RISCV_ABI
	string
	default "lp64"

config RISCV_CODEMODEL
	string
	default "medany"

config MAX_CPUS
	int
	default 5

config RISCV_WORKING_HARTID
	int
	default 0

config OPENSBI_PLATFORM
	string
	default "sifive/fu540"

config OPENSBI_TEXT_START
	hex
	default 0x80000000
endif
```

## src/soc/sifive/fu740/Kconfig
```kconfig
# SPDX-License-Identifier: GPL-2.0-only

config SOC_SIFIVE_FU740
	bool
	select ARCH_RISCV_RV64
	select ARCH_RISCV_S
	select ARCH_RISCV_U
	select ARCH_RISCV_PMP
	select ARCH_BOOTBLOCK_RISCV
	select ARCH_VERSTAGE_RISCV
	select ARCH_ROMSTAGE_RISCV
	select ARCH_RAMSTAGE_RISCV
	select DRIVERS_UART_SIFIVE
	select RISCV_USE_ARCH_TIMER
	select UART_OVERRIDE_REFCLK
	select RISCV_HAS_OPENSBI

config SEPARATE_ROMSTAGE
	default n if SOC_SIFIVE_FU740

if SOC_SIFIVE_FU740

config MEMLAYOUT_LD_FILE
	string
	default "src/soc/sifive/fu740/memlayout.ld"

config RISCV_ARCH
	string
	default "rv64imac"

config RISCV_ABI
	string
	default "lp64"

config RISCV_CODEMODEL
	string
	default "medany"

# 4x U7 cores (RV64IMAFDC) + 1x S7 core (RV64IMAC)
config MAX_CPUS
	int
	default 5

config RISCV_WORKING_HARTID
	int
	default 1 # use U7 core as S7 core does not support supervisor mode

config OPENSBI_PLATFORM
	string
	default "generic"

config OPENSBI_TEXT_START
	hex
	default 0x80000000

config OPENSBI_FW_DYNAMIC_BOOT_HART
	int
	default 1
	help
	  Choose the first U74 core as boot hart since
	  hart 0 is the S7 which does not support Supervisor mode

endif
```

## src/soc/ucb/riscv/Kconfig
```kconfig
## SPDX-License-Identifier: GPL-2.0-only

config SOC_UCB_RISCV
	select ARCH_RISCV_S
	select ARCH_RISCV_U
	select ARCH_RISCV_PMP
	select ARCH_BOOTBLOCK_RISCV
	select ARCH_VERSTAGE_RISCV
	select ARCH_ROMSTAGE_RISCV
	select ARCH_RAMSTAGE_RISCV
	select RISCV_USE_ARCH_TIMER
	select FLATTENED_DEVICE_TREE
	bool
	default n

if SOC_UCB_RISCV

if ARCH_RISCV_RV64

config RISCV_ARCH
	string
	default "rv64imafd"

config RISCV_ABI
	string
	default "lp64d"

config RISCV_CODEMODEL
	string
	default "medany"

endif

if ARCH_RISCV_RV32

config RISCV_ARCH
	string
	default "rv32im"

config RISCV_ABI
	string
	default "ilp32"

config RISCV_CODEMODEL
	string
	default "medany"

endif

config RISCV_WORKING_HARTID
	int
	default 0

endif
```

## src/soc/xilinx/Kconfig
```kconfig
## SPDX-License-Identifier: GPL-2.0-only

# Load all chipsets
source "src/soc/xilinx/*/Kconfig"
```

## src/soc/xilinx/zynq7000/Kconfig
```kconfig
## SPDX-License-Identifier: GPL-2.0-only
#
config SOC_XILINX_ZYNQ7000
	bool
	default n
	select ARCH_BOOTBLOCK_ARMV7
	select ARCH_VERSTAGE_ARMV7
	select ARCH_ROMSTAGE_ARMV7
	select ARCH_RAMSTAGE_ARMV7

if SOC_XILINX_ZYNQ7000

config MEMLAYOUT_LD_FILE
	string
	default "src/soc/xilinx/zynq7000/memlayout.ld"

endif
```
