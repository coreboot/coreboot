/* SPDX-License-Identifier: GPL-2.0-only */

#include <memlayout.h>
#include <arch/header.ld>
#include <soc/memlayout.h>

/*
 * The linker script below configures the memory layout for the Qualcomm Calypso SoC.
 *
 * The memory map and addressing scheme are implemented according to the official Qualcomm
 * Hardware Reference Document (HRD) for this specific SoC.
 *
 * 0x10000000000 +----------------------------------------------------------+ <--------------
 *               |                      dram_space_2                        | DRAM Space 2  ^
 * 0x8800000000  +----------------------------------------------------------+ <---------    |
 *               |         ... (Memory not mapped: Unavailable) ...         |  XXXXXXXXX    |
 * 0x1000000000  +----------------------------------------------------------+ <---------    |
 *               |                      dram_space_1                        | DRAM Space 1  |
 * 0x880000000   +----------------------------------------------------------+ <---------    |
 *               |         ... (Memory not mapped: Unavailable) ...         |  XXXXXXXXX    |
 * 0x100000000   +----------------------------------------------------------+ <---------    |
 *               |                 dram_smem (Shared Memory)                |      ^        |
 * 0xFFE00000    +----------------------------------------------------------+      |        |
 *               |                ... Usable memory ...                     |      |        |
 * 0xFEEE0000    +----------------------------------------------------------+      |        |
 *               |                   dram_oob_wlan_assist                   |      |        |
 * 0xFEED0000    +----------------------------------------------------------+      |        |
 *               |                   dram_oob_mdm_assist                    |      |        |
 * 0xFEEC0000    +----------------------------------------------------------+      |        |
 *               |                  dram_oob_glink_assist                   |      |        |
 * 0xFED80000    +----------------------------------------------------------+      |        |
 *               |                  dram_oob_glink_always                   |      |        |
 * 0xFEC00000    +----------------------------------------------------------+      |        |
 *               |                ... Usable memory ...                     |      |        |
 * 0xE6900000    +----------------------------------------------------------+      |        |
 *               |                     dram_display                         |      |        |
 * 0xE4800000    +----------------------------------------------------------+      |        |
 *               |                ... Usable memory ...                     |      |        |
 * 0xD9632000    +----------------------------------------------------------+      |        |
 *               |                       dram_ta                            |      |        |
 * 0xD7800000    +----------------------------------------------------------+      |        |
 *               |                  dram_tz (TrustZone)                     |      |        |
 * 0xD7180000    +----------------------------------------------------------+      |        |
 *               |                 BL31 (ARM Trusted Firmware)              |      |        |
 * 0xD7029000    +----------------------------------------------------------+      |      DRAM
 *               |                   dram_tz_ac                             |      |        |
 * 0xD7019000    +----------------------------------------------------------+      |        |
 *               |                   dram_hyp_ac                            |      |        |
 * 0xD7000000    +----------------------------------------------------------+      |        |
 *               |                        dram_bert                         |      |        |
 * 0xD6F00000    +----------------------------------------------------------+      |        |
 *               |                ... Usable memory ...                     |      |        |
 * 0xA1800000    +----------------------------------------------------------+      |        |
 *               |                      RAMSTAGE                            | DRAM Space 0  |
 * 0x94F00000    +----------------------------------------------------------+      |        |
 *               |                 POSTRAM_CBFS_CACHE                       |      |        |
 * 0x93F00000    +----------------------------------------------------------+      |        |
 *               |                ... Usable memory ...                     |      |        |
 * 0x91380000    +----------------------------------------------------------+      |        |
 *               |                       dram_pil                           |      |        |
 * 0x86E10000    +----------------------------------------------------------+      |        |
 *               |                        CBMEM                             |      |        |
 *               +----------------------------------------------------------+      |        |
 *               |                ... Usable memory ...                     |      |        |
 * 0x85D90000    +----------------------------------------------------------+      |        |
 *               |                       dram_smmu_pt                       |      |        |
 * 0x85370000    +----------------------------------------------------------+      |        |
 *               |                ... Usable memory ...                     |      |        |
 * 0x85300000    +----------------------------------------------------------+      |        |
 *               |                 dram_adsp_rpc_heap                       |      |        |
 * 0x84A00000    +----------------------------------------------------------+      |        |
 *               |                     dram_spu_secure                      |      |        |
 * 0x84900000    +----------------------------------------------------------+      |        |
 *               |                ... Usable memory ...                     |      |        |
 * 0x84400000    +----------------------------------------------------------+      |        |
 *               |                       dram_ncc                           |      |        |
 * 0x84000000    +----------------------------------------------------------+      |        |
 *               |                  dram_xbl_scratch_buf1                   |      |        |
 * 0x83F00000    +----------------------------------------------------------+      |        |
 *               |                ... Usable memory ...                     |      |        |
 * 0x829C0000    +----------------------------------------------------------+      |        |
 *               |                  dram_xbl_scratch_buf2                   |      |        |
 * 0x82800000    +----------------------------------------------------------+      |        |
 *               |                   dram_tz_static                         |      |        |
 * 0x82700000    +----------------------------------------------------------+      |        |
 *               |                ... Usable memory ...                     |      |        |
 * 0x823E0000    +----------------------------------------------------------+      |        |
 *               |                     dram_soccp_sdi                       |      |        |
 * 0x823A0000    +----------------------------------------------------------+      |        |
 *               |                ... Usable memory ...                     |      |        |
 * 0x82200000    +----------------------------------------------------------+      |        |
 *               |                      dram_acpi_ta                        |      |        |
 * 0x82000000    +----------------------------------------------------------+      |        |
 *               |                     dram_pdp_ns                          |      |        |
 * 0x81E00000    +----------------------------------------------------------+      |        |
 *               |                ... Usable memory ...                     |      |        |
 * 0x81DB1000    +----------------------------------------------------------+      |        |
 *               |                      dram_softsku                        |      |        |
 * 0x81DA8000    +----------------------------------------------------------+      |        |
 *               |                       dram_qup_fw                        |      |        |
 * 0x81D90000    +----------------------------------------------------------+      |        |
 *               |                      dram_qcskext                        |      |        |
 * 0x81D70000    +----------------------------------------------------------+      |        |
 *               |                ... Usable memory ...                     |      |        |
 * 0x81D60000    +----------------------------------------------------------+      |        |
 *               |                      dram_pld_pdp                        |      |        |
 * 0x81D50000    +----------------------------------------------------------+      |        |
 *               |                      dram_pld_gmu                        |      |        |
 * 0x81D40000    +----------------------------------------------------------+      |        |
 *               |                      dram_pld_pep                        |      |        |
 * 0x81D30000    +----------------------------------------------------------+      |        |
 *               |                     dram_usb_ucsi                        |      |        |
 * 0x81D20000    +----------------------------------------------------------+      |        |
 *               |                     dram_tpm_ctrl                        |      |        |
 * 0x81D10000    +----------------------------------------------------------+      |        |
 *               |                      dram_gpu_prr                        |      |        |
 * 0x81D00000    +----------------------------------------------------------+      |        |
 *               |                ... Usable memory ...                     |      |        |
 * 0x81CF4000    +----------------------------------------------------------+      |        |
 *               |                       dram_dc_log                        |      |        |
 * 0x81CF0000    +----------------------------------------------------------+      |        |
 *               |                       dram_tme_log                       |      |        |
 * 0x81CE0000    +----------------------------------------------------------+      |        |
 *               |                  dram_tme_crashdump                      |      |        |
 * 0x81CA0000    +----------------------------------------------------------+      |        |
 *               |                   dram_aop_config                        |      |        |
 * 0x81C80000    +----------------------------------------------------------+      |        |
 *               |                   dram_aop_cmd_db                        |      |        |
 * 0x81C60000    +----------------------------------------------------------+      |        |
 *               |                       dram_aop                           |      |        |
 * 0x81C00000    +----------------------------------------------------------+      |        |
 *               |                ... Usable memory ...                     |      |        |
 * 0x81C00000    +----------------------------------------------------------+      |        |
 *               |                     dram_ramdump                         |      |        |
 * 0x81A40000    +----------------------------------------------------------+      |        |
 *               |                     dram_xbl_log                         |      |        |
 * 0x81A00000    +----------------------------------------------------------+      |        |
 *               |                 POSTRAM_DMA_COHERENT                     |      |        |
 * 0x81860000    +----------------------------------------------------------+      |        |
 *               |                    POSTRAM_STACK                         |      |        |
 * 0x81860000    +----------------------------------------------------------+      |        |
 *               |                      dram_pdp_cdb                        |      |        |
 * 0x814CC000    +----------------------------------------------------------+      |        |
 *               |                       dram_pdp                           |      |        |
 * 0x81400000    +----------------------------------------------------------+      |        |
 *               |                      dram_cpucp                          |      |        |
 * 0x80900000    +----------------------------------------------------------+      |        |
 *               |                    dram_llcc_lpi                         |      v        v
 * 0x80000000    +----------------------------------------------------------+ <--------------
 *               |         ... (Memory not mapped: Unavailable) ...         | XXXXXXXXX
 * 0x20260000    +----------------------------------------------------------+ <---------
 *               |                         shrm                             |    SHRM
 * 0x20220000    +----------------------------------------------------------+ <---------
 *               |         ... (Memory not mapped: Unavailable) ...         | XXXXXXXXX
 * 0x1DB80000    +----------------------------------------------------------+ <---------
 *               |                         cpucp                            |    CPUCP
 * 0x1DB00000    +----------------------------------------------------------+ <---------
 *               |         ... (Memory not mapped: Unavailable) ...         | XXXXXXXXX
 * 0x14A80000    +----------------------------------------------------------+ <---------
 *               |                    auth_metadata                         |      ^
 * 0x14A7F000    +----------------------------------------------------------+      |
 *               |                     debug_policy                         |      |
 * 0x14A7E000    +----------------------------------------------------------+      |
 *               |         OVERLAP_DECOMPRESSOR_VERSTAGE_ROMSTAGE           |      |
 * 0x14A56000    +----------------------------------------------------------+      |
 *               |                 PRERAM_CBMEM_CONSOLE                     |      |
 * 0x14A50000    +----------------------------------------------------------+      |
 *               |                       qclib                              |      |
 * 0x148A0000    +----------------------------------------------------------+      |
 *               |                    ddr_training                          |      |
 * 0x14880000    +----------------------------------------------------------+      |
 *               |             TTB (Translation Table Base)                 |      |
 * 0x1486E000    +----------------------------------------------------------+      |
 *               |                 PRERAM_CBFS_CACHE                        |      |
 * 0x14852000    +----------------------------------------------------------+      |
 *               |                    cdt_data (optional)                   |      |
 * 0x14851000    +----------------------------------------------------------+      |
 *               |                    cpr_settings                          |      |
 * 0x14850000    +----------------------------------------------------------+      |
 *               |                  apdp_ramdump_meta                       |      |
 * 0x1484F000    +----------------------------------------------------------+      |
 *               |                    aop_blob_meta                         |      |
 * 0x1484B000    +----------------------------------------------------------+      |
 *               |                    qc_blob_meta                          |      |
 * 0x14847000    +----------------------------------------------------------+      |
 *               |                dcb (DDR Config Block)                    |      |
 * 0x14839000    +----------------------------------------------------------+      |
 *               |                     FMAP_CACHE                           |      |
 * 0x14838800    +----------------------------------------------------------+    BSRAM
 *               |                    CBFS_MCACHE                           |      |
 * 0x14833000    +----------------------------------------------------------+      |
 *               |                  qclib_serial_log                        |      |
 * 0x14832000    +----------------------------------------------------------+      |
 *               |               PRERAM_DMA_COHERENT                        |      |
 * 0x14830000    +----------------------------------------------------------+      |
 *               |                    VBOOT2_WORK                           |      |
 * 0x1482D000    +----------------------------------------------------------+      |
 *               |                    PRERAM_STACK                          |      |
 * 0x14829000    +----------------------------------------------------------+      |
 *               |                     TIMESTAMP                            |      |
 * 0x14828000    +----------------------------------------------------------+      |
 *               |                     BOOTBLOCK                            |      |
 * 0x14819000    +----------------------------------------------------------+      |
 *               |                   pbl_timestamps                         |      v
 * 0x14800000    +----------------------------------------------------------+ <---------
 *               |         ... (Memory not mapped: Unavailable) ...         | XXXXXXXXX
 * 0x146AC000    +----------------------------------------------------------+ <---------
 *               |                 WATCHDOG_TOMBSTONE                       |      ^
 * 0x146ABFFC    +----------------------------------------------------------+      |
 *               |                   ddr_information                        |      |
 * 0x146ABFE8    +----------------------------------------------------------+      |
 *               |                     shared_imem                          |      |
 * 0x146AA000    +----------------------------------------------------------+      |
 *               |                      aop_imem                            |      |
 * 0x146A8000    +----------------------------------------------------------+    SSRAM
 *               |                   qdss_usb_trace                         |      |
 * 0x146A6000    +----------------------------------------------------------+      |
 *               |                     delta_dcb                            |      |
 * 0x146A2000    +----------------------------------------------------------+      |
 *               |               dtb (Device Tree Blob)                     |      |
 * 0x14692000    +----------------------------------------------------------+      |
 *               |                      aop_sdi                             |      |
 * 0x14686000    +----------------------------------------------------------+      |
 *               |                 Reserved for QSEE                        |      v
 * 0x14680000    +----------------------------------------------------------+ <---------
 *               |         ... (Memory not mapped: Unavailable) ...         | XXXXXXXXX
 * 0x0EF30000    +----------------------------------------------------------+ <---------
 *               |                   spel_rvss_dram                          |      ^
 * 0x0EF24000    +----------------------------------------------------------+      |
 *               |                   spel_rvss_iram                          |      |
 * 0x0EF20000    +----------------------------------------------------------+      |
 *               |                ... Usable memory ...                     |      |
 * 0x0B128000    +----------------------------------------------------------+      |
 *               |                   aop_data_ram                           |      |
 * 0x0B100000    +----------------------------------------------------------+   AOP SRAM
 *               |                ... Usable memory ...                     |      |
 * 0x0B0D8000    +----------------------------------------------------------+      |
 *               |                   aop_code_ram                           |      |
 * 0x0B080000    +----------------------------------------------------------+      |
 *               |                ... Usable memory ...                     |      |
 * 0x0B000000    +----------------------------------------------------------+      v
 *               +----------------------------------------------------------+ <---------
 *
 */

SECTIONS
{
	AOPSRAM_START(0x0B000000)
	REGION(aop_code_ram, 0x0B080000, 0x58000, 4K)
	REGION(aop_data_ram, 0x0B100000, 0x28000, 4K)
	REGION(spel_rvss_iram, 0x0EF20000, 16K, 4k)
	REGION(spel_rvss_dram, 0x0EF24000, 8k, 4k)
	AOPSRAM_END(0x0EF30000)

	SSRAM_START(0x14680000)
	REGION(qsee, 0x14680000, 24K, 4K)
	REGION(aop_sdi, 0x14686000, 48K, 4K)
	REGION(dtb, 0x14692000, 64K, 4K)
	REGION(delta_dcb, 0x146A2000, 16K, 4K)
	REGION(qdss_usb_trace, 0x146A6000, 8K, 4K)
	REGION(aop_imem, 0x146A8000, 8K, 4K)
	REGION(shared_imem, 0x146AA000, 0x1000, 4K)
	REGION(ddr_information, 0x146ABFE8, 16, 8)
	WATCHDOG_TOMBSTONE(0x146ABFFC, 4)
	SSRAM_END(0x146AC000)

	BSRAM_START(0x14800000)
	REGION(pbl_timestamps, 0x14800000, 84K, 4K)
	BOOTBLOCK(0x14819000, 60K)
	TIMESTAMP(0x14828000, 4K)
	PRERAM_STACK(0x14829000, 16K)
	VBOOT2_WORK(0x1482D000, 12K)
	PRERAM_DMA_COHERENT(0x14830000, 8K)
	REGION(qclib_serial_log, 0x14832000, 4K, 4K)
	CBFS_MCACHE(0x14833000, 22K)
	FMAP_CACHE(0x14838800, 2K)
	REGION(dcb, 0x14839000, 56K, 4K)
	REGION(qc_blob_meta, 0x14847000, 16K, 4K)
	REGION(aop_blob_meta, 0x1484B000, 16K, 4K)
	REGION(apdp_ramdump_meta, 0x1484F000, 4K, 4K)
	REGION(cpr_settings, 0x14850000, 4K, 4K)
#if CONFIG(SOC_QUALCOMM_CDT)
    REGION(cdt_data, 0x14851000, 4K, 4K)
#endif
	PRERAM_CBFS_CACHE(0x14852000, 112K)
#if CONFIG(BOARD_GOOGLE_MODEL_CALYPSO)
    TTB(0x1486E000, 64K)
#else
    TTB(0x1486E000, 56K)
#endif
	REGION(ddr_training, 0x14880000, 64K, 4K)
	REGION(qclib, 0x148A0000, 1728K, 4K)
	PRERAM_CBMEM_CONSOLE(0x14A50000, 24K)
	OVERLAP_DECOMPRESSOR_VERSTAGE_ROMSTAGE(0x14A56000, 160K)
	REGION(debug_policy, 0x14A7E000, 4K, 4K)
	REGION(auth_metadata, 0x14A7F000, 4K, 4K)
	BSRAM_END(0x14A80000)

	REGION(cpucp, 0x1DB00000, 512K , 4K)

	REGION(shrm, 0x20220000, 256k , 4K)

	DRAM_START(0x80000000)
	REGION(dram_llcc_lpi, 0x80000000, 0x900000, 4K)
	REGION(dram_cpucp, 0x80900000, 0xB00000, 4K)
	REGION(dram_pdp, 0x81400000, 0xCC000, 4K)
	REGION(dram_pdp_cdb, 0x814CC000, 0x394000, 4K)
	POSTRAM_STACK(0x81860000, 32K)
	POSTRAM_DMA_COHERENT(0x81868000, 16K)
	REGION(dram_xbl_log, 0x81A00000, 0x40000, 4K)
	REGION(dram_ramdump, 0x81A40000, 0x1C0000, 4K)
	REGION(dram_aop, 0x81C00000, 0x60000, 4K)
	REGION(dram_aop_cmd_db, 0x81C60000, 0x20000, 4K)
	REGION(dram_aop_config, 0x81C80000, 0x20000, 4K)
	REGION(dram_tme_crashdump, 0x81CA0000, 0x40000, 4K)
	REGION(dram_tme_log, 0x81CE0000, 0x10000, 4K)
	REGION(dram_dc_log, 0x81CF0000, 0x10000, 4K)
	REGION(dram_gpu_prr, 0x81D00000, 0x10000, 4K)
	REGION(dram_tpm_ctrl, 0x81D10000, 0x10000, 4K)
	REGION(dram_usb_ucsi, 0x81D20000, 0x10000, 4K)
	REGION(dram_pld_pep, 0x81D30000, 0x10000, 4K)
	REGION(dram_pld_gmu, 0x81D40000, 0x10000, 4K)
	REGION(dram_pld_pdp, 0x81D50000, 0x10000, 4K)
	REGION(dram_qcskext, 0x81D70000, 0x20000, 4K)
	REGION(dram_qup_fw, 0x81D90000, 0x18000, 4K)
	REGION(dram_softsku, 0x81DA8000, 0x9000, 4K)
	REGION(dram_pdp_ns, 0x81E00000, 0x200000, 4K)
	REGION(dram_acpi_ta, 0x82000000, 0x200000, 4K)
	REGION(dram_tz_static, 0x82700000, 0x100000, 4K)
	REGION(dram_xbl_scratch_buf2, 0x82800000, 0x1C0000, 4K)
	REGION(dram_xbl_scratch_buf1, 0x83F00000, 0x100000, 4K)
	REGION(dram_ncc, 0x84000000, 0x400000, 4K)
	REGION(dram_spu_secure, 0x84900000, 0x100000, 4K)
	REGION(dram_adsp_rpc_heap, 0x84A00000, 0x900000, 4K)
	REGION(dram_smmu_pt, 0x85370000, 0xA20000, 4K)
	REGION(dram_pil, 0x86E10000, 0xD0F0000, 4K)
	POSTRAM_CBFS_CACHE(0x93F00000, 16M)
	RAMSTAGE(0x94F00000, 16M)
	REGION(dram_bert, 0xD6F00000, 0x100000, 4K)
	REGION(dram_hyp_ac, 0xD7000000, 0x19000, 4K)
	REGION(dram_tz_ac, 0xD7019000, 0x10000, 4K)
	BL31(0xD7029000, 800K)
	REGION(dram_tz, 0xD7180000, 0x680000, 4K)
	REGION(dram_ta, 0xD7800000, 0x1C00000, 4K)
	REGION(dram_display, 0xE4800000, 0x2100000, 4K)
	REGION(dram_oob_glink_always, 0xFEC00000, 0x180000, 4K)
	REGION(dram_oob_glink_assist, 0xFED80000, 0x140000, 4K)
	REGION(dram_oob_mdm_assist, 0xFEEC0000, 0x10000, 4K)
	REGION(dram_oob_wlan_assist, 0xFEED0000, 0x10000, 4K)
	REGION(dram_smem, 0xFFE00000, 0x200000, 4K)
	DRAM_END(0x100000000)

	/*
	 * Define the address range limits for fragmented DRAM regions.
	 *
	 * These regions, `dram_space_1` and `dram_space_2`, are used to map physical
	 * memory beyond the initial `_dram` region. The MMU configuration logic in
	 * `mmu.c` uses `REGION_SIZE()` to dynamically size these ranges based on the
	 * total system DRAM capacity, which is determined by the QCLib.
	 *
	 * Example for a 16GB DRAM system:
	 * - `_dram` (2GB):          0x80000000 - 0x100000000
	 * - `_dram_space_1` (14GB): 0x880000000 - 0x440000000 (0x880000000 + 14GB)
	 *
	 * Note: The example memory addresses are for illustration and depend on the
	 * platform's specific memory map.
	 */
	REGION(dram_space_1, 0x880000000, 0x780000000, 4K)
	REGION(dram_space_2, 0x8800000000, 0x7800000000, 4K)
}
