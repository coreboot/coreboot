## src/southbridge/amd/cimx/sb900/Kconfig
```kconfig
##
## This file is part of the coreboot project.
##
## Copyright (C) 2011 Advanced Micro Devices, Inc.
##
## This program is free software; you can redistribute it and/or modify
## it under the terms of the GNU General Public License as published by
## the Free Software Foundation; version 2 of the License.
##
## This program is distributed in the hope that it will be useful,
## but WITHOUT ANY WARRANTY; without even the implied warranty of
## MERCHANTABILITY or FITNESS FOR A PARTICULAR PURPOSE.  See the
## GNU General Public License for more details.
##
## You should have received a copy of the GNU General Public License
## along with this program; if not, write to the Free Software
## Foundation, Inc.
##

config SOUTHBRIDGE_AMD_CIMX_SB900
	bool
	default n
	select IOAPIC
	select AMD_SB_CIMX
	select HAVE_HARD_RESET

if SOUTHBRIDGE_AMD_CIMX_SB900
config SATA_CONTROLLER_MODE
	hex
	default 0x0
	help
	  0x0 = Native IDE mode.
	  0x1 = RAID mode.
	  0x2 = AHCI mode.
	  0x3 = Legacy IDE mode.
	  0x4 = IDE->AHCI mode.
	  0x5 = AHCI mode as 7804 ID (AMD driver).
	  0x6 = IDE->AHCI mode as 7804 ID (AMD driver).

config PCIB_ENABLE
	bool
	default n
	help
	  n = Disable PCI Bridge Device 14 Function 4.
	  y = Enable PCI Bridge Device 14 Function 4.

config ACPI_SCI_IRQ
	hex
	default 0x9
	help
	  Set SCI IRQ to 9.

config BOOTBLOCK_SOUTHBRIDGE_INIT
	string
	default "southbridge/amd/cimx/sb900/bootblock.c"

endif #SOUTHBRIDGE_AMD_CIMX_SB900
```

## src/southbridge/amd/cs5530/Kconfig
```kconfig
##
## This file is part of the coreboot project.
##
## Copyright (C) 2009 Uwe Hermann <uwe@hermann-uwe.de>
##
## This program is free software; you can redistribute it and/or modify
## it under the terms of the GNU General Public License as published by
## the Free Software Foundation; version 2 of the License.
##
## This program is distributed in the hope that it will be useful,
## but WITHOUT ANY WARRANTY; without even the implied warranty of
## MERCHANTABILITY or FITNESS FOR A PARTICULAR PURPOSE.  See the
## GNU General Public License for more details.
##
## You should have received a copy of the GNU General Public License
## along with this program; if not, write to the Free Software
## Foundation, Inc., 51 Franklin St, Fifth Floor, Boston, MA 02110-1301 USA
##

config SOUTHBRIDGE_AMD_CS5530
	bool

menu "AMD Geode GX1 video support"
	depends on SOUTHBRIDGE_AMD_CS5530

config GX1_VIDEO
	bool "AMD Geode GX1 video mode support"
	default y
	depends on SOUTHBRIDGE_AMD_CS5530

choice
	prompt "AMD Geode GX1 video mode"
	default GX1_VIDEOMODE_0
	depends on GX1_VIDEO

config GX1_VIDEOMODE_0
	bool "640x480"
config GX1_VIDEOMODE_1
	bool "800x600"
config GX1_VIDEOMODE_2
	bool "1024x768"
config GX1_VIDEOMODE_3
	bool "1280x960"
config GX1_VIDEOMODE_4
	bool "1280x1024"

endchoice

config GX1_VIDEOMODE
	int
	default 0 if GX1_VIDEOMODE_0
	default 1 if GX1_VIDEOMODE_1
	default 2 if GX1_VIDEOMODE_2
	default 3 if GX1_VIDEOMODE_3
	default 4 if GX1_VIDEOMODE_4
	depends on GX1_VIDEO

# TODO: Check how much RAM each of the modes actually needs.
config VIDEO_MB
	int
	default 2 if GX1_VIDEOMODE_0
	default 2 if GX1_VIDEOMODE_1
	default 2 if GX1_VIDEOMODE_2
	default 2 if GX1_VIDEOMODE_3
	default 2 if GX1_VIDEOMODE_4
	depends on GX1_VIDEO

config SPLASH_GRAPHIC
	bool "Enable splash screen on AMD Geode GX1 boards"
	default y
	depends on GX1_VIDEO

endmenu
```

## src/southbridge/amd/pi/Kconfig
```kconfig
# SPDX-License-Identifier: GPL-2.0-only

source "src/southbridge/amd/pi/hudson/Kconfig"
```

## src/southbridge/amd/pi/hudson/Kconfig
```kconfig
# SPDX-License-Identifier: GPL-2.0-only

config SOUTHBRIDGE_AMD_PI_AVALON
	bool

config SOUTHBRIDGE_AMD_PI_KERN
	bool

if SOUTHBRIDGE_AMD_PI_AVALON || SOUTHBRIDGE_AMD_PI_KERN

config SOUTHBRIDGE_SPECIFIC_OPTIONS
	def_bool y
	select HAVE_USBDEBUG_OPTIONS
	select HAVE_CF9_RESET
	select HAVE_CF9_RESET_PREPARE
	select SOC_AMD_COMMON
	select SOC_AMD_COMMON_BLOCK_ACPIMMIO
	select SOC_AMD_COMMON_BLOCK_ACPIMMIO_BIOSRAM
	select SOC_AMD_COMMON_BLOCK_BANKED_GPIOS
	select SOC_AMD_COMMON_BLOCK_BANKED_GPIOS_NON_SOC_CODEBASE
	select SOC_AMD_COMMON_BLOCK_PCI_MMCONF

config EHCI_BAR
	hex
	default 0xfef00000

config HUDSON_XHCI_ENABLE
	bool "Enable Hudson XHCI Controller"
	default y
	help
	  The XHCI controller must be enabled and the XHCI firmware
	  must be added in order to have USB 3.0 support configured
	  by coreboot. The OS will be responsible for enabling the XHCI
	  controller if the XHCI firmware is available but the
	  XHCI controller is not enabled by coreboot.

config HUDSON_XHCI_FWM
	bool "Add xhci firmware"
	default y
	help
	  Add Hudson 2/3/4 XHCI Firmware to support the onboard USB 3.0

config HUDSON_IMC_ENABLE
	bool
	default n

config HUDSON_IMC_FWM
	bool "Add IMC firmware"
	depends on HUDSON_IMC_ENABLE
	default y
	help
	  Add Hudson 2/3/4 IMC Firmware to support the onboard fan control

config HUDSON_GEC_FWM
	bool
	default n
	help
	  Add Hudson 2/3/4 GEC Firmware to support the onboard gigabit Ethernet MAC.
	  Must be connected to a Broadcom B50610 or B50610M PHY on the motherboard.

config HUDSON_PSP
	bool
	default y if CPU_AMD_PI_00730F01

config AMDFW_CONFIG_FILE
	string "AMD PSP Firmware config file"
	default "src/southbridge/amd/pi/hudson/fw_avl.cfg" if CPU_AMD_PI_00730F01

config HUDSON_XHCI_FWM_FILE
	string "XHCI firmware path and filename"
	default "3rdparty/blobs/southbridge/amd/avalon/xhci.bin" if SOUTHBRIDGE_AMD_PI_AVALON
	default "3rdparty/blobs/southbridge/amd/kern/xhci.bin" if SOUTHBRIDGE_AMD_PI_KERN
	depends on HUDSON_XHCI_FWM

config HUDSON_IMC_FWM_FILE
	string "IMC firmware path and filename"
	default "3rdparty/blobs/southbridge/amd/avalon/imc.bin" if SOUTHBRIDGE_AMD_PI_AVALON
	default "3rdparty/blobs/southbridge/amd/kern/imc.bin" if SOUTHBRIDGE_AMD_PI_KERN
	depends on HUDSON_IMC_FWM

config HUDSON_GEC_FWM_FILE
	string "GEC firmware path and filename"
	depends on HUDSON_GEC_FWM

config AMD_PUBKEY_FILE
	depends on HUDSON_PSP
	string "AMD public Key"
	default "3rdparty/blobs/southbridge/amd/avalon/PSP/AmdPubKey.bin" if CPU_AMD_PI_00730F01

config HUDSON_SATA_MODE
	int "SATA Mode"
	default 2
	range 0 6
	help
	  Select the mode in which SATA should be driven. NATIVE AHCI, or RAID.
	  The default is NATIVE.
	  0: NATIVE mode does not require a ROM.
	  1: RAID mode must have the two ROM files.
	  2: AHCI may work with or without AHCI ROM. It depends on the payload support.
	     For example, seabios does not require the AHCI ROM.
	  3: LEGACY IDE
	  4: IDE to AHCI
	  5: AHCI7804: ROM Required, and AMD driver required in the OS.
	  6: IDE to AHCI7804: ROM Required, and AMD driver required in the OS.

comment "NATIVE"
	depends on HUDSON_SATA_MODE = 0

comment "RAID"
	depends on HUDSON_SATA_MODE = 1

comment "AHCI"
	depends on HUDSON_SATA_MODE = 2

comment "LEGACY IDE"
	depends on HUDSON_SATA_MODE = 3

comment "IDE to AHCI"
	depends on HUDSON_SATA_MODE = 4

comment "AHCI7804"
	depends on HUDSON_SATA_MODE = 5

comment "IDE to AHCI7804"
	depends on HUDSON_SATA_MODE = 6

if HUDSON_SATA_MODE = 1

config RAID_MISC_ROM_POSITION
	hex "RAID Misc ROM Position"
	default 0xFFF00000
	help
	  The RAID ROM requires that the MISC ROM is located between the range
	  0xFFF0_0000 to 0xFFF0_FFFF. Also, it must 1K bytes aligned.
	  The CONFIG_ROM_SIZE must be larger than 0x100000.

endif

config HUDSON_LEGACY_FREE
	bool "System is legacy free"
	help
	  Select y if there is no keyboard controller in the system.
	  This sets variables in AGESA and ACPI.

config AMDFW_OUTSIDE_CBFS
	def_bool n
	help
	  The AMDFW (PSP) is typically locatable in cbfs.  Select this
	  option to manually attach the generated amdfw.rom at an
	  offset of 0x20000 from the bottom of the coreboot ROM image.

config SERIRQ_CONTINUOUS_MODE
	bool
	default n
	help
	  Set this option to y for serial IRQ in continuous mode.
	  Otherwise it is in quiet mode.

config HUDSON_ACPI_IO_BASE
	hex
	default 0x800
	help
	  Base address for the ACPI registers.
	  This value must match the hardcoded value of AGESA.

endif
```

## src/southbridge/amd/sb600/Kconfig
```kconfig
##
## This file is part of the coreboot project.
##
## Copyright (C) 2008-2009 coresystems GmbH
##
## This program is free software; you can redistribute it and/or modify
## it under the terms of the GNU General Public License as published by
## the Free Software Foundation; version 2 of the License.
##
## This program is distributed in the hope that it will be useful,
## but WITHOUT ANY WARRANTY; without even the implied warranty of
## MERCHANTABILITY or FITNESS FOR A PARTICULAR PURPOSE.  See the
## GNU General Public License for more details.
##
## You should have received a copy of the GNU General Public License
## along with this program; if not, write to the Free Software
## Foundation, Inc., 51 Franklin St, Fifth Floor, Boston, MA 02110-1301 USA
##

config SOUTHBRIDGE_AMD_SB600
	bool
	select IOAPIC
	select HAVE_USBDEBUG
	select HAVE_HARD_RESET

if SOUTHBRIDGE_AMD_SB600
config BOOTBLOCK_SOUTHBRIDGE_INIT
	string
	default "southbridge/amd/sb600/bootblock.c"

config EHCI_BAR
	hex
	default 0xfef00000

config EHCI_DEBUG_OFFSET
	hex
	default 0xe0

choice
	prompt "SATA Mode"
	default SATA_MODE_IDE
	help
	  Select the mode in which SATA should be driven. IDE or AHCI.
	  The default is IDE.

	config SATA_MODE_IDE
	bool "IDE"

	config SATA_MODE_AHCI
	bool "AHCI"
endchoice

config SATA_MODE
	int
	default 1 if SATA_MODE_IDE
	default 0 if SATA_MODE_AHCI

config HPET_MIN_TICKS
        hex
        default 0x14

endif
```

## src/southbridge/amd/sb700/Kconfig
```kconfig
##
## This file is part of the coreboot project.
##
## Copyright (C) 2010 Advanced Micro Devices, Inc.
##
## This program is free software; you can redistribute it and/or modify
## it under the terms of the GNU General Public License as published by
## the Free Software Foundation; version 2 of the License.
##
## This program is distributed in the hope that it will be useful,
## but WITHOUT ANY WARRANTY; without even the implied warranty of
## MERCHANTABILITY or FITNESS FOR A PARTICULAR PURPOSE.  See the
## GNU General Public License for more details.
##
## You should have received a copy of the GNU General Public License
## along with this program; if not, write to the Free Software
## Foundation, Inc., 51 Franklin St, Fifth Floor, Boston, MA 02110-1301 USA
##

config SOUTHBRIDGE_AMD_SB700
	bool

if SOUTHBRIDGE_AMD_SB700

config SOUTHBRIDGE_SPECIFIC_OPTIONS # dummy
	def_bool y
	select IOAPIC
	select HAVE_USBDEBUG
	select HAVE_HARD_RESET

# Set for southbridge SP5100 which also uses SB700 driver
config SOUTHBRIDGE_AMD_SUBTYPE_SP5100
	bool
	default n

config BOOTBLOCK_SOUTHBRIDGE_INIT
	string
	default "southbridge/amd/sb700/bootblock.c"

config SOUTHBRIDGE_AMD_SB700_SKIP_ISA_DMA_INIT
	bool
	default n

config EHCI_BAR
	hex
	default 0xfef00000

config EHCI_DEBUG_OFFSET
	hex
	default 0xe0

endif # SOUTHBRIDGE_AMD_SB700
```

## src/southbridge/amd/sb800/Kconfig
```kconfig
##
## This file is part of the coreboot project.
##
## Copyright (C) 2010 Advanced Micro Devices, Inc.
##
## This program is free software; you can redistribute it and/or modify
## it under the terms of the GNU General Public License as published by
## the Free Software Foundation; version 2 of the License.
##
## This program is distributed in the hope that it will be useful,
## but WITHOUT ANY WARRANTY; without even the implied warranty of
## MERCHANTABILITY or FITNESS FOR A PARTICULAR PURPOSE.  See the
## GNU General Public License for more details.
##
## You should have received a copy of the GNU General Public License
## along with this program; if not, write to the Free Software
## Foundation, Inc., 51 Franklin St, Fifth Floor, Boston, MA 02110-1301 USA
##

config SOUTHBRIDGE_AMD_SB800
	bool
	select IOAPIC
	select HAVE_USBDEBUG
	select HAVE_HARD_RESET

if SOUTHBRIDGE_AMD_SB800

config BOOTBLOCK_SOUTHBRIDGE_INIT
	string
	default "southbridge/amd/sb800/bootblock.c"

config SOUTHBRIDGE_AMD_SB800_SKIP_ISA_DMA_INIT
	bool
	default n

config EHCI_BAR
	hex
	default 0xfef00000

config EHCI_DEBUG_OFFSET
	hex
	default 0xe0

endif # SOUTHBRIDGE_AMD_SB800
```

## src/southbridge/broadcom/Kconfig
```kconfig
source src/southbridge/broadcom/bcm21000/Kconfig
source src/southbridge/broadcom/bcm5780/Kconfig
source src/southbridge/broadcom/bcm5785/Kconfig
```

## src/southbridge/intel/Kconfig
```kconfig
source src/southbridge/intel/common/Kconfig
source src/southbridge/intel/esb6300/Kconfig
source src/southbridge/intel/i3100/Kconfig
source src/southbridge/intel/i82371eb/Kconfig
source src/southbridge/intel/i82801ax/Kconfig
source src/southbridge/intel/i82801bx/Kconfig
source src/southbridge/intel/i82801cx/Kconfig
source src/southbridge/intel/i82801dx/Kconfig
source src/southbridge/intel/i82801ex/Kconfig
source src/southbridge/intel/i82801gx/Kconfig
source src/southbridge/intel/i82801ix/Kconfig
source src/southbridge/intel/i82870/Kconfig
source src/southbridge/intel/pxhd/Kconfig
source src/southbridge/intel/sch/Kconfig
source src/southbridge/intel/bd82x6x/Kconfig
source src/southbridge/intel/lynxpoint/Kconfig
```

## src/southbridge/intel/bd82x6x/Kconfig
```kconfig
## SPDX-License-Identifier: GPL-2.0-only

config SOUTHBRIDGE_INTEL_BD82X6X
	bool

config SOUTHBRIDGE_INTEL_C216
	bool

if SOUTHBRIDGE_INTEL_BD82X6X || SOUTHBRIDGE_INTEL_C216

config SOUTH_BRIDGE_OPTIONS
	def_bool y
	select ACPI_INTEL_HARDWARE_SLEEP_VALUES
	select ACPI_SOC_NVS
	select AZALIA_PLUGIN_SUPPORT
	select SOUTHBRIDGE_INTEL_COMMON_FINALIZE
	select SOUTHBRIDGE_INTEL_COMMON_RCBA_PIRQ
	select SOUTHBRIDGE_INTEL_COMMON_SMBUS
	select SOUTHBRIDGE_INTEL_COMMON_EARLY_SMBUS
	select SOUTHBRIDGE_INTEL_COMMON_SPI_ICH9
	select SOUTHBRIDGE_INTEL_COMMON_ME
	select SOUTHBRIDGE_INTEL_COMMON_PMCLIB
	select SOUTHBRIDGE_INTEL_COMMON_PMBASE
	select SOUTHBRIDGE_INTEL_COMMON_RTC
	select SOUTHBRIDGE_INTEL_COMMON_RESET
	select HAVE_USBDEBUG_OPTIONS
	select HAVE_SMI_HANDLER
	select USE_WATCHDOG_ON_BOOT
	select PCIEXP_ASPM
	select PCIEXP_COMMON_CLOCK
	select INTEL_DESCRIPTOR_MODE_CAPABLE
	select SOUTHBRIDGE_INTEL_COMMON_GPIO
	select RTC
	select HAVE_INTEL_CHIPSET_LOCKDOWN
	select SOUTHBRIDGE_INTEL_COMMON_SMM
	select SOUTHBRIDGE_INTEL_COMMON_ACPI_MADT
	select SOUTHBRIDGE_INTEL_COMMON_WATCHDOG
	select SOUTHBRIDGE_INTEL_COMMON_USB_DEBUG
	select TCO_SPACE_NOT_YET_SPLIT

config EHCI_BAR
	hex
	default 0xfef00000

config DRAM_RESET_GATE_GPIO
	int
	default 60

config SERIRQ_CONTINUOUS_MODE
	bool
	default n
	help
	  If you set this option to y, the serial IRQ machine will be
	  operated in continuous mode.

config HPET_MIN_TICKS
	default 0x80

config HIDE_MEI_ON_ERROR
	bool "Hide MEI device on error"
	default n
	help
	  If you enable this option, the Management Engine Interface
	  device will be hidden when ME is in an inoperable mode, e.g.
	  if me_cleaner was used.

config PCIEXP_HOTPLUG
	default y

endif
```
