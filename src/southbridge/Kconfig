## src/southbridge/Kconfig
```kconfig
source src/southbridge/amd/Kconfig
source src/southbridge/broadcom/Kconfig
source src/southbridge/dmp/Kconfig
source src/southbridge/intel/Kconfig
source src/southbridge/nvidia/Kconfig
source src/southbridge/rdc/Kconfig
source src/southbridge/ricoh/Kconfig
source src/southbridge/sis/Kconfig
source src/southbridge/ti/Kconfig
source src/southbridge/via/Kconfig
```

## src/southbridge/amd/Kconfig
```kconfig
source src/southbridge/amd/amd8111/Kconfig
source src/southbridge/amd/amd8131/Kconfig
source src/southbridge/amd/cs5536/Kconfig
source src/southbridge/amd/amd8132/Kconfig
source src/southbridge/amd/amd8151/Kconfig
source src/southbridge/amd/cs5535/Kconfig
source src/southbridge/amd/rs690/Kconfig
source src/southbridge/amd/sb600/Kconfig
source src/southbridge/amd/rs780/Kconfig
source src/southbridge/amd/sb700/Kconfig
source src/southbridge/amd/sb800/Kconfig
source src/southbridge/amd/cimx/Kconfig
source src/southbridge/amd/agesa/Kconfig
source src/southbridge/amd/pi/Kconfig
source src/southbridge/amd/sr5650/Kconfig
```

## src/southbridge/amd/agesa/Kconfig
```kconfig
# SPDX-License-Identifier: GPL-2.0-only

source "src/southbridge/amd/agesa/hudson/Kconfig"
```

## src/southbridge/amd/agesa/hudson/Kconfig
```kconfig
# SPDX-License-Identifier: GPL-2.0-only

config SOUTHBRIDGE_AMD_AGESA_HUDSON
	bool

config SOUTHBRIDGE_AMD_AGESA_YANGTZE
	bool

if SOUTHBRIDGE_AMD_AGESA_HUDSON || SOUTHBRIDGE_AMD_AGESA_YANGTZE

config SOUTHBRIDGE_SPECIFIC_OPTIONS
	def_bool y
	select HAVE_USBDEBUG_OPTIONS
	select HAVE_CF9_RESET
	select HAVE_CF9_RESET_PREPARE
	select SOC_AMD_COMMON
	select SOC_AMD_COMMON_BLOCK_ACPIMMIO
	select SOC_AMD_COMMON_BLOCK_ACPIMMIO_BIOSRAM
	select SOC_AMD_COMMON_BLOCK_PCI_MMCONF
	select BOOT_DEVICE_SUPPORTS_WRITES

config EHCI_BAR
	hex
	default 0xfef00000

config HUDSON_XHCI_ENABLE
	bool "Enable Hudson XHCI Controller"
	default y if HUDSON_XHCI_FWM
	help
	  The XHCI controller must be enabled and the XHCI firmware
	  must be added in order to have USB 3.0 support configured
	  by coreboot. The OS will be responsible for enabling the XHCI
	  controller if the XHCI firmware is available but the
	  XHCI controller is not enabled by coreboot.

config HUDSON_XHCI_FWM
	bool "Add xhci firmware"
	default y if USE_BLOBS
	help
	  Add Hudson 2/3/4 XHCI Firmware to support the onboard USB 3.0

config HUDSON_IMC_ENABLE
	bool
	default n

config HUDSON_IMC_FWM
	bool "Add IMC firmware"
	depends on HUDSON_IMC_ENABLE
	default y if USE_BLOBS
	select SPI_FLASH_HAS_VOLATILE_GROUP if SPI_FLASH
	help
	  Add Hudson 2/3/4 IMC Firmware to support the onboard fan control

config HUDSON_GEC_FWM
	bool
	default n
	help
	  Add Hudson 2/3/4 GEC Firmware to support the onboard gigabit Ethernet MAC.
	  Must be connected to a Broadcom B50610 or B50610M PHY on the motherboard.

config HUDSON_XHCI_FWM_FILE
	string "XHCI firmware path and filename"
	default "3rdparty/blobs/southbridge/amd/hudson/xhci.bin" if SOUTHBRIDGE_AMD_AGESA_HUDSON
	default "3rdparty/blobs/southbridge/amd/yangtze/xhci.bin" if SOUTHBRIDGE_AMD_AGESA_YANGTZE
	depends on HUDSON_XHCI_FWM

config HUDSON_IMC_FWM_FILE
	string "IMC firmware path and filename"
	default "3rdparty/blobs/southbridge/amd/hudson/imc.bin" if SOUTHBRIDGE_AMD_AGESA_HUDSON
	default "3rdparty/blobs/southbridge/amd/yangtze/imc.bin" if SOUTHBRIDGE_AMD_AGESA_YANGTZE
	depends on HUDSON_IMC_FWM

config HUDSON_GEC_FWM_FILE
	string "GEC firmware path and filename"
	default "3rdparty/blobs/southbridge/amd/hudson/gec.bin"  if SOUTHBRIDGE_AMD_AGESA_HUDSON
	default "3rdparty/blobs/southbridge/amd/yangtze/gec.bin"  if SOUTHBRIDGE_AMD_AGESA_YANGTZE
	depends on HUDSON_GEC_FWM

config HUDSON_SATA_MODE
	int "SATA Mode"
	default 2
	range 0 6
	help
	  Select the mode in which SATA should be driven. NATIVE AHCI, or RAID.
	  The default is NATIVE.
	  0: NATIVE mode does not require a ROM.
	  1: RAID mode must have the two ROM files.
	  2: AHCI may work with or without AHCI ROM. It depends on the payload support.
	     For example, seabios does not require the AHCI ROM.
	  3: LEGACY IDE
	  4: IDE to AHCI
	  5: AHCI7804: ROM Required, and AMD driver required in the OS.
	  6: IDE to AHCI7804: ROM Required, and AMD driver required in the OS.

comment "NATIVE"
	depends on HUDSON_SATA_MODE = 0

comment "RAID"
	depends on HUDSON_SATA_MODE = 1

comment "AHCI"
	depends on HUDSON_SATA_MODE = 2

comment "LEGACY IDE"
	depends on HUDSON_SATA_MODE = 3

comment "IDE to AHCI"
	depends on HUDSON_SATA_MODE = 4

comment "AHCI7804"
	depends on HUDSON_SATA_MODE = 5

comment "IDE to AHCI7804"
	depends on HUDSON_SATA_MODE = 6

if HUDSON_SATA_MODE = 2 || HUDSON_SATA_MODE = 5

config AHCI_ROM_ID
	string  "AHCI device PCI IDs"
	default "1022,7801" if HUDSON_SATA_MODE = 2
	default "1022,7804" if HUDSON_SATA_MODE = 5

config HUDSON_AHCI_ROM
	bool "Add a AHCI ROM"

config AHCI_ROM_FILE
	string "AHCI ROM path and filename"
	depends on HUDSON_AHCI_ROM
	default "src/southbridge/amd/agesa/hudson/ahci.bin"

endif

if HUDSON_SATA_MODE = 1

config RAID_ROM_ID
	string "RAID device PCI IDs"
	default "1022,7802"
	help
	  1022,7802 for SATA NON-RAID5 module, 1022,7803 for SATA RAID5 mode

config RAID_ROM_FILE
	string "RAID ROM path and filename"
	default "src/southbridge/amd/agesa/hudson/raid.bin"

config RAID_MISC_ROM_FILE
	string "RAID Misc ROM path and filename"
	default "src/southbridge/amd/agesa/hudson/misc.bin"

config RAID_MISC_ROM_POSITION
	hex "RAID Misc ROM Position"
	default 0xFFF00000
	help
	  The RAID ROM requires that the MISC ROM is located between the range
	  0xFFF0_0000 to 0xFFF0_FFFF. Also, it must 1K bytes aligned.
	  The CONFIG_ROM_SIZE must be larger than 0x100000.

endif

config HUDSON_LEGACY_FREE
	bool "System is legacy free"
	help
	  Select y if there is no keyboard controller in the system.
	  This sets variables in AGESA and ACPI.

config ACPI_ENABLE_THERMAL_ZONE
	bool
	default y

endif # SOUTHBRIDGE_AMD_AGESA_HUDSON || SOUTHBRIDGE_AMD_AGESA_YANGTZE

if SOUTHBRIDGE_AMD_AGESA_YANGTZE
	config AZ_PIN
		hex
		default 0xaa
		help
		  bit 1,0 - pin 0
		  bit 3,2 - pin 1
		  bit 5,4 - pin 2
		  bit 7,6 - pin 3
endif
```

## src/southbridge/amd/cimx/Kconfig
```kconfig
# SPDX-License-Identifier: GPL-2.0-only

config AMD_SB_CIMX
	bool
	default n

source "src/southbridge/amd/cimx/sb800/Kconfig"
```

## src/southbridge/amd/cimx/sb700/Kconfig
```kconfig
##
## This file is part of the coreboot project.
##
## Copyright (C) 2012 Advanced Micro Devices, Inc.
##
## This program is free software; you can redistribute it and/or modify
## it under the terms of the GNU General Public License as published by
## the Free Software Foundation; version 2 of the License.
##
## This program is distributed in the hope that it will be useful,
## but WITHOUT ANY WARRANTY; without even the implied warranty of
## MERCHANTABILITY or FITNESS FOR A PARTICULAR PURPOSE.  See the
## GNU General Public License for more details.
##
## You should have received a copy of the GNU General Public License
## along with this program; if not, write to the Free Software
## Foundation, Inc., 51 Franklin St, Fifth Floor, Boston, MA 02110-1301 USA
##

config SOUTHBRIDGE_AMD_CIMX_SB700
	bool
	select IOAPIC
	select HAVE_USBDEBUG
	select AMD_SB_CIMX
	select HAVE_HARD_RESET

if SOUTHBRIDGE_AMD_CIMX_SB700
config SATA_CONTROLLER_MODE
	hex
	default 0x0
	help
		0x0 = Native IDE mode.
		0x1 = RAID mode.
		0x2 = AHCI mode.
		0x3 = Legacy IDE mode.
		0x4 = IDE->AHCI mode.
		0x5 = AHCI mode as 7804 ID (AMD driver).
		0x6 = IDE->AHCI mode as 7804 ID (AMD driver).

config PCIB_ENABLE
	bool
	default n
	help
		n = Disable PCI Bridge Device 14 Function 4.
		y = Enable PCI Bridge Device 14 Function 4.

config ACPI_SCI_IRQ
	hex
	default 0x9
	help
		Set SCI IRQ to 9.

config EHCI_BAR
	hex
	default 0xfef00000

config EHCI_DEBUG_OFFSET
	hex
	default 0xe0

config BOOTBLOCK_SOUTHBRIDGE_INIT
	string
	default "southbridge/amd/cimx/sb700/bootblock.c"

config REDIRECT_SBCIMX_TRACE_TO_SERIAL
	bool "Redirect AMD Southbridge CIMX Trace to serial console"
	default n
	help
	  This Option allows you to redirect the AMD Southbridge CIMX Trace
	  debug information to the serial console.

	  Warning: Only enable this option when debuging or tracing AMD CIMX code.

config S3_DATA_POS
	hex "S3 volatile storage position"
	default 0xFFFF0000
	depends on HAVE_ACPI_RESUME
	help
	  For a system with S3 feature, the BIOS needs to save some data to
	  non-volatile storage at cold boot stage.

config S3_DATA_SIZE
	int "S3 volatile storage size"
	default 32768
	depends on HAVE_ACPI_RESUME
	help
	  For a system with S3 feature, the BIOS needs to save some data to
	  non-volatile storage at cold boot stage.

endif #SOUTHBRIDGE_AMD_CIMX_SB700
```

## src/southbridge/amd/cimx/sb800/Kconfig
```kconfig
# SPDX-License-Identifier: GPL-2.0-only

config SOUTHBRIDGE_AMD_CIMX_SB800
	bool
	default n
	select HAVE_USBDEBUG_OPTIONS
	select AMD_SB_CIMX
	select HAVE_CF9_RESET
	select HAVE_CF9_RESET_PREPARE
	select SOC_AMD_COMMON
	select SOC_AMD_COMMON_BLOCK_ACPIMMIO
	select SOC_AMD_COMMON_BLOCK_ACPIMMIO_BIOSRAM
	select SOC_AMD_COMMON_BLOCK_PCI_MMCONF
	select BOOT_DEVICE_SUPPORTS_WRITES

if SOUTHBRIDGE_AMD_CIMX_SB800
config ENABLE_IDE_COMBINED_MODE
	bool "Enable SATA IDE combined mode"
	default n
	help
	  If Combined Mode is enabled. IDE controller is exposed and
	  SATA controller has control over Port0 through Port3,
	  IDE controller has control over Port4 and Port5.

	  If Combined Mode is disabled, IDE controller is hidden and
	  SATA controller has full control of all 6 Ports when operating in non-IDE mode.

config IDE_COMBINED_MODE
	hex
	default 0x0 if ENABLE_IDE_COMBINED_MODE
	default 0x1 if !ENABLE_IDE_COMBINED_MODE

choice
	prompt "SATA Mode"
	default SB800_SATA_AHCI
	help
	  Select the mode in which SATA should be driven. NATIVE AHCI, or RAID.
	  The default is AHCI.

config SB800_SATA_IDE
	bool "NATIVE"
	help
	  NATIVE does not require a ROM.

config SB800_SATA_AHCI
	bool "AHCI"
	help
	  AHCI is the default and may work with or without AHCI ROM. It depends on the payload support.
	  For example, seabios does not require the AHCI ROM.

config SB800_SATA_RAID
	bool "RAID"
	help
	  sb800 RAID mode must have the two required ROM files.

endchoice

config SB800_SATA_MODE
	hex
	depends on (SB800_SATA_IDE || SB800_SATA_RAID || SB800_SATA_AHCI)
	default 0x0 if SB800_SATA_IDE
	default 0x1 if SB800_SATA_RAID
	default 0x2 if SB800_SATA_AHCI

config SB_SUPERIO_HWM
	bool
	default n

if SB800_SATA_AHCI
config AHCI_ROM_ID
	string "AHCI device PCI IDs"
	default "1002,4391"

config SB800_AHCI_ROM
	bool "Add a AHCI ROM"

config AHCI_ROM_FILE
	string "AHCI ROM path and filename"
	depends on SB800_AHCI_ROM
	default "site-local/sb800/ahci.bin"
endif

if SB800_SATA_RAID
config RAID_ROM_ID
	string "RAID device PCI IDs"
	default "1002,4393"
	help
	  1002,4392 for SATA NON-RAID5 module, 1002,4393 for SATA RAID5 mode

config RAID_ROM_FILE
	string "RAID ROM path and filename"
	depends on SB800_SATA_RAID
	default "site-local/sb800/raid.bin"

config RAID_MISC_ROM_FILE
	string "RAID Misc ROM path and filename"
	default "site-local/sb800/misc.bin"
	depends on SB800_SATA_RAID

config RAID_MISC_ROM_POSITION
	hex "RAID Misc ROM Position"
	default 0xFFF00000
	depends on SB800_SATA_RAID
	help
	  The RAID ROM requires that the MISC ROM is located between the range
	  0xFFF0_0000 to 0xFFF0_FFFF. Also, it must 1K bytes aligned.
	  The CONFIG_ROM_SIZE must larger than 0x100000.

endif

config SB800_IMC_FWM
	bool "Add IMC firmware"
	default n
	select SPI_FLASH_HAS_VOLATILE_GROUP if SPI_FLASH
	help
	  Add SB800 / Hudson 1 IMC Firmware to support the onboard fan control.

if SB800_IMC_FWM

config SB800_IMC_FWM_FILE
	string "IMC firmware path and filename"
	default "3rdparty/blobs/southbridge/amd/sb800/imc.bin"

choice
	prompt "SB800 Firmware ROM Position"

config SB800_FWM_AT_FFFA0000
	bool "0xFFFA0000"
	help
	  The IMC and GEC ROMs requires a 'signature' located at one of several
	  fixed locations in memory.  The location used shouldn't matter, just
	  select an area that doesn't conflict with anything else.

config SB800_FWM_AT_FFF20000
	bool "0xFFF20000"
	help
	  The IMC and GEC ROMs requires a 'signature' located at one of several
	  fixed locations in memory.  The location used shouldn't matter, just
	  select an area that doesn't conflict with anything else.

config SB800_FWM_AT_FFE20000
	depends on BOARD_ROMSIZE_KB_8192 || BOARD_ROMSIZE_KB_4096 || BOARD_ROMSIZE_KB_2048
	bool "0xFFE20000"
	help
	  The IMC and GEC ROMs requires a 'signature' located at one of several
	  fixed locations in memory.  The location used shouldn't matter, just
	  select an area that doesn't conflict with anything else.

config SB800_FWM_AT_FFC20000
	depends on BOARD_ROMSIZE_KB_8192 || BOARD_ROMSIZE_KB_4096
	bool "0xFFC20000"
	help
	  The IMC and GEC ROMs requires a 'signature' located at one of several
	  fixed locations in memory.  The location used shouldn't matter, just
	  select an area that doesn't conflict with anything else.

config SB800_FWM_AT_FF820000
	depends on BOARD_ROMSIZE_KB_8192
	bool "0xFF820000"
	help
	  The IMC and GEC ROMs requires a 'signature' located at one of several
	  fixed locations in memory.  The location used shouldn't matter, just
	  select an area that doesn't conflict with anything else.

endchoice

config SB800_FWM_POSITION
	hex
	default 0xFFFA0000 if SB800_FWM_AT_FFFA0000
	default 0xFFF20000 if SB800_FWM_AT_FFF20000
	default 0xFFE20000 if SB800_FWM_AT_FFE20000
	default 0xFFC20000 if SB800_FWM_AT_FFC20000
	default 0xFF820000 if SB800_FWM_AT_FF820000

endif  #SB800_IMC_FWM

config EHCI_BAR
	hex
	default 0xfef00000

choice
	prompt "Fan Control"
	default SB800_NO_FAN_CONTROL
	help
	  Select the method of SB800 fan control to be used.  None would be
	  for either fixed maximum speed fans connected to the SB800 or for
	  an external chip controlling the fan speeds.  Manual control sets
	  up the SB800 fan control registers.  IMC fan control uses the SB800
	  IMC to actively control the fan speeds.

config SB800_NO_FAN_CONTROL
	bool "None"
	help
	  No SB800 Fan control - Do not set up the SB800 fan control registers.

config SB800_MANUAL_FAN_CONTROL
	bool "Manual"
	help
	  Configure the SB800 fan control registers in devicetree.cb.

config SB800_IMC_FAN_CONTROL
	bool "IMC Based"
	depends on SB800_IMC_FWM
	help
	  Set up the SB800 to use the IMC based Fan controller.  This requires
	  the IMC ROM from AMD.  Configure the registers in devicetree.cb.

endchoice

endif #SOUTHBRIDGE_AMD_CIMX_SB800
```
