## src/southbridge/intel/fsp_rangeley/Kconfig
```kconfig
##
## This file is part of the coreboot project.
##
## Copyright (C) 2011 Google Inc.
## Copyright (C) 2013-2014 Sage Electronic Engineering, LLC.
##
## This program is free software; you can redistribute it and/or modify
## it under the terms of the GNU General Public License as published by
## the Free Software Foundation; version 2 of the License.
##
## This program is distributed in the hope that it will be useful,
## but WITHOUT ANY WARRANTY; without even the implied warranty of
## MERCHANTABILITY or FITNESS FOR A PARTICULAR PURPOSE.  See the
## GNU General Public License for more details.
##

config SOUTHBRIDGE_INTEL_FSP_RANGELEY
	bool

if SOUTHBRIDGE_INTEL_FSP_RANGELEY

config SOUTH_BRIDGE_OPTIONS # dummy
	def_bool y
	select ACPI_INTEL_HARDWARE_SLEEP_VALUES
	select IOAPIC
	select HAVE_HARD_RESET
	select HAVE_USBDEBUG
	select USE_WATCHDOG_ON_BOOT
	select PCIEXP_ASPM
	select PCIEXP_COMMON_CLOCK
	select SPI_FLASH
	select INTEL_DESCRIPTOR_MODE_CAPABLE
	select SOUTHBRIDGE_INTEL_COMMON
	select SOUTHBRIDGE_INTEL_COMMON_SMBUS

config EHCI_BAR
	hex
	default 0xfef00000

config SERIRQ_CONTINUOUS_MODE
	bool
	default n
	help
	  If you set this option to y, the serial IRQ machine will be
	  operated in continuous mode.

config HPET_MIN_TICKS
	hex
	default 0x80

config IFD_BIN_PATH
	string
	depends on HAVE_IFD_BIN
	default "../intel/mainboard/intel/rangeley"
	help
	  The path and filename to the descriptor.bin file.

endif
```

## src/southbridge/intel/i3100/Kconfig
```kconfig
config SOUTHBRIDGE_INTEL_I3100
	bool
	select IOAPIC
	select HAVE_HARD_RESET
	select SOUTHBRIDGE_INTEL_COMMON
	select SOUTHBRIDGE_INTEL_COMMON_SMBUS

if SOUTHBRIDGE_INTEL_I3100

config HPET_MIN_TICKS
	hex
	default 0x90

endif
```

## src/southbridge/intel/i82371eb/Kconfig
```kconfig
config SOUTHBRIDGE_INTEL_I82371EB
	select ACPI_COMMON_MADT_IOAPIC if SMP
	select ACPI_COMMON_MADT_LAPIC if SMP
	select ACPI_NO_CUSTOM_MADT
	select ACPI_INTEL_HARDWARE_SLEEP_VALUES
	select SOUTHBRIDGE_INTEL_COMMON_SMBUS
	select SOUTHBRIDGE_INTEL_COMMON_RTC
	select SOUTHBRIDGE_INTEL_COMMON_RESET
	select BOOT_DEVICE_NOT_SPI_FLASH
	bool
```

## src/southbridge/intel/i82801cx/Kconfig
```kconfig
config SOUTHBRIDGE_INTEL_I82801CX
	bool
	select IOAPIC if !DRIVERS_GENERIC_IOAPIC
	select HAVE_HARD_RESET
```

## src/southbridge/intel/i82801dx/Kconfig
```kconfig
# SPDX-License-Identifier: GPL-2.0-only

config SOUTHBRIDGE_INTEL_I82801DX
	bool
	select ACPI_INTEL_HARDWARE_SLEEP_VALUES
	select HAVE_SMI_HANDLER
	select SOUTHBRIDGE_INTEL_COMMON_SMBUS
	select SOUTHBRIDGE_INTEL_COMMON_SMM
	select SOUTHBRIDGE_INTEL_COMMON_EARLY_SMBUS
	select SOUTHBRIDGE_INTEL_COMMON_RTC
	select SOUTHBRIDGE_INTEL_COMMON_RESET
	select SOUTHBRIDGE_INTEL_COMMON_USB_DEBUG
	select HAVE_POWER_STATE_AFTER_FAILURE
	select HAVE_POWER_STATE_PREVIOUS_AFTER_FAILURE
	select BOOT_DEVICE_NOT_SPI_FLASH
	select TCO_SPACE_NOT_YET_SPLIT

if SOUTHBRIDGE_INTEL_I82801DX

config EHCI_BAR
	hex
	default 0xfef00000

endif
```

## src/southbridge/intel/i82801ex/Kconfig
```kconfig
config SOUTHBRIDGE_INTEL_I82801EX
	bool
	select SOUTHBRIDGE_INTEL_COMMON
	select IOAPIC
	select HAVE_HARD_RESET
	select HAVE_USBDEBUG

if SOUTHBRIDGE_INTEL_I82801EX

config EHCI_BAR
	hex
	default 0xfef00000

endif
```

## src/southbridge/intel/i82801gx/Kconfig
```kconfig
# SPDX-License-Identifier: GPL-2.0-only

config SOUTHBRIDGE_INTEL_I82801GX
	bool
	select ACPI_INTEL_HARDWARE_SLEEP_VALUES
	select ACPI_SOC_NVS
	select AZALIA_PLUGIN_SUPPORT
	select USE_WATCHDOG_ON_BOOT
	select HAVE_SMI_HANDLER
	select SOUTHBRIDGE_INTEL_COMMON_GPIO
	select SOUTHBRIDGE_INTEL_COMMON_SMBUS
	select SOUTHBRIDGE_INTEL_COMMON_EARLY_SMBUS
	select SOUTHBRIDGE_INTEL_COMMON_SPI_ICH7 if BOOT_DEVICE_SPI_FLASH
	select SOUTHBRIDGE_INTEL_COMMON_PMCLIB
	select SOUTHBRIDGE_INTEL_COMMON_PMBASE
	select HAVE_INTEL_CHIPSET_LOCKDOWN
	select SOUTHBRIDGE_INTEL_COMMON_RCBA_PIRQ
	select INTEL_HAS_TOP_SWAP
	select SOUTHBRIDGE_INTEL_COMMON_SMM
	select SOUTHBRIDGE_INTEL_COMMON_WATCHDOG
	select SOUTHBRIDGE_INTEL_COMMON_RTC
	select SOUTHBRIDGE_INTEL_COMMON_RESET
	select SOUTHBRIDGE_INTEL_COMMON_USB_DEBUG
	select SOUTHBRIDGE_INTEL_COMMON_HPET
	select TCO_SPACE_NOT_YET_SPLIT

if SOUTHBRIDGE_INTEL_I82801GX

config EHCI_BAR
	hex
	default 0xfef00000

config HPET_MIN_TICKS
	default 0x80

config INTEL_TOP_SWAP_BOOTBLOCK_SIZE
	hex
	# Always 64K, all other options are invalid
	default 0x10000

endif
```

## src/southbridge/intel/i82801hx/Kconfig
```kconfig
# SPDX-License-Identifier: GPL-2.0-only

config SOUTHBRIDGE_INTEL_I82801HX
	bool
	select ACPI_COMMON_MADT_IOAPIC
	select ACPI_COMMON_MADT_LAPIC
	select ACPI_INTEL_HARDWARE_SLEEP_VALUES
	select ACPI_SOC_NVS
	select AZALIA_HDA_CODEC_SUPPORT
	select HAVE_INTEL_CHIPSET_LOCKDOWN
	select HAVE_SMI_HANDLER
	select HAVE_USBDEBUG_OPTIONS
	select INTEL_DESCRIPTOR_MODE_CAPABLE
	select SOUTHBRIDGE_INTEL_COMMON_EARLY_SMBUS
	select SOUTHBRIDGE_INTEL_COMMON_GPIO
	select SOUTHBRIDGE_INTEL_COMMON_HPET
	select SOUTHBRIDGE_INTEL_COMMON_PMBASE
	select SOUTHBRIDGE_INTEL_COMMON_PMCLIB
	select SOUTHBRIDGE_INTEL_COMMON_RCBA_PIRQ
	select SOUTHBRIDGE_INTEL_COMMON_RESET
	select SOUTHBRIDGE_INTEL_COMMON_RTC
	select SOUTHBRIDGE_INTEL_COMMON_SMBUS
	select SOUTHBRIDGE_INTEL_COMMON_SMM
	select SOUTHBRIDGE_INTEL_COMMON_SPI_ICH9
	select SOUTHBRIDGE_INTEL_COMMON_USB_DEBUG
	select SOUTHBRIDGE_INTEL_COMMON_WATCHDOG
	select TCO_SPACE_NOT_YET_SPLIT
	select USE_WATCHDOG_ON_BOOT
	select INTEL_HAS_TOP_SWAP

if SOUTHBRIDGE_INTEL_I82801HX

config EHCI_BAR
	hex
	default 0xfef00000

config HPET_MIN_TICKS
	default 0x80

endif
```

## src/southbridge/intel/i82801ix/Kconfig
```kconfig
##
## This file is part of the coreboot project.
##
## Copyright (C) 2008-2009 coresystems GmbH
##               2012 secunet security Networks AG
##
## This program is free software; you can redistribute it and/or modify
## it under the terms of the GNU General Public License as published by
## the Free Software Foundation; version 2 of the License.
##
## This program is distributed in the hope that it will be useful,
## but WITHOUT ANY WARRANTY; without even the implied warranty of
## MERCHANTABILITY or FITNESS FOR A PARTICULAR PURPOSE.  See the
## GNU General Public License for more details.
##

config SOUTHBRIDGE_INTEL_I82801IX
	bool
	select SOUTHBRIDGE_INTEL_COMMON
	select SOUTHBRIDGE_INTEL_COMMON_SMBUS
	select SOUTHBRIDGE_INTEL_COMMON_RCBA_PIRQ
	select IOAPIC
	select HAVE_USBDEBUG
	select HAVE_HARD_RESET
	select USE_WATCHDOG_ON_BOOT
	select HAVE_SMI_HANDLER
	select HAVE_USBDEBUG_OPTIONS
	select SOUTHBRIDGE_INTEL_COMMON_GPIO
	select SOUTHBRIDGE_INTEL_COMMON_SMM
	select INTEL_DESCRIPTOR_MODE_CAPABLE
	select ACPI_INTEL_HARDWARE_SLEEP_VALUES

if SOUTHBRIDGE_INTEL_I82801IX

config EHCI_BAR
	hex
	default 0xfef00000

## Some enterprise variants may require an IFD
config INTEL_DESCRIPTOR_MODE_REQUIRED
	bool
	default n

config HPET_MIN_TICKS
	hex
	default 0x80

config BOOTBLOCK_SOUTHBRIDGE_INIT
	string
	default "southbridge/intel/i82801ix/bootblock.c"

endif
```

## src/southbridge/intel/i82801jx/Kconfig
```kconfig
# SPDX-License-Identifier: GPL-2.0-only

config SOUTHBRIDGE_INTEL_I82801JX
	bool
	select ACPI_INTEL_HARDWARE_SLEEP_VALUES
	select AZALIA_PLUGIN_SUPPORT
	select HAVE_POWER_STATE_AFTER_FAILURE
	select HAVE_POWER_STATE_PREVIOUS_AFTER_FAILURE
	select HAVE_SMI_HANDLER
	select HAVE_USBDEBUG_OPTIONS
	select INTEL_DESCRIPTOR_MODE_CAPABLE
	select SOUTHBRIDGE_INTEL_COMMON_GPIO
	select SOUTHBRIDGE_INTEL_COMMON_PMBASE
	select SOUTHBRIDGE_INTEL_COMMON_PMCLIB
	select SOUTHBRIDGE_INTEL_COMMON_RCBA_PIRQ
	select SOUTHBRIDGE_INTEL_COMMON_RESET
	select SOUTHBRIDGE_INTEL_COMMON_RTC
	select SOUTHBRIDGE_INTEL_COMMON_SMBUS
	select SOUTHBRIDGE_INTEL_COMMON_EARLY_SMBUS
	select SOUTHBRIDGE_INTEL_COMMON_SMM
	select SOUTHBRIDGE_INTEL_COMMON_SPI_ICH9
	select SOUTHBRIDGE_INTEL_COMMON_USB_DEBUG
	select SOUTHBRIDGE_INTEL_COMMON_WATCHDOG
	select TCO_SPACE_NOT_YET_SPLIT
	select USE_WATCHDOG_ON_BOOT

if SOUTHBRIDGE_INTEL_I82801JX

config EHCI_BAR
	hex
	default 0xfef00000

config HPET_MIN_TICKS
	default 0x80

## Some enterprise variants may require an IFD
config INTEL_DESCRIPTOR_MODE_REQUIRED
	bool
	default n

config PCIEXP_HOTPLUG
	default y

endif
```

## src/southbridge/intel/ibexpeak/Kconfig
```kconfig
##
## This file is part of the coreboot project.
##
## Copyright (C) 2011 Google Inc.
##
## This program is free software; you can redistribute it and/or modify
## it under the terms of the GNU General Public License as published by
## the Free Software Foundation; version 2 of the License.
##
## This program is distributed in the hope that it will be useful,
## but WITHOUT ANY WARRANTY; without even the implied warranty of
## MERCHANTABILITY or FITNESS FOR A PARTICULAR PURPOSE.  See the
## GNU General Public License for more details.
##

config SOUTHBRIDGE_INTEL_IBEXPEAK
	bool

if SOUTHBRIDGE_INTEL_IBEXPEAK

config SOUTH_BRIDGE_OPTIONS # dummy
	def_bool y
	select ACPI_INTEL_HARDWARE_SLEEP_VALUES
	select IOAPIC
	select HAVE_HARD_RESET
	select HAVE_USBDEBUG
	select HAVE_SMI_HANDLER
	select USE_WATCHDOG_ON_BOOT
	select PCIEXP_ASPM
	select PCIEXP_COMMON_CLOCK
	select SOUTHBRIDGE_INTEL_COMMON
	select SOUTHBRIDGE_INTEL_COMMON_RCBA_PIRQ
	select SOUTHBRIDGE_INTEL_COMMON_SMBUS
	select SOUTHBRIDGE_INTEL_COMMON_SPI
	select HAVE_USBDEBUG_OPTIONS
	select COMMON_FADT
	select ACPI_SATA_GENERATOR
	select INTEL_DESCRIPTOR_MODE_CAPABLE
	select SOUTHBRIDGE_INTEL_COMMON_GPIO
	select HAVE_INTEL_CHIPSET_LOCKDOWN

config EHCI_BAR
	hex
	default 0xfef00000

config DRAM_RESET_GATE_GPIO
	int
	default 60

config BOOTBLOCK_SOUTHBRIDGE_INIT
	string
	default "southbridge/intel/bd82x6x/bootblock.c"

config SERIRQ_CONTINUOUS_MODE
	bool
	default n
	help
	  If you set this option to y, the serial IRQ machine will be
	  operated in continuous mode.

config HPET_MIN_TICKS
	hex
	default 0x80

endif
```

## src/southbridge/intel/lynxpoint/Kconfig
```kconfig
## SPDX-License-Identifier: GPL-2.0-only

config SOUTHBRIDGE_INTEL_LYNXPOINT
	bool

if SOUTHBRIDGE_INTEL_LYNXPOINT

config SOUTH_BRIDGE_OPTIONS
	def_bool y
	select ACPI_INTEL_HARDWARE_SLEEP_VALUES
	select ACPI_SOC_NVS
	select AZALIA_PLUGIN_SUPPORT
	select SOUTHBRIDGE_INTEL_COMMON_SMBUS
	select SOUTHBRIDGE_INTEL_COMMON_EARLY_SMBUS
	select SOUTHBRIDGE_INTEL_COMMON_SPI_ICH9
	select SOUTHBRIDGE_INTEL_COMMON_ACPI_MADT
	select SOUTHBRIDGE_INTEL_COMMON_FINALIZE
	select SOUTHBRIDGE_INTEL_COMMON_PMCLIB
	select SOUTHBRIDGE_INTEL_COMMON_PMBASE
	select SOUTHBRIDGE_INTEL_COMMON_RTC
	select SOUTHBRIDGE_INTEL_COMMON_RESET
	select HAVE_SMI_HANDLER
	select HAVE_USBDEBUG_OPTIONS
	select USE_WATCHDOG_ON_BOOT
	select PCIEXP_ASPM
	select PCIEXP_COMMON_CLOCK
	select INTEL_DESCRIPTOR_MODE_CAPABLE
	select HAVE_EM100PRO_SPI_CONSOLE_SUPPORT
	select RTC
	select SOUTHBRIDGE_INTEL_COMMON_GPIO if !INTEL_LYNXPOINT_LP
	select SOUTHBRIDGE_INTEL_COMMON_RCBA_PIRQ
	select HAVE_INTEL_CHIPSET_LOCKDOWN
	select HAVE_POWER_STATE_AFTER_FAILURE
	select HAVE_POWER_STATE_PREVIOUS_AFTER_FAILURE
	select SOUTHBRIDGE_INTEL_COMMON_WATCHDOG
	select SOUTHBRIDGE_INTEL_COMMON_USB_DEBUG
	select TCO_SPACE_NOT_YET_SPLIT

config INTEL_LYNXPOINT_LP
	bool
	default n
	help
	  Set this option to y for LynxPoint LP (Haswell ULT).

config EHCI_BAR
	hex
	default 0xe8000000

config SERIRQ_CONTINUOUS_MODE
	bool
	default n
	help
	  If you set this option to y, the serial IRQ machine will be
	  operated in continuous mode.

config HPET_MIN_TICKS
	default 0x80

config FINALIZE_USB_ROUTE_XHCI
	bool "Route all ports to XHCI controller in finalize step"
	default y
	help
	  If you set this option to y, the USB ports will be routed
	  to the XHCI controller during the finalize SMM callback.

config PCIEXP_AER
	bool
	default y

config PCIEXP_CLK_PM
	default y

config PCIEXP_L1_SUB_STATE
	default y

config SERIALIO_UART_CONSOLE
	bool "Use SerialIO UART for console"
	depends on INTEL_LYNXPOINT_LP
	select DRIVERS_UART_8250MEM_32
	help
	  Selected by mainboards where SerialIO UARTs can be used to retrieve
	  coreboot logs. Boards also need to set UART_FOR_CONSOLE accordingly.

config CONSOLE_UART_BASE_ADDRESS
	default 0xd6000000 if SERIALIO_UART_CONSOLE

endif
```

## src/southbridge/intel/sch/Kconfig
```kconfig
##
## This file is part of the coreboot project.
##
## Copyright (C) 2010 coresystems GmbH
##
## This program is free software; you can redistribute it and/or modify
## it under the terms of the GNU General Public License as published by
## the Free Software Foundation; version 2 of the License.
##
## This program is distributed in the hope that it will be useful,
## but WITHOUT ANY WARRANTY; without even the implied warranty of
## MERCHANTABILITY or FITNESS FOR A PARTICULAR PURPOSE.  See the
## GNU General Public License for more details.
##
## You should have received a copy of the GNU General Public License
## along with this program; if not, write to the Free Software
## Foundation, Inc., 51 Franklin St, Fifth Floor, Boston, MA 02110-1301 USA
##

config SOUTHBRIDGE_INTEL_SCH
	bool
	select SOUTHBRIDGE_INTEL_COMMON
	select HAVE_USBDEBUG
	select HAVE_HARD_RESET
	select HAVE_SMI_HANDLER

if SOUTHBRIDGE_INTEL_SCH

config EHCI_BAR
	hex
	default 0xfef00000

config EHCI_DEBUG_OFFSET
	hex
	default 0xa0

config HAVE_CMC
	bool "Add a CMC state machine binary"
	help
	  Select this option to add a CMC state machine binary to
	  the resulting coreboot image.

	  Note: Without this binary coreboot will not work

config CMC_FILE
	string "Intel CMC path and filename"
	depends on HAVE_CMC
	default "cmc.bin"
	help
	  The path and filename of the file to use as CMC state machine
	  binary.

config HPET_MIN_TICKS
        hex
        default 0x80

endif
```

## src/southbridge/nvidia/Kconfig
```kconfig
source src/southbridge/nvidia/ck804/Kconfig
source src/southbridge/nvidia/mcp55/Kconfig
```
