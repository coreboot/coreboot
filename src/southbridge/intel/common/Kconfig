## src/southbridge/intel/common/Kconfig
```kconfig
config SOUTHBRIDGE_INTEL_COMMON
	def_bool n

config SOUTHBRIDGE_INTEL_COMMON_GPIO
	def_bool n

config SOUTHBRIDGE_INTEL_COMMON_SMBUS
	def_bool n
	select HAVE_DEBUG_SMBUS

config SOUTHBRIDGE_INTEL_COMMON_SPI
	def_bool n
	select SPI_FLASH

config SOUTHBRIDGE_INTEL_COMMON_PIRQ_ACPI_GEN
	def_bool n

config SOUTHBRIDGE_INTEL_COMMON_RCBA_PIRQ
	def_bool n
	select SOUTHBRIDGE_INTEL_COMMON_PIRQ_ACPI_GEN

config HAVE_INTEL_CHIPSET_LOCKDOWN
	def_bool n

config SOUTHBRIDGE_INTEL_COMMON_SMM
	def_bool n

config INTEL_DESCRIPTOR_MODE_CAPABLE
	def_bool n
	help
	  This config simply states that the platform is *capable* of running in
	  descriptor mode (when the descriptor in flash is valid).

config INTEL_DESCRIPTOR_MODE_REQUIRED
	def_bool y if INTEL_DESCRIPTOR_MODE_CAPABLE
	help
	  This config states descriptor mode is *required* for the platform to
	  function properly, or to function at all.

config INTEL_CHIPSET_LOCKDOWN
	depends on HAVE_INTEL_CHIPSET_LOCKDOWN && HAVE_SMI_HANDLER && !CHROMEOS
	#ChromeOS's payload seems to handle finalization on its on.
	bool "Lock down chipset in coreboot"
	default y
	help
	  Some registers within host bridge on particular chipsets should be
	  locked down on each normal boot path (done by either coreboot or payload)
	  and S3 resume (always done by coreboot). Select this to let coreboot
	  to do this on normal boot path.
```

## src/southbridge/intel/common/Kconfig.common
```kconfig
config SOUTHBRIDGE_INTEL_COMMON_RESET
	def_bool n
	select HAVE_CF9_RESET

config SOUTHBRIDGE_INTEL_COMMON_RTC
	def_bool n

config SOUTHBRIDGE_INTEL_COMMON_PMCLIB
	def_bool n
	depends on SOUTHBRIDGE_INTEL_COMMON_PMBASE

config SOUTHBRIDGE_INTEL_COMMON_PMBASE
	def_bool n

config SOUTHBRIDGE_INTEL_COMMON_GPIO
	def_bool n

config SOUTHBRIDGE_INTEL_COMMON_ME
	def_bool n

config SOUTHBRIDGE_INTEL_COMMON_HPET
	def_bool n

config SOUTHBRIDGE_INTEL_COMMON_EARLY_SMBUS
	def_bool n

config SOUTHBRIDGE_INTEL_COMMON_SMBUS
	def_bool n
	select HAVE_DEBUG_SMBUS

config SOUTHBRIDGE_INTEL_COMMON_SPI
	def_bool n
	select SPI_FLASH
	select BOOT_DEVICE_SUPPORTS_WRITES

config SOUTHBRIDGE_INTEL_COMMON_SPI_ICH7
	def_bool n
	select SOUTHBRIDGE_INTEL_COMMON_SPI

config SOUTHBRIDGE_INTEL_COMMON_SPI_ICH9
	def_bool n
	select SOUTHBRIDGE_INTEL_COMMON_SPI

config SOUTHBRIDGE_INTEL_COMMON_SPI_SILVERMONT
	def_bool n
	select SOUTHBRIDGE_INTEL_COMMON_SPI

config SOUTHBRIDGE_INTEL_COMMON_PIRQ_ACPI_GEN
	def_bool n

config SOUTHBRIDGE_INTEL_COMMON_RCBA_PIRQ
	def_bool n
	select SOUTHBRIDGE_INTEL_COMMON_PIRQ_ACPI_GEN

config HAVE_INTEL_CHIPSET_LOCKDOWN
	def_bool n

config SOUTHBRIDGE_INTEL_COMMON_SMM
	def_bool n
	select HAVE_POWER_STATE_AFTER_FAILURE
	select HAVE_POWER_STATE_PREVIOUS_AFTER_FAILURE
	select SOUTHBRIDGE_INTEL_COMMON_PMBASE

config SOUTHBRIDGE_INTEL_COMMON_ACPI_MADT
	bool

config SOUTHBRIDGE_INTEL_COMMON_FINALIZE
	bool

config SOUTHBRIDGE_INTEL_COMMON_USB_DEBUG
	def_bool n
	select HAVE_USBDEBUG

config INTEL_DESCRIPTOR_MODE_CAPABLE
	def_bool n
	help
	  This config simply states that the platform is *capable* of running in
	  descriptor mode (when the descriptor in flash is valid).

config INTEL_DESCRIPTOR_MODE_REQUIRED
	def_bool y if INTEL_DESCRIPTOR_MODE_CAPABLE
	help
	  This config states descriptor mode is *required* for the platform to
	  function properly, or to function at all.

config VALIDATE_INTEL_DESCRIPTOR
	depends on INTEL_DESCRIPTOR_MODE_CAPABLE
	bool "Validate Intel firmware descriptor"
	default n
	help
	  This config enables validating the Intel firmware descriptor against the
	  fmap layout. If the firmware descriptor layout does not match the fmap
	  then the bootimage cannot be built.

config INTEL_CHIPSET_LOCKDOWN
	depends on HAVE_INTEL_CHIPSET_LOCKDOWN && HAVE_SMI_HANDLER && !CHROMEOS
	#ChromeOS's payload seems to handle finalization on its on.
	bool "Lock down chipset in coreboot"
	default y
	help
	  Some registers within host bridge on particular chipsets should be
	  locked down on each normal boot path (done by either coreboot or payload)
	  and S3 resume (always done by coreboot). Select this to let coreboot
	  to do this on normal boot path.

config TCO_SPACE_NOT_YET_SPLIT
	bool

config SOUTHBRIDGE_INTEL_COMMON_WATCHDOG
	bool
	depends on SOUTHBRIDGE_INTEL_COMMON_PMBASE

config FIXED_RCBA_MMIO_BASE
	hex
	default 0xfed1c000

config RCBA_LENGTH
	hex
	default 0x4000

config FIXED_SMBUS_IO_BASE
	hex
	depends on SOUTHBRIDGE_INTEL_COMMON_SMBUS
	default 0x400
```

## src/southbridge/intel/common/firmware/Kconfig
```kconfig
# SPDX-License-Identifier: GPL-2.0-only

config HAVE_INTEL_FIRMWARE
	bool
	default y if INTEL_DESCRIPTOR_MODE_CAPABLE
	help
	  Platform uses the Intel Firmware Descriptor to describe the
	  layout of the SPI ROM chip. Enabling this option will allow you to
	  select further features that rely on this like providing individual
	  firmware blobs.

if HAVE_INTEL_FIRMWARE

comment "Intel Firmware"

config HAVE_IFD_BIN
	bool "Add Intel descriptor.bin file"
	select HAVE_EM100_SUPPORT  # We use ifdtool to enable this.
	help
	  The descriptor binary

config IFD_BIN_PATH
	string "Path and filename of the descriptor.bin file"
	default "3rdparty/blobs/mainboard/\$(MAINBOARDDIR)/descriptor.bin"
	depends on HAVE_IFD_BIN

config HAVE_ME_BIN
	bool "Add Intel ME/TXE firmware"
	depends on HAVE_IFD_BIN
	help
	  The Intel processor in the selected system requires a special firmware
	  for an integrated controller.  This might be called the Management
	  Engine (ME), the Trusted Execution Engine (TXE) or something else
	  depending on the chip. This firmware might or might not be available
	  in coreboot's 3rdparty/blobs repository. If it is not and if you don't
	  have access to the firmware from elsewhere, you can still build
	  coreboot without it. In this case however, you'll have to make sure
	  that you don't overwrite your ME/TXE firmware on your flash ROM.

config STITCH_ME_BIN
	bool "Stitch individual ME/CSE components"
	default n
	depends on HAVE_ME_BIN
	help
	  This config can be selected by mainboard if it wants to stitch ME/CSE
	  components during build time instead of supplying a pre-stitched
	  binary.

config ME_BIN_PATH
	string "Path to management engine firmware" if !STITCH_ME_BIN
	default "3rdparty/blobs/mainboard/\$(MAINBOARDDIR)/me.bin"
	depends on HAVE_ME_BIN && !STITCH_ME_BIN

config CHECK_ME
	bool "Verify the integrity of the supplied ME/TXE firmware"
	default n
	depends on HAVE_ME_BIN && (NORTHBRIDGE_INTEL_IRONLAKE || \
		NORTHBRIDGE_INTEL_SANDYBRIDGE || \
		NORTHBRIDGE_INTEL_HASWELL || \
		SOC_INTEL_BROADWELL || SOC_INTEL_SKYLAKE || \
		SOC_INTEL_KABYLAKE || SOC_INTEL_BAYTRAIL || SOC_INTEL_BRASWELL)
	help
	  Verify the integrity of the supplied Intel ME/TXE firmware before
	  proceeding with the build, in order to prevent an accidental loading
	  of a corrupted ME/TXE image.

config ME_REGION_ALLOW_CPU_READ_ACCESS
	bool "Allows HOST/CPU read access to ME region"
	depends on HAVE_IFD_BIN
	default y if SOC_INTEL_CSE_LITE_SKU
	default n
	help
	 The config ensures Host has read access to the ME region if it is locked
	 through LOCK_MANAGEMENT_ENGINE config. This config is enabled when the CSE
	 Lite SKU is integrated.

config USE_ME_CLEANER
	bool "Strip down the Intel ME/TXE firmware"
	depends on HAVE_ME_BIN && (NORTHBRIDGE_INTEL_IRONLAKE || \
		NORTHBRIDGE_INTEL_SANDYBRIDGE || \
		NORTHBRIDGE_INTEL_HASWELL || \
		SOC_INTEL_BROADWELL || SOC_INTEL_SKYLAKE || \
		SOC_INTEL_KABYLAKE || SOC_INTEL_BAYTRAIL || SOC_INTEL_BRASWELL)
	help
	  Use me_cleaner to remove all the non-fundamental code from the Intel
	  ME/TXE firmware.
	  The resulting Intel ME/TXE firmware will have only the code
	  responsible for the very basic hardware initialization, leaving the
	  ME/TXE subsystem essentially in a disabled state.

	  Don't flash a modified ME/TXE firmware and a new coreboot image at the
	  same time, test them in two different steps.

	  WARNING: this tool isn't based on any official Intel documentation but
	           only on reverse engineering and trial & error.

	  See the project's page
	   https://github.com/corna/me_cleaner
	  or the wiki
	   https://github.com/corna/me_cleaner/wiki/How-to-apply-me_cleaner
	   https://github.com/corna/me_cleaner/wiki/How-does-it-work%3F
	   https://github.com/corna/me_cleaner/wiki/me_cleaner-status
	  for more info about this tool

	  If unsure, say N.

comment "Please test coreboot with the original, unmodified ME firmware before using me_cleaner"
	depends on USE_ME_CLEANER

config ME_CLEANER_ARGS
	string
	depends on USE_ME_CLEANER
	default "-S"

config MAINBOARD_USES_IFD_GBE_REGION
	def_bool n

config HAVE_GBE_BIN
	bool "Add gigabit ethernet configuration"
	depends on HAVE_IFD_BIN && MAINBOARD_USES_IFD_GBE_REGION
	help
	  The integrated gigabit ethernet controller needs a configuration
	  file. Select this if you are going to use the PCH integrated
	  controller and want to add that file.

config GBE_BIN_PATH
	string "Path to gigabit ethernet configuration"
	depends on HAVE_GBE_BIN
	default "3rdparty/blobs/mainboard/\$(MAINBOARDDIR)/gbe.bin"

config MAINBOARD_USES_IFD_EC_REGION
	def_bool n

config HAVE_EC_BIN
	bool "Add EC firmware"
	depends on HAVE_IFD_BIN && MAINBOARD_USES_IFD_EC_REGION
	help
	  The embedded controller needs a firmware file.

	  Select this if you are going to use the PCH integrated controller
	  and have the EC firmware. EC firmware will be added to final image
	  through ifdtool.

config EC_BIN_PATH
	string "Path to EC firmware"
	depends on HAVE_EC_BIN
	default "3rdparty/blobs/mainboard/\$(MAINBOARDDIR)/ec.bin"

config MAINBOARD_USES_IFD_10GBE_0_REGION
	def_bool n

config HAVE_10GBE_0_BIN
	bool "Add 10GbE Firmware Region 0"
	depends on HAVE_IFD_BIN && MAINBOARD_USES_IFD_10GBE_0_REGION
	help
	  The 10GbE region firmware file for LAN device 0.

	  Select this if you are going to use the 10GbE 0 region and have the
	  firmware. The firmware will be added to final image through ifdtool.

config 10GBE_0_BIN_PATH
	string "Path to 10GbE region 0 firmware"
	depends on HAVE_10GBE_0_BIN
	default "3rdparty/blobs/mainboard/\$(MAINBOARDDIR)/10gbe0.bin"

config MAINBOARD_USES_IFD_10GBE_1_REGION
	def_bool n
	depends on MAINBOARD_USES_IFD_10GBE_0_REGION

config HAVE_10GBE_1_BIN
	bool "Add 10GbE Firmware Region 1"
	depends on HAVE_IFD_BIN && MAINBOARD_USES_IFD_10GBE_1_REGION
	help
	  The 10GbE region firmware file for LAN device 1.

	  Select this if you are going to use the 10GbE 1 region and have the
	  firmware. The firmware will be added to final image through ifdtool.

config 10GBE_1_BIN_PATH
	string "Path to 10GbE region 1 firmware"
	depends on HAVE_10GBE_1_BIN
	default "3rdparty/blobs/mainboard/\$(MAINBOARDDIR)/10gbe1.bin"

choice
	prompt "Protect flash regions" if HAVE_IFD_BIN
	default UNLOCK_FLASH_REGIONS if HAVE_IFD_BIN
	help
	  This option allows you to protect flash regions.

config DO_NOT_TOUCH_DESCRIPTOR_REGION
	bool "Use the preset values to protect the regions"
	help
	  Read and write access permissions to different regions in the flash
	  can be controlled via dedicated bitfields in the flash descriptor.
	  These permissions can be modified with the Intel Flash Descriptor
	  Tool (ifdtool). If you don't want to change these permissions and
	  keep the ones provided in the initial descriptor, use this option.

config LOCK_MANAGEMENT_ENGINE
	bool "Lock ME/TXE section"
	help
	  The Intel Firmware Descriptor supports preventing write and read
	  accesses from the host to the ME or TXE section. If the section
	  is locked, it can only be overwritten with an external SPI flash
	  programmer or HECI HMRFPO_ENABLE command needs to be sent to CSE
	  before writing to the ME Section. If CSE Lite SKU is integrated,
	  the Kconfig prevents only writing to the ME section.

	  If unsure, select "Unlock flash regions".

config UNLOCK_FLASH_REGIONS
	bool "Unlock flash regions"
	help
	  All regions are completely unprotected and can be overwritten using
	  a flash programming tool.

endchoice

config CBFS_SIZE
	default 0x100000
	help
	  Reduce CBFS size to give room to the IFD blobs.

endif #INTEL_FIRMWARE
```

## src/southbridge/intel/esb6300/Kconfig
```kconfig
config SOUTHBRIDGE_INTEL_ESB6300
	bool
	select IOAPIC if !DRIVERS_GENERIC_IOAPIC
	select HAVE_HARD_RESET
```

## src/southbridge/intel/fsp_bd82x6x/Kconfig
```kconfig
##
## This file is part of the coreboot project.
##
## Copyright (C) 2011 Google Inc.
## Copyright (C) 2013 Sage Electronic Engineering, LLC.
##
## This program is free software; you can redistribute it and/or modify
## it under the terms of the GNU General Public License as published by
## the Free Software Foundation; version 2 of the License.
##
## This program is distributed in the hope that it will be useful,
## but WITHOUT ANY WARRANTY; without even the implied warranty of
## MERCHANTABILITY or FITNESS FOR A PARTICULAR PURPOSE.  See the
## GNU General Public License for more details.
##
## You should have received a copy of the GNU General Public License
## along with this program; if not, write to the Free Software
## Foundation, Inc.
##

config SOUTHBRIDGE_INTEL_FSP_BD82X6X
	bool

if SOUTHBRIDGE_INTEL_FSP_BD82X6X

config SOUTH_BRIDGE_OPTIONS # dummy
	def_bool y
	select IOAPIC
	select HAVE_HARD_RESET
	select HAVE_SMI_HANDLER
	select USE_WATCHDOG_ON_BOOT
	select PCIEXP_ASPM
	select PCIEXP_COMMON_CLOCK
	select SPI_FLASH
	select COMMON_FADT
	select HAVE_INTEL_FIRMWARE
	select USES_INTEL_ME

config EHCI_BAR
	hex
	default 0xfef00000

config BOOTBLOCK_SOUTHBRIDGE_INIT
	string
	default "southbridge/intel/fsp_bd82x6x/bootblock.c"

config SERIRQ_CONTINUOUS_MODE
	bool
	default n
	help
	  If you set this option to y, the serial IRQ machine will be
	  operated in continuous mode.

config HPET_MIN_TICKS
	hex
	default 0x80

endif
```

## src/southbridge/intel/fsp_i89xx/Kconfig
```kconfig
##
## This file is part of the coreboot project.
##
## Copyright (C) 2011 Google Inc.
## Copyright (C) 2013 Sage Electronic Engineering, LLC.
##
## This program is free software; you can redistribute it and/or modify
## it under the terms of the GNU General Public License as published by
## the Free Software Foundation; version 2 of the License.
##
## This program is distributed in the hope that it will be useful,
## but WITHOUT ANY WARRANTY; without even the implied warranty of
## MERCHANTABILITY or FITNESS FOR A PARTICULAR PURPOSE.  See the
## GNU General Public License for more details.
##

config SOUTHBRIDGE_INTEL_FSP_I89XX
	bool

if SOUTHBRIDGE_INTEL_FSP_I89XX

config SOUTH_BRIDGE_OPTIONS # dummy
	def_bool y
	select ACPI_INTEL_HARDWARE_SLEEP_VALUES
	select IOAPIC
	select HAVE_HARD_RESET
	select HAVE_SMI_HANDLER
	select USE_WATCHDOG_ON_BOOT
	select PCIEXP_ASPM
	select PCIEXP_COMMON_CLOCK
	select COMMON_FADT
	select INTEL_DESCRIPTOR_MODE_CAPABLE
	select NO_EARLY_BOOTBLOCK_POSTCODES
	select SOUTHBRIDGE_INTEL_COMMON
	select SOUTHBRIDGE_INTEL_COMMON_SMBUS
	select SOUTHBRIDGE_INTEL_COMMON_SPI

config EHCI_BAR
	hex
	default 0xfe700000


config BOOTBLOCK_SOUTHBRIDGE_INIT
	string
	default "southbridge/intel/fsp_i89xx/bootblock.c"

config SERIRQ_CONTINUOUS_MODE
	bool
	default n
	help
	  If you set this option to y, the serial IRQ machine will be
	  operated in continuous mode.

config HPET_MIN_TICKS
	hex
	default 0x80

endif
```
