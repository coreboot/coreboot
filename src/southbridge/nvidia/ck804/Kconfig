## src/southbridge/nvidia/ck804/Kconfig
```kconfig
config SOUTHBRIDGE_NVIDIA_CK804
	bool
	select HAVE_USBDEBUG
	select IOAPIC
	select HAVE_POWER_STATE_AFTER_FAILURE

if SOUTHBRIDGE_NVIDIA_CK804

config BOOTBLOCK_SOUTHBRIDGE_INIT
	string
	default "southbridge/nvidia/ck804/bootblock.c"

config EHCI_BAR
	hex
	default 0xfef00000

config CK804_USE_NIC
	bool
	default n

config CK804_USE_ACI
	bool
	default n

config CK804_PCI_E_X
	int
	default 4

config CK804B_PCI_E_X
	int
	default 4

config CK804_PCIE_PME_WAKE
	bool "Enable system wake on PCIe PME# signal"
	default n

config HPET_MIN_TICKS
	hex
	default 0xfa

endif
```

## src/southbridge/nvidia/mcp55/Kconfig
```kconfig
config SOUTHBRIDGE_NVIDIA_MCP55
	bool
	select HAVE_USBDEBUG
	select IOAPIC
	select HAVE_HARD_RESET

if SOUTHBRIDGE_NVIDIA_MCP55

config BOOTBLOCK_SOUTHBRIDGE_INIT
	string
	default "southbridge/nvidia/mcp55/bootblock.c"

config EHCI_BAR
	hex
	default 0xfef00000

config EHCI_DEBUG_OFFSET
	hex
	default 0x98

config MCP55_USE_NIC
	bool
	default n

config MCP55_USE_AZA
	bool
	default n

config MCP55_NUM
	int
	default 1

config MCP55_PCI_E_X_0
	int
	default 4

config MCP55_PCI_E_X_1
	int
	default 4

config MCP55_PCI_E_X_2
	int
	default 4

config MCP55_PCI_E_X_3
	int
	default 4

endif
```

## src/southbridge/sis/sis966/Kconfig
```kconfig
config SOUTHBRIDGE_SIS_SIS966
	bool
	select IOAPIC
	select HAVE_USBDEBUG
	select HAVE_HARD_RESET

if SOUTHBRIDGE_SIS_SIS966

config BOOTBLOCK_SOUTHBRIDGE_INIT
	string
	default "southbridge/sis/sis966/bootblock.c"

config EHCI_BAR
	hex
	default 0xfef00000

config CHIPSET_BOOTBLOCK_INCLUDE
	string
	default "southbridge/sis/sis966/romstrap.inc"

endif
```

## src/southbridge/via/Kconfig
```kconfig
source src/southbridge/via/k8t890/Kconfig
source src/southbridge/via/vt8237r/Kconfig
```

## src/southbridge/via/k8t890/Kconfig
```kconfig
config SOUTHBRIDGE_VIA_K8T890
	bool

if SOUTHBRIDGE_VIA_K8T890

config SOUTHBRIDGE_VIA_SUBTYPE_K8M800     # not tested
	def_bool n
config SOUTHBRIDGE_VIA_SUBTYPE_K8T800_OLD # not tested, lspci lists B188 and 3188
	def_bool n
config SOUTHBRIDGE_VIA_SUBTYPE_K8T800     # lspci lists 0282, 1282, 2282, 3282, and 7282
	def_bool n
config SOUTHBRIDGE_VIA_SUBTYPE_K8T800PRO  # lspci lists 0282, 1282, 2282, 3282, and 7282
	def_bool n
config SOUTHBRIDGE_VIA_SUBTYPE_K8M890
	def_bool n
config SOUTHBRIDGE_VIA_SUBTYPE_K8T890
	def_bool n

config SOUTHBRIDGE_VIA_K8M890_VGA_EN
	bool "Enable onboard K8M890 graphics"
	default y
	depends on SOUTHBRIDGE_VIA_SUBTYPE_K8M890
	select VGA
	select GFXUMA

choice
	prompt "Framebuffer size"
	default K8M890_VIDEO_MB_32MB
	depends on SOUTHBRIDGE_VIA_K8M890_VGA_EN

config K8M890_VIDEO_MB_32MB
	bool "32MB"
config K8M890_VIDEO_MB_64MB
	bool "64MB"
config K8M890_VIDEO_MB_128MB
	bool "128MB"
config K8M890_VIDEO_MB_256MB
	bool "256MB"
config K8M890_VIDEO_MB_CMOS
	bool "Use CMOS option"

endchoice

config VIDEO_MB
	int
	default 32  if K8M890_VIDEO_MB_32MB
	default 64  if K8M890_VIDEO_MB_64MB
	default 128  if K8M890_VIDEO_MB_128MB
	default 256 if K8M890_VIDEO_MB_256MB
	default -1  if K8M890_VIDEO_MB_CMOS
	depends on SOUTHBRIDGE_VIA_K8M890_VGA_EN

endif # SOUTHBRIDGE_K8T890
```

## src/southbridge/via/vt8237r/Kconfig
```kconfig
##
## This file is part of the coreboot project.
##
## Copyright (C) 2008-2009 coresystems GmbH
##
## This program is free software; you can redistribute it and/or modify
## it under the terms of the GNU General Public License as published by
## the Free Software Foundation; version 2 of the License.
##
## This program is distributed in the hope that it will be useful,
## but WITHOUT ANY WARRANTY; without even the implied warranty of
## MERCHANTABILITY or FITNESS FOR A PARTICULAR PURPOSE.  See the
## GNU General Public License for more details.
##
## You should have received a copy of the GNU General Public License
## along with this program; if not, write to the Free Software
## Foundation, Inc., 51 Franklin St, Fifth Floor, Boston, MA 02110-1301 USA
##

config SOUTHBRIDGE_VIA_VT8237R
	bool
	select HAVE_DEBUG_SMBUS
	select IOAPIC

if SOUTHBRIDGE_VIA_VT8237R

if NORTHBRIDGE_AMD_K8 || NORTHBRIDGE_AMD_FAM10
config SOUTH_BRIDGE_OPTIONS # dummy
	def_bool y
	select HAVE_SMI_HANDLER
endif

config EPIA_VT8237R_INIT
	bool
	default n

config BOOTBLOCK_SOUTHBRIDGE_INIT
	string
	default "southbridge/via/vt8237r/bootblock.c"

endif
```

## src/superio/Kconfig
```kconfig
source src/superio/fintek/Kconfig
source src/superio/intel/Kconfig
source src/superio/ite/Kconfig
source src/superio/nsc/Kconfig
source src/superio/serverengines/Kconfig
source src/superio/smsc/Kconfig
source src/superio/via/Kconfig
source src/superio/winbond/Kconfig
```

## src/superio/aspeed/ast2400/Kconfig
```kconfig
# SPDX-License-Identifier: GPL-2.0-only

config SUPERIO_ASPEED_AST2400
	bool
	default n
	select SUPERIO_ASPEED_COMMON_PRE_RAM
```

## src/superio/aspeed/common/Kconfig
```kconfig
# SPDX-License-Identifier: GPL-2.0-only

# Generic Aspeed preram driver - Just enough UART initialisation code for
# preram phase.
config SUPERIO_ASPEED_COMMON_PRE_RAM
	bool
	default n

config SUPERIO_ASPEED_HAS_UART_DELAY_WORKAROUND
	bool
	default n

config SUPERIO_ASPEED_USE_UART_DELAY_WORKAROUND
	bool "Workaround for BMC serial console setup bug"
	depends on CONSOLE_SERIAL && SUPERIO_ASPEED_HAS_UART_DELAY_WORKAROUND
	default y
	help
	  Some mainboards with an ASPEED BMC have scrambled console output in early boot phases
	  because the serial output routing is not set up fast enough by the BMC. By enabling
	  this a delay of 500ms gets added before setting up the console and before any console
	  output gets printed.

	  Note: this problem may disappear with future BMC firmware versions. Another approach
	  is using a different BMC firmware like OpenBMC, u-bmc, ...
```

## src/superio/fintek/Kconfig
```kconfig
##
## This file is part of the coreboot project.
##
## Copyright (C) 2009 Ronald G. Minnich
## Copyright (C) 2014 Edward O'Callaghan <eocallaghan@alterapraxis.com>
##
## This program is free software; you can redistribute it and/or modify
## it under the terms of the GNU General Public License as published by
## the Free Software Foundation; version 2 of the License.
##
## This program is distributed in the hope that it will be useful,
## but WITHOUT ANY WARRANTY; without even the implied warranty of
## MERCHANTABILITY or FITNESS FOR A PARTICULAR PURPOSE.  See the
## GNU General Public License for more details.
##

# Generic Fintek romstage driver - Just enough UART initialisation code for
# romstage.
config SUPERIO_FINTEK_COMMON_ROMSTAGE
	bool

config SUPERIO_FINTEK_F71805F
	bool
	select SUPERIO_FINTEK_COMMON_ROMSTAGE

config SUPERIO_FINTEK_F71859
	bool
	select SUPERIO_FINTEK_COMMON_ROMSTAGE

config SUPERIO_FINTEK_F71863FG
	bool
	select SUPERIO_FINTEK_COMMON_ROMSTAGE

config SUPERIO_FINTEK_F71869AD
	bool
	select SUPERIO_FINTEK_COMMON_ROMSTAGE

config SUPERIO_FINTEK_F71872
	bool
	select SUPERIO_FINTEK_COMMON_ROMSTAGE

config SUPERIO_FINTEK_F81216H
	bool
# N.B. 'special romstage'

config SUPERIO_FINTEK_F81865F
	bool
	select SUPERIO_FINTEK_COMMON_ROMSTAGE

config SUPERIO_FINTEK_F81866D
	bool
	select SUPERIO_FINTEK_COMMON_ROMSTAGE
```

## src/superio/fintek/common/Kconfig
```kconfig
# SPDX-License-Identifier: GPL-2.0-only

# Generic Fintek romstage driver - Just enough UART initialisation code for
# romstage.
config SUPERIO_FINTEK_COMMON_PRE_RAM
	bool
```

## src/superio/fintek/f71808a/Kconfig
```kconfig
# SPDX-License-Identifier: GPL-2.0-only

config SUPERIO_FINTEK_F71808A
	bool
	select SUPERIO_FINTEK_COMMON_PRE_RAM
```

## src/superio/fintek/f71859/Kconfig
```kconfig
# SPDX-License-Identifier: GPL-2.0-only

config SUPERIO_FINTEK_F71859
	bool
	select SUPERIO_FINTEK_COMMON_PRE_RAM
```

## src/superio/fintek/f71863fg/Kconfig
```kconfig
# SPDX-License-Identifier: GPL-2.0-only

config SUPERIO_FINTEK_F71863FG
	bool
	select SUPERIO_FINTEK_COMMON_PRE_RAM
```

## src/superio/fintek/f81216h/Kconfig
```kconfig
# SPDX-License-Identifier: GPL-2.0-only
# This file is part of the coreboot project.

config SUPERIO_FINTEK_F81216H
	bool
# N.B. 'special romstage'
```

## src/superio/fintek/f81803a/Kconfig
```kconfig
# SPDX-License-Identifier: GPL-2.0-only

config SUPERIO_FINTEK_F81803A
	bool
	select SUPERIO_FINTEK_COMMON_PRE_RAM

config SUPERIO_FINTEK_FAN_CONTROL
	bool
	default n

config SUPERIO_FINTEK_FAN_API_CALL
	depends on SUPERIO_FINTEK_FAN_CONTROL
	bool
	default n
```
