## src/superio/fintek/f81865f/Kconfig
```kconfig
# SPDX-License-Identifier: GPL-2.0-only

config SUPERIO_FINTEK_F81865F
	bool
	select SUPERIO_FINTEK_COMMON_PRE_RAM
```

## src/superio/fintek/f81866d/Kconfig
```kconfig
# SPDX-License-Identifier: GPL-2.0-only
# This file is part of the coreboot project.

config SUPERIO_FINTEK_F81866D
	bool
	select SUPERIO_FINTEK_COMMON_PRE_RAM
```

## src/superio/fintek/f81966d/Kconfig
```kconfig
# SPDX-License-Identifier: GPL-2.0-only

config SUPERIO_FINTEK_F81966D
	bool
	select SUPERIO_FINTEK_COMMON_PRE_RAM
```

## src/superio/ite/Kconfig
```kconfig
##
## This file is part of the coreboot project.
##
## Copyright (C) 2009 Ronald G. Minnich
## Copyright (C) 2014 Edward O'Callaghan <eocallaghan@alterapraxis.com>
##
## This program is free software; you can redistribute it and/or modify
## it under the terms of the GNU General Public License as published by
## the Free Software Foundation; version 2 of the License.
##
## This program is distributed in the hope that it will be useful,
## but WITHOUT ANY WARRANTY; without even the implied warranty of
## MERCHANTABILITY or FITNESS FOR A PARTICULAR PURPOSE.  See the
## GNU General Public License for more details.
##

# Generic ITE romstage driver - Just enough UART initialisation code for
# romstage.
config SUPERIO_ITE_COMMON_ROMSTAGE
	bool

config SUPERIO_ITE_IT8671F
	bool
	select SUPERIO_ITE_COMMON_ROMSTAGE

config SUPERIO_ITE_IT8712F
	bool
	select SUPERIO_ITE_COMMON_ROMSTAGE

config SUPERIO_ITE_IT8716F
	bool
	select SUPERIO_ITE_COMMON_ROMSTAGE

config SUPERIO_ITE_IT8716F_OVERRIDE_FANCTL
	bool
	depends on SUPERIO_ITE_IT8716F
	default n
	select SUPERIO_ITE_COMMON_ROMSTAGE

config SUPERIO_ITE_IT8718F
	bool
	select SUPERIO_ITE_COMMON_ROMSTAGE

config SUPERIO_ITE_IT8721F
	bool
	select SUPERIO_ITE_COMMON_ROMSTAGE

config SUPERIO_ITE_IT8728F
	bool
	select SUPERIO_ITE_COMMON_ROMSTAGE

config SUPERIO_ITE_IT8772F
	bool
	select SUPERIO_ITE_COMMON_ROMSTAGE
```

## src/superio/ite/common/Kconfig
```kconfig
# SPDX-License-Identifier: GPL-2.0-only

# Generic ITE romstage driver - Just enough UART initialisation code for
# romstage.
config SUPERIO_ITE_COMMON_PRE_RAM
	bool

config SUPERIO_ITE_COMMON_GPIO_PRE_RAM
	bool
	help
	  Enable generic pre-ram driver for configuring ITE SIO GPIOs.
	  It applies only to ITE SIOs not ITE ECs using LDN 7 (typically)
	  to configure GPIO Simple I/O mode.

if SUPERIO_ITE_COMMON_GPIO_PRE_RAM

config SUPERIO_ITE_COMMON_NUM_GPIO_SETS
	int
	help
	  The maximum number of GPIO sets supported by ITE SIO chip.
	  Each SIO chip must set this config option to a proper values
	  if it intends to enable SUPERIO_ITE_COMMON_GPIO_PRE_RAM.

config SUPERIO_ITE_COMMON_GPIO_LED_FREQ_5BIT
	bool
	default n
	help
	  Selected ITE SIOs control the GPIO LED frequency using 5 bits
	  instead of two. The LED register layout is also different for
	  these chips. Select this if the SIO GP LED Frequency control
	  field has 5 bits and support duty cycle as well.

endif

# Generic ITE environment controller driver
config SUPERIO_ITE_ENV_CTRL
	bool

if SUPERIO_ITE_ENV_CTRL

config SUPERIO_ITE_ENV_CTRL_FAN16_CONFIG
	bool
	help
	  Enable extended, 16-bit wide tacho counters.

config SUPERIO_ITE_ENV_CTRL_8BIT_PWM
	bool
	help
	  PWM duty cycles are set in 8-bit registers (instead of 7 bit).

config SUPERIO_ITE_ENV_CTRL_PWM_FREQ2
	bool
	help
	  The second FAN controller has a separate frequency setting.

config SUPERIO_ITE_ENV_CTRL_NO_ONOFF
	bool
	help
	  FAN controller always works in SmartGuardian mode.

config SUPERIO_ITE_ENV_CTRL_5FANS
	bool
	help
	  ITE FAN controller has 5 independent outputs.

config SUPERIO_ITE_ENV_CTRL_7BIT_SLOPE_REG
	bool
	help
	  Slope PWM registers have no separate BIT6 and are set directly by
	  7-bit values instead.

config SUPERIO_ITE_ENV_CTRL_EXT_ANY_TMPIN
	bool
	help
	  Temperature can be read to any TMPIN from an external sensor via SST/PECI
	  (instead of TMPIN3 only).

config SUPERIO_ITE_ENV_CTRL_NO_FULLSPEED_SETTING
	bool
	help
	  Fan controller does not support running at full speed when limit
	  temperature is reached.

config SUPERIO_ITE_ENV_CTRL_FAN_VECTOR
	bool
	help
	  Special fan control that will assist the smart control

config SUPERIO_ITE_ENV_CTRL_FAN_VECTOR_RANGED
	bool
	depends on SUPERIO_ITE_ENV_CTRL_FAN_VECTOR
	help
	  Range and negative slope support

endif
```

## src/superio/ite/it8528e/Kconfig
```kconfig
# SPDX-License-Identifier: GPL-2.0-only

config SUPERIO_ITE_IT8528E
	bool
	select SUPERIO_ITE_COMMON_PRE_RAM
```

## src/superio/ite/it8623e/Kconfig
```kconfig
##
## This file is part of the coreboot project.
##
## Copyright (C) 2009 Ronald G. Minnich
## Copyright (C) 2014 Edward O'Callaghan <eocallaghan@alterapraxis.com>
## Copyright (C) 2017 Gergely Kiss <mail.gery@gmail.com>
## Copyright (C) 2018 Kevin Cody-Little <kcodyjr@gmail.com>
##
## This program is free software; you can redistribute it and/or modify
## it under the terms of the GNU General Public License as published by
## the Free Software Foundation; version 2 of the License.
##
## This program is distributed in the hope that it will be useful,
## but WITHOUT ANY WARRANTY; without even the implied warranty of
## MERCHANTABILITY or FITNESS FOR A PARTICULAR PURPOSE.  See the
## GNU General Public License for more details.
##

config SUPERIO_ITE_IT8623E
	bool
	select SUPERIO_ITE_COMMON_ROMSTAGE
	select SUPERIO_ITE_ENV_CTRL
	select SUPERIO_ITE_ENV_CTRL_PWM_FREQ2
	select SUPERIO_ITE_ENV_CTRL_FAN16_CONFIG
	select SUPERIO_ITE_ENV_CTRL_8BIT_PWM
```

## src/superio/ite/it8659e/Kconfig
```kconfig
# SPDX-License-Identifier: GPL-2.0-only

config SUPERIO_ITE_IT8659E
	bool
	select SUPERIO_ITE_COMMON_PRE_RAM
	select SUPERIO_ITE_COMMON_GPIO_PRE_RAM
	select SUPERIO_ITE_ENV_CTRL
	select SUPERIO_ITE_ENV_CTRL_PWM_FREQ2
	select SUPERIO_ITE_ENV_CTRL_7BIT_SLOPE_REG
	select SUPERIO_ITE_ENV_CTRL_8BIT_PWM
	select SUPERIO_ITE_ENV_CTRL_EXT_ANY_TMPIN


if SUPERIO_ITE_IT8659E

config SUPERIO_ITE_COMMON_NUM_GPIO_SETS
	default 6

endif
```

## src/superio/ite/it8712f/Kconfig
```kconfig
# SPDX-License-Identifier: GPL-2.0-only

config SUPERIO_ITE_IT8712F
	bool
	select SUPERIO_ITE_COMMON_PRE_RAM
	select SUPERIO_ITE_COMMON_GPIO_PRE_RAM

if SUPERIO_ITE_IT8712F

config SUPERIO_ITE_COMMON_NUM_GPIO_SETS
	default 5

endif
```

## src/superio/ite/it8720f/Kconfig
```kconfig
# SPDX-License-Identifier: GPL-2.0-only

config SUPERIO_ITE_IT8720F
	bool
	select SUPERIO_ITE_COMMON_PRE_RAM
	select SUPERIO_ITE_COMMON_GPIO_PRE_RAM
	select SUPERIO_ITE_ENV_CTRL
	select SUPERIO_ITE_ENV_CTRL_FAN16_CONFIG
	select SUPERIO_ITE_ENV_CTRL_PWM_FREQ2

if SUPERIO_ITE_IT8720F

config SUPERIO_ITE_COMMON_NUM_GPIO_SETS
	default 8

endif
```

## src/superio/ite/it8721f/Kconfig
```kconfig
# SPDX-License-Identifier: GPL-2.0-only

config SUPERIO_ITE_IT8721F
	bool
	select SUPERIO_ITE_COMMON_PRE_RAM
	select SUPERIO_ITE_ENV_CTRL
	select SUPERIO_ITE_ENV_CTRL_FAN16_CONFIG
	select SUPERIO_ITE_ENV_CTRL_PWM_FREQ2
	select SUPERIO_ITE_ENV_CTRL_EXT_ANY_TMPIN
```

## src/superio/ite/it8728f/Kconfig
```kconfig
# SPDX-License-Identifier: GPL-2.0-only

config SUPERIO_ITE_IT8728F
	bool
	select SUPERIO_ITE_COMMON_PRE_RAM
	select SUPERIO_ITE_COMMON_GPIO_PRE_RAM
	select SUPERIO_ITE_ENV_CTRL
	select SUPERIO_ITE_ENV_CTRL_PWM_FREQ2
	select SUPERIO_ITE_ENV_CTRL_FAN16_CONFIG
	select SUPERIO_ITE_ENV_CTRL_8BIT_PWM
	select SUPERIO_ITE_ENV_CTRL_5FANS
	select SUPERIO_ITE_ENV_CTRL_7BIT_SLOPE_REG
	select SUPERIO_ITE_ENV_CTRL_EXT_ANY_TMPIN
	select SUPERIO_ITE_ENV_CTRL_FAN_VECTOR

if SUPERIO_ITE_IT8728F

config SUPERIO_ITE_COMMON_NUM_GPIO_SETS
	default 8

endif
```

## src/superio/ite/it8772f/Kconfig
```kconfig
# SPDX-License-Identifier: GPL-2.0-only

config SUPERIO_ITE_IT8772F
	bool
	select SUPERIO_ITE_COMMON_PRE_RAM
	select SUPERIO_ITE_COMMON_GPIO_PRE_RAM
	select SUPERIO_ITE_ENV_CTRL
	select SUPERIO_ITE_ENV_CTRL_7BIT_SLOPE_REG
	select SUPERIO_ITE_ENV_CTRL_8BIT_PWM
	select SUPERIO_ITE_ENV_CTRL_EXT_ANY_TMPIN
	select SUPERIO_ITE_ENV_CTRL_FAN_VECTOR
	select SUPERIO_ITE_ENV_CTRL_FAN_VECTOR_RANGED
	select SUPERIO_ITE_ENV_CTRL_NO_FULLSPEED_SETTING
	select SUPERIO_ITE_ENV_CTRL_PWM_FREQ2

if SUPERIO_ITE_IT8772F

config SUPERIO_ITE_COMMON_NUM_GPIO_SETS
	default 6

endif
```

## src/superio/ite/it8783ef/Kconfig
```kconfig
# SPDX-License-Identifier: GPL-2.0-only

config SUPERIO_ITE_IT8783EF
	bool
	select SUPERIO_ITE_COMMON_PRE_RAM
	select SUPERIO_ITE_COMMON_GPIO_PRE_RAM
	select SUPERIO_ITE_ENV_CTRL
	select SUPERIO_ITE_ENV_CTRL_FAN16_CONFIG
	select SUPERIO_ITE_ENV_CTRL_PWM_FREQ2

if SUPERIO_ITE_IT8783EF

config SUPERIO_ITE_COMMON_NUM_GPIO_SETS
	default 6

endif
```

## src/superio/ite/it8786e/Kconfig
```kconfig
# SPDX-License-Identifier: GPL-2.0-only

config SUPERIO_ITE_IT8786E
	bool
	select SUPERIO_ITE_COMMON_PRE_RAM
	select SUPERIO_ITE_ENV_CTRL
	select SUPERIO_ITE_ENV_CTRL_PWM_FREQ2
	select SUPERIO_ITE_ENV_CTRL_8BIT_PWM
	select SUPERIO_ITE_ENV_CTRL_7BIT_SLOPE_REG
	select SUPERIO_ITE_ENV_CTRL_EXT_ANY_TMPIN
```

## src/superio/nsc/Kconfig
```kconfig
##
## This file is part of the coreboot project.
##
## Copyright (C) 2009 Ronald G. Minnich
##
## This program is free software; you can redistribute it and/or modify
## it under the terms of the GNU General Public License as published by
## the Free Software Foundation; version 2 of the License.
##
## This program is distributed in the hope that it will be useful,
## but WITHOUT ANY WARRANTY; without even the implied warranty of
## MERCHANTABILITY or FITNESS FOR A PARTICULAR PURPOSE.  See the
## GNU General Public License for more details.
##


config SUPERIO_NSC_PC87309
	bool
config SUPERIO_NSC_PC87360
	bool
config SUPERIO_NSC_PC87366
	bool
config SUPERIO_NSC_PC87382
	bool
config SUPERIO_NSC_PC87384
	bool
config SUPERIO_NSC_PC87392
	bool
config SUPERIO_NSC_PC87417
	bool
config SUPERIO_NSC_PC97317
	bool
```

## src/superio/nsc/common/Kconfig
```kconfig
# SPDX-License-Identifier: GPL-2.0-only

# Generic NSC romstage driver - Just enough UART initialisation code for
# pre-ram.
config SUPERIO_NSC_COMMON_PRE_RAM
	bool
```

## src/superio/nsc/pc87392/Kconfig
```kconfig
# SPDX-License-Identifier: GPL-2.0-only
# This file is part of the coreboot project.

config SUPERIO_NSC_PC87392
	bool
	select SUPERIO_NSC_COMMON_PRE_RAM
```

## src/superio/nsc/pc87417/Kconfig
```kconfig
# SPDX-License-Identifier: GPL-2.0-only

config SUPERIO_NSC_PC87417
	bool
	select SUPERIO_NSC_COMMON_PRE_RAM
```

## src/superio/nuvoton/common/Kconfig
```kconfig
# SPDX-License-Identifier: GPL-2.0-only

# Generic Nuvoton romstage driver - Just enough UART initialisation code for
# pre-ram.
config SUPERIO_NUVOTON_COMMON_PRE_RAM
	bool

config SUPERIO_NUVOTON_COMMON_COM_A
	bool
	depends on SUPERIO_NUVOTON_COMMON_PRE_RAM
	help
	  When enabled, the 'nuvoton_enable_serial()' function will unset
	  global CR 0x2a bit 7 to route COM A to the GPIO8 pin group.

config HAVE_SHARED_PS2_PORT
	bool
	depends on SUPERIO_NUVOTON_COMMON_PRE_RAM
	help
	  Select this option if your mainboard has a single PS/2 port for both keyboard and
	  mouse, and where a Y-cable cannot allow both keyboard and mouse to work off the same
	  port. This one port usually works for keyboards only. Add the nvram option
	  "swap_keyboard_and_mouse" to cmos.layout to allow changing this port into a
	  mouse port.
```

## src/superio/nuvoton/nct5104d/Kconfig
```kconfig
# SPDX-License-Identifier: GPL-2.0-only
# This file is part of the coreboot project.

config SUPERIO_NUVOTON_NCT5104D
	bool
	select SUPERIO_NUVOTON_COMMON_PRE_RAM
```

## src/superio/nuvoton/nct5535d/Kconfig
```kconfig
# SPDX-License-Identifier: GPL-2.0-only

config SUPERIO_NUVOTON_NCT5535D
	bool
	select SUPERIO_NUVOTON_COMMON_PRE_RAM
	select HAVE_POWER_STATE_AFTER_FAILURE
	help
	  NCT5535D is a cut-down version of NCT6779D and is otherwise supported by
	  superio/nuvoton/nct6779d, which provides C code for initialization. This directory
	  only provides consistently-named header and structures.
```
