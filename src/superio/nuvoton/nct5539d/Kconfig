## src/superio/nuvoton/nct5539d/Kconfig
```kconfig
# SPDX-License-Identifier: GPL-2.0-only

config SUPERIO_NUVOTON_NCT5539D
	bool
	select SUPERIO_NUVOTON_COMMON_PRE_RAM
```

## src/superio/nuvoton/nct5572d/Kconfig
```kconfig
# SPDX-License-Identifier: GPL-2.0-only

config SUPERIO_NUVOTON_NCT5572D
	bool
	select SUPERIO_NUVOTON_COMMON_PRE_RAM
	select HAVE_POWER_STATE_AFTER_FAILURE
	select HAVE_POWER_STATE_PREVIOUS_AFTER_FAILURE
```

## src/superio/nuvoton/nct6687d/Kconfig
```kconfig
# SPDX-License-Identifier: GPL-2.0-only

config SUPERIO_NUVOTON_NCT6687D
	bool
	select SUPERIO_NUVOTON_COMMON_PRE_RAM
```

## src/superio/nuvoton/nct6776/Kconfig
```kconfig
# SPDX-License-Identifier: GPL-2.0-only

config SUPERIO_NUVOTON_NCT6776
	bool
	select SUPERIO_NUVOTON_COMMON_PRE_RAM
```

## src/superio/nuvoton/nct6779d/Kconfig
```kconfig
# SPDX-License-Identifier: GPL-2.0-only

config SUPERIO_NUVOTON_NCT6779D
	bool
	select SUPERIO_NUVOTON_COMMON_PRE_RAM
	select HAVE_POWER_STATE_AFTER_FAILURE
```

## src/superio/nuvoton/nct6791d/Kconfig
```kconfig
# SPDX-License-Identifier: GPL-2.0-only

config SUPERIO_NUVOTON_NCT6791D
	bool
	select SUPERIO_NUVOTON_COMMON_PRE_RAM

config SUPERIO_NUVOTON_NCT6791D_COM_A
	bool
	depends on SUPERIO_NUVOTON_NCT6791D
	default n
```

## src/superio/serverengines/pilot/Kconfig
```kconfig
# SPDX-License-Identifier: GPL-2.0-only

config SUPERIO_SERVERENGINES_PILOT
	bool
```

## src/superio/smsc/Kconfig
```kconfig
##
## This file is part of the coreboot project.
##
## Copyright (C) 2009 Ronald G. Minnich
## Copyright (C) 2012 Advanced Micro Devices, Inc.
##
## This program is free software; you can redistribute it and/or modify
## it under the terms of the GNU General Public License as published by
## the Free Software Foundation; version 2 of the License.
##
## This program is distributed in the hope that it will be useful,
## but WITHOUT ANY WARRANTY; without even the implied warranty of
## MERCHANTABILITY or FITNESS FOR A PARTICULAR PURPOSE.  See the
## GNU General Public License for more details.
##
## You should have received a copy of the GNU General Public License
## along with this program; if not, write to the Free Software
## Foundation, Inc., 51 Franklin St, Fifth Floor, Boston, MA 02110-1301 USA
##

config SUPERIO_SMSC_FDC37M60X
	bool
config SUPERIO_SMSC_FDC37N972
	bool
config SUPERIO_SMSC_LPC47B272
	bool
config SUPERIO_SMSC_LPC47B397
	bool
config SUPERIO_SMSC_LPC47M10X
	bool
config SUPERIO_SMSC_LPC47M15X
	bool
config SUPERIO_SMSC_LPC47N217
	bool
config SUPERIO_SMSC_LPC47N227
	bool
config SUPERIO_SMSC_SIO10N268
	bool
config SUPERIO_SMSC_SIO1007
	bool
config SUPERIO_SMSC_KBC1100
	bool
config SUPERIO_SMSC_MEC1308
	bool
config SUPERIO_SMSC_SMSCSUPERIO
	bool
	select SUPERIO_WANTS_14MHZ_CLOCK
config SUPERIO_SMSC_SIO1036
	bool
config SUPERIO_SMSC_SCH4037
	bool
```

## src/superio/smsc/smscsuperio/Kconfig
```kconfig
# SPDX-License-Identifier: GPL-2.0-only

config SUPERIO_WANTS_14MHZ_CLOCK
	bool

config SUPERIO_SMSC_SMSCSUPERIO
	bool
	select SUPERIO_WANTS_14MHZ_CLOCK
```
