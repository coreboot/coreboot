## src/vendorcode/amd/opensil/Kconfig.debug
```kconfig
## SPDX-License-Identifier: GPL-2.0-only

if SOC_AMD_OPENSIL

config OPENSIL_DEBUG_OUTPUT
	bool "OpenSIL console output"
	default y
	help
	  Select this if you want OpenSIL debug messages compiled
	  in the image.

if OPENSIL_DEBUG_OUTPUT

config OPENSIL_DEBUG_PREFIX
	bool "Print the openSIL prefix"
	default n
	help
	  This prints the function name and line level in front of the
	  actual message.

config OPENSIL_DEBUG_APOB
	bool "Enable APOB messages"
	default n
	help
	  Enable printing APOB related messages.

config OPENSIL_DEBUG_NBIO
	bool "Enable NBIO messages"
	default y
	help
	  Enable printing NBIO related messages.

config OPENSIL_DEBUG_CCX
	bool "Enable CCX messages"
	default y
	help
	  Enable printing CCX related messages.

config OPENSIL_DEBUG_SMU
	bool "Enable SMU messages"
	default y
	help
	  Enable printing SMU related messages.

config OPENSIL_DEBUG_DF
	bool "Enable DF messages"
	default y
	help
	  Enable printing DF related messages.

config OPENSIL_DEBUG_MEM
	bool "Enable MEM messages"
	default y
	help
	  Enable printing MEM related messages.

config OPENSIL_DEBUG_FCH
	bool "Enable FCH messages"
	default y
	help
	  Enable printing FCH related messages.

config OPENSIL_DEBUG_RAS
	bool "Enable RAS messages"
	default y
	help
	  Enable printing RAS related messages.

endif # OPENSIL_DEBUG_OUTPUT

endif # SOC_AMD_OPENSIL
```

## src/vendorcode/amd/pi/Kconfig
```kconfig
#
# Copyright (c) 2013 - 2014, Sage Electronic Engineering, LLC
# Copyright (C) 2016 Advanced Micro Devices, Inc.
# All rights reserved.
#
# Redistribution and use in source and binary forms, with or without
# modification, are permitted provided that the following conditions are met:
#     * Redistributions of source code must retain the above copyright
#       notice, this list of conditions and the following disclaimer.
#     * Redistributions in binary form must reproduce the above copyright
#       notice, this list of conditions and the following disclaimer in the
#       documentation and/or other materials provided with the distribution.
#     * Neither the name of Advanced Micro Devices, Inc. nor the names of
#       its contributors may be used to endorse or promote products derived
#       from this software without specific prior written permission.
#
# THIS SOFTWARE IS PROVIDED BY THE COPYRIGHT HOLDERS AND CONTRIBUTORS "AS IS" AND
# ANY EXPRESS OR IMPLIED WARRANTIES, INCLUDING, BUT NOT LIMITED TO, THE IMPLIED
# WARRANTIES OF MERCHANTABILITY AND FITNESS FOR A PARTICULAR PURPOSE ARE
# DISCLAIMED. IN NO EVENT SHALL ADVANCED MICRO DEVICES, INC. BE LIABLE FOR ANY
# DIRECT, INDIRECT, INCIDENTAL, SPECIAL, EXEMPLARY, OR CONSEQUENTIAL DAMAGES
# (INCLUDING, BUT NOT LIMITED TO, PROCUREMENT OF SUBSTITUTE GOODS OR SERVICES;
# LOSS OF USE, DATA, OR PROFITS; OR BUSINESS INTERRUPTION) HOWEVER CAUSED AND
# ON ANY THEORY OF LIABILITY, WHETHER IN CONTRACT, STRICT LIABILITY, OR TORT
# (INCLUDING NEGLIGENCE OR OTHERWISE) ARISING IN ANY WAY OUT OF THE USE OF THIS
# SOFTWARE, EVEN IF ADVISED OF THE POSSIBILITY OF SUCH DAMAGE.
#

if CPU_AMD_PI_00630F01 || CPU_AMD_PI_00730F01 || SOC_AMD_STONEYRIDGE

config AGESA_BINARY_PI_VENDORCODE_PATH
	string "AGESA PI directory path"
	default "src/vendorcode/amd/pi/00630F01" if CPU_AMD_PI_00630F01
	default "src/vendorcode/amd/pi/00730F01" if CPU_AMD_PI_00730F01
	default "src/vendorcode/amd/pi/00670F00" if AMD_APU_MERLINFALCON
	default "src/vendorcode/amd/pi/00670F00" if AMD_APU_STONEYRIDGE || AMD_APU_PRAIRIEFALCON
	help
	  Specify where to find the AGESA header files
	  for AMD platform initialization.

config AGESA_BINARY_PI_FILE
	string "AGESA PI binary file name"
	default "3rdparty/blobs/pi/amd/00630F01/FP3/AGESA.bin" if CPU_AMD_PI_00630F01
	default "3rdparty/blobs/pi/amd/00730F01/FT3b/AGESA.bin" if CPU_AMD_PI_00730F01
	default "3rdparty/amd_blobs/stoneyridge/pi/CZ/\$(CONFIG_AMD_SOC_PACKAGE)/AGESA.bin" if AMD_APU_MERLINFALCON && USE_AMD_BLOBS
	default "3rdparty/amd_blobs/stoneyridge/pi/ST/\$(CONFIG_AMD_SOC_PACKAGE)/AGESA.bin" if AMD_APU_PRAIRIEFALCON && USE_AMD_BLOBS
	default "3rdparty/amd_blobs/stoneyridge/pi/ST/\$(CONFIG_AMD_SOC_PACKAGE)/AGESA.bin" if AMD_APU_STONEYRIDGE && USE_AMD_BLOBS
	help
	  Specify the binary file to use for AMD platform initialization.

config AGESA_BINARY_PI_AS_STAGE
	bool "AGESA Binary PI is added as stage to CBFS."
	depends on SOC_AMD_STONEYRIDGE
	help
	  AGESA will be added as a stage utilizing --xip cbfstool options
	  as needed relocating the image to the proper location in memory-mapped
	  cpu address space. It's required that the file be in ELF format
	  containing the relocations necessary for relocating at runtime.

config AGESA_SPLIT_MEMORY_FILES
	bool "Split AGESA Binary PI into pre- and post-memory files."
	depends on AGESA_BINARY_PI_AS_STAGE
	default n
	help
	  Specifies that AGESA is split into two binaries for pre- and
	  post-memory.

config AGESA_PRE_MEMORY_BINARY_PI_FILE
	string "Pre memory Binary PI file name"
	depends on AGESA_SPLIT_MEMORY_FILES
	default "3rdparty/blobs/pi/amd/00670F00/FT4/AGESA_premem.elf" if SOC_AMD_STONEYRIDGE && USE_AMD_BLOBS
	help
	  Specify the binary file to use for pre-memory AMD platform
	  initialization.

config AGESA_POST_MEMORY_BINARY_PI_FILE
	string "Post memory Binary PI file name"
	depends on AGESA_SPLIT_MEMORY_FILES
	default "3rdparty/blobs/pi/amd/00670F00/FT4/AGESA_postmem.elf" if SOC_AMD_STONEYRIDGE && USE_AMD_BLOBS
	help
	  Specify the binary file to use for post-memory AMD platform
	  initialization.

config AGESA_CBFS_NAME
	string
	default "AGESA"

config AGESA_PRE_MEMORY_CBFS_NAME
	string
	default "AGESA_PRE_MEM"

config AGESA_POST_MEMORY_CBFS_NAME
	string
	default "AGESA_POST_MEM"

config AGESA_BINARY_PI_LOCATION
	hex "AGESA PI binary address in ROM"
	default 0xFFE00000
	depends on !AGESA_BINARY_PI_AS_STAGE
	help
	  Specify the ROM address at which to store the binary Platform
	  Initialization code.

endif
```

## src/vendorcode/cavium/Kconfig
```kconfig
##
## This file is part of the coreboot project.
##
## Copyright 2017-present Facebook, Inc.
##
## This program is free software; you can redistribute it and/or modify
## it under the terms of the GNU General Public License as published by
## the Free Software Foundation; version 2 of the License.
##
## This program is distributed in the hope that it will be useful,
## but WITHOUT ANY WARRANTY; without even the implied warranty of
## MERCHANTABILITY or FITNESS FOR A PARTICULAR PURPOSE.  See the
## GNU General Public License for more details.
##

config CAVIUM_BDK
	def_bool n
	select HAVE_DEBUG_RAM_SETUP
	help
	  Build Cavium's BDK in romstage.

if CAVIUM_BDK

menu "BDK"

config CAVIUM_BDK_VERBOSE_INIT
	bool "Enable verbose init"
	depends on CAVIUM_BDK
	help
	  Build Cavium's BDK with verbose init code.

config CAVIUM_BDK_VERBOSE_DRAM
	bool "Enable verbose dram init"
	default y if DEBUG_RAM_SETUP
	depends on CAVIUM_BDK
	help
	  Build Cavium's BDK with verbose dram init code.

config CAVIUM_BDK_VERBOSE_DRAM_TEST
	bool "Enable verbose raminit tests"
	depends on CAVIUM_BDK
	help
	  Build Cavium's BDK with verbose DRAM testing code.

config CAVIUM_BDK_VERBOSE_QLM
	bool "Enable verbose qlm init"
	depends on CAVIUM_BDK
	help
	  Build Cavium's BDK with verbose QLM code.

config CAVIUM_BDK_VERBOSE_PCIE_CONFIG
	bool "Enable verbose pcie config"
	depends on CAVIUM_BDK
	help
	  Build Cavium's BDK with verbose PCIe config code.

config CAVIUM_BDK_VERBOSE_PCIE
	bool "Enable verbose pcie init"
	depends on CAVIUM_BDK
	help
	  Build Cavium's BDK with verbose PCIe code.

config CAVIUM_BDK_VERBOSE_PHY
	bool "Enable verbose phy init"
	depends on CAVIUM_BDK
	help
	  Build Cavium's BDK with verbose PHY code.

config CAVIUM_BDK_DDR_TUNE_HW_OFFSETS
	bool "Hardware assisted DLL read offset tuning"
	default n
	depends on CAVIUM_BDK

	help
	  Automatically tune the data byte DLL read offsets.
	  Always done by default, but allow use of HW-assist.
	  NOTE: HW-assist will also tune the ECC byte.

config CAVIUM_BDK_DDR_TUNE_WRITE_OFFSETS
	bool "Automatically tune the data byte DLL write offsets"
	default n
	depends on CAVIUM_BDK

config CAVIUM_BDK_DDR_TUNE_ECC_ENABLE
	bool "Automatically tune the ECC byte DLL read offsets"
	default n
	depends on CAVIUM_BDK

endmenu

endif
```

## src/vendorcode/eltan/security/Kconfig
```kconfig
## SPDX-License-Identifier: GPL-2.0-only

config USE_VENDORCODE_ELTAN
	bool

if USE_VENDORCODE_ELTAN

menu "Eltan Security Settings"

source "src/vendorcode/eltan/security/mboot/Kconfig"
source "src/vendorcode/eltan/security/verified_boot/Kconfig"

endmenu

endif
```

## src/vendorcode/eltan/security/mboot/Kconfig
```kconfig
## SPDX-License-Identifier: GPL-2.0-only

menu "Measured Boot (mboot)"

config VENDORCODE_ELTAN_MBOOT
	bool "Measure firmware with mboot."
	default n
	select VBOOT_LIB
	help
	  Enabling MBOOT will use mboot to measure the components of the firmware
	  (stages, payload, etc).

if VENDORCODE_ELTAN_MBOOT

config VENDORCODE_ELTAN_CRTM_VERSION_STRING
	string "default CRTM version"
	default "default CRTM version"

endif # VENDORCODE_ELTAN_MBOOT
endmenu # Measured Boot (mboot)
```

## src/vendorcode/eltan/security/verified_boot/Kconfig
```kconfig
## SPDX-License-Identifier: GPL-2.0-only

menu "Verified Boot (verified_boot)"

config VENDORCODE_ELTAN_VBOOT
	bool "Enable Verified Boot"
	depends on !VBOOT
	default n
	select VBOOT_LIB

if VENDORCODE_ELTAN_VBOOT

config VENDORCODE_ELTAN_VBOOT_SIGNED_MANIFEST
	bool "Enable Signed Manifest"
	depends on VENDORCODE_ELTAN_VBOOT
	default n

config VENDORCODE_ELTAN_VBOOT_USE_SHA512
	bool "SHA512 hashes"
	depends on VENDORCODE_ELTAN_VBOOT
	default n
	help
	  Use SHA512 for the vboot operations, this applies to the digest in
	  the manifest and the manifest digest.

config VENDORCODE_ELTAN_OEM_MANIFEST_LOC
	hex "Manifest Location"
	default 0xFFFFF840

config VENDORCODE_ELTAN_VBOOT_MANIFEST
	string "Verified boot manifest file"
	default "mainboard/\$(MAINBOARD_DIR)/manifest.h"

config VENDORCODE_ELTAN_OEM_MANIFEST_ITEMS
	int "Manifest Items"
	default 12

config VENDORCODE_ELTAN_OEM_MANIFEST_ITEM_SIZE
	int
	default 64 if VENDORCODE_ELTAN_VBOOT_USE_SHA512
	default 32

config VENDORCODE_ELTAN_VBOOT_KEY_LOCATION
	hex "Verified boot Key Location"
	depends on VENDORCODE_ELTAN_VBOOT_SIGNED_MANIFEST
	default 0xFFFFF500

config VENDORCODE_ELTAN_VBOOT_KEY_FILE
	string "Verified boot Key File"
	depends on VENDORCODE_ELTAN_VBOOT_SIGNED_MANIFEST
	default "3rdparty/eltan/verified_boot/Keys/key.vbpubk"

config VENDORCODE_ELTAN_VBOOT_KEY_SIZE
	int
	default 552

endif # VENDORCODE_ELTAN_VBOOT
endmenu # Verified Boot (verified_boot)
```

## src/vendorcode/google/Kconfig
```kconfig
## SPDX-License-Identifier: GPL-2.0-only

source "src/vendorcode/google/chromeos/Kconfig"

config GOOGLE_SMBIOS_MAINBOARD_VERSION
	bool
	default n
	depends on GENERATE_SMBIOS_TABLES
	help
	  Provide a common implementation for mainboard version,
	  which returns a formatted 'rev%d' board_id() string.

config GOOGLE_DSM_CALIB
	bool
	default n
	depends on VPD
	help
	  On some boards, there are calibrated parameters for Dynamic Speaker Management(DSM)
	  stored in VPD. Enable this config to read and parse these VPD values and write them
	  to ACPI DSD table in device driver. These parameters will be applied by kernel driver
	  through device property at boot.

config GOOGLE_DSM_PARAM_FILE_NAME
	bool
	default n
	depends on GOOGLE_DSM_CALIB
	help
	  On some boards, there are different dsm parameter files for Dynamic Speaker
	  Management (DSM). Enable this config to assign dsm parameters file name in ACPI
	  SSDT table. Kernel driver uses this to load the DSM parameter file.

config MAINBOARD_HAS_GOOGLE_STRAUSS_KEYBOARD
	bool
	default n
	help
	  Select this config to indicate that a board has Strauss keyboard.

config ACPI_FNKEY_GEN_SCANCODE
	default 94 if MAINBOARD_HAS_GOOGLE_STRAUSS_KEYBOARD
```
