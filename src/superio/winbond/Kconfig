## src/superio/winbond/Kconfig
```kconfig
##
## This file is part of the coreboot project.
##
## Copyright (C) 2009 Ronald G. Minnich
## Copyright (C) 2014 Edward O'Callaghan <eocallaghan@alterapraxis.com>
##
## This program is free software; you can redistribute it and/or modify
## it under the terms of the GNU General Public License as published by
## the Free Software Foundation; version 2 of the License.
##
## This program is distributed in the hope that it will be useful,
## but WITHOUT ANY WARRANTY; without even the implied warranty of
## MERCHANTABILITY or FITNESS FOR A PARTICULAR PURPOSE.  See the
## GNU General Public License for more details.
##
## You should have received a copy of the GNU General Public License
## along with this program; if not, write to the Free Software
## Foundation, Inc., 51 Franklin St, Fifth Floor, Boston, MA 02110-1301 USA
##

# Generic Winbond romstage driver - Just enough UART initialisation code for
# romstage.
config SUPERIO_WINBOND_COMMON_ROMSTAGE
	bool

config SUPERIO_WINBOND_W83627DHG
	bool
	select SUPERIO_WINBOND_COMMON_ROMSTAGE

config SUPERIO_WINBOND_W83627EHG
	bool
	select SUPERIO_WINBOND_COMMON_ROMSTAGE

config SUPERIO_WINBOND_W83627HF
	bool
	select SUPERIO_WINBOND_COMMON_ROMSTAGE

config SUPERIO_WINBOND_W83627THG
	bool
	select SUPERIO_WINBOND_COMMON_ROMSTAGE

config SUPERIO_WINBOND_W83627UHG
	bool
	select SUPERIO_WINBOND_COMMON_ROMSTAGE

config SUPERIO_WINBOND_W83697HF
	bool
	select SUPERIO_WINBOND_COMMON_ROMSTAGE

config SUPERIO_WINBOND_W83977TF
	bool
	select SUPERIO_WINBOND_COMMON_ROMSTAGE
```

## src/superio/winbond/common/Kconfig
```kconfig
# SPDX-License-Identifier: GPL-2.0-only

# Generic Winbond romstage driver - Just enough UART initialisation code for
# romstage.
config SUPERIO_WINBOND_COMMON_PRE_RAM
	bool
```

## src/superio/winbond/w83627ehg/Kconfig
```kconfig
# SPDX-License-Identifier: GPL-2.0-only
# This file is part of the coreboot project.

config SUPERIO_WINBOND_W83627EHG
	bool
	select SUPERIO_WINBOND_COMMON_PRE_RAM
```

## src/superio/winbond/w83627thg/Kconfig
```kconfig
# SPDX-License-Identifier: GPL-2.0-only

config SUPERIO_WINBOND_W83627THG
	bool
	select SUPERIO_WINBOND_COMMON_PRE_RAM
```

## src/superio/winbond/w83627uhg/Kconfig
```kconfig
# SPDX-License-Identifier: GPL-2.0-only
# This file is part of the coreboot project.

config SUPERIO_WINBOND_W83627UHG
	bool
	select SUPERIO_WINBOND_COMMON_PRE_RAM
```

## src/superio/winbond/w83667hg-a/Kconfig
```kconfig
# SPDX-License-Identifier: GPL-2.0-only
# This file is part of the coreboot project.

config SUPERIO_WINBOND_W83667HG_A
	bool
	select SUPERIO_WINBOND_COMMON_PRE_RAM
	select HAVE_POWER_STATE_AFTER_FAILURE
	select HAVE_POWER_STATE_PREVIOUS_AFTER_FAILURE
```

## src/superio/winbond/w83977tf/Kconfig
```kconfig
# SPDX-License-Identifier: GPL-2.0-only

config SUPERIO_WINBOND_W83977TF
	bool
	select SUPERIO_WINBOND_COMMON_PRE_RAM

config W83977TF_HAVE_SEPARATE_IR_DEVICE
	bool
	help
	  Mainboard should select this option if it contains an old
	  version of W83977TF with a separate IR logical device.
```

## src/superio/winbond/wpcd376i/Kconfig
```kconfig
# SPDX-License-Identifier: GPL-2.0-only

config SUPERIO_WINBOND_WPCD376I
	bool
	select SUPERIO_WINBOND_COMMON_PRE_RAM
```

## src/vboot/Kconfig
```kconfig
## This file is part of the coreboot project.
##
## Copyright (C) 2014 The ChromiumOS Authors.  All rights reserved.
##
## This program is free software; you can redistribute it and/or modify
## it under the terms of the GNU General Public License as published by
## the Free Software Foundation; version 2 of the License.
##
## This program is distributed in the hope that it will be useful,
## but WITHOUT ANY WARRANTY; without even the implied warranty of
## MERCHANTABILITY or FITNESS FOR A PARTICULAR PURPOSE.  See the
## GNU General Public License for more details.
##

config VBOOT_VBNV_OFFSET
	hex
	default 0x26
	depends on PC80_SYSTEM
	help
	  CMOS offset for VbNv data. This value must match cmos.layout
	  in the mainboard directory, minus 14 bytes for the RTC.

config VBOOT_VBNV_CMOS
	bool "Vboot non-volatile storage in CMOS."
	default n
	help
	  VBNV is stored in CMOS

config VBOOT_VBNV_CMOS_BACKUP_TO_FLASH
	bool "Back up Vboot non-volatile storage from CMOS to flash."
	default n
	depends on VBOOT_VBNV_CMOS && BOOT_DEVICE_SUPPORTS_WRITES
	help
	  Vboot non-volatile storage data will be backed up from CMOS to flash
	  and restored from flash if the CMOS is invalid due to power loss.

config VBOOT_VBNV_EC
	bool "Vboot non-volatile storage in EC."
	default n
	help
	  VBNV is stored in EC

config VBOOT_VBNV_FLASH
	def_bool n
	depends on BOOT_DEVICE_SUPPORTS_WRITES
	help
	  VBNV is stored in flash storage

config VBOOT_STARTS_IN_BOOTBLOCK
	bool "Vboot starts verifying in bootblock"
	default n
	depends on VBOOT
	help
	  Firmware verification happens during or at the end of bootblock.

config VBOOT_STARTS_IN_ROMSTAGE
	bool "Vboot starts verifying in romstage"
	default n
	depends on VBOOT && !VBOOT_STARTS_IN_BOOTBLOCK
	help
	  Firmware verification happens during or at the end of romstage.

config VBOOT_MOCK_SECDATA
	bool "Mock secdata for firmware verification"
	default n
	depends on VBOOT
	help
	  Enabling VBOOT_MOCK_SECDATA will mock secdata for the firmware
	  verification to avoid access to a secdata storage (typically TPM).
	  All operations for a secdata storage will be successful. This option
	  can be used during development when a TPM is not present or broken.
	  THIS SHOULD NOT BE LEFT ON FOR PRODUCTION DEVICES.

config VBOOT_DISABLE_DEV_ON_RECOVERY
	bool "Disable dev mode on recovery requests"
	default n
	depends on VBOOT
	help
	  When this option is enabled, the Chrome OS device leaves the
	  developer mode as soon as recovery request is detected. This is
	  handy on embedded devices with limited input capabilities.

config SEPARATE_VERSTAGE
	bool "Vboot verification is built into a separate stage"
	default n
	depends on VBOOT && VBOOT_STARTS_IN_BOOTBLOCK
	help
	  If this option is set, vboot verification runs in a standalone stage
	  that is loaded from the bootblock and exits into romstage. If it is
	  not set, the verification code is linked directly into the bootblock
	  or the romstage and runs as part of that stage (cf. related options
	  VBOOT_STARTS_IN_BOOTBLOCK/_ROMSTAGE and RETURN_FROM_VERSTAGE).

config RETURN_FROM_VERSTAGE
	bool "The separate verification stage returns to its caller"
	default n
	depends on SEPARATE_VERSTAGE
	help
	  If this is set, the verstage returns back to the calling stage instead
	  of exiting to the succeeding stage so that the verstage space can be
	  reused by the succeeding stage. This is useful if a RAM space is too
	  small to fit both the verstage and the succeeding stage.

config VBOOT_SAVE_RECOVERY_REASON_ON_REBOOT
	bool
	default n
	depends on VBOOT
	help
	  This option ensures that the recovery request is not lost because of
	  reboots caused after vboot verification is run. e.g. reboots caused by
	  FSP components on Intel platforms.

config VBOOT_OPROM_MATTERS
	bool "Video option ROM matters (= can skip display init)"
	default n
	depends on VBOOT
	help
	  Set this option to indicate to vboot that this platform will skip its
	  display initialization on a normal (non-recovery, non-developer) boot.
	  Vboot calls this "oprom matters" because on x86 devices this
	  traditionally meant that the video option ROM will not be loaded, but
	  it works functionally the same for other platforms that can skip their
	  native display initialization code instead.

config VBOOT_HAS_REC_HASH_SPACE
	bool
	default n
	depends on VBOOT
	help
	  Set this option to indicate to vboot that recovery data hash space
	  is present in TPM.

config VBOOT_SOFT_REBOOT_WORKAROUND
	bool
	default n

config VBOOT
	bool "Verify firmware with vboot."
	default n
	select TPM if !MAINBOARD_HAS_TPM2
	select TPM2 if MAINBOARD_HAS_TPM2
	select TPM_INIT_FAILURE_IS_FATAL if PC80_SYSTEM && LPC_TPM
	select SKIP_TPM_STARTUP_ON_NORMAL_BOOT if PC80_SYSTEM && LPC_TPM
	depends on HAVE_HARD_RESET
	help
	  Enabling VBOOT will use vboot to verify the components of the firmware
	  (stages, payload, etc).
```

## src/vendorcode/Kconfig
```kconfig
source src/vendorcode/amd/Kconfig
source src/vendorcode/google/Kconfig
source src/vendorcode/intel/Kconfig
```

## src/vendorcode/amd/Kconfig
```kconfig
# SPDX-License-Identifier: GPL-2.0-only

if CPU_AMD_PI || SOC_AMD_PI

menu "AMD Platform Initialization"

source "src/vendorcode/amd/pi/Kconfig"

config AGESA_EXTRA_TIMESTAMPS
	bool "Add instrumentation for AGESA calls"
	default n
	depends on DRIVERS_AMD_PI
	help
	  Insert additional timestamps around each entrypoint into
	  AGESA vendorcode.

endmenu

endif
```

## src/vendorcode/amd/agesa/Kconfig
```kconfig
# SPDX-License-Identifier: GPL-2.0-only

config IDS_OPTIONS_HOOKED_UP
	bool
	help
	  to Kconfig options.
	  Historically, IDS configuration was defined in a mainboard-specific
	  `OptionsIds.h` header. Select this on platforms where IDS config is
	  hooked up to Kconfig options instead.

if IDS_OPTIONS_HOOKED_UP

config IDS_ENABLED
	bool "Enable AGESA IDS (Integrated Debug Services) support"
	default y
	help
	  This is the master switch for the IDS sub-system. Use this option to
	  enable or remove the entire IDS feature set. This switch must be TRUE
	  for any of the other options to function.

comment "Warning: IDS options may not work. Enable at your own risk!"
	depends on IDS_ENABLED

config IDS_CONTROL_ENABLED
	bool "Enable IDS User Interface controls"
	depends on IDS_ENABLED
	help
	  This is the main switch for the IDS configuration controls. This
	  switch must be TRUE for any of the configuration controls to function.

	  This seems to allow AGESA to retrieve settings from CMOS.

config IDS_PERF_ANALYSIS
	bool "Enable IDS performance analysis"
	depends on IDS_ENABLED
	help
	  This is the main switch for the IDS performance analysis controls,
	  macros and support code needed to enable time data gathering. This
	  switch must be TRUE for any of the performance analysis features to
	  function.

config IDS_TRACING_ENABLED
	bool "Enable IDS console"
	depends on IDS_ENABLED
	help
	  This is the main switch for the IDS console controls, macros and
	  support code needed to enable tracing of algorithms. This switch
	  must be TRUE for any of the tracing features to function.

config IDS_TRACING_CONSOLE_SERIAL
	bool "Use serial port as IDS console"
	depends on IDS_TRACING_ENABLED
	default DRIVERS_UART_8250IO && CONSOLE_SERIAL
	help
	  Use an I/O-mapped serial port to output IDS messages.

endif # IDS_OPTIONS_HOOKED_UP

choice
	prompt "DDR3 memory profile"
	default CPU_AMD_AGESA_OPENSOURCE_MEM_JEDEC
	help
	  Choose the DDR3 memory profile to use for your RAM sticks, e.g. XMP 1.
	  XMP support is experimental, and your PC will fail booting if you choose
	  a profile which does not exist on ANY of your RAM sticks! If in doubt
	  check their SPD Data using a coreboot's great fork of memtest86+ 5.01.

config CPU_AMD_AGESA_OPENSOURCE_MEM_JEDEC
	bool "JEDEC"
	help
	  JEDEC memory profile, standard and stable. Is guaranteed to be working.

config CPU_AMD_AGESA_OPENSOURCE_MEM_XMP_1
	bool "XMP 1"
	help
	  XMP 1 memory profile. Check that it exists on ALL of your RAM sticks!

config CPU_AMD_AGESA_OPENSOURCE_MEM_XMP_2
	bool "XMP 2"
	help
	  XMP 2 memory profile. Check that it exists on ALL of your RAM sticks!

config CPU_AMD_AGESA_OPENSOURCE_MEM_CUSTOM
	bool "CUSTOM"
	help
	  Custom memory profile. Use the XMP SPD values as the base, if available.

endchoice

if CPU_AMD_AGESA_OPENSOURCE_MEM_CUSTOM

config CUSTOM_SPD_DIVIDENT
	int "[10]: Medium Timebase (MTB) Dividend"
	default 1
	range 1 255

config CUSTOM_SPD_DIVISOR
	int "[11]: Medium Timebase (MTB) Divisor"
	default 14
	range 1 255

config CUSTOM_SPD_TCK
	int "[12]: SDRAM Minimum Cycle Time, tCK"
	default 15
	range 1 255

config CUSTOM_SPD_CASLO
	int "[14]: CAS Latencies Supported, Lower Byte"
	default 124
	range 0 255

config CUSTOM_SPD_CASHI
	int "[15]: CAS Latencies Supported, Higher Byte"
	default 0
	range 0 255

config CUSTOM_SPD_TAA
	int "[16]: Min CAS Latency Time, tAA"
	default 132
	range 1 255

config CUSTOM_SPD_TWR
	int "[17]: Min Write Recovery Time, tWR"
	default 210
	range 1 255

config CUSTOM_SPD_TRCD
	int "[18]: Min RAS# to CAS# Delay Time, tRCD"
	default 132
	range 1 255

config CUSTOM_SPD_TRRD
	int "[19]: Min Row Active to Row Active Delay Time, tRRD"
	default 84
	range 1 255

config CUSTOM_SPD_TRP
	int "[20]: Min Row Precharge Delay Time, tRP"
	default 132
	range 1 255

config CUSTOM_SPD_UPPER_TRC
	int "[21][7:4]: Min Active to Active/Refresh Delay, UPPER tRC"
	default 2
	range 0 16

config CUSTOM_SPD_UPPER_TRAS
	int "[21][3:0]: Min Active to Precharge Delay Time, UPPER tRAS"
	default 1
	range 0 16

config CUSTOM_SPD_TRAS
	int "[22]: Min Active to Precharge Delay Time, LOWER tRAS"
	default 138
	range 1 255

config CUSTOM_SPD_TRC
	int "[23]: Min Active to Active/Refresh Delay, LOWER tRC"
	default 181
	range 1 255

config CUSTOM_SPD_TWTR
	int "[26]: Min Internal Write to Read Command Delay, tWTR"
	default 105
	range 1 255

config CUSTOM_SPD_TRTP
	int "[27]: Min Internal Read to Precharge Command Delay, tRTP"
	default 105
	range 1 255

config CUSTOM_SPD_UPPER_TFAW
	int "[28][3:0]: Min Four Activate Window Delay, UPPER tFAW"
	default 1
	range 0 16

config CUSTOM_SPD_TFAW
	int "[29]: Min Four Activate Window Delay Time, tFAW"
	default 164
	range 1 255

endif
```

## src/vendorcode/amd/opensil/Kconfig
```kconfig
## SPDX-License-Identifier: GPL-2.0-only

if SOC_AMD_OPENSIL

config SOC_AMD_OPENSIL_STUB
	bool
	help
	  Select this option to include the openSIL stub in the build that can
	  be used for build-testing before the actual openSIL source code for a
	  SoC is released.

config SOC_AMD_OPENSIL_GENOA_POC
	bool
	help
	  Select this on SoCs that use the Genoa proof of concept version of
	  openSIL.

config AMD_OPENSIL_PATH
	string "Path to openSIL source"
	depends on !SOC_AMD_OPENSIL_STUB
	default "$(top)/src/vendorcode/amd/opensil/genoa_poc/opensil" if SOC_AMD_OPENSIL_GENOA_POC
	help
	  Set to the path of the openSIL directory containing meson.build.
	  example

config AMD_OPENSIL_MPIO_CHIP_H_FILE
	string "Location of specific MPIO chip.h implementation"
	default "$(top)/src/vendorcode/amd/opensil/genoa_poc/mpio/chip.h" if SOC_AMD_OPENSIL_GENOA_POC
	default "$(top)/src/vendorcode/amd/opensil/stub/mpio/chip.h"
	help
	  Set to the location of the MPIO chip.h in the selected openSIL
	  implementation, so that the common MPIO chip.h file can include the
	  specific one.

endif
```
