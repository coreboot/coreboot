## src/vendorcode/google/chromeos/Kconfig
```kconfig
## SPDX-License-Identifier: GPL-2.0-only

config MAINBOARD_HAS_CHROMEOS
	def_bool n

menu "ChromeOS"
	depends on MAINBOARD_HAS_CHROMEOS

config CHROMEOS
	bool "Build for ChromeOS"
	default n
	select ELOG if BOOT_DEVICE_SUPPORTS_WRITES
	select COLLECT_TIMESTAMPS
	select VBOOT
	select CHROMEOS_NVS if ACPI_SOC_NVS
	select VPD
	select VBOOT_SLOTS_RW_AB
	help
	  Enable ChromeOS specific features like the GPIO sub table in
	  the coreboot table. NOTE: Enabling this option on an unsupported
	  board will most likely break your build.

if CHROMEOS

config CHROMEOS_RAMOOPS
	bool "Reserve space for ChromeOS ramoops"
	default y

config CHROMEOS_RAMOOPS_RAM_SIZE
	hex "Size of preserved RAM"
	default 0x00100000
	depends on CHROMEOS_RAMOOPS

config HAVE_REGULATORY_DOMAIN
	bool "Add regulatory domain methods"
	default n
	help
	 This option is needed to add ACPI regulatory domain methods

config CHROMEOS_DISABLE_PLATFORM_HIERARCHY_ON_RESUME
	bool
	default y
	depends on TPM2 && RESUME_PATH_SAME_AS_BOOT
	help
	  Disable the platform hierarchy on resume path if the firmware
	  is involved in resume. The hierarchy is disabled prior to jumping
	  to the OS.  Note that this option is sepcific to TPM2 boards.
	  This option is auto selected if CHROMEOS because it matches with
	  vboot_reference model which disables the platform hierarchy in
	  the boot loader. However, those operations need to be symmetric
	  on normal boot as well as resume and coreboot is only involved
	  in the resume piece w.r.t. the platform hierarchy.

config CHROMEOS_USE_EC_WATCHDOG_FLAG
	bool
	default n
	help
	  Use the AP watchdog flag stored in EC.

config CHROMEOS_CSE_BOARD_RESET_OVERRIDE
	bool
	default n
	depends on SOC_INTEL_CSE_LITE_SKU
	help
	  On some boards that run old firmware version in cr50, Embedded Controller (EC) needs
	  to trigger the cold reset of Application Processor (AP) when CSE jumps from RO to RW
	  so that cr50 resets the TPM state. This is required on boards where the cr50 firmware
	  does not understand the new cr50 strap config (applicable only to boards using strap
	  config 0xe). Enabling this config will help to override the default global reset.

config CHROMEOS_DRAM_PART_NUMBER_IN_CBI
	def_bool n
	depends on EC_GOOGLE_CHROMEEC
	help
	  Some boards declare the DRAM part number in the CBI instead of the SPD.  This option
	  allows those boards to declare that their DRAM part number is stored in the CBI.

config CHROMEOS_NVS
	bool
	depends on ACPI_SOC_NVS

config CHROMEOS_FW_SPLASH_SCREEN
	bool "Display Splash Screen in firmware"
	default n
	select BMP_LOGO
	select HAVE_CUSTOM_BMP_LOGO
	help
	  Select this option to display the manufacturer's logo or
	  custom image (OEM splash screen) early in the boot process.
	  This can enhance the user experience by providing visual
	  feedback while the system starts up. For example, ChromeOS
	  devices use this option to show their logo before the operating
	  system loads.

config CHROMEOS_LOGO_PATH
	string "Path to ChromeOS logo file"
	depends on CHROMEOS_FW_SPLASH_SCREEN
	default "3rdparty/blobs/mainboard/\$(MAINBOARDDIR)/logo.bmp"

config CHROMEBOOK_PLUS_LOGO_PATH
	string "Path to Chromebook Plus logo file"
	depends on CHROMEOS_FW_SPLASH_SCREEN
	default "3rdparty/blobs/mainboard/\$(MAINBOARDDIR)/logo.bmp"

config CHROMEOS_ENABLE_ESOL
	def_bool FSP_UGOP_EARLY_SIGN_OF_LIFE || MAINBOARD_HAS_EARLY_LIBGFXINIT
	help
	  Early sign-of-life (eSOL) provides an early boot notification during
	  critical firmware updates on Chrome OS devices, particularly for
	  updates requiring a restart (e.g., CSE and FSP).

	  eSOL Implementation Options:

	  - FSP uGOP: Closed-source solution from Intel's Firmware Support
	  Package.
	  - libgfxinit: Open-source graphics initialization library.

	  Platforms before Intel Meteor Lake are expected to use the libgfxinit.

	  Devices from Intel Meteor Lake onwards will utilize the Intel FSP
	  uGOP driver for eSOL.

	  If your platform supports eSOL, enable it by selecting the
	  appropriate option.

endif # CHROMEOS
endmenu
```

## src/vendorcode/google/chromeos/vboot1/Kconfig
```kconfig
## This file is part of the coreboot project.
##
## Copyright (C) 2014 The ChromiumOS Authors.  All rights reserved.
##
## This program is free software; you can redistribute it and/or modify
## it under the terms of the GNU General Public License as published by
## the Free Software Foundation; version 2 of the License.
##
## This program is distributed in the hope that it will be useful,
## but WITHOUT ANY WARRANTY; without even the implied warranty of
## MERCHANTABILITY or FITNESS FOR A PARTICULAR PURPOSE.  See the
## GNU General Public License for more details.
##
## You should have received a copy of the GNU General Public License
## along with this program; if not, write to the Free Software
## Foundation, Inc., 51 Franklin St, Fifth Floor, Boston, MA 02110-1301 USA
##

config VBOOT_VERIFY_FIRMWARE
	bool "Verify firmware with vboot."
	default n
	depends on CHROMEOS
	select RELOCATABLE_MODULES
	help
	  Enabling VBOOT_VERIFY_FIRMWARE will use vboot to verify the ramstage
	  and boot loader.

config VBOOT_REFCODE_INDEX
	hex "Reference code firmware index"
	default 1
	depends on VBOOT_VERIFY_FIRMWARE
	help
	  This is the index of the reference code component in the verified
	  firmware block.
```

## src/vendorcode/google/chromeos/vboot2/Kconfig
```kconfig
## This file is part of the coreboot project.
##
## Copyright (C) 2014 The ChromiumOS Authors.  All rights reserved.
##
## This program is free software; you can redistribute it and/or modify
## it under the terms of the GNU General Public License as published by
## the Free Software Foundation; version 2 of the License.
##
## This program is distributed in the hope that it will be useful,
## but WITHOUT ANY WARRANTY; without even the implied warranty of
## MERCHANTABILITY or FITNESS FOR A PARTICULAR PURPOSE.  See the
## GNU General Public License for more details.
##

config VBOOT_STARTS_IN_BOOTBLOCK
	bool "Vboot starts verifying in bootblock"
	default n
	depends on VBOOT_VERIFY_FIRMWARE
	help
	  Firmware verification happens during or at the end of bootblock.

config VBOOT_STARTS_IN_ROMSTAGE
	bool "Vboot starts verifying in romstage"
	default n
	depends on VBOOT_VERIFY_FIRMWARE && !VBOOT_STARTS_IN_BOOTBLOCK
	help
	  Firmware verification happens during or at the end of romstage.

config VBOOT2_MOCK_SECDATA
	bool "Mock secdata for firmware verification"
	default n
	depends on VBOOT_VERIFY_FIRMWARE
	help
	  Enabling VBOOT2_MOCK_SECDATA will mock secdata for the firmware
	  verification to avoid access to a secdata storage (typically TPM).
	  All operations for a secdata storage will be successful. This option
	  can be used during development when a TPM is not present or broken.
	  THIS SHOULD NOT BE LEFT ON FOR PRODUCTION DEVICES.

config VBOOT_DISABLE_DEV_ON_RECOVERY
	bool "Disable dev mode on recovery requests"
	default n
	depends on VBOOT_VERIFY_FIRMWARE
	help
	  When this option is enabled, the Chrome OS device leaves the
	  developer mode as soon as recovery request is detected. This is
	  handy on embedded devices with limited input capabilities.

config SEPARATE_VERSTAGE
	bool "Vboot verification is built into a separate stage"
	default n
	depends on VBOOT_VERIFY_FIRMWARE

config RETURN_FROM_VERSTAGE
	bool "The separate verification stage returns to its caller"
	default n
	depends on SEPARATE_VERSTAGE
	help
	  If this is set, the verstage returns back to the calling stage instead
	  of exiting to the succeeding stage so that the verstage space can be
	  reused by the succeeding stage. This is useful if a ram space is too
	  small to fit both the verstage and the succeeding stage.

config CHIPSET_PROVIDES_VERSTAGE_MAIN_SYMBOL
	bool "The chipset provides the main() entry point for verstage"
	default n
	depends on SEPARATE_VERSTAGE
	help
	  The chipset code provides their own main() entry point.

config VBOOT_DYNAMIC_WORK_BUFFER
	bool "Vboot's work buffer is dynamically allocated."
	default y if ARCH_ROMSTAGE_X86_32 && !SEPARATE_VERSTAGE
	default n
	depends on VBOOT_VERIFY_FIRMWARE
	help
	  This option is used when there isn't enough pre-main memory
	  ram to allocate the vboot work buffer. That means vboot verification
	  is after memory init and requires main memory to back the work
	  buffer.
```

## src/vendorcode/intel/Kconfig
```kconfig
## SPDX-License-Identifier: GPL-2.0-only

config UDK_BASE
	def_bool n

config UEFI_2_4_BINDING
	def_bool n
	select UDK_BASE

config UDK_2017_BINDING
	def_bool n
	select UDK_BASE

config UDK_202005_BINDING
	def_bool n
	select UDK_BASE

config UDK_202111_BINDING
	def_bool n
	select UDK_BASE

if UDK_BASE
config UDK_2013_VERSION
	int
	default 2013

config UDK_2017_VERSION
	int
	default 2017

config UDK_202005_VERSION
	int
	default 202005

config UDK_202111_VERSION
	int
	default 202111

config UDK_VERSION
	int
	default UDK_202111_VERSION if UDK_202111_BINDING
	default UDK_202005_VERSION if UDK_202005_BINDING
	default UDK_2017_VERSION if UDK_2017_BINDING
	default UDK_2013_VERSION
	help
	  UEFI Development Kit version for Platform
endif # UDK_BASE
```

## src/vendorcode/siemens/Kconfig
```kconfig
## SPDX-License-Identifier: GPL-2.0-only

config USE_SIEMENS_HWILIB
	bool
	default n
```
