d.a 0x80000000 mov x0,#0x8c
d.a 0x80000004 lsl x0, x0, #0x14
d.a 0x80000008 mov x1,#0x18
d.a 0x8000000c lsl x1,x1, #0x10
d.a 0x80000010 mov x2,#0x0
d.a 0x80000014 mov x3,#0x80
d.a 0x80000018 lsl x3, x3, #0x18
d.a 0x8000001c add x3, x3, #0x14
d.a 0x80000020 str x2,[x0]
d.a 0x80000024 sub x1, x1, #0x8
d.a 0x80000028 add x0, x0, #0x8
d.a 0x8000002c cmp x1,0x0
d.a 0x80000030 b.ne 0x20
d.a 0x80000034 b 0x34
r.s pc 0x80000000
go
