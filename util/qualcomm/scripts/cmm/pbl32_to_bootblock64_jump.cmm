PER.Set.simple SPR:0x36100 %Long 00c5183C
D.S AZSD:0x8600034 %LE %Long 0x8600000
D.S AZSD:0x8600000 %LE %Long 0x1400000
d.a 0x8600004 ldr r0,0x8600034
d.a 0x8600008 mcr p15,0x0,r0,c12,c0,1
d.a 0x860000c dsb
d.a 0x8600010 isb
d.a 0x8600014 mrc p15,0x0,r1,c12,c0,2
d.a 0x8600018 orr r1,r1,0x3
d.a 0x860001c mcr p15,0x0,r1,c12,c0,2
d.a 0x8600020 isb
d.a 0x8600024 wfi
r.s pc 0x8600004
go
b
